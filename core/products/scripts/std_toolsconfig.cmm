//============================================================================
//  Name:                                                                     
//    std_toolsconfig.cmm 
//
//  Description:                                                              
//    None 
//                                                                            
// Copyright (c) 2015 by QUALCOMM, Incorporated.  All Rights Reserved.        
//============================================================================
//                                                                            
// *** AUTO GENERATED FILE - DO NOT EDIT                                      
//                                                                            
// GENERATED: Tue Mar 17 21:55:08 2015 
//============================================================================


GLOBAL &ADSP_ABS_BUILD_ROOT
GLOBAL &ADSP_BUILD_ROOT
GLOBAL &ADSP_CBSP_ROOT
GLOBAL &CHIPSET
GLOBAL &ADSP_SCRIPTSDIR
GLOBAL &ADSP_BUILDMSDIR



&ADSP_ABS_BUILD_ROOT="Z:/b/adsp_proc"
&ADSP_BUILD_ROOT=os.ppd()+"/../../.."
&ADSP_CBSP_ROOT=os.ppd()+"/../.."
&CHIPSET="8974"
&ADSP_SCRIPTSDIR=os.ppd()+"/../../products"
&ADSP_BUILDMSDIR=os.ppd()+"/../../../core_libs/build/ms"


ENDDO