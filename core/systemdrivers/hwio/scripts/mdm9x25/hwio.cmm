y.create.l HWIO_BIMC_HW_VERSION_ADDR A:0xfc380000
y.create.l HWIO_BIMC_CORE_INFO_ADDR A:0xfc380004
y.create.l HWIO_BIMC_HW_INFO_ADDR A:0xfc380008
y.create.l HWIO_BIMC_CORE_CLK_SEL_ADDR A:0xfc380020
y.create.l HWIO_BIMC_CORE_CLK_PERIOD_ADDR A:0xfc380024
y.create.l HWIO_BIMC_SCMO0_LOCAL_CGC_THRESHOLD_ADDR A:0xfc380100
y.create.l HWIO_BIMC_DPE0_LOCAL_CGC_THRESHOLD_ADDR A:0xfc380140
y.create.l HWIO_BIMC_MPORT_CORE_DOMAIN_LOCAL_CGC_THRESHOLD_ADDR A:0xfc380180
y.create.l HWIO_BIMC_MPORT0_CLK_LOCAL_CGC_THRESHOLD_ADDR A:0xfc3801c0
y.create.l HWIO_BIMC_MPORT1_CLK_LOCAL_CGC_THRESHOLD_ADDR A:0xfc3801c4
y.create.l HWIO_BIMC_MPORT2_CLK_LOCAL_CGC_THRESHOLD_ADDR A:0xfc3801c8
y.create.l HWIO_BIMC_SWAY_LOCAL_CGC_THRESHOLD_ADDR A:0xfc380200
y.create.l HWIO_BIMC_SCMO0_CGC_CFG_ADDR A:0xfc380240
y.create.l HWIO_BIMC_DPE0_CGC_CFG_ADDR A:0xfc380280
y.create.l HWIO_BIMC_CALIBRATION_CFG_ADDR A:0xfc380400
y.create.l HWIO_BIMC_DFI0_LP_CFG_ADDR A:0xfc380600
y.create.l HWIO_BIMC_HFSC_CFG_ADDR A:0xfc380800
y.create.l HWIO_BIMC_HFSC_STATUS_ADDR A:0xfc38080c
y.create.l HWIO_BIMC_HFSC_STAGE1_CTRL_ADDR A:0xfc380840
y.create.l HWIO_BIMC_HFSC_STAGE2_CTRL_ADDR A:0xfc380860
y.create.l HWIO_BIMC_BRIC_GLOBAL1_COMPONENT_INFO_ADDR A:0xfc381000
y.create.l HWIO_BIMC_BRIC_HW_INFO_ADDR A:0xfc381010
y.create.l HWIO_BIMC_BRIC_CONFIGURATION_INFO_0_ADDR A:0xfc381020
y.create.l HWIO_BIMC_BRIC_CONFIGURATION_INFO_1_ADDR A:0xfc381030
y.create.l HWIO_BIMC_BRIC_INTERRUPT_STATUS_0_ADDR A:0xfc381100
y.create.l HWIO_BIMC_BRIC_INTERRUPT_CLEAR_0_ADDR A:0xfc381108
y.create.l HWIO_BIMC_BRIC_INTERRUPT_ENABLE_0_ADDR A:0xfc38110c
y.create.l HWIO_BIMC_BRIC_INTERRUPT_STATUS_1_ADDR A:0xfc381110
y.create.l HWIO_BIMC_BRIC_INTERRUPT_CLEAR_1_ADDR A:0xfc381118
y.create.l HWIO_BIMC_BRIC_INTERRUPT_ENABLE_1_ADDR A:0xfc38111c
y.create.l HWIO_BIMC_BRIC_INTERRUPT_STATUS_2_ADDR A:0xfc381120
y.create.l HWIO_BIMC_BRIC_INTERRUPT_CLEAR_2_ADDR A:0xfc381128
y.create.l HWIO_BIMC_BRIC_INTERRUPT_ENABLE_2_ADDR A:0xfc38112c
y.create.l HWIO_BIMC_BRIC_INTERRUPT_STATUS_3_ADDR A:0xfc381130
y.create.l HWIO_BIMC_BRIC_INTERRUPT_CLEAR_3_ADDR A:0xfc381138
y.create.l HWIO_BIMC_BRIC_INTERRUPT_ENABLE_3_ADDR A:0xfc38113c
y.create.l HWIO_BIMC_BRIC_REF_TIMER_INTERVAL_ADDR A:0xfc381200
y.create.l HWIO_BIMC_BRIC_DEBUG_SELECT_ADDR A:0xfc381210
y.create.l HWIO_BIMC_BRIC_GLOBAL2_COMPONENT_INFO_ADDR A:0xfc382000
y.create.l HWIO_BIMC_BRIC_DEFAULT_SEGMENT_ADDR A:0xfc3821f0
y.create.l HWIO_BIMC_BRIC_SEGMENT0_ADDR_BASE_A_LOWER_ADDR A:0xfc382200
y.create.l HWIO_BIMC_BRIC_SEGMENT1_ADDR_BASE_A_LOWER_ADDR A:0xfc382280
y.create.l HWIO_BIMC_BRIC_SEGMENT2_ADDR_BASE_A_LOWER_ADDR A:0xfc382300
y.create.l HWIO_BIMC_BRIC_SEGMENT0_ADDR_BASE_A_UPPER_ADDR A:0xfc382204
y.create.l HWIO_BIMC_BRIC_SEGMENT1_ADDR_BASE_A_UPPER_ADDR A:0xfc382284
y.create.l HWIO_BIMC_BRIC_SEGMENT2_ADDR_BASE_A_UPPER_ADDR A:0xfc382304
y.create.l HWIO_BIMC_BRIC_SEGMENT0_ADDR_MASK_A_LOWER_ADDR A:0xfc382208
y.create.l HWIO_BIMC_BRIC_SEGMENT1_ADDR_MASK_A_LOWER_ADDR A:0xfc382288
y.create.l HWIO_BIMC_BRIC_SEGMENT2_ADDR_MASK_A_LOWER_ADDR A:0xfc382308
y.create.l HWIO_BIMC_BRIC_SEGMENT0_ADDR_MASK_A_UPPER_ADDR A:0xfc38220c
y.create.l HWIO_BIMC_BRIC_SEGMENT1_ADDR_MASK_A_UPPER_ADDR A:0xfc38228c
y.create.l HWIO_BIMC_BRIC_SEGMENT2_ADDR_MASK_A_UPPER_ADDR A:0xfc38230c
y.create.l HWIO_BIMC_BRIC_SEGMENT0_ADDR_BASE_B_LOWER_ADDR A:0xfc382210
y.create.l HWIO_BIMC_BRIC_SEGMENT1_ADDR_BASE_B_LOWER_ADDR A:0xfc382290
y.create.l HWIO_BIMC_BRIC_SEGMENT2_ADDR_BASE_B_LOWER_ADDR A:0xfc382310
y.create.l HWIO_BIMC_BRIC_SEGMENT0_ADDR_BASE_B_UPPER_ADDR A:0xfc382214
y.create.l HWIO_BIMC_BRIC_SEGMENT1_ADDR_BASE_B_UPPER_ADDR A:0xfc382294
y.create.l HWIO_BIMC_BRIC_SEGMENT2_ADDR_BASE_B_UPPER_ADDR A:0xfc382314
y.create.l HWIO_BIMC_BRIC_SEGMENT0_ADDR_MASK_B_LOWER_ADDR A:0xfc382218
y.create.l HWIO_BIMC_BRIC_SEGMENT1_ADDR_MASK_B_LOWER_ADDR A:0xfc382298
y.create.l HWIO_BIMC_BRIC_SEGMENT2_ADDR_MASK_B_LOWER_ADDR A:0xfc382318
y.create.l HWIO_BIMC_BRIC_SEGMENT0_ADDR_MASK_B_UPPER_ADDR A:0xfc38221c
y.create.l HWIO_BIMC_BRIC_SEGMENT1_ADDR_MASK_B_UPPER_ADDR A:0xfc38229c
y.create.l HWIO_BIMC_BRIC_SEGMENT2_ADDR_MASK_B_UPPER_ADDR A:0xfc38231c
y.create.l HWIO_BIMC_BRIC_SEGMENT0_ADDR_BASE_C_LOWER_ADDR A:0xfc382220
y.create.l HWIO_BIMC_BRIC_SEGMENT1_ADDR_BASE_C_LOWER_ADDR A:0xfc3822a0
y.create.l HWIO_BIMC_BRIC_SEGMENT2_ADDR_BASE_C_LOWER_ADDR A:0xfc382320
y.create.l HWIO_BIMC_BRIC_SEGMENT0_ADDR_BASE_C_UPPER_ADDR A:0xfc382224
y.create.l HWIO_BIMC_BRIC_SEGMENT1_ADDR_BASE_C_UPPER_ADDR A:0xfc3822a4
y.create.l HWIO_BIMC_BRIC_SEGMENT2_ADDR_BASE_C_UPPER_ADDR A:0xfc382324
y.create.l HWIO_BIMC_BRIC_SEGMENT0_ADDR_MASK_C_LOWER_ADDR A:0xfc382228
y.create.l HWIO_BIMC_BRIC_SEGMENT1_ADDR_MASK_C_LOWER_ADDR A:0xfc3822a8
y.create.l HWIO_BIMC_BRIC_SEGMENT2_ADDR_MASK_C_LOWER_ADDR A:0xfc382328
y.create.l HWIO_BIMC_BRIC_SEGMENT0_ADDR_MASK_C_UPPER_ADDR A:0xfc38222c
y.create.l HWIO_BIMC_BRIC_SEGMENT1_ADDR_MASK_C_UPPER_ADDR A:0xfc3822ac
y.create.l HWIO_BIMC_BRIC_SEGMENT2_ADDR_MASK_C_UPPER_ADDR A:0xfc38232c
y.create.l HWIO_BIMC_CONFIG_APU_XPU_SCR_ADDR A:0xfc384000
y.create.l HWIO_BIMC_CONFIG_APU_XPU_SWDR_ADDR A:0xfc384004
y.create.l HWIO_BIMC_CONFIG_APU_XPU_SEAR0_ADDR A:0xfc384040
y.create.l HWIO_BIMC_CONFIG_APU_XPU_SESR_ADDR A:0xfc384048
y.create.l HWIO_BIMC_CONFIG_APU_XPU_SESRRESTORE_ADDR A:0xfc38404c
y.create.l HWIO_BIMC_CONFIG_APU_XPU_SESYNR0_ADDR A:0xfc384050
y.create.l HWIO_BIMC_CONFIG_APU_XPU_SESYNR1_ADDR A:0xfc384054
y.create.l HWIO_BIMC_CONFIG_APU_XPU_SESYNR2_ADDR A:0xfc384058
y.create.l HWIO_BIMC_CONFIG_APU_XPU_MCR_ADDR A:0xfc384100
y.create.l HWIO_BIMC_CONFIG_APU_XPU_MEAR0_ADDR A:0xfc384140
y.create.l HWIO_BIMC_CONFIG_APU_XPU_MESR_ADDR A:0xfc384148
y.create.l HWIO_BIMC_CONFIG_APU_XPU_MESRRESTORE_ADDR A:0xfc38414c
y.create.l HWIO_BIMC_CONFIG_APU_XPU_MESYNR0_ADDR A:0xfc384150
y.create.l HWIO_BIMC_CONFIG_APU_XPU_MESYNR1_ADDR A:0xfc384154
y.create.l HWIO_BIMC_CONFIG_APU_XPU_MESYNR2_ADDR A:0xfc384158
y.create.l HWIO_BIMC_CONFIG_APU_XPU_CR_ADDR A:0xfc384080
y.create.l HWIO_BIMC_CONFIG_APU_XPU_RPU_ACR0_ADDR A:0xfc3840a0
y.create.l HWIO_BIMC_CONFIG_APU_XPU_EAR0_ADDR A:0xfc3840c0
y.create.l HWIO_BIMC_CONFIG_APU_XPU_ESR_ADDR A:0xfc3840c8
y.create.l HWIO_BIMC_CONFIG_APU_XPU_ESRRESTORE_ADDR A:0xfc3840cc
y.create.l HWIO_BIMC_CONFIG_APU_XPU_ESYNR0_ADDR A:0xfc3840d0
y.create.l HWIO_BIMC_CONFIG_APU_XPU_ESYNR1_ADDR A:0xfc3840d4
y.create.l HWIO_BIMC_CONFIG_APU_XPU_ESYNR2_ADDR A:0xfc3840d8
y.create.l HWIO_BIMC_CONFIG_APU_XPU_IDR0_ADDR A:0xfc384074
y.create.l HWIO_BIMC_CONFIG_APU_XPU_IDR1_ADDR A:0xfc384078
y.create.l HWIO_BIMC_CONFIG_APU_XPU_REV_ADDR A:0xfc38407c
y.create.l HWIO_BIMC_CONFIG_APU_XPU_RG0_RACR0_ADDR A:0xfc384200
y.create.l HWIO_BIMC_CONFIG_APU_XPU_RG1_RACR0_ADDR A:0xfc384280
y.create.l HWIO_BIMC_CONFIG_APU_XPU_RG2_RACR0_ADDR A:0xfc384300
y.create.l HWIO_BIMC_CONFIG_APU_XPU_RG3_RACR0_ADDR A:0xfc384380
y.create.l HWIO_BIMC_CONFIG_APU_XPU_RG4_RACR0_ADDR A:0xfc384400
y.create.l HWIO_BIMC_CONFIG_APU_XPU_RG5_RACR0_ADDR A:0xfc384480
y.create.l HWIO_BIMC_CONFIG_APU_XPU_RG6_RACR0_ADDR A:0xfc384500
y.create.l HWIO_BIMC_CONFIG_APU_XPU_RG7_RACR0_ADDR A:0xfc384580
y.create.l HWIO_BIMC_CONFIG_APU_XPU_RG8_RACR0_ADDR A:0xfc384600
y.create.l HWIO_BIMC_CONFIG_APU_XPU_RG9_RACR0_ADDR A:0xfc384680
y.create.l HWIO_BIMC_CONFIG_APU_XPU_RG0_WACR0_ADDR A:0xfc384220
y.create.l HWIO_BIMC_CONFIG_APU_XPU_RG1_WACR0_ADDR A:0xfc3842a0
y.create.l HWIO_BIMC_CONFIG_APU_XPU_RG2_WACR0_ADDR A:0xfc384320
y.create.l HWIO_BIMC_CONFIG_APU_XPU_RG3_WACR0_ADDR A:0xfc3843a0
y.create.l HWIO_BIMC_CONFIG_APU_XPU_RG4_WACR0_ADDR A:0xfc384420
y.create.l HWIO_BIMC_CONFIG_APU_XPU_RG5_WACR0_ADDR A:0xfc3844a0
y.create.l HWIO_BIMC_CONFIG_APU_XPU_RG6_WACR0_ADDR A:0xfc384520
y.create.l HWIO_BIMC_CONFIG_APU_XPU_RG7_WACR0_ADDR A:0xfc3845a0
y.create.l HWIO_BIMC_CONFIG_APU_XPU_RG8_WACR0_ADDR A:0xfc384620
y.create.l HWIO_BIMC_CONFIG_APU_XPU_RG9_WACR0_ADDR A:0xfc3846a0
y.create.l HWIO_BIMC_CONFIG_APU_XPU_RG0_SCR_ADDR A:0xfc384250
y.create.l HWIO_BIMC_CONFIG_APU_XPU_RG1_SCR_ADDR A:0xfc3842d0
y.create.l HWIO_BIMC_CONFIG_APU_XPU_RG2_SCR_ADDR A:0xfc384350
y.create.l HWIO_BIMC_CONFIG_APU_XPU_RG3_SCR_ADDR A:0xfc3843d0
y.create.l HWIO_BIMC_CONFIG_APU_XPU_RG4_SCR_ADDR A:0xfc384450
y.create.l HWIO_BIMC_CONFIG_APU_XPU_RG5_SCR_ADDR A:0xfc3844d0
y.create.l HWIO_BIMC_CONFIG_APU_XPU_RG6_SCR_ADDR A:0xfc384550
y.create.l HWIO_BIMC_CONFIG_APU_XPU_RG7_SCR_ADDR A:0xfc3845d0
y.create.l HWIO_BIMC_CONFIG_APU_XPU_RG8_SCR_ADDR A:0xfc384650
y.create.l HWIO_BIMC_CONFIG_APU_XPU_RG9_SCR_ADDR A:0xfc3846d0
y.create.l HWIO_BIMC_CONFIG_APU_XPU_RG0_MCR_ADDR A:0xfc384254
y.create.l HWIO_BIMC_CONFIG_APU_XPU_RG1_MCR_ADDR A:0xfc3842d4
y.create.l HWIO_BIMC_CONFIG_APU_XPU_RG2_MCR_ADDR A:0xfc384354
y.create.l HWIO_BIMC_CONFIG_APU_XPU_RG3_MCR_ADDR A:0xfc3843d4
y.create.l HWIO_BIMC_CONFIG_APU_XPU_RG4_MCR_ADDR A:0xfc384454
y.create.l HWIO_BIMC_CONFIG_APU_XPU_RG5_MCR_ADDR A:0xfc3844d4
y.create.l HWIO_BIMC_CONFIG_APU_XPU_RG6_MCR_ADDR A:0xfc384554
y.create.l HWIO_BIMC_CONFIG_APU_XPU_RG7_MCR_ADDR A:0xfc3845d4
y.create.l HWIO_BIMC_CONFIG_APU_XPU_RG8_MCR_ADDR A:0xfc384654
y.create.l HWIO_BIMC_CONFIG_APU_XPU_RG9_MCR_ADDR A:0xfc3846d4
y.create.l HWIO_BIMC_PERFMON_COMPONENT_INFO_ADDR A:0xfc383000
y.create.l HWIO_BIMC_PERFMON_CONFIGURATION_INFO_ADDR A:0xfc383020
y.create.l HWIO_BIMC_PERFMON_CLOCK_CTRL_ADDR A:0xfc383200
y.create.l HWIO_BIMC_PERFMON_MODE_ADDR A:0xfc383210
y.create.l HWIO_BIMC_PERFMON_DUMP_ADDR A:0xfc383214
y.create.l HWIO_BIMC_PERFMON_TIMED_MODE_INTERVAL_ADDR A:0xfc383220
y.create.l HWIO_BIMC_PERFMON_TIMED_MODE_ITERATIONS_ADDR A:0xfc383230
y.create.l HWIO_BIMC_PERFMON_STATUS_ADDR A:0xfc3832f0
y.create.l HWIO_BIMC_PERFMON_COUNTER_0_CONFIG_ADDR A:0xfc383300
y.create.l HWIO_BIMC_PERFMON_COUNTER_1_CONFIG_ADDR A:0xfc383310
y.create.l HWIO_BIMC_PERFMON_COUNTER_2_CONFIG_ADDR A:0xfc383320
y.create.l HWIO_BIMC_PERFMON_COUNTER_3_CONFIG_ADDR A:0xfc383330
y.create.l HWIO_BIMC_PERFMON_COUNTER_4_CONFIG_ADDR A:0xfc383340
y.create.l HWIO_BIMC_PERFMON_COUNTER_5_CONFIG_ADDR A:0xfc383350
y.create.l HWIO_BIMC_PERFMON_COUNTER_6_CONFIG_ADDR A:0xfc383360
y.create.l HWIO_BIMC_PERFMON_COUNTER_7_CONFIG_ADDR A:0xfc383370
y.create.l HWIO_BIMC_PERFMON_COUNTER_8_CONFIG_ADDR A:0xfc383380
y.create.l HWIO_BIMC_PERFMON_COUNTER_9_CONFIG_ADDR A:0xfc383390
y.create.l HWIO_BIMC_PERFMON_COUNTER_0_ADDR A:0xfc383308
y.create.l HWIO_BIMC_PERFMON_COUNTER_1_ADDR A:0xfc383318
y.create.l HWIO_BIMC_PERFMON_COUNTER_2_ADDR A:0xfc383328
y.create.l HWIO_BIMC_PERFMON_COUNTER_3_ADDR A:0xfc383338
y.create.l HWIO_BIMC_PERFMON_COUNTER_4_ADDR A:0xfc383348
y.create.l HWIO_BIMC_PERFMON_COUNTER_5_ADDR A:0xfc383358
y.create.l HWIO_BIMC_PERFMON_COUNTER_6_ADDR A:0xfc383368
y.create.l HWIO_BIMC_PERFMON_COUNTER_7_ADDR A:0xfc383378
y.create.l HWIO_BIMC_PERFMON_COUNTER_8_ADDR A:0xfc383388
y.create.l HWIO_BIMC_PERFMON_COUNTER_9_ADDR A:0xfc383398
y.create.l HWIO_BIMC_PERFMON_COUNTER_0_OVERFLOW_ADDR A:0xfc38330c
y.create.l HWIO_BIMC_PERFMON_COUNTER_1_OVERFLOW_ADDR A:0xfc38331c
y.create.l HWIO_BIMC_PERFMON_COUNTER_2_OVERFLOW_ADDR A:0xfc38332c
y.create.l HWIO_BIMC_PERFMON_COUNTER_3_OVERFLOW_ADDR A:0xfc38333c
y.create.l HWIO_BIMC_PERFMON_COUNTER_4_OVERFLOW_ADDR A:0xfc38334c
y.create.l HWIO_BIMC_PERFMON_COUNTER_5_OVERFLOW_ADDR A:0xfc38335c
y.create.l HWIO_BIMC_PERFMON_COUNTER_6_OVERFLOW_ADDR A:0xfc38336c
y.create.l HWIO_BIMC_PERFMON_COUNTER_7_OVERFLOW_ADDR A:0xfc38337c
y.create.l HWIO_BIMC_PERFMON_COUNTER_8_OVERFLOW_ADDR A:0xfc38338c
y.create.l HWIO_BIMC_PERFMON_COUNTER_9_OVERFLOW_ADDR A:0xfc38339c
y.create.l HWIO_BIMC_DTE_HW_INFO_ADDR A:0xfc386000
y.create.l HWIO_BIMC_DTE_GLOBAL_CNTL_ADDR A:0xfc386004
y.create.l HWIO_BIMC_DTE_PROGRAM_CNTL_ADDR A:0xfc38600c
y.create.l HWIO_BIMC_DTE_REG_CNTL_ADDR A:0xfc386010
y.create.l HWIO_BIMC_DTE_REG_DATA_ADDR A:0xfc386014
y.create.l HWIO_BIMC_DTE_TEST_STATUS_DDR_ADDR A:0xfc386020
y.create.l HWIO_BIMC_DTE_TEST_STATUS_QSB_ADDR A:0xfc386024
y.create.l HWIO_BIMC_DTE_TEST_MEM_CNTL_ADDR A:0xfc386030
y.create.l HWIO_BIMC_DTE_TEST_MEM_DATA_0_ADDR A:0xfc386038
y.create.l HWIO_BIMC_DTE_TEST_MEM_DATA_1_ADDR A:0xfc38603c
y.create.l HWIO_BIMC_M_APP0_MPORT_COMPONENT_INFO_ADDR A:0xfc388000
y.create.l HWIO_BIMC_M_APP0_MPORT_CONFIGURATION_INFO_0_ADDR A:0xfc388020
y.create.l HWIO_BIMC_M_APP0_MPORT_CONFIGURATION_INFO_1_ADDR A:0xfc388030
y.create.l HWIO_BIMC_M_APP0_MPORT_CONFIGURATION_INFO_2_ADDR A:0xfc388040
y.create.l HWIO_BIMC_M_APP0_MPORT_CONFIGURATION_INFO_3_ADDR A:0xfc388050
y.create.l HWIO_BIMC_M_APP0_MPORT_CONFIGURATION_INFO_4_ADDR A:0xfc388060
y.create.l HWIO_BIMC_M_APP0_MPORT_CONFIGURATION_INFO_5_ADDR A:0xfc388070
y.create.l HWIO_BIMC_M_APP0_MPORT_INTERRUPT_STATUS_ADDR A:0xfc388100
y.create.l HWIO_BIMC_M_APP0_MPORT_INTERRUPT_CLEAR_ADDR A:0xfc388108
y.create.l HWIO_BIMC_M_APP0_MPORT_INTERRUPT_ENABLE_ADDR A:0xfc38810c
y.create.l HWIO_BIMC_M_APP0_MPORT_CLOCK_CTRL_ADDR A:0xfc388200
y.create.l HWIO_BIMC_M_APP0_MPORT_MODE_ADDR A:0xfc388210
y.create.l HWIO_BIMC_M_APP0_MPORT_WR_WAY_CROSSING_ADDR A:0xfc388220
y.create.l HWIO_BIMC_M_APP0_MPORT_PRIORITYLVL_OVERRIDE_ADDR A:0xfc388230
y.create.l HWIO_BIMC_M_APP0_MPORT_READ_COMMAND_OVERRIDE_ADDR A:0xfc388240
y.create.l HWIO_BIMC_M_APP0_MPORT_WRITE_COMMAND_OVERRIDE_ADDR A:0xfc388250
y.create.l HWIO_BIMC_M_APP0_MPORT_BKE_ENABLE_ADDR A:0xfc388300
y.create.l HWIO_BIMC_M_APP0_MPORT_BKE_GRANT_PERIOD_ADDR A:0xfc388304
y.create.l HWIO_BIMC_M_APP0_MPORT_BKE_GRANT_COUNT_ADDR A:0xfc388308
y.create.l HWIO_BIMC_M_APP0_MPORT_BKE_THRESHOLD_HIGH_ADDR A:0xfc388320
y.create.l HWIO_BIMC_M_APP0_MPORT_BKE_THRESHOLD_MEDIUM_ADDR A:0xfc388324
y.create.l HWIO_BIMC_M_APP0_MPORT_BKE_THRESHOLD_LOW_ADDR A:0xfc388328
y.create.l HWIO_BIMC_M_APP0_MPORT_BKE_HEALTH_0_ADDR A:0xfc388340
y.create.l HWIO_BIMC_M_APP0_MPORT_BKE_HEALTH_1_ADDR A:0xfc388344
y.create.l HWIO_BIMC_M_APP0_MPORT_BKE_HEALTH_2_ADDR A:0xfc388348
y.create.l HWIO_BIMC_M_APP0_MPORT_BKE_HEALTH_3_ADDR A:0xfc38834c
y.create.l HWIO_BIMC_M_APP0_MPORT_BUFFER_STATUS_0_ADDR A:0xfc388400
y.create.l HWIO_BIMC_M_APP0_MPORT_BUFFER_STATUS_1_ADDR A:0xfc388410
y.create.l HWIO_BIMC_M_DSP0_MPORT_COMPONENT_INFO_ADDR A:0xfc38c000
y.create.l HWIO_BIMC_M_DSP0_MPORT_CONFIGURATION_INFO_0_ADDR A:0xfc38c020
y.create.l HWIO_BIMC_M_DSP0_MPORT_CONFIGURATION_INFO_1_ADDR A:0xfc38c030
y.create.l HWIO_BIMC_M_DSP0_MPORT_CONFIGURATION_INFO_2_ADDR A:0xfc38c040
y.create.l HWIO_BIMC_M_DSP0_MPORT_CONFIGURATION_INFO_3_ADDR A:0xfc38c050
y.create.l HWIO_BIMC_M_DSP0_MPORT_CONFIGURATION_INFO_4_ADDR A:0xfc38c060
y.create.l HWIO_BIMC_M_DSP0_MPORT_CONFIGURATION_INFO_5_ADDR A:0xfc38c070
y.create.l HWIO_BIMC_M_DSP0_MPORT_INTERRUPT_STATUS_ADDR A:0xfc38c100
y.create.l HWIO_BIMC_M_DSP0_MPORT_INTERRUPT_CLEAR_ADDR A:0xfc38c108
y.create.l HWIO_BIMC_M_DSP0_MPORT_INTERRUPT_ENABLE_ADDR A:0xfc38c10c
y.create.l HWIO_BIMC_M_DSP0_MPORT_CLOCK_CTRL_ADDR A:0xfc38c200
y.create.l HWIO_BIMC_M_DSP0_MPORT_MODE_ADDR A:0xfc38c210
y.create.l HWIO_BIMC_M_DSP0_MPORT_WR_WAY_CROSSING_ADDR A:0xfc38c220
y.create.l HWIO_BIMC_M_DSP0_MPORT_PRIORITYLVL_OVERRIDE_ADDR A:0xfc38c230
y.create.l HWIO_BIMC_M_DSP0_MPORT_READ_COMMAND_OVERRIDE_ADDR A:0xfc38c240
y.create.l HWIO_BIMC_M_DSP0_MPORT_WRITE_COMMAND_OVERRIDE_ADDR A:0xfc38c250
y.create.l HWIO_BIMC_M_DSP0_MPORT_BKE_ENABLE_ADDR A:0xfc38c300
y.create.l HWIO_BIMC_M_DSP0_MPORT_BKE_GRANT_PERIOD_ADDR A:0xfc38c304
y.create.l HWIO_BIMC_M_DSP0_MPORT_BKE_GRANT_COUNT_ADDR A:0xfc38c308
y.create.l HWIO_BIMC_M_DSP0_MPORT_BKE_THRESHOLD_HIGH_ADDR A:0xfc38c320
y.create.l HWIO_BIMC_M_DSP0_MPORT_BKE_THRESHOLD_MEDIUM_ADDR A:0xfc38c324
y.create.l HWIO_BIMC_M_DSP0_MPORT_BKE_THRESHOLD_LOW_ADDR A:0xfc38c328
y.create.l HWIO_BIMC_M_DSP0_MPORT_BKE_HEALTH_0_ADDR A:0xfc38c340
y.create.l HWIO_BIMC_M_DSP0_MPORT_BKE_HEALTH_1_ADDR A:0xfc38c344
y.create.l HWIO_BIMC_M_DSP0_MPORT_BKE_HEALTH_2_ADDR A:0xfc38c348
y.create.l HWIO_BIMC_M_DSP0_MPORT_BKE_HEALTH_3_ADDR A:0xfc38c34c
y.create.l HWIO_BIMC_M_DSP0_MPORT_BUFFER_STATUS_0_ADDR A:0xfc38c400
y.create.l HWIO_BIMC_M_DSP0_MPORT_BUFFER_STATUS_1_ADDR A:0xfc38c410
y.create.l HWIO_BIMC_M_SYS0_MPORT_COMPONENT_INFO_ADDR A:0xfc390000
y.create.l HWIO_BIMC_M_SYS0_MPORT_CONFIGURATION_INFO_0_ADDR A:0xfc390020
y.create.l HWIO_BIMC_M_SYS0_MPORT_CONFIGURATION_INFO_1_ADDR A:0xfc390030
y.create.l HWIO_BIMC_M_SYS0_MPORT_CONFIGURATION_INFO_2_ADDR A:0xfc390040
y.create.l HWIO_BIMC_M_SYS0_MPORT_CONFIGURATION_INFO_3_ADDR A:0xfc390050
y.create.l HWIO_BIMC_M_SYS0_MPORT_CONFIGURATION_INFO_4_ADDR A:0xfc390060
y.create.l HWIO_BIMC_M_SYS0_MPORT_CONFIGURATION_INFO_5_ADDR A:0xfc390070
y.create.l HWIO_BIMC_M_SYS0_MPORT_INTERRUPT_STATUS_ADDR A:0xfc390100
y.create.l HWIO_BIMC_M_SYS0_MPORT_INTERRUPT_CLEAR_ADDR A:0xfc390108
y.create.l HWIO_BIMC_M_SYS0_MPORT_INTERRUPT_ENABLE_ADDR A:0xfc39010c
y.create.l HWIO_BIMC_M_SYS0_MPORT_CLOCK_CTRL_ADDR A:0xfc390200
y.create.l HWIO_BIMC_M_SYS0_MPORT_MODE_ADDR A:0xfc390210
y.create.l HWIO_BIMC_M_SYS0_MPORT_WR_WAY_CROSSING_ADDR A:0xfc390220
y.create.l HWIO_BIMC_M_SYS0_MPORT_PRIORITYLVL_OVERRIDE_ADDR A:0xfc390230
y.create.l HWIO_BIMC_M_SYS0_MPORT_READ_COMMAND_OVERRIDE_ADDR A:0xfc390240
y.create.l HWIO_BIMC_M_SYS0_MPORT_WRITE_COMMAND_OVERRIDE_ADDR A:0xfc390250
y.create.l HWIO_BIMC_M_SYS0_MPORT_BKE_ENABLE_ADDR A:0xfc390300
y.create.l HWIO_BIMC_M_SYS0_MPORT_BKE_GRANT_PERIOD_ADDR A:0xfc390304
y.create.l HWIO_BIMC_M_SYS0_MPORT_BKE_GRANT_COUNT_ADDR A:0xfc390308
y.create.l HWIO_BIMC_M_SYS0_MPORT_BKE_THRESHOLD_HIGH_ADDR A:0xfc390320
y.create.l HWIO_BIMC_M_SYS0_MPORT_BKE_THRESHOLD_MEDIUM_ADDR A:0xfc390324
y.create.l HWIO_BIMC_M_SYS0_MPORT_BKE_THRESHOLD_LOW_ADDR A:0xfc390328
y.create.l HWIO_BIMC_M_SYS0_MPORT_BKE_HEALTH_0_ADDR A:0xfc390340
y.create.l HWIO_BIMC_M_SYS0_MPORT_BKE_HEALTH_1_ADDR A:0xfc390344
y.create.l HWIO_BIMC_M_SYS0_MPORT_BKE_HEALTH_2_ADDR A:0xfc390348
y.create.l HWIO_BIMC_M_SYS0_MPORT_BKE_HEALTH_3_ADDR A:0xfc39034c
y.create.l HWIO_BIMC_M_SYS0_MPORT_BUFFER_STATUS_0_ADDR A:0xfc390400
y.create.l HWIO_BIMC_M_SYS0_MPORT_BUFFER_STATUS_1_ADDR A:0xfc390410
y.create.l HWIO_BIMC_M_APP0_PROF_COMPONENT_INFO_ADDR A:0xfc389000
y.create.l HWIO_BIMC_M_APP0_PROF_CONFIGURATION_INFO_0_ADDR A:0xfc389020
y.create.l HWIO_BIMC_M_APP0_PROF_CONFIGURATION_INFO_1_ADDR A:0xfc389030
y.create.l HWIO_BIMC_M_APP0_PROF_CLOCK_CTRL_ADDR A:0xfc389200
y.create.l HWIO_BIMC_M_APP0_PROF_MODE_ADDR A:0xfc389210
y.create.l HWIO_BIMC_M_APP0_PROF_RD_TENURE_THRESHOLD_ADDR A:0xfc389214
y.create.l HWIO_BIMC_M_APP0_PROF_WR_TENURE_THRESHOLD_ADDR A:0xfc389218
y.create.l HWIO_BIMC_M_APP0_PROF_SWAY_SELECT_ADDR A:0xfc389220
y.create.l HWIO_BIMC_M_APP0_PROF_MID_MASK_ADDR A:0xfc389230
y.create.l HWIO_BIMC_M_APP0_PROF_MID_MATCH_ADDR A:0xfc389234
y.create.l HWIO_BIMC_M_APP0_PROF_MID_INV_MATCH_ADDR A:0xfc389238
y.create.l HWIO_BIMC_M_APP0_PROF_ADDR_MASK_LOWER_ADDR A:0xfc389240
y.create.l HWIO_BIMC_M_APP0_PROF_ADDR_MASK_UPPER_ADDR A:0xfc389244
y.create.l HWIO_BIMC_M_APP0_PROF_ADDR_MATCH_LOWER_ADDR A:0xfc389248
y.create.l HWIO_BIMC_M_APP0_PROF_ADDR_MATCH_UPPER_ADDR A:0xfc38924c
y.create.l HWIO_BIMC_M_APP0_PROF_ADDR_INV_MATCH_ADDR A:0xfc389250
y.create.l HWIO_BIMC_M_APP0_PROF_ACH_MASK_0_ADDR A:0xfc389260
y.create.l HWIO_BIMC_M_APP0_PROF_ACH_MATCH_0_ADDR A:0xfc389264
y.create.l HWIO_BIMC_M_APP0_PROF_ACH_MASK_1_ADDR A:0xfc389270
y.create.l HWIO_BIMC_M_APP0_PROF_ACH_MATCH_1_ADDR A:0xfc389274
y.create.l HWIO_BIMC_M_APP0_PROF_ACH_INV_MATCH_1_ADDR A:0xfc389278
y.create.l HWIO_BIMC_M_APP0_PROF_ACH_MASK_2_ADDR A:0xfc389280
y.create.l HWIO_BIMC_M_APP0_PROF_ACH_MATCH_2_ADDR A:0xfc389284
y.create.l HWIO_BIMC_M_APP0_PROF_ACH_MASK_3_ADDR A:0xfc389290
y.create.l HWIO_BIMC_M_APP0_PROF_ACH_MATCH_3_ADDR A:0xfc389294
y.create.l HWIO_BIMC_M_APP0_PROF_ACH_INV_MATCH_3_ADDR A:0xfc389298
y.create.l HWIO_BIMC_M_APP0_PROF_ACH_MASK_4_ADDR A:0xfc3892a0
y.create.l HWIO_BIMC_M_APP0_PROF_ACH_MATCH_4_ADDR A:0xfc3892a4
y.create.l HWIO_BIMC_M_APP0_PROF_ACH_INV_MATCH_4_ADDR A:0xfc3892a8
y.create.l HWIO_BIMC_M_APP0_PROF_BCH_MASK_ADDR A:0xfc389300
y.create.l HWIO_BIMC_M_APP0_PROF_BCH_MATCH_ADDR A:0xfc389304
y.create.l HWIO_BIMC_M_APP0_PROF_BCH_INV_MATCH_ADDR A:0xfc389308
y.create.l HWIO_BIMC_M_APP0_PROF_RCH_MASK_ADDR A:0xfc389340
y.create.l HWIO_BIMC_M_APP0_PROF_RCH_MATCH_ADDR A:0xfc389344
y.create.l HWIO_BIMC_M_APP0_PROF_RCH_INV_MATCH_ADDR A:0xfc389348
y.create.l HWIO_BIMC_M_APP0_PROF_RD_STATUS_ADDR A:0xfc389400
y.create.l HWIO_BIMC_M_APP0_PROF_WR_STATUS_ADDR A:0xfc389410
y.create.l HWIO_BIMC_M_DSP0_PROF_COMPONENT_INFO_ADDR A:0xfc38d000
y.create.l HWIO_BIMC_M_DSP0_PROF_CONFIGURATION_INFO_0_ADDR A:0xfc38d020
y.create.l HWIO_BIMC_M_DSP0_PROF_CONFIGURATION_INFO_1_ADDR A:0xfc38d030
y.create.l HWIO_BIMC_M_DSP0_PROF_CLOCK_CTRL_ADDR A:0xfc38d200
y.create.l HWIO_BIMC_M_DSP0_PROF_MODE_ADDR A:0xfc38d210
y.create.l HWIO_BIMC_M_DSP0_PROF_RD_TENURE_THRESHOLD_ADDR A:0xfc38d214
y.create.l HWIO_BIMC_M_DSP0_PROF_WR_TENURE_THRESHOLD_ADDR A:0xfc38d218
y.create.l HWIO_BIMC_M_DSP0_PROF_SWAY_SELECT_ADDR A:0xfc38d220
y.create.l HWIO_BIMC_M_DSP0_PROF_MID_MASK_ADDR A:0xfc38d230
y.create.l HWIO_BIMC_M_DSP0_PROF_MID_MATCH_ADDR A:0xfc38d234
y.create.l HWIO_BIMC_M_DSP0_PROF_MID_INV_MATCH_ADDR A:0xfc38d238
y.create.l HWIO_BIMC_M_DSP0_PROF_ADDR_MASK_LOWER_ADDR A:0xfc38d240
y.create.l HWIO_BIMC_M_DSP0_PROF_ADDR_MASK_UPPER_ADDR A:0xfc38d244
y.create.l HWIO_BIMC_M_DSP0_PROF_ADDR_MATCH_LOWER_ADDR A:0xfc38d248
y.create.l HWIO_BIMC_M_DSP0_PROF_ADDR_MATCH_UPPER_ADDR A:0xfc38d24c
y.create.l HWIO_BIMC_M_DSP0_PROF_ADDR_INV_MATCH_ADDR A:0xfc38d250
y.create.l HWIO_BIMC_M_DSP0_PROF_ACH_MASK_0_ADDR A:0xfc38d260
y.create.l HWIO_BIMC_M_DSP0_PROF_ACH_MATCH_0_ADDR A:0xfc38d264
y.create.l HWIO_BIMC_M_DSP0_PROF_ACH_MASK_1_ADDR A:0xfc38d270
y.create.l HWIO_BIMC_M_DSP0_PROF_ACH_MATCH_1_ADDR A:0xfc38d274
y.create.l HWIO_BIMC_M_DSP0_PROF_ACH_INV_MATCH_1_ADDR A:0xfc38d278
y.create.l HWIO_BIMC_M_DSP0_PROF_ACH_MASK_2_ADDR A:0xfc38d280
y.create.l HWIO_BIMC_M_DSP0_PROF_ACH_MATCH_2_ADDR A:0xfc38d284
y.create.l HWIO_BIMC_M_DSP0_PROF_ACH_MASK_3_ADDR A:0xfc38d290
y.create.l HWIO_BIMC_M_DSP0_PROF_ACH_MATCH_3_ADDR A:0xfc38d294
y.create.l HWIO_BIMC_M_DSP0_PROF_ACH_INV_MATCH_3_ADDR A:0xfc38d298
y.create.l HWIO_BIMC_M_DSP0_PROF_ACH_MASK_4_ADDR A:0xfc38d2a0
y.create.l HWIO_BIMC_M_DSP0_PROF_ACH_MATCH_4_ADDR A:0xfc38d2a4
y.create.l HWIO_BIMC_M_DSP0_PROF_ACH_INV_MATCH_4_ADDR A:0xfc38d2a8
y.create.l HWIO_BIMC_M_DSP0_PROF_BCH_MASK_ADDR A:0xfc38d300
y.create.l HWIO_BIMC_M_DSP0_PROF_BCH_MATCH_ADDR A:0xfc38d304
y.create.l HWIO_BIMC_M_DSP0_PROF_BCH_INV_MATCH_ADDR A:0xfc38d308
y.create.l HWIO_BIMC_M_DSP0_PROF_RCH_MASK_ADDR A:0xfc38d340
y.create.l HWIO_BIMC_M_DSP0_PROF_RCH_MATCH_ADDR A:0xfc38d344
y.create.l HWIO_BIMC_M_DSP0_PROF_RCH_INV_MATCH_ADDR A:0xfc38d348
y.create.l HWIO_BIMC_M_DSP0_PROF_RD_STATUS_ADDR A:0xfc38d400
y.create.l HWIO_BIMC_M_DSP0_PROF_WR_STATUS_ADDR A:0xfc38d410
y.create.l HWIO_BIMC_M_SYS0_PROF_COMPONENT_INFO_ADDR A:0xfc391000
y.create.l HWIO_BIMC_M_SYS0_PROF_CONFIGURATION_INFO_0_ADDR A:0xfc391020
y.create.l HWIO_BIMC_M_SYS0_PROF_CONFIGURATION_INFO_1_ADDR A:0xfc391030
y.create.l HWIO_BIMC_M_SYS0_PROF_CLOCK_CTRL_ADDR A:0xfc391200
y.create.l HWIO_BIMC_M_SYS0_PROF_MODE_ADDR A:0xfc391210
y.create.l HWIO_BIMC_M_SYS0_PROF_RD_TENURE_THRESHOLD_ADDR A:0xfc391214
y.create.l HWIO_BIMC_M_SYS0_PROF_WR_TENURE_THRESHOLD_ADDR A:0xfc391218
y.create.l HWIO_BIMC_M_SYS0_PROF_SWAY_SELECT_ADDR A:0xfc391220
y.create.l HWIO_BIMC_M_SYS0_PROF_MID_MASK_ADDR A:0xfc391230
y.create.l HWIO_BIMC_M_SYS0_PROF_MID_MATCH_ADDR A:0xfc391234
y.create.l HWIO_BIMC_M_SYS0_PROF_MID_INV_MATCH_ADDR A:0xfc391238
y.create.l HWIO_BIMC_M_SYS0_PROF_ADDR_MASK_LOWER_ADDR A:0xfc391240
y.create.l HWIO_BIMC_M_SYS0_PROF_ADDR_MASK_UPPER_ADDR A:0xfc391244
y.create.l HWIO_BIMC_M_SYS0_PROF_ADDR_MATCH_LOWER_ADDR A:0xfc391248
y.create.l HWIO_BIMC_M_SYS0_PROF_ADDR_MATCH_UPPER_ADDR A:0xfc39124c
y.create.l HWIO_BIMC_M_SYS0_PROF_ADDR_INV_MATCH_ADDR A:0xfc391250
y.create.l HWIO_BIMC_M_SYS0_PROF_ACH_MASK_0_ADDR A:0xfc391260
y.create.l HWIO_BIMC_M_SYS0_PROF_ACH_MATCH_0_ADDR A:0xfc391264
y.create.l HWIO_BIMC_M_SYS0_PROF_ACH_MASK_1_ADDR A:0xfc391270
y.create.l HWIO_BIMC_M_SYS0_PROF_ACH_MATCH_1_ADDR A:0xfc391274
y.create.l HWIO_BIMC_M_SYS0_PROF_ACH_INV_MATCH_1_ADDR A:0xfc391278
y.create.l HWIO_BIMC_M_SYS0_PROF_ACH_MASK_2_ADDR A:0xfc391280
y.create.l HWIO_BIMC_M_SYS0_PROF_ACH_MATCH_2_ADDR A:0xfc391284
y.create.l HWIO_BIMC_M_SYS0_PROF_ACH_MASK_3_ADDR A:0xfc391290
y.create.l HWIO_BIMC_M_SYS0_PROF_ACH_MATCH_3_ADDR A:0xfc391294
y.create.l HWIO_BIMC_M_SYS0_PROF_ACH_INV_MATCH_3_ADDR A:0xfc391298
y.create.l HWIO_BIMC_M_SYS0_PROF_ACH_MASK_4_ADDR A:0xfc3912a0
y.create.l HWIO_BIMC_M_SYS0_PROF_ACH_MATCH_4_ADDR A:0xfc3912a4
y.create.l HWIO_BIMC_M_SYS0_PROF_ACH_INV_MATCH_4_ADDR A:0xfc3912a8
y.create.l HWIO_BIMC_M_SYS0_PROF_BCH_MASK_ADDR A:0xfc391300
y.create.l HWIO_BIMC_M_SYS0_PROF_BCH_MATCH_ADDR A:0xfc391304
y.create.l HWIO_BIMC_M_SYS0_PROF_BCH_INV_MATCH_ADDR A:0xfc391308
y.create.l HWIO_BIMC_M_SYS0_PROF_RCH_MASK_ADDR A:0xfc391340
y.create.l HWIO_BIMC_M_SYS0_PROF_RCH_MATCH_ADDR A:0xfc391344
y.create.l HWIO_BIMC_M_SYS0_PROF_RCH_INV_MATCH_ADDR A:0xfc391348
y.create.l HWIO_BIMC_M_SYS0_PROF_RD_STATUS_ADDR A:0xfc391400
y.create.l HWIO_BIMC_M_SYS0_PROF_WR_STATUS_ADDR A:0xfc391410
y.create.l HWIO_BIMC_S_SYS_SWAY_COMPONENT_INFO_ADDR A:0xfc3d0000
y.create.l HWIO_BIMC_S_SYS_SWAY_CONFIGURATION_INFO_0_ADDR A:0xfc3d0020
y.create.l HWIO_BIMC_S_SYS_SWAY_CONFIGURATION_INFO_1_ADDR A:0xfc3d0030
y.create.l HWIO_BIMC_S_SYS_SWAY_CONFIGURATION_INFO_2_ADDR A:0xfc3d0040
y.create.l HWIO_BIMC_S_SYS_SWAY_CONFIGURATION_INFO_3_ADDR A:0xfc3d0050
y.create.l HWIO_BIMC_S_SYS_SWAY_CONFIGURATION_INFO_4_ADDR A:0xfc3d0060
y.create.l HWIO_BIMC_S_SYS_SWAY_CONFIGURATION_INFO_5_ADDR A:0xfc3d0070
y.create.l HWIO_BIMC_S_SYS_SWAY_CONFIGURATION_INFO_6_ADDR A:0xfc3d0080
y.create.l HWIO_BIMC_S_SYS_SWAY_INTERRUPT_STATUS_ADDR A:0xfc3d0100
y.create.l HWIO_BIMC_S_SYS_SWAY_INTERRUPT_CLEAR_ADDR A:0xfc3d0108
y.create.l HWIO_BIMC_S_SYS_SWAY_INTERRUPT_ENABLE_ADDR A:0xfc3d010c
y.create.l HWIO_BIMC_S_SYS_SWAY_CLOCK_CTRL_ADDR A:0xfc3d0200
y.create.l HWIO_BIMC_S_SYS_SWAY_RCH_SELECT_ADDR A:0xfc3d0210
y.create.l HWIO_BIMC_S_SYS_SWAY_MAX_OUTSTANDING_REQUESTS_ADDR A:0xfc3d0220
y.create.l HWIO_BIMC_S_SYS_SWAY_BUFFER_STATUS_0_ADDR A:0xfc3d0400
y.create.l HWIO_BIMC_S_SYS_SWAY_BUFFER_STATUS_1_ADDR A:0xfc3d0410
y.create.l HWIO_BIMC_S_SYS_SWAY_BUFFER_STATUS_2_ADDR A:0xfc3d0420
y.create.l HWIO_BIMC_S_DEFAULT_SWAY_COMPONENT_INFO_ADDR A:0xfc3d8000
y.create.l HWIO_BIMC_S_DEFAULT_SWAY_CONFIGURATION_INFO_0_ADDR A:0xfc3d8020
y.create.l HWIO_BIMC_S_DEFAULT_SWAY_CONFIGURATION_INFO_1_ADDR A:0xfc3d8030
y.create.l HWIO_BIMC_S_DEFAULT_SWAY_INTERRUPT_STATUS_ADDR A:0xfc3d8100
y.create.l HWIO_BIMC_S_DEFAULT_SWAY_INTERRUPT_CLEAR_ADDR A:0xfc3d8108
y.create.l HWIO_BIMC_S_DEFAULT_SWAY_INTERRUPT_ENABLE_ADDR A:0xfc3d810c
y.create.l HWIO_BIMC_S_DEFAULT_SWAY_DEFAULT_SLAVE_STATUS_0_ADDR A:0xfc3d8400
y.create.l HWIO_BIMC_S_DEFAULT_SWAY_DEFAULT_SLAVE_STATUS_1_ADDR A:0xfc3d8410
y.create.l HWIO_BIMC_S_DEFAULT_SWAY_DEFAULT_SLAVE_STATUS_2_ADDR A:0xfc3d8420
y.create.l HWIO_BIMC_S_DDR0_ARB_COMPONENT_INFO_ADDR A:0xfc3c9000
y.create.l HWIO_BIMC_S_DDR0_ARB_CONFIGURATION_INFO_0_ADDR A:0xfc3c9020
y.create.l HWIO_BIMC_S_DDR0_ARB_CONFIGURATION_INFO_1_ADDR A:0xfc3c9030
y.create.l HWIO_BIMC_S_DDR0_ARB_CLOCK_CTRL_ADDR A:0xfc3c9200
y.create.l HWIO_BIMC_S_DDR0_ARB_MODE_ADDR A:0xfc3c9210
y.create.l HWIO_BIMC_S_SYS_ARB_COMPONENT_INFO_ADDR A:0xfc3d1000
y.create.l HWIO_BIMC_S_SYS_ARB_CONFIGURATION_INFO_0_ADDR A:0xfc3d1020
y.create.l HWIO_BIMC_S_SYS_ARB_CONFIGURATION_INFO_1_ADDR A:0xfc3d1030
y.create.l HWIO_BIMC_S_SYS_ARB_CLOCK_CTRL_ADDR A:0xfc3d1200
y.create.l HWIO_BIMC_S_SYS_ARB_MODE_ADDR A:0xfc3d1210
y.create.l HWIO_BIMC_S_DEFAULT_ARB_COMPONENT_INFO_ADDR A:0xfc3d9000
y.create.l HWIO_BIMC_S_DEFAULT_ARB_CONFIGURATION_INFO_0_ADDR A:0xfc3d9020
y.create.l HWIO_BIMC_S_DEFAULT_ARB_CONFIGURATION_INFO_1_ADDR A:0xfc3d9030
y.create.l HWIO_BIMC_S_DEFAULT_ARB_CLOCK_CTRL_ADDR A:0xfc3d9200
y.create.l HWIO_BIMC_S_DEFAULT_ARB_MODE_ADDR A:0xfc3d9210
y.create.l HWIO_BIMC_S_DDR0_SCMO_COMPONENT_INFO_ADDR A:0xfc3c8000
y.create.l HWIO_BIMC_S_DDR0_SCMO_HW_INFO_ADDR A:0xfc3c8010
y.create.l HWIO_BIMC_S_DDR0_SCMO_CONFIGURATION_INFO_0_ADDR A:0xfc3c8020
y.create.l HWIO_BIMC_S_DDR0_SCMO_CONFIGURATION_INFO_1_ADDR A:0xfc3c8030
y.create.l HWIO_BIMC_S_DDR0_SCMO_CONFIGURATION_INFO_2_ADDR A:0xfc3c8040
y.create.l HWIO_BIMC_S_DDR0_SCMO_CONFIGURATION_INFO_3_ADDR A:0xfc3c8050
y.create.l HWIO_BIMC_S_DDR0_SCMO_CONFIGURATION_INFO_4_ADDR A:0xfc3c8060
y.create.l HWIO_BIMC_S_DDR0_SCMO_CONFIGURATION_INFO_5_ADDR A:0xfc3c8070
y.create.l HWIO_BIMC_S_DDR0_SCMO_CONFIGURATION_INFO_6_ADDR A:0xfc3c8080
y.create.l HWIO_BIMC_S_DDR0_SCMO_INTERRUPT_STATUS_ADDR A:0xfc3c8100
y.create.l HWIO_BIMC_S_DDR0_SCMO_INTERRUPT_CLEAR_ADDR A:0xfc3c8108
y.create.l HWIO_BIMC_S_DDR0_SCMO_INTERRUPT_ENABLE_ADDR A:0xfc3c810c
y.create.l HWIO_BIMC_S_DDR0_SCMO_ESYN_ADDR_ADDR A:0xfc3c8120
y.create.l HWIO_BIMC_S_DDR0_SCMO_ESYN_APACKET_0_ADDR A:0xfc3c8128
y.create.l HWIO_BIMC_S_DDR0_SCMO_ESYN_APACKET_1_ADDR A:0xfc3c812c
y.create.l HWIO_BIMC_S_DDR0_SCMO_CLOCK_CTRL_ADDR A:0xfc3c8200
y.create.l HWIO_BIMC_S_DDR0_SCMO_SLV_INTERLEAVE_CFG_ADDR A:0xfc3c8400
y.create.l HWIO_BIMC_S_DDR0_SCMO_ADDR_BASE_CS0_ADDR A:0xfc3c8410
y.create.l HWIO_BIMC_S_DDR0_SCMO_ADDR_BASE_CS1_ADDR A:0xfc3c8414
y.create.l HWIO_BIMC_S_DDR0_SCMO_ADDR_MAP_CS0_ADDR A:0xfc3c8420
y.create.l HWIO_BIMC_S_DDR0_SCMO_ADDR_MAP_CS1_ADDR A:0xfc3c8424
y.create.l HWIO_BIMC_S_DDR0_SCMO_ADDR_MASK_CS0_ADDR A:0xfc3c8430
y.create.l HWIO_BIMC_S_DDR0_SCMO_ADDR_MASK_CS1_ADDR A:0xfc3c8434
y.create.l HWIO_BIMC_S_DDR0_SCMO_SLV_STATUS_ADDR A:0xfc3c8450
y.create.l HWIO_BIMC_S_DDR0_SCMO_CMD_BUF_CFG_ADDR A:0xfc3c8500
y.create.l HWIO_BIMC_S_DDR0_SCMO_CMD_BUF_STATUS_ADDR A:0xfc3c8520
y.create.l HWIO_BIMC_S_DDR0_SCMO_RCH_SELECT_ADDR A:0xfc3c8540
y.create.l HWIO_BIMC_S_DDR0_SCMO_RCH_BKPR_CFG_ADDR A:0xfc3c8544
y.create.l HWIO_BIMC_S_DDR0_SCMO_RCH_STATUS_ADDR A:0xfc3c8560
y.create.l HWIO_BIMC_S_DDR0_SCMO_WCH_BUF_CFG_ADDR A:0xfc3c8580
y.create.l HWIO_BIMC_S_DDR0_SCMO_WCH_STATUS_ADDR A:0xfc3c85a0
y.create.l HWIO_BIMC_S_DDR0_SCMO_FLUSH_CFG_ADDR A:0xfc3c85c0
y.create.l HWIO_BIMC_S_DDR0_SCMO_FLUSH_CMD_ADDR A:0xfc3c85c4
y.create.l HWIO_BIMC_S_DDR0_SCMO_CMD_OPT_CFG0_ADDR A:0xfc3c8700
y.create.l HWIO_BIMC_S_DDR0_SCMO_CMD_OPT_CFG1_ADDR A:0xfc3c8704
y.create.l HWIO_BIMC_S_DDR0_SCMO_CMD_OPT_CFG2_ADDR A:0xfc3c8708
y.create.l HWIO_BIMC_S_DDR0_SCMO_CMD_OPT_CFG3_ADDR A:0xfc3c870c
y.create.l HWIO_BIMC_S_DDR0_XPU_SCR_ADDR A:0xfc3ca000
y.create.l HWIO_BIMC_S_DDR0_XPU_SWDR_ADDR A:0xfc3ca004
y.create.l HWIO_BIMC_S_DDR0_XPU_PRTN_RACR_SSHADOW_ADDR A:0xfc3ca008
y.create.l HWIO_BIMC_S_DDR0_XPU_PRTN_WACR_SSHADOW_ADDR A:0xfc3ca00c
y.create.l HWIO_BIMC_S_DDR0_XPU_PRTN_START_SSHADOW0_ADDR A:0xfc3ca010
y.create.l HWIO_BIMC_S_DDR0_XPU_PRTN_END_SSHADOW0_ADDR A:0xfc3ca018
y.create.l HWIO_BIMC_S_DDR0_XPU_SEAR0_ADDR A:0xfc3ca040
y.create.l HWIO_BIMC_S_DDR0_XPU_SESR_ADDR A:0xfc3ca048
y.create.l HWIO_BIMC_S_DDR0_XPU_SESRRESTORE_ADDR A:0xfc3ca04c
y.create.l HWIO_BIMC_S_DDR0_XPU_SESYNR0_ADDR A:0xfc3ca050
y.create.l HWIO_BIMC_S_DDR0_XPU_SESYNR1_ADDR A:0xfc3ca054
y.create.l HWIO_BIMC_S_DDR0_XPU_SESYNR2_ADDR A:0xfc3ca058
y.create.l HWIO_BIMC_S_DDR0_XPU_MCR_ADDR A:0xfc3ca100
y.create.l HWIO_BIMC_S_DDR0_XPU_MEAR0_ADDR A:0xfc3ca140
y.create.l HWIO_BIMC_S_DDR0_XPU_MESR_ADDR A:0xfc3ca148
y.create.l HWIO_BIMC_S_DDR0_XPU_MESRRESTORE_ADDR A:0xfc3ca14c
y.create.l HWIO_BIMC_S_DDR0_XPU_MESYNR0_ADDR A:0xfc3ca150
y.create.l HWIO_BIMC_S_DDR0_XPU_MESYNR1_ADDR A:0xfc3ca154
y.create.l HWIO_BIMC_S_DDR0_XPU_MESYNR2_ADDR A:0xfc3ca158
y.create.l HWIO_BIMC_S_DDR0_XPU_CR_ADDR A:0xfc3ca080
y.create.l HWIO_BIMC_S_DDR0_XPU_PRTN_RACR_SHADOW_ADDR A:0xfc3ca088
y.create.l HWIO_BIMC_S_DDR0_XPU_PRTN_WACR_SHADOW_ADDR A:0xfc3ca08c
y.create.l HWIO_BIMC_S_DDR0_XPU_PRTN_START_SHADOW0_ADDR A:0xfc3ca090
y.create.l HWIO_BIMC_S_DDR0_XPU_PRTN_END_SHADOW0_ADDR A:0xfc3ca098
y.create.l HWIO_BIMC_S_DDR0_XPU_RPU_ACR0_ADDR A:0xfc3ca0a0
y.create.l HWIO_BIMC_S_DDR0_XPU_EAR0_ADDR A:0xfc3ca0c0
y.create.l HWIO_BIMC_S_DDR0_XPU_ESR_ADDR A:0xfc3ca0c8
y.create.l HWIO_BIMC_S_DDR0_XPU_ESRRESTORE_ADDR A:0xfc3ca0cc
y.create.l HWIO_BIMC_S_DDR0_XPU_ESYNR0_ADDR A:0xfc3ca0d0
y.create.l HWIO_BIMC_S_DDR0_XPU_ESYNR1_ADDR A:0xfc3ca0d4
y.create.l HWIO_BIMC_S_DDR0_XPU_ESYNR2_ADDR A:0xfc3ca0d8
y.create.l HWIO_BIMC_S_DDR0_XPU_UMR_RACR_ADDR A:0xfc3ca0e0
y.create.l HWIO_BIMC_S_DDR0_XPU_UMR_WACR_ADDR A:0xfc3ca0e4
y.create.l HWIO_BIMC_S_DDR0_XPU_IDR0_ADDR A:0xfc3ca074
y.create.l HWIO_BIMC_S_DDR0_XPU_IDR1_ADDR A:0xfc3ca078
y.create.l HWIO_BIMC_S_DDR0_XPU_REV_ADDR A:0xfc3ca07c
y.create.l HWIO_BIMC_S_DDR0_XPU_PRT0_RACR0_ADDR A:0xfc3ca200
y.create.l HWIO_BIMC_S_DDR0_XPU_PRT1_RACR0_ADDR A:0xfc3ca280
y.create.l HWIO_BIMC_S_DDR0_XPU_PRT2_RACR0_ADDR A:0xfc3ca300
y.create.l HWIO_BIMC_S_DDR0_XPU_PRT3_RACR0_ADDR A:0xfc3ca380
y.create.l HWIO_BIMC_S_DDR0_XPU_PRT4_RACR0_ADDR A:0xfc3ca400
y.create.l HWIO_BIMC_S_DDR0_XPU_PRT5_RACR0_ADDR A:0xfc3ca480
y.create.l HWIO_BIMC_S_DDR0_XPU_PRT6_RACR0_ADDR A:0xfc3ca500
y.create.l HWIO_BIMC_S_DDR0_XPU_PRT7_RACR0_ADDR A:0xfc3ca580
y.create.l HWIO_BIMC_S_DDR0_XPU_PRT8_RACR0_ADDR A:0xfc3ca600
y.create.l HWIO_BIMC_S_DDR0_XPU_PRT9_RACR0_ADDR A:0xfc3ca680
y.create.l HWIO_BIMC_S_DDR0_XPU_PRT0_WACR0_ADDR A:0xfc3ca220
y.create.l HWIO_BIMC_S_DDR0_XPU_PRT1_WACR0_ADDR A:0xfc3ca2a0
y.create.l HWIO_BIMC_S_DDR0_XPU_PRT2_WACR0_ADDR A:0xfc3ca320
y.create.l HWIO_BIMC_S_DDR0_XPU_PRT3_WACR0_ADDR A:0xfc3ca3a0
y.create.l HWIO_BIMC_S_DDR0_XPU_PRT4_WACR0_ADDR A:0xfc3ca420
y.create.l HWIO_BIMC_S_DDR0_XPU_PRT5_WACR0_ADDR A:0xfc3ca4a0
y.create.l HWIO_BIMC_S_DDR0_XPU_PRT6_WACR0_ADDR A:0xfc3ca520
y.create.l HWIO_BIMC_S_DDR0_XPU_PRT7_WACR0_ADDR A:0xfc3ca5a0
y.create.l HWIO_BIMC_S_DDR0_XPU_PRT8_WACR0_ADDR A:0xfc3ca620
y.create.l HWIO_BIMC_S_DDR0_XPU_PRT9_WACR0_ADDR A:0xfc3ca6a0
y.create.l HWIO_BIMC_S_DDR0_XPU_PRT0_START0_ADDR A:0xfc3ca240
y.create.l HWIO_BIMC_S_DDR0_XPU_PRT1_START0_ADDR A:0xfc3ca2c0
y.create.l HWIO_BIMC_S_DDR0_XPU_PRT2_START0_ADDR A:0xfc3ca340
y.create.l HWIO_BIMC_S_DDR0_XPU_PRT3_START0_ADDR A:0xfc3ca3c0
y.create.l HWIO_BIMC_S_DDR0_XPU_PRT4_START0_ADDR A:0xfc3ca440
y.create.l HWIO_BIMC_S_DDR0_XPU_PRT5_START0_ADDR A:0xfc3ca4c0
y.create.l HWIO_BIMC_S_DDR0_XPU_PRT6_START0_ADDR A:0xfc3ca540
y.create.l HWIO_BIMC_S_DDR0_XPU_PRT7_START0_ADDR A:0xfc3ca5c0
y.create.l HWIO_BIMC_S_DDR0_XPU_PRT8_START0_ADDR A:0xfc3ca640
y.create.l HWIO_BIMC_S_DDR0_XPU_PRT9_START0_ADDR A:0xfc3ca6c0
y.create.l HWIO_BIMC_S_DDR0_XPU_PRT0_END0_ADDR A:0xfc3ca248
y.create.l HWIO_BIMC_S_DDR0_XPU_PRT1_END0_ADDR A:0xfc3ca2c8
y.create.l HWIO_BIMC_S_DDR0_XPU_PRT2_END0_ADDR A:0xfc3ca348
y.create.l HWIO_BIMC_S_DDR0_XPU_PRT3_END0_ADDR A:0xfc3ca3c8
y.create.l HWIO_BIMC_S_DDR0_XPU_PRT4_END0_ADDR A:0xfc3ca448
y.create.l HWIO_BIMC_S_DDR0_XPU_PRT5_END0_ADDR A:0xfc3ca4c8
y.create.l HWIO_BIMC_S_DDR0_XPU_PRT6_END0_ADDR A:0xfc3ca548
y.create.l HWIO_BIMC_S_DDR0_XPU_PRT7_END0_ADDR A:0xfc3ca5c8
y.create.l HWIO_BIMC_S_DDR0_XPU_PRT8_END0_ADDR A:0xfc3ca648
y.create.l HWIO_BIMC_S_DDR0_XPU_PRT9_END0_ADDR A:0xfc3ca6c8
y.create.l HWIO_BIMC_S_DDR0_XPU_PRT0_SCR_ADDR A:0xfc3ca250
y.create.l HWIO_BIMC_S_DDR0_XPU_PRT1_SCR_ADDR A:0xfc3ca2d0
y.create.l HWIO_BIMC_S_DDR0_XPU_PRT2_SCR_ADDR A:0xfc3ca350
y.create.l HWIO_BIMC_S_DDR0_XPU_PRT3_SCR_ADDR A:0xfc3ca3d0
y.create.l HWIO_BIMC_S_DDR0_XPU_PRT4_SCR_ADDR A:0xfc3ca450
y.create.l HWIO_BIMC_S_DDR0_XPU_PRT5_SCR_ADDR A:0xfc3ca4d0
y.create.l HWIO_BIMC_S_DDR0_XPU_PRT6_SCR_ADDR A:0xfc3ca550
y.create.l HWIO_BIMC_S_DDR0_XPU_PRT7_SCR_ADDR A:0xfc3ca5d0
y.create.l HWIO_BIMC_S_DDR0_XPU_PRT8_SCR_ADDR A:0xfc3ca650
y.create.l HWIO_BIMC_S_DDR0_XPU_PRT9_SCR_ADDR A:0xfc3ca6d0
y.create.l HWIO_BIMC_S_DDR0_XPU_PRT0_MCR_ADDR A:0xfc3ca254
y.create.l HWIO_BIMC_S_DDR0_XPU_PRT1_MCR_ADDR A:0xfc3ca2d4
y.create.l HWIO_BIMC_S_DDR0_XPU_PRT2_MCR_ADDR A:0xfc3ca354
y.create.l HWIO_BIMC_S_DDR0_XPU_PRT3_MCR_ADDR A:0xfc3ca3d4
y.create.l HWIO_BIMC_S_DDR0_XPU_PRT4_MCR_ADDR A:0xfc3ca454
y.create.l HWIO_BIMC_S_DDR0_XPU_PRT5_MCR_ADDR A:0xfc3ca4d4
y.create.l HWIO_BIMC_S_DDR0_XPU_PRT6_MCR_ADDR A:0xfc3ca554
y.create.l HWIO_BIMC_S_DDR0_XPU_PRT7_MCR_ADDR A:0xfc3ca5d4
y.create.l HWIO_BIMC_S_DDR0_XPU_PRT8_MCR_ADDR A:0xfc3ca654
y.create.l HWIO_BIMC_S_DDR0_XPU_PRT9_MCR_ADDR A:0xfc3ca6d4
y.create.l HWIO_BIMC_S_DDR0_XPU_PRT0_CNTL0_ADDR A:0xfc3ca258
y.create.l HWIO_BIMC_S_DDR0_XPU_PRT1_CNTL0_ADDR A:0xfc3ca2d8
y.create.l HWIO_BIMC_S_DDR0_XPU_PRT2_CNTL0_ADDR A:0xfc3ca358
y.create.l HWIO_BIMC_S_DDR0_XPU_PRT3_CNTL0_ADDR A:0xfc3ca3d8
y.create.l HWIO_BIMC_S_DDR0_XPU_PRT4_CNTL0_ADDR A:0xfc3ca458
y.create.l HWIO_BIMC_S_DDR0_XPU_PRT5_CNTL0_ADDR A:0xfc3ca4d8
y.create.l HWIO_BIMC_S_DDR0_XPU_PRT6_CNTL0_ADDR A:0xfc3ca558
y.create.l HWIO_BIMC_S_DDR0_XPU_PRT7_CNTL0_ADDR A:0xfc3ca5d8
y.create.l HWIO_BIMC_S_DDR0_XPU_PRT8_CNTL0_ADDR A:0xfc3ca658
y.create.l HWIO_BIMC_S_DDR0_XPU_PRT9_CNTL0_ADDR A:0xfc3ca6d8
y.create.l HWIO_BIMC_S_DDR0_XPU_PRT0_CNTL1_ADDR A:0xfc3ca25c
y.create.l HWIO_BIMC_S_DDR0_XPU_PRT1_CNTL1_ADDR A:0xfc3ca2dc
y.create.l HWIO_BIMC_S_DDR0_XPU_PRT2_CNTL1_ADDR A:0xfc3ca35c
y.create.l HWIO_BIMC_S_DDR0_XPU_PRT3_CNTL1_ADDR A:0xfc3ca3dc
y.create.l HWIO_BIMC_S_DDR0_XPU_PRT4_CNTL1_ADDR A:0xfc3ca45c
y.create.l HWIO_BIMC_S_DDR0_XPU_PRT5_CNTL1_ADDR A:0xfc3ca4dc
y.create.l HWIO_BIMC_S_DDR0_XPU_PRT6_CNTL1_ADDR A:0xfc3ca55c
y.create.l HWIO_BIMC_S_DDR0_XPU_PRT7_CNTL1_ADDR A:0xfc3ca5dc
y.create.l HWIO_BIMC_S_DDR0_XPU_PRT8_CNTL1_ADDR A:0xfc3ca65c
y.create.l HWIO_BIMC_S_DDR0_XPU_PRT9_CNTL1_ADDR A:0xfc3ca6dc
y.create.l HWIO_BIMC_S_DDR0_XPU_AMT_RACR_ADDR A:0xfc3ca0e8
y.create.l HWIO_BIMC_S_DDR0_XPU_AMT_WACR_ADDR A:0xfc3ca0ec
y.create.l HWIO_BIMC_S_DDR0_XPU_AMTR0_ADDR A:0xfc3cae80
y.create.l HWIO_BIMC_S_DDR0_XPU_AMTR1_ADDR A:0xfc3cae84
y.create.l HWIO_BIMC_S_DDR0_XPU_AMTR2_ADDR A:0xfc3cae88
y.create.l HWIO_BIMC_S_DDR0_XPU_AMTR3_ADDR A:0xfc3cae8c
y.create.l HWIO_BIMC_S_DDR0_XPU_AMTR4_ADDR A:0xfc3cae90
y.create.l HWIO_BIMC_S_DDR0_XPU_AMTR5_ADDR A:0xfc3cae94
y.create.l HWIO_BIMC_S_DDR0_XPU_AMTR6_ADDR A:0xfc3cae98
y.create.l HWIO_BIMC_S_DDR0_XPU_AMTR7_ADDR A:0xfc3cae9c
y.create.l HWIO_BIMC_S_DDR0_XPU_AMTR8_ADDR A:0xfc3caea0
y.create.l HWIO_BIMC_S_DDR0_XPU_AMTR9_ADDR A:0xfc3caea4
y.create.l HWIO_BIMC_S_DDR0_DPE_HW_INFO_ADDR A:0xfc3cc000
y.create.l HWIO_BIMC_S_DDR0_DPE_CONFIG_0_ADDR A:0xfc3cc010
y.create.l HWIO_BIMC_S_DDR0_DPE_CONFIG_1_ADDR A:0xfc3cc014
y.create.l HWIO_BIMC_S_DDR0_DPE_CONFIG_2_ADDR A:0xfc3cc018
y.create.l HWIO_BIMC_S_DDR0_DPE_CONFIG_3_ADDR A:0xfc3cc01c
y.create.l HWIO_BIMC_S_DDR0_DPE_CONFIG_4_ADDR A:0xfc3cc020
y.create.l HWIO_BIMC_S_DDR0_DPE_CONFIG_5_ADDR A:0xfc3cc024
y.create.l HWIO_BIMC_S_DDR0_DPE_CONFIG_6_ADDR A:0xfc3cc028
y.create.l HWIO_BIMC_S_DDR0_DPE_CONFIG_7_ADDR A:0xfc3cc02c
y.create.l HWIO_BIMC_S_DDR0_DPE_CA_TRAIN_PRE_CS_ADDR A:0xfc3cc050
y.create.l HWIO_BIMC_S_DDR0_DPE_CA_TRAIN_CS_ADDR A:0xfc3cc054
y.create.l HWIO_BIMC_S_DDR0_DPE_CA_TRAIN_POST_CS_ADDR A:0xfc3cc058
y.create.l HWIO_BIMC_S_DDR0_DPE_PWR_CTRL_0_ADDR A:0xfc3cc068
y.create.l HWIO_BIMC_S_DDR0_DPE_OPT_CTRL_0_ADDR A:0xfc3cc078
y.create.l HWIO_BIMC_S_DDR0_DPE_OPT_CTRL_1_ADDR A:0xfc3cc07c
y.create.l HWIO_BIMC_S_DDR0_DPE_DRAM_STATUS_0_ADDR A:0xfc3cc08c
y.create.l HWIO_BIMC_S_DDR0_DPE_MEMC_STATUS_0_ADDR A:0xfc3cc09c
y.create.l HWIO_BIMC_S_DDR0_DPE_MEMC_STATUS_1_ADDR A:0xfc3cc0a0
y.create.l HWIO_BIMC_S_DDR0_DPE_MEMC_STATUS_2_ADDR A:0xfc3cc0a4
y.create.l HWIO_BIMC_S_DDR0_DPE_INTERRUPT_ENABLE_ADDR A:0xfc3cc0b4
y.create.l HWIO_BIMC_S_DDR0_DPE_INTERRUPT_STATUS_ADDR A:0xfc3cc0b8
y.create.l HWIO_BIMC_S_DDR0_DPE_INTERRUPT_CLR_ADDR A:0xfc3cc0bc
y.create.l HWIO_BIMC_S_DDR0_DPE_INTERRUPT_SET_ADDR A:0xfc3cc0c0
y.create.l HWIO_BIMC_S_DDR0_DPE_ELEVATE_PRI_RD_ADDR A:0xfc3cc0d0
y.create.l HWIO_BIMC_S_DDR0_DPE_ELEVATE_PRI_WR_ADDR A:0xfc3cc0d4
y.create.l HWIO_BIMC_S_DDR0_DPE_TIMER_0_ADDR A:0xfc3cc0e4
y.create.l HWIO_BIMC_S_DDR0_DPE_TIMER_1_ADDR A:0xfc3cc0e8
y.create.l HWIO_BIMC_S_DDR0_DPE_TIMER_2_ADDR A:0xfc3cc0ec
y.create.l HWIO_BIMC_S_DDR0_DPE_TIMER_3_ADDR A:0xfc3cc0f0
y.create.l HWIO_BIMC_S_DDR0_DPE_MRW_BEFORE_FREQ_SWITCH_0_ADDR A:0xfc3cc114
y.create.l HWIO_BIMC_S_DDR0_DPE_MRW_BEFORE_FREQ_SWITCH_1_ADDR A:0xfc3cc118
y.create.l HWIO_BIMC_S_DDR0_DPE_MRW_BEFORE_FREQ_SWITCH_2_ADDR A:0xfc3cc11c
y.create.l HWIO_BIMC_S_DDR0_DPE_MRW_BEFORE_FREQ_SWITCH_3_ADDR A:0xfc3cc120
y.create.l HWIO_BIMC_S_DDR0_DPE_MRW_AFTER_FREQ_SWITCH_0_ADDR A:0xfc3cc124
y.create.l HWIO_BIMC_S_DDR0_DPE_MRW_AFTER_FREQ_SWITCH_1_ADDR A:0xfc3cc128
y.create.l HWIO_BIMC_S_DDR0_DPE_MRW_AFTER_FREQ_SWITCH_2_ADDR A:0xfc3cc12c
y.create.l HWIO_BIMC_S_DDR0_DPE_MRW_AFTER_FREQ_SWITCH_3_ADDR A:0xfc3cc130
y.create.l HWIO_BIMC_S_DDR0_DPE_MRW_FREQ_SWITCH_ADDR A:0xfc3cc134
y.create.l HWIO_BIMC_S_DDR0_DPE_DRAM_TIMING_0_ADDR A:0xfc3cc144
y.create.l HWIO_BIMC_S_DDR0_DPE_DRAM_TIMING_1_ADDR A:0xfc3cc148
y.create.l HWIO_BIMC_S_DDR0_DPE_DRAM_TIMING_2_ADDR A:0xfc3cc14c
y.create.l HWIO_BIMC_S_DDR0_DPE_DRAM_TIMING_3_ADDR A:0xfc3cc150
y.create.l HWIO_BIMC_S_DDR0_DPE_DRAM_TIMING_4_ADDR A:0xfc3cc154
y.create.l HWIO_BIMC_S_DDR0_DPE_DRAM_TIMING_5_ADDR A:0xfc3cc158
y.create.l HWIO_BIMC_S_DDR0_DPE_DRAM_TIMING_6_ADDR A:0xfc3cc15c
y.create.l HWIO_BIMC_S_DDR0_DPE_DRAM_TIMING_7_ADDR A:0xfc3cc160
y.create.l HWIO_BIMC_S_DDR0_DPE_DRAM_TIMING_8_ADDR A:0xfc3cc164
y.create.l HWIO_BIMC_S_DDR0_DPE_DRAM_TIMING_9_ADDR A:0xfc3cc168
y.create.l HWIO_BIMC_S_DDR0_DPE_DRAM_TIMING_10_ADDR A:0xfc3cc16c
y.create.l HWIO_BIMC_S_DDR0_DPE_DRAM_TIMING_11_ADDR A:0xfc3cc170
y.create.l HWIO_BIMC_S_DDR0_DPE_DRAM_TIMING_12_ADDR A:0xfc3cc174
y.create.l HWIO_BIMC_S_DDR0_DPE_DRAM_TIMING_13_ADDR A:0xfc3cc178
y.create.l HWIO_BIMC_S_DDR0_DPE_DRAM_TIMING_14_ADDR A:0xfc3cc17c
y.create.l HWIO_BIMC_S_DDR0_DPE_DRAM_TIMING_15_ADDR A:0xfc3cc180
y.create.l HWIO_BIMC_S_DDR0_DPE_DRAM_TIMING_16_ADDR A:0xfc3cc184
y.create.l HWIO_BIMC_S_DDR0_DPE_DRAM_TIMING_17_ADDR A:0xfc3cc188
y.create.l HWIO_BIMC_S_DDR0_DPE_DRAM_TIMING_0_ACT_ADDR A:0xfc3cc1a4
y.create.l HWIO_BIMC_S_DDR0_DPE_DRAM_TIMING_1_ACT_ADDR A:0xfc3cc1a8
y.create.l HWIO_BIMC_S_DDR0_DPE_DRAM_TIMING_2_ACT_ADDR A:0xfc3cc1ac
y.create.l HWIO_BIMC_S_DDR0_DPE_DRAM_TIMING_3_ACT_ADDR A:0xfc3cc1b0
y.create.l HWIO_BIMC_S_DDR0_DPE_DRAM_TIMING_4_ACT_ADDR A:0xfc3cc1b4
y.create.l HWIO_BIMC_S_DDR0_DPE_DRAM_TIMING_5_ACT_ADDR A:0xfc3cc1b8
y.create.l HWIO_BIMC_S_DDR0_DPE_DRAM_TIMING_6_ACT_ADDR A:0xfc3cc1bc
y.create.l HWIO_BIMC_S_DDR0_DPE_DRAM_TIMING_7_ACT_ADDR A:0xfc3cc1c0
y.create.l HWIO_BIMC_S_DDR0_DPE_DRAM_TIMING_8_ACT_ADDR A:0xfc3cc1c4
y.create.l HWIO_BIMC_S_DDR0_DPE_DRAM_TIMING_9_ACT_ADDR A:0xfc3cc1c8
y.create.l HWIO_BIMC_S_DDR0_DPE_DRAM_TIMING_10_ACT_ADDR A:0xfc3cc1cc
y.create.l HWIO_BIMC_S_DDR0_DPE_DRAM_TIMING_11_ACT_ADDR A:0xfc3cc1d0
y.create.l HWIO_BIMC_S_DDR0_DPE_DRAM_TIMING_12_ACT_ADDR A:0xfc3cc1d4
y.create.l HWIO_BIMC_S_DDR0_DPE_DRAM_TIMING_13_ACT_ADDR A:0xfc3cc1d8
y.create.l HWIO_BIMC_S_DDR0_DPE_DRAM_TIMING_14_ACT_ADDR A:0xfc3cc1dc
y.create.l HWIO_BIMC_S_DDR0_DPE_DRAM_TIMING_15_ACT_ADDR A:0xfc3cc1e0
y.create.l HWIO_BIMC_S_DDR0_DPE_DRAM_TIMING_16_ACT_ADDR A:0xfc3cc1e4
y.create.l HWIO_BIMC_S_DDR0_DPE_DRAM_TIMING_17_ACT_ADDR A:0xfc3cc1e8
y.create.l HWIO_BIMC_S_DDR0_DPE_TESTBUS_CTRL_ADDR A:0xfc3cc204
y.create.l HWIO_BIMC_S_DDR0_DPE_SPARE_REG_ADDR A:0xfc3cc214
y.create.l HWIO_BIMC_S_DDR0_DPE_CGC_CTRL_ADDR A:0xfc3cc2fc
y.create.l HWIO_BIMC_S_DDR0_DPE_PMON_EN_ADDR A:0xfc3cc300
y.create.l HWIO_BIMC_S_DDR0_DPE_PMON_CFG_ADDR A:0xfc3cc304
y.create.l HWIO_BIMC_S_DDR0_DPE_PMON_CMD_QUEUED_0_ADDR A:0xfc3cc310
y.create.l HWIO_BIMC_S_DDR0_DPE_PMON_CMD_QUEUED_1_ADDR A:0xfc3cc314
y.create.l HWIO_BIMC_S_DDR0_DPE_PMON_CMD_QUEUED_2_ADDR A:0xfc3cc318
y.create.l HWIO_BIMC_S_DDR0_DPE_PMON_CMD_QUEUED_3_ADDR A:0xfc3cc31c
y.create.l HWIO_BIMC_S_DDR0_DPE_PMON_CMD_EXEC_0_ADDR A:0xfc3cc320
y.create.l HWIO_BIMC_S_DDR0_DPE_PMON_CMD_EXEC_1_ADDR A:0xfc3cc324
y.create.l HWIO_BIMC_S_DDR0_DPE_PMON_CMD_EXEC_2_ADDR A:0xfc3cc328
y.create.l HWIO_BIMC_S_DDR0_DPE_PMON_CMD_EXEC_3_ADDR A:0xfc3cc32c
y.create.l HWIO_BIMC_S_DDR0_DPE_PMON_CMD_FLTR_0_ADDR A:0xfc3cc330
y.create.l HWIO_BIMC_S_DDR0_DPE_PMON_CMD_FLTR_1_ADDR A:0xfc3cc334
y.create.l HWIO_BIMC_S_DDR0_DPE_PMON_CMD_FLTR_2_ADDR A:0xfc3cc338
y.create.l HWIO_BIMC_S_DDR0_DPE_PMON_CMD_FLTR_3_ADDR A:0xfc3cc33c
y.create.l HWIO_BIMC_S_DDR0_DPE_PMON_ADDR_FLTR_0_ADDR A:0xfc3cc340
y.create.l HWIO_BIMC_S_DDR0_DPE_PMON_ADDR_FLTR_1_ADDR A:0xfc3cc344
y.create.l HWIO_BIMC_S_DDR0_DPE_PMON_ADDR_FLTR_2_ADDR A:0xfc3cc348
y.create.l HWIO_BIMC_S_DDR0_DPE_PMON_ADDR_FLTR_3_ADDR A:0xfc3cc34c
y.create.l HWIO_BIMC_S_DDR0_DPE_PMON_MID_FLTR_0_ADDR A:0xfc3cc350
y.create.l HWIO_BIMC_S_DDR0_DPE_PMON_MID_FLTR_1_ADDR A:0xfc3cc354
y.create.l HWIO_BIMC_S_DDR0_DPE_PMON_LAT_LIM_0_ADDR A:0xfc3cc360
y.create.l HWIO_BIMC_S_DDR0_DPE_PMON_LAT_LIM_1_ADDR A:0xfc3cc364
y.create.l HWIO_BIMC_S_DDR0_DPE_PMON_LAT_LIM_2_ADDR A:0xfc3cc368
y.create.l HWIO_BIMC_S_DDR0_DPE_PMON_LAT_LIM_3_ADDR A:0xfc3cc36c
y.create.l HWIO_BIMC_S_DDR0_DPE_PMON_PRI_FLTR_0_ADDR A:0xfc3cc370
y.create.l HWIO_BIMC_S_DDR0_DPE_PMON_PRI_FLTR_1_ADDR A:0xfc3cc374
y.create.l HWIO_BIMC_S_DDR0_DPE_PMON_PRI_FLTR_2_ADDR A:0xfc3cc378
y.create.l HWIO_BIMC_S_DDR0_DPE_PMON_PRI_FLTR_3_ADDR A:0xfc3cc37c
y.create.l HWIO_BIMC_S_DDR0_DPE_PMON_CMDQ_0_ADDR A:0xfc3cc380
y.create.l HWIO_BIMC_S_DDR0_DPE_PMON_CMDQ_1_ADDR A:0xfc3cc384
y.create.l HWIO_BIMC_S_DDR0_DPE_PMON_WRBUF_0_ADDR A:0xfc3cc388
y.create.l HWIO_BIMC_S_DDR0_DPE_PMON_WRBUF_1_ADDR A:0xfc3cc38c
y.create.l HWIO_BIMC_S_DDR0_DPE_PMON_DDR_CMD_0_ADDR A:0xfc3cc390
y.create.l HWIO_BIMC_S_DDR0_DPE_PMON_DDR_CMD_1_ADDR A:0xfc3cc394
y.create.l HWIO_BIMC_S_DDR0_DPE_PMON_DDR_CMD_2_ADDR A:0xfc3cc398
y.create.l HWIO_BIMC_S_DDR0_DPE_PMON_DDR_CMD_3_ADDR A:0xfc3cc39c
y.create.l HWIO_BIMC_S_DDR0_DPE_PMON_DDR_DATA_0_ADDR A:0xfc3cc3a0
y.create.l HWIO_BIMC_S_DDR0_DPE_PMON_DDR_DATA_1_ADDR A:0xfc3cc3a4
y.create.l HWIO_BIMC_S_DDR0_DPE_PMON_RANK_STATE_0_ADDR A:0xfc3cc3b0
y.create.l HWIO_BIMC_S_DDR0_DPE_PMON_RANK_STATE_1_ADDR A:0xfc3cc3b4
y.create.l HWIO_BIMC_S_DDR0_DPE_PMON_RANK_STATE_2_ADDR A:0xfc3cc3b8
y.create.l HWIO_BIMC_S_DDR0_DPE_PMON_RANK_STATE_3_ADDR A:0xfc3cc3bc
y.create.l HWIO_BIMC_S_DDR0_DPE_PMON_SHKE_0_ADDR A:0xfc3cc3c0
y.create.l HWIO_BIMC_S_DDR0_DPE_PMON_SHKE_1_ADDR A:0xfc3cc3c4
y.create.l HWIO_BIMC_S_DDR0_DPE_PMON_SHKE_2_ADDR A:0xfc3cc3c8
y.create.l HWIO_BIMC_S_DDR0_DPE_PMON_SHKE_3_ADDR A:0xfc3cc3cc
y.create.l HWIO_BIMC_S_DDR0_DPE_PMON_SHKE_4_ADDR A:0xfc3cc3d0
y.create.l HWIO_BIMC_S_DDR0_DPE_PMON_SHKE_5_ADDR A:0xfc3cc3d4
y.create.l HWIO_BIMC_S_DDR0_DPE_PMON_SHKE_6_ADDR A:0xfc3cc3d8
y.create.l HWIO_BIMC_S_DDR0_DPE_PMON_SHKE_7_ADDR A:0xfc3cc3dc
y.create.l HWIO_BIMC_S_DDR0_SHKE_HW_INFO_ADDR A:0xfc3cd000
y.create.l HWIO_BIMC_S_DDR0_SHKE_CONFIG_ADDR A:0xfc3cd004
y.create.l HWIO_BIMC_S_DDR0_SHKE_CGC_CNTL_ADDR A:0xfc3cd010
y.create.l HWIO_BIMC_S_DDR0_SHKE_DRAM_MANUAL_0_ADDR A:0xfc3cd020
y.create.l HWIO_BIMC_S_DDR0_SHKE_DRAM_MANUAL_1_ADDR A:0xfc3cd024
y.create.l HWIO_BIMC_S_DDR0_SHKE_MREG_ADDR_WDATA_CNTL_ADDR A:0xfc3cd030
y.create.l HWIO_BIMC_S_DDR0_SHKE_MREG_RDATA_RANK1_U_ADDR A:0xfc3cd050
y.create.l HWIO_BIMC_S_DDR0_SHKE_MREG_RDATA_RANK1_L_ADDR A:0xfc3cd054
y.create.l HWIO_BIMC_S_DDR0_SHKE_MREG_RDATA_RANK0_U_ADDR A:0xfc3cd060
y.create.l HWIO_BIMC_S_DDR0_SHKE_MREG_RDATA_RANK0_L_ADDR A:0xfc3cd064
y.create.l HWIO_BIMC_S_DDR0_SHKE_MREG_RDATA_STATUS_ADDR A:0xfc3cd070
y.create.l HWIO_BIMC_S_DDR0_SHKE_DRAM_STATUS_ADDR A:0xfc3cd074
y.create.l HWIO_BIMC_S_DDR0_SHKE_DRAM_DEBUG_CMD_0_ADDR A:0xfc3cd080
y.create.l HWIO_BIMC_S_DDR0_SHKE_DRAM_DEBUG_CMD_1_ADDR A:0xfc3cd084
y.create.l HWIO_BIMC_S_DDR0_SHKE_DRAM_DEBUG_CMD_2_ADDR A:0xfc3cd088
y.create.l HWIO_BIMC_S_DDR0_SHKE_PERIODIC_MRR_ADDR A:0xfc3cd0a0
y.create.l HWIO_BIMC_S_DDR0_SHKE_PERIODIC_MRR_RDATA_RANK1_U_ADDR A:0xfc3cd0b0
y.create.l HWIO_BIMC_S_DDR0_SHKE_PERIODIC_MRR_RDATA_RANK1_L_ADDR A:0xfc3cd0b4
y.create.l HWIO_BIMC_S_DDR0_SHKE_PERIODIC_MRR_RDATA_RANK0_U_ADDR A:0xfc3cd0b8
y.create.l HWIO_BIMC_S_DDR0_SHKE_PERIODIC_MRR_RDATA_RANK0_L_ADDR A:0xfc3cd0bc
y.create.l HWIO_BIMC_S_DDR0_SHKE_PERIODIC_ZQCAL_ADDR A:0xfc3cd0d0
y.create.l HWIO_BIMC_S_DDR0_SHKE_AUTO_REFRESH_CNTL_ADDR A:0xfc3cd0f0
y.create.l HWIO_BIMC_S_DDR0_SHKE_SELF_REFRESH_CNTL_ADDR A:0xfc3cd0f4
y.create.l HWIO_BIMC_S_DDR0_SHKE_TESTBUS_CNTL_ADDR A:0xfc3cd114
y.create.l HWIO_BIMC_S_DDR0_SHKE_SPARE_REG_ADDR A:0xfc3cd130
y.create.l HWIO_BOOT_ROM_XPU_SCR_ADDR A:0xfc0ff000
y.create.l HWIO_BOOT_ROM_XPU_SWDR_ADDR A:0xfc0ff004
y.create.l HWIO_BOOT_ROM_XPU_PRTN_RACR_SSHADOW_ADDR A:0xfc0ff008
y.create.l HWIO_BOOT_ROM_XPU_PRTN_START_SSHADOW0_ADDR A:0xfc0ff010
y.create.l HWIO_BOOT_ROM_XPU_PRTN_END_SSHADOW0_ADDR A:0xfc0ff018
y.create.l HWIO_BOOT_ROM_XPU_SEAR0_ADDR A:0xfc0ff040
y.create.l HWIO_BOOT_ROM_XPU_SESR_ADDR A:0xfc0ff048
y.create.l HWIO_BOOT_ROM_XPU_SESRRESTORE_ADDR A:0xfc0ff04c
y.create.l HWIO_BOOT_ROM_XPU_SESYNR0_ADDR A:0xfc0ff050
y.create.l HWIO_BOOT_ROM_XPU_SESYNR1_ADDR A:0xfc0ff054
y.create.l HWIO_BOOT_ROM_XPU_SESYNR2_ADDR A:0xfc0ff058
y.create.l HWIO_BOOT_ROM_XPU_MCR_ADDR A:0xfc0ff100
y.create.l HWIO_BOOT_ROM_XPU_MEAR0_ADDR A:0xfc0ff140
y.create.l HWIO_BOOT_ROM_XPU_MESR_ADDR A:0xfc0ff148
y.create.l HWIO_BOOT_ROM_XPU_MESRRESTORE_ADDR A:0xfc0ff14c
y.create.l HWIO_BOOT_ROM_XPU_MESYNR0_ADDR A:0xfc0ff150
y.create.l HWIO_BOOT_ROM_XPU_MESYNR1_ADDR A:0xfc0ff154
y.create.l HWIO_BOOT_ROM_XPU_MESYNR2_ADDR A:0xfc0ff158
y.create.l HWIO_BOOT_ROM_XPU_CR_ADDR A:0xfc0ff080
y.create.l HWIO_BOOT_ROM_XPU_PRTN_RACR_SHADOW_ADDR A:0xfc0ff088
y.create.l HWIO_BOOT_ROM_XPU_PRTN_START_SHADOW0_ADDR A:0xfc0ff090
y.create.l HWIO_BOOT_ROM_XPU_PRTN_END_SHADOW0_ADDR A:0xfc0ff098
y.create.l HWIO_BOOT_ROM_XPU_RPU_ACR0_ADDR A:0xfc0ff0a0
y.create.l HWIO_BOOT_ROM_XPU_EAR0_ADDR A:0xfc0ff0c0
y.create.l HWIO_BOOT_ROM_XPU_ESR_ADDR A:0xfc0ff0c8
y.create.l HWIO_BOOT_ROM_XPU_ESRRESTORE_ADDR A:0xfc0ff0cc
y.create.l HWIO_BOOT_ROM_XPU_ESYNR0_ADDR A:0xfc0ff0d0
y.create.l HWIO_BOOT_ROM_XPU_ESYNR1_ADDR A:0xfc0ff0d4
y.create.l HWIO_BOOT_ROM_XPU_ESYNR2_ADDR A:0xfc0ff0d8
y.create.l HWIO_BOOT_ROM_XPU_UMR_RACR_ADDR A:0xfc0ff0e0
y.create.l HWIO_BOOT_ROM_XPU_UMR_WACR_ADDR A:0xfc0ff0e4
y.create.l HWIO_BOOT_ROM_XPU_IDR0_ADDR A:0xfc0ff074
y.create.l HWIO_BOOT_ROM_XPU_IDR1_ADDR A:0xfc0ff078
y.create.l HWIO_BOOT_ROM_XPU_REV_ADDR A:0xfc0ff07c
y.create.l HWIO_BOOT_ROM_XPU_PRT0_RACR0_ADDR A:0xfc0ff200
y.create.l HWIO_BOOT_ROM_XPU_PRT1_RACR0_ADDR A:0xfc0ff280
y.create.l HWIO_BOOT_ROM_XPU_PRT2_RACR0_ADDR A:0xfc0ff300
y.create.l HWIO_BOOT_ROM_XPU_PRT3_RACR0_ADDR A:0xfc0ff380
y.create.l HWIO_BOOT_ROM_XPU_PRT0_START0_ADDR A:0xfc0ff240
y.create.l HWIO_BOOT_ROM_XPU_PRT1_START0_ADDR A:0xfc0ff2c0
y.create.l HWIO_BOOT_ROM_XPU_PRT2_START0_ADDR A:0xfc0ff340
y.create.l HWIO_BOOT_ROM_XPU_PRT3_START0_ADDR A:0xfc0ff3c0
y.create.l HWIO_BOOT_ROM_XPU_PRT0_END0_ADDR A:0xfc0ff248
y.create.l HWIO_BOOT_ROM_XPU_PRT1_END0_ADDR A:0xfc0ff2c8
y.create.l HWIO_BOOT_ROM_XPU_PRT2_END0_ADDR A:0xfc0ff348
y.create.l HWIO_BOOT_ROM_XPU_PRT3_END0_ADDR A:0xfc0ff3c8
y.create.l HWIO_BOOT_ROM_XPU_PRT0_SCR_ADDR A:0xfc0ff250
y.create.l HWIO_BOOT_ROM_XPU_PRT1_SCR_ADDR A:0xfc0ff2d0
y.create.l HWIO_BOOT_ROM_XPU_PRT2_SCR_ADDR A:0xfc0ff350
y.create.l HWIO_BOOT_ROM_XPU_PRT3_SCR_ADDR A:0xfc0ff3d0
y.create.l HWIO_BOOT_ROM_XPU_PRT0_MCR_ADDR A:0xfc0ff254
y.create.l HWIO_BOOT_ROM_XPU_PRT1_MCR_ADDR A:0xfc0ff2d4
y.create.l HWIO_BOOT_ROM_XPU_PRT2_MCR_ADDR A:0xfc0ff354
y.create.l HWIO_BOOT_ROM_XPU_PRT3_MCR_ADDR A:0xfc0ff3d4
y.create.l HWIO_BOOT_ROM_XPU_PRT0_CNTL0_ADDR A:0xfc0ff258
y.create.l HWIO_BOOT_ROM_XPU_PRT1_CNTL0_ADDR A:0xfc0ff2d8
y.create.l HWIO_BOOT_ROM_XPU_PRT2_CNTL0_ADDR A:0xfc0ff358
y.create.l HWIO_BOOT_ROM_XPU_PRT3_CNTL0_ADDR A:0xfc0ff3d8
y.create.l HWIO_BOOT_ROM_XPU_PRT0_CNTL1_ADDR A:0xfc0ff25c
y.create.l HWIO_BOOT_ROM_XPU_PRT1_CNTL1_ADDR A:0xfc0ff2dc
y.create.l HWIO_BOOT_ROM_XPU_PRT2_CNTL1_ADDR A:0xfc0ff35c
y.create.l HWIO_BOOT_ROM_XPU_PRT3_CNTL1_ADDR A:0xfc0ff3dc
y.create.l HWIO_GCC_GPLL0_MODE_ADDR A:0xfc400000
y.create.l HWIO_GCC_GPLL0_L_VAL_ADDR A:0xfc400004
y.create.l HWIO_GCC_GPLL0_M_VAL_ADDR A:0xfc400008
y.create.l HWIO_GCC_GPLL0_N_VAL_ADDR A:0xfc40000c
y.create.l HWIO_GCC_GPLL0_USER_CTL_ADDR A:0xfc400010
y.create.l HWIO_GCC_GPLL0_CONFIG_CTL_ADDR A:0xfc400014
y.create.l HWIO_GCC_GPLL0_TEST_CTL_ADDR A:0xfc400018
y.create.l HWIO_GCC_GPLL0_STATUS_ADDR A:0xfc40001c
y.create.l HWIO_GCC_GPLL1_MODE_ADDR A:0xfc400040
y.create.l HWIO_GCC_GPLL1_L_VAL_ADDR A:0xfc400044
y.create.l HWIO_GCC_GPLL1_M_VAL_ADDR A:0xfc400048
y.create.l HWIO_GCC_GPLL1_N_VAL_ADDR A:0xfc40004c
y.create.l HWIO_GCC_GPLL1_USER_CTL_ADDR A:0xfc400050
y.create.l HWIO_GCC_GPLL1_CONFIG_CTL_ADDR A:0xfc400054
y.create.l HWIO_GCC_GPLL1_TEST_CTL_ADDR A:0xfc400058
y.create.l HWIO_GCC_GPLL1_STATUS_ADDR A:0xfc40005c
y.create.l HWIO_GCC_GPLL2_MODE_ADDR A:0xfc400080
y.create.l HWIO_GCC_GPLL2_L_VAL_ADDR A:0xfc400084
y.create.l HWIO_GCC_GPLL2_M_VAL_ADDR A:0xfc400088
y.create.l HWIO_GCC_GPLL2_N_VAL_ADDR A:0xfc40008c
y.create.l HWIO_GCC_GPLL2_USER_CTL_ADDR A:0xfc400090
y.create.l HWIO_GCC_GPLL2_CONFIG_CTL_ADDR A:0xfc400094
y.create.l HWIO_GCC_GPLL2_TEST_CTL_ADDR A:0xfc400098
y.create.l HWIO_GCC_GPLL2_STATUS_ADDR A:0xfc40009c
y.create.l HWIO_GCC_GPLL3_MODE_ADDR A:0xfc4000c0
y.create.l HWIO_GCC_GPLL3_L_VAL_ADDR A:0xfc4000c4
y.create.l HWIO_GCC_GPLL3_M_VAL_ADDR A:0xfc4000c8
y.create.l HWIO_GCC_GPLL3_N_VAL_ADDR A:0xfc4000cc
y.create.l HWIO_GCC_GPLL3_USER_CTL_ADDR A:0xfc4000d0
y.create.l HWIO_GCC_GPLL3_CONFIG_CTL_ADDR A:0xfc4000d4
y.create.l HWIO_GCC_GPLL3_TEST_CTL_ADDR A:0xfc4000d8
y.create.l HWIO_GCC_GPLL3_STATUS_ADDR A:0xfc4000dc
y.create.l HWIO_GCC_SYSTEM_NOC_BCR_ADDR A:0xfc400100
y.create.l HWIO_GCC_SYSTEM_NOC_CMD_RCGR_ADDR A:0xfc400120
y.create.l HWIO_GCC_SYSTEM_NOC_CFG_RCGR_ADDR A:0xfc400124
y.create.l HWIO_GCC_CONFIG_NOC_CMD_RCGR_ADDR A:0xfc400150
y.create.l HWIO_GCC_CONFIG_NOC_CFG_RCGR_ADDR A:0xfc400154
y.create.l HWIO_GCC_PERIPH_NOC_CMD_RCGR_ADDR A:0xfc400190
y.create.l HWIO_GCC_PERIPH_NOC_CFG_RCGR_ADDR A:0xfc400194
y.create.l HWIO_GCC_SYS_NOC_AXI_CBCR_ADDR A:0xfc400104
y.create.l HWIO_GCC_SYS_NOC_QDSS_STM_AXI_CBCR_ADDR A:0xfc40010c
y.create.l HWIO_GCC_SYS_NOC_KPSS_AHB_CBCR_ADDR A:0xfc400110
y.create.l HWIO_GCC_SNOC_CNOC_AHB_CBCR_ADDR A:0xfc400114
y.create.l HWIO_GCC_SNOC_PNOC_AHB_CBCR_ADDR A:0xfc400118
y.create.l HWIO_GCC_SYS_NOC_AT_CBCR_ADDR A:0xfc40011c
y.create.l HWIO_GCC_SYS_NOC_IPA_AXI_CBCR_ADDR A:0xfc400128
y.create.l HWIO_GCC_CONFIG_NOC_BCR_ADDR A:0xfc400140
y.create.l HWIO_GCC_CFG_NOC_AHB_CBCR_ADDR A:0xfc400144
y.create.l HWIO_GCC_CFG_NOC_DDR_CFG_CBCR_ADDR A:0xfc400148
y.create.l HWIO_GCC_CFG_NOC_RPM_AHB_CBCR_ADDR A:0xfc40014c
y.create.l HWIO_GCC_PERIPH_NOC_BCR_ADDR A:0xfc400180
y.create.l HWIO_GCC_PERIPH_NOC_AHB_CBCR_ADDR A:0xfc400184
y.create.l HWIO_GCC_PERIPH_NOC_CFG_AHB_CBCR_ADDR A:0xfc400188
y.create.l HWIO_GCC_PERIPH_NOC_AT_CBCR_ADDR A:0xfc40018c
y.create.l HWIO_GCC_NOC_CONF_XPU_AHB_CBCR_ADDR A:0xfc4001c0
y.create.l HWIO_GCC_IMEM_BCR_ADDR A:0xfc400200
y.create.l HWIO_GCC_IMEM_AXI_CBCR_ADDR A:0xfc400204
y.create.l HWIO_GCC_IMEM_CFG_AHB_CBCR_ADDR A:0xfc400208
y.create.l HWIO_GCC_MSS_CFG_AHB_CBCR_ADDR A:0xfc400280
y.create.l HWIO_GCC_MSS_Q6_BIMC_AXI_CBCR_ADDR A:0xfc400284
y.create.l HWIO_GCC_QDSS_RBCPR_XPU_AHB_CBCR_ADDR A:0xfc4002c0
y.create.l HWIO_GCC_QDSS_BCR_ADDR A:0xfc400300
y.create.l HWIO_GCC_QDSS_DAP_AHB_CBCR_ADDR A:0xfc400304
y.create.l HWIO_GCC_QDSS_CFG_AHB_CBCR_ADDR A:0xfc400308
y.create.l HWIO_GCC_QDSS_AT_CMD_RCGR_ADDR A:0xfc400340
y.create.l HWIO_GCC_QDSS_AT_CFG_RCGR_ADDR A:0xfc400344
y.create.l HWIO_GCC_QDSS_AT_CBCR_ADDR A:0xfc40030c
y.create.l HWIO_GCC_QDSS_ETR_USB_CBCR_ADDR A:0xfc400310
y.create.l HWIO_GCC_QDSS_STM_CMD_RCGR_ADDR A:0xfc400358
y.create.l HWIO_GCC_QDSS_STM_CFG_RCGR_ADDR A:0xfc40035c
y.create.l HWIO_GCC_QDSS_STM_CBCR_ADDR A:0xfc400314
y.create.l HWIO_GCC_QDSS_TRACECLKIN_CMD_RCGR_ADDR A:0xfc400380
y.create.l HWIO_GCC_QDSS_TRACECLKIN_CFG_RCGR_ADDR A:0xfc400384
y.create.l HWIO_GCC_QDSS_TRACECLKIN_CBCR_ADDR A:0xfc400318
y.create.l HWIO_GCC_QDSS_TSCTR_CMD_RCGR_ADDR A:0xfc400398
y.create.l HWIO_GCC_QDSS_TSCTR_CFG_RCGR_ADDR A:0xfc40039c
y.create.l HWIO_GCC_QDSS_TSCTR_DIV2_CBCR_ADDR A:0xfc40031c
y.create.l HWIO_GCC_QDSS_TSCTR_DIV3_CBCR_ADDR A:0xfc400320
y.create.l HWIO_GCC_QDSS_DAP_CBCR_ADDR A:0xfc400324
y.create.l HWIO_GCC_QDSS_TSCTR_DIV4_CBCR_ADDR A:0xfc400328
y.create.l HWIO_GCC_QDSS_TSCTR_DIV8_CBCR_ADDR A:0xfc40032c
y.create.l HWIO_GCC_QDSS_TSCTR_DIV16_CBCR_ADDR A:0xfc400330
y.create.l HWIO_GCC_GCC_SLEEP_CMD_RCGR_ADDR A:0xfc4010d0
y.create.l HWIO_GCC_USB_HS_HSIC_BCR_ADDR A:0xfc400400
y.create.l HWIO_GCC_USB_HS_HSIC_GDSCR_ADDR A:0xfc400404
y.create.l HWIO_GCC_USB_HSIC_AHB_CBCR_ADDR A:0xfc400408
y.create.l HWIO_GCC_USB_HSIC_SYSTEM_CMD_RCGR_ADDR A:0xfc40041c
y.create.l HWIO_GCC_USB_HSIC_SYSTEM_CFG_RCGR_ADDR A:0xfc400420
y.create.l HWIO_GCC_USB_HSIC_SYSTEM_CBCR_ADDR A:0xfc40040c
y.create.l HWIO_GCC_USB_HSIC_CMD_RCGR_ADDR A:0xfc400440
y.create.l HWIO_GCC_USB_HSIC_CFG_RCGR_ADDR A:0xfc400444
y.create.l HWIO_GCC_USB_HSIC_CBCR_ADDR A:0xfc400410
y.create.l HWIO_GCC_USB_HSIC_IO_CAL_CMD_RCGR_ADDR A:0xfc400458
y.create.l HWIO_GCC_USB_HSIC_IO_CAL_CFG_RCGR_ADDR A:0xfc40045c
y.create.l HWIO_GCC_USB_HSIC_IO_CAL_CBCR_ADDR A:0xfc400414
y.create.l HWIO_GCC_USB_HSIC_IO_CAL_SLEEP_CBCR_ADDR A:0xfc400418
y.create.l HWIO_GCC_USB_HSIC_XCVR_FS_CMD_RCGR_ADDR A:0xfc400424
y.create.l HWIO_GCC_USB_HSIC_XCVR_FS_CFG_RCGR_ADDR A:0xfc400428
y.create.l HWIO_GCC_USB_HSIC_XCVR_FS_CBCR_ADDR A:0xfc40042c
y.create.l HWIO_GCC_USB_HS_BCR_ADDR A:0xfc400480
y.create.l HWIO_GCC_USB_HS_SYSTEM_CBCR_ADDR A:0xfc400484
y.create.l HWIO_GCC_USB_HS_AHB_CBCR_ADDR A:0xfc400488
y.create.l HWIO_GCC_USB_HS_INACTIVITY_TIMERS_CBCR_ADDR A:0xfc40048c
y.create.l HWIO_GCC_USB_HS_SYSTEM_CMD_RCGR_ADDR A:0xfc400490
y.create.l HWIO_GCC_USB_HS_SYSTEM_CFG_RCGR_ADDR A:0xfc400494
y.create.l HWIO_GCC_USB2B_PHY_BCR_ADDR A:0xfc4004b0
y.create.l HWIO_GCC_USB2B_PHY_SLEEP_CBCR_ADDR A:0xfc4004b4
y.create.l HWIO_GCC_SDCC2_BCR_ADDR A:0xfc400500
y.create.l HWIO_GCC_SDCC2_APPS_CMD_RCGR_ADDR A:0xfc400510
y.create.l HWIO_GCC_SDCC2_APPS_CFG_RCGR_ADDR A:0xfc400514
y.create.l HWIO_GCC_SDCC2_APPS_M_ADDR A:0xfc400518
y.create.l HWIO_GCC_SDCC2_APPS_N_ADDR A:0xfc40051c
y.create.l HWIO_GCC_SDCC2_APPS_D_ADDR A:0xfc400520
y.create.l HWIO_GCC_SDCC2_APPS_CBCR_ADDR A:0xfc400504
y.create.l HWIO_GCC_SDCC2_AHB_CBCR_ADDR A:0xfc400508
y.create.l HWIO_GCC_SDCC2_INACTIVITY_TIMERS_CBCR_ADDR A:0xfc40050c
y.create.l HWIO_GCC_SDCC3_BCR_ADDR A:0xfc400540
y.create.l HWIO_GCC_SDCC3_APPS_CMD_RCGR_ADDR A:0xfc400550
y.create.l HWIO_GCC_SDCC3_APPS_CFG_RCGR_ADDR A:0xfc400554
y.create.l HWIO_GCC_SDCC3_APPS_M_ADDR A:0xfc400558
y.create.l HWIO_GCC_SDCC3_APPS_N_ADDR A:0xfc40055c
y.create.l HWIO_GCC_SDCC3_APPS_D_ADDR A:0xfc400560
y.create.l HWIO_GCC_SDCC3_APPS_CBCR_ADDR A:0xfc400544
y.create.l HWIO_GCC_SDCC3_AHB_CBCR_ADDR A:0xfc400548
y.create.l HWIO_GCC_SDCC3_INACTIVITY_TIMERS_CBCR_ADDR A:0xfc40054c
y.create.l HWIO_GCC_BLSP1_BCR_ADDR A:0xfc4005c0
y.create.l HWIO_GCC_BLSP1_SLEEP_CBCR_ADDR A:0xfc4005c8
y.create.l HWIO_GCC_BLSP1_AHB_CBCR_ADDR A:0xfc4005c4
y.create.l HWIO_GCC_BLSP1_QUP1_BCR_ADDR A:0xfc400640
y.create.l HWIO_GCC_BLSP1_QUP1_SPI_APPS_CBCR_ADDR A:0xfc400644
y.create.l HWIO_GCC_BLSP1_QUP1_I2C_APPS_CBCR_ADDR A:0xfc400648
y.create.l HWIO_GCC_BLSP1_QUP1_SPI_APPS_CMD_RCGR_ADDR A:0xfc40064c
y.create.l HWIO_GCC_BLSP1_QUP1_SPI_APPS_CFG_RCGR_ADDR A:0xfc400650
y.create.l HWIO_GCC_BLSP1_QUP1_SPI_APPS_M_ADDR A:0xfc400654
y.create.l HWIO_GCC_BLSP1_QUP1_SPI_APPS_N_ADDR A:0xfc400658
y.create.l HWIO_GCC_BLSP1_QUP1_SPI_APPS_D_ADDR A:0xfc40065c
y.create.l HWIO_GCC_BLSP1_UART1_BCR_ADDR A:0xfc400680
y.create.l HWIO_GCC_BLSP1_UART1_APPS_CBCR_ADDR A:0xfc400684
y.create.l HWIO_GCC_BLSP1_UART1_SIM_CBCR_ADDR A:0xfc400688
y.create.l HWIO_GCC_BLSP1_UART1_APPS_CMD_RCGR_ADDR A:0xfc40068c
y.create.l HWIO_GCC_BLSP1_UART1_APPS_CFG_RCGR_ADDR A:0xfc400690
y.create.l HWIO_GCC_BLSP1_UART1_APPS_M_ADDR A:0xfc400694
y.create.l HWIO_GCC_BLSP1_UART1_APPS_N_ADDR A:0xfc400698
y.create.l HWIO_GCC_BLSP1_UART1_APPS_D_ADDR A:0xfc40069c
y.create.l HWIO_GCC_BLSP1_QUP2_BCR_ADDR A:0xfc4006c0
y.create.l HWIO_GCC_BLSP1_QUP2_SPI_APPS_CBCR_ADDR A:0xfc4006c4
y.create.l HWIO_GCC_BLSP1_QUP2_I2C_APPS_CBCR_ADDR A:0xfc4006c8
y.create.l HWIO_GCC_BLSP1_QUP2_SPI_APPS_CMD_RCGR_ADDR A:0xfc4006cc
y.create.l HWIO_GCC_BLSP1_QUP2_SPI_APPS_CFG_RCGR_ADDR A:0xfc4006d0
y.create.l HWIO_GCC_BLSP1_QUP2_SPI_APPS_M_ADDR A:0xfc4006d4
y.create.l HWIO_GCC_BLSP1_QUP2_SPI_APPS_N_ADDR A:0xfc4006d8
y.create.l HWIO_GCC_BLSP1_QUP2_SPI_APPS_D_ADDR A:0xfc4006dc
y.create.l HWIO_GCC_BLSP1_UART2_BCR_ADDR A:0xfc400700
y.create.l HWIO_GCC_BLSP1_UART2_APPS_CBCR_ADDR A:0xfc400704
y.create.l HWIO_GCC_BLSP1_UART2_SIM_CBCR_ADDR A:0xfc400708
y.create.l HWIO_GCC_BLSP1_UART2_APPS_CMD_RCGR_ADDR A:0xfc40070c
y.create.l HWIO_GCC_BLSP1_UART2_APPS_CFG_RCGR_ADDR A:0xfc400710
y.create.l HWIO_GCC_BLSP1_UART2_APPS_M_ADDR A:0xfc400714
y.create.l HWIO_GCC_BLSP1_UART2_APPS_N_ADDR A:0xfc400718
y.create.l HWIO_GCC_BLSP1_UART2_APPS_D_ADDR A:0xfc40071c
y.create.l HWIO_GCC_BLSP1_QUP3_BCR_ADDR A:0xfc400740
y.create.l HWIO_GCC_BLSP1_QUP3_SPI_APPS_CBCR_ADDR A:0xfc400744
y.create.l HWIO_GCC_BLSP1_QUP3_I2C_APPS_CBCR_ADDR A:0xfc400748
y.create.l HWIO_GCC_BLSP1_QUP3_SPI_APPS_CMD_RCGR_ADDR A:0xfc40074c
y.create.l HWIO_GCC_BLSP1_QUP3_SPI_APPS_CFG_RCGR_ADDR A:0xfc400750
y.create.l HWIO_GCC_BLSP1_QUP3_SPI_APPS_M_ADDR A:0xfc400754
y.create.l HWIO_GCC_BLSP1_QUP3_SPI_APPS_N_ADDR A:0xfc400758
y.create.l HWIO_GCC_BLSP1_QUP3_SPI_APPS_D_ADDR A:0xfc40075c
y.create.l HWIO_GCC_BLSP1_UART3_BCR_ADDR A:0xfc400780
y.create.l HWIO_GCC_BLSP1_UART3_APPS_CBCR_ADDR A:0xfc400784
y.create.l HWIO_GCC_BLSP1_UART3_SIM_CBCR_ADDR A:0xfc400788
y.create.l HWIO_GCC_BLSP1_UART3_APPS_CMD_RCGR_ADDR A:0xfc40078c
y.create.l HWIO_GCC_BLSP1_UART3_APPS_CFG_RCGR_ADDR A:0xfc400790
y.create.l HWIO_GCC_BLSP1_UART3_APPS_M_ADDR A:0xfc400794
y.create.l HWIO_GCC_BLSP1_UART3_APPS_N_ADDR A:0xfc400798
y.create.l HWIO_GCC_BLSP1_UART3_APPS_D_ADDR A:0xfc40079c
y.create.l HWIO_GCC_BLSP1_QUP4_BCR_ADDR A:0xfc4007c0
y.create.l HWIO_GCC_BLSP1_QUP4_SPI_APPS_CBCR_ADDR A:0xfc4007c4
y.create.l HWIO_GCC_BLSP1_QUP4_I2C_APPS_CBCR_ADDR A:0xfc4007c8
y.create.l HWIO_GCC_BLSP1_QUP4_SPI_APPS_CMD_RCGR_ADDR A:0xfc4007cc
y.create.l HWIO_GCC_BLSP1_QUP4_SPI_APPS_CFG_RCGR_ADDR A:0xfc4007d0
y.create.l HWIO_GCC_BLSP1_QUP4_SPI_APPS_M_ADDR A:0xfc4007d4
y.create.l HWIO_GCC_BLSP1_QUP4_SPI_APPS_N_ADDR A:0xfc4007d8
y.create.l HWIO_GCC_BLSP1_QUP4_SPI_APPS_D_ADDR A:0xfc4007dc
y.create.l HWIO_GCC_BLSP1_UART4_BCR_ADDR A:0xfc400800
y.create.l HWIO_GCC_BLSP1_UART4_APPS_CBCR_ADDR A:0xfc400804
y.create.l HWIO_GCC_BLSP1_UART4_SIM_CBCR_ADDR A:0xfc400808
y.create.l HWIO_GCC_BLSP1_UART4_APPS_CMD_RCGR_ADDR A:0xfc40080c
y.create.l HWIO_GCC_BLSP1_UART4_APPS_CFG_RCGR_ADDR A:0xfc400810
y.create.l HWIO_GCC_BLSP1_UART4_APPS_M_ADDR A:0xfc400814
y.create.l HWIO_GCC_BLSP1_UART4_APPS_N_ADDR A:0xfc400818
y.create.l HWIO_GCC_BLSP1_UART4_APPS_D_ADDR A:0xfc40081c
y.create.l HWIO_GCC_BLSP1_QUP5_BCR_ADDR A:0xfc400840
y.create.l HWIO_GCC_BLSP1_QUP5_SPI_APPS_CBCR_ADDR A:0xfc400844
y.create.l HWIO_GCC_BLSP1_QUP5_I2C_APPS_CBCR_ADDR A:0xfc400848
y.create.l HWIO_GCC_BLSP1_QUP5_SPI_APPS_CMD_RCGR_ADDR A:0xfc40084c
y.create.l HWIO_GCC_BLSP1_QUP5_SPI_APPS_CFG_RCGR_ADDR A:0xfc400850
y.create.l HWIO_GCC_BLSP1_QUP5_SPI_APPS_M_ADDR A:0xfc400854
y.create.l HWIO_GCC_BLSP1_QUP5_SPI_APPS_N_ADDR A:0xfc400858
y.create.l HWIO_GCC_BLSP1_QUP5_SPI_APPS_D_ADDR A:0xfc40085c
y.create.l HWIO_GCC_BLSP1_UART5_BCR_ADDR A:0xfc400880
y.create.l HWIO_GCC_BLSP1_UART5_APPS_CBCR_ADDR A:0xfc400884
y.create.l HWIO_GCC_BLSP1_UART5_SIM_CBCR_ADDR A:0xfc400888
y.create.l HWIO_GCC_BLSP1_UART5_APPS_CMD_RCGR_ADDR A:0xfc40088c
y.create.l HWIO_GCC_BLSP1_UART5_APPS_CFG_RCGR_ADDR A:0xfc400890
y.create.l HWIO_GCC_BLSP1_UART5_APPS_M_ADDR A:0xfc400894
y.create.l HWIO_GCC_BLSP1_UART5_APPS_N_ADDR A:0xfc400898
y.create.l HWIO_GCC_BLSP1_UART5_APPS_D_ADDR A:0xfc40089c
y.create.l HWIO_GCC_BLSP1_QUP6_BCR_ADDR A:0xfc4008c0
y.create.l HWIO_GCC_BLSP1_QUP6_SPI_APPS_CBCR_ADDR A:0xfc4008c4
y.create.l HWIO_GCC_BLSP1_QUP6_I2C_APPS_CBCR_ADDR A:0xfc4008c8
y.create.l HWIO_GCC_BLSP1_QUP6_SPI_APPS_CMD_RCGR_ADDR A:0xfc4008cc
y.create.l HWIO_GCC_BLSP1_QUP6_SPI_APPS_CFG_RCGR_ADDR A:0xfc4008d0
y.create.l HWIO_GCC_BLSP1_QUP6_SPI_APPS_M_ADDR A:0xfc4008d4
y.create.l HWIO_GCC_BLSP1_QUP6_SPI_APPS_N_ADDR A:0xfc4008d8
y.create.l HWIO_GCC_BLSP1_QUP6_SPI_APPS_D_ADDR A:0xfc4008dc
y.create.l HWIO_GCC_BLSP1_UART6_BCR_ADDR A:0xfc400900
y.create.l HWIO_GCC_BLSP1_UART6_APPS_CBCR_ADDR A:0xfc400904
y.create.l HWIO_GCC_BLSP1_UART6_SIM_CBCR_ADDR A:0xfc400908
y.create.l HWIO_GCC_BLSP1_UART6_APPS_CMD_RCGR_ADDR A:0xfc40090c
y.create.l HWIO_GCC_BLSP1_UART6_APPS_CFG_RCGR_ADDR A:0xfc400910
y.create.l HWIO_GCC_BLSP1_UART6_APPS_M_ADDR A:0xfc400914
y.create.l HWIO_GCC_BLSP1_UART6_APPS_N_ADDR A:0xfc400918
y.create.l HWIO_GCC_BLSP1_UART6_APPS_D_ADDR A:0xfc40091c
y.create.l HWIO_GCC_BLSP_UART_SIM_CMD_RCGR_ADDR A:0xfc400600
y.create.l HWIO_GCC_BLSP_UART_SIM_CFG_RCGR_ADDR A:0xfc400604
y.create.l HWIO_GCC_PERIPH_XPU_AHB_CBCR_ADDR A:0xfc400c80
y.create.l HWIO_GCC_PDM_BCR_ADDR A:0xfc400cc0
y.create.l HWIO_GCC_PDM_AHB_CBCR_ADDR A:0xfc400cc4
y.create.l HWIO_GCC_PDM_XO4_CBCR_ADDR A:0xfc400cc8
y.create.l HWIO_GCC_PDM2_CBCR_ADDR A:0xfc400ccc
y.create.l HWIO_GCC_PDM2_CMD_RCGR_ADDR A:0xfc400cd0
y.create.l HWIO_GCC_PDM2_CFG_RCGR_ADDR A:0xfc400cd4
y.create.l HWIO_GCC_PRNG_BCR_ADDR A:0xfc400d00
y.create.l HWIO_GCC_PRNG_AHB_CBCR_ADDR A:0xfc400d04
y.create.l HWIO_GCC_BAM_DMA_BCR_ADDR A:0xfc400d40
y.create.l HWIO_GCC_BAM_DMA_AHB_CBCR_ADDR A:0xfc400d44
y.create.l HWIO_GCC_BAM_DMA_INACTIVITY_TIMERS_CBCR_ADDR A:0xfc400d48
y.create.l HWIO_GCC_TCSR_BCR_ADDR A:0xfc400dc0
y.create.l HWIO_GCC_TCSR_AHB_CBCR_ADDR A:0xfc400dc4
y.create.l HWIO_GCC_BOOT_ROM_BCR_ADDR A:0xfc400e00
y.create.l HWIO_GCC_BOOT_ROM_AHB_CBCR_ADDR A:0xfc400e04
y.create.l HWIO_GCC_MSG_RAM_BCR_ADDR A:0xfc400e40
y.create.l HWIO_GCC_MSG_RAM_AHB_CBCR_ADDR A:0xfc400e44
y.create.l HWIO_GCC_TLMM_BCR_ADDR A:0xfc400e80
y.create.l HWIO_GCC_TLMM_AHB_CBCR_ADDR A:0xfc400e84
y.create.l HWIO_GCC_TLMM_CBCR_ADDR A:0xfc400e88
y.create.l HWIO_GCC_MPM_BCR_ADDR A:0xfc400ec0
y.create.l HWIO_GCC_MPM_MISC_ADDR A:0xfc400ec4
y.create.l HWIO_GCC_MPM_AHB_CBCR_ADDR A:0xfc400ec8
y.create.l HWIO_GCC_RPM_PROC_HCLK_CBCR_ADDR A:0xfc400f00
y.create.l HWIO_GCC_RPM_BUS_AHB_CBCR_ADDR A:0xfc400f04
y.create.l HWIO_GCC_RPM_SLEEP_CBCR_ADDR A:0xfc400f08
y.create.l HWIO_GCC_RPM_TIMER_CBCR_ADDR A:0xfc400f0c
y.create.l HWIO_GCC_RPM_CMD_RCGR_ADDR A:0xfc400f10
y.create.l HWIO_GCC_RPM_CFG_RCGR_ADDR A:0xfc400f14
y.create.l HWIO_GCC_RPM_MISC_ADDR A:0xfc400f24
y.create.l HWIO_GCC_SEC_CTRL_BCR_ADDR A:0xfc400f40
y.create.l HWIO_GCC_ACC_CMD_RCGR_ADDR A:0xfc400f80
y.create.l HWIO_GCC_ACC_CFG_RCGR_ADDR A:0xfc400f84
y.create.l HWIO_GCC_ACC_MISC_ADDR A:0xfc400f94
y.create.l HWIO_GCC_SEC_CTRL_ACC_CBCR_ADDR A:0xfc400f44
y.create.l HWIO_GCC_SEC_CTRL_AHB_CBCR_ADDR A:0xfc400f48
y.create.l HWIO_GCC_SEC_CTRL_CBCR_ADDR A:0xfc400f4c
y.create.l HWIO_GCC_SEC_CTRL_SENSE_CBCR_ADDR A:0xfc400f50
y.create.l HWIO_GCC_SEC_CTRL_BOOT_ROM_PATCH_CBCR_ADDR A:0xfc400f54
y.create.l HWIO_GCC_SEC_CTRL_CMD_RCGR_ADDR A:0xfc400f98
y.create.l HWIO_GCC_SEC_CTRL_CFG_RCGR_ADDR A:0xfc400f9c
y.create.l HWIO_GCC_SPMI_BCR_ADDR A:0xfc400fc0
y.create.l HWIO_GCC_SPMI_SER_CMD_RCGR_ADDR A:0xfc400fd0
y.create.l HWIO_GCC_SPMI_SER_CFG_RCGR_ADDR A:0xfc400fd4
y.create.l HWIO_GCC_SPMI_SER_CBCR_ADDR A:0xfc400fc4
y.create.l HWIO_GCC_SPMI_CNOC_AHB_CBCR_ADDR A:0xfc400fc8
y.create.l HWIO_GCC_SPMI_AHB_CMD_RCGR_ADDR A:0xfc400fe8
y.create.l HWIO_GCC_SPMI_AHB_CFG_RCGR_ADDR A:0xfc400fec
y.create.l HWIO_GCC_SPMI_AHB_CBCR_ADDR A:0xfc400fcc
y.create.l HWIO_GCC_SPDM_BCR_ADDR A:0xfc401000
y.create.l HWIO_GCC_SPDM_CFG_AHB_CBCR_ADDR A:0xfc401004
y.create.l HWIO_GCC_SPDM_MSTR_AHB_CBCR_ADDR A:0xfc401008
y.create.l HWIO_GCC_SPDM_FF_CBCR_ADDR A:0xfc40100c
y.create.l HWIO_GCC_SPDM_BIMC_CY_CBCR_ADDR A:0xfc401010
y.create.l HWIO_GCC_SPDM_SNOC_CY_CBCR_ADDR A:0xfc401014
y.create.l HWIO_GCC_SPDM_DEBUG_CY_CBCR_ADDR A:0xfc401018
y.create.l HWIO_GCC_SPDM_PNOC_CY_CBCR_ADDR A:0xfc40101c
y.create.l HWIO_GCC_SPDM_RPM_CY_CBCR_ADDR A:0xfc401020
y.create.l HWIO_GCC_CE1_BCR_ADDR A:0xfc401040
y.create.l HWIO_GCC_CE1_CMD_RCGR_ADDR A:0xfc401050
y.create.l HWIO_GCC_CE1_CFG_RCGR_ADDR A:0xfc401054
y.create.l HWIO_GCC_CE1_CBCR_ADDR A:0xfc401044
y.create.l HWIO_GCC_CE1_AXI_CBCR_ADDR A:0xfc401048
y.create.l HWIO_GCC_CE1_AHB_CBCR_ADDR A:0xfc40104c
y.create.l HWIO_GCC_GCC_AHB_CBCR_ADDR A:0xfc4010c0
y.create.l HWIO_GCC_GCC_XO_CMD_RCGR_ADDR A:0xfc4010e8
y.create.l HWIO_GCC_GCC_XO_CBCR_ADDR A:0xfc4010c4
y.create.l HWIO_GCC_GCC_XO_DIV4_CBCR_ADDR A:0xfc4010c8
y.create.l HWIO_GCC_GCC_IM_SLEEP_CBCR_ADDR A:0xfc4010cc
y.create.l HWIO_GCC_BIMC_BCR_ADDR A:0xfc401100
y.create.l HWIO_GCC_BIMC_GDSCR_ADDR A:0xfc401104
y.create.l HWIO_GCC_BIMC_DDR_XO_CMD_RCGR_ADDR A:0xfc401140
y.create.l HWIO_GCC_BIMC_XO_CBCR_ADDR A:0xfc401108
y.create.l HWIO_GCC_BIMC_CFG_AHB_CBCR_ADDR A:0xfc40110c
y.create.l HWIO_GCC_BIMC_SLEEP_CBCR_ADDR A:0xfc401110
y.create.l HWIO_GCC_BIMC_SYSNOC_AXI_CBCR_ADDR A:0xfc401114
y.create.l HWIO_GCC_BIMC_DDR_CMD_RCGR_ADDR A:0xfc401158
y.create.l HWIO_GCC_BIMC_DDR_CFG_RCGR_ADDR A:0xfc40115c
y.create.l HWIO_GCC_BIMC_MISC_ADDR A:0xfc40116c
y.create.l HWIO_GCC_BIMC_CBCR_ADDR A:0xfc401118
y.create.l HWIO_GCC_BIMC_KPSS_AXI_CBCR_ADDR A:0xfc40111c
y.create.l HWIO_GCC_DDR_DIM_CFG_CBCR_ADDR A:0xfc401180
y.create.l HWIO_GCC_DDR_DIM_SLEEP_CBCR_ADDR A:0xfc40118c
y.create.l HWIO_GCC_LPASS_Q6_AXI_CBCR_ADDR A:0xfc4011c0
y.create.l HWIO_GCC_KPSS_AHB_CMD_RCGR_ADDR A:0xfc40120c
y.create.l HWIO_GCC_KPSS_AHB_CFG_RCGR_ADDR A:0xfc401210
y.create.l HWIO_GCC_KPSS_AHB_MISC_ADDR A:0xfc401220
y.create.l HWIO_GCC_KPSS_AHB_CBCR_ADDR A:0xfc401204
y.create.l HWIO_GCC_KPSS_AXI_CBCR_ADDR A:0xfc401208
y.create.l HWIO_GCC_SNOC_BUS_TIMEOUT0_BCR_ADDR A:0xfc401240
y.create.l HWIO_GCC_SNOC_BUS_TIMEOUT0_AHB_CBCR_ADDR A:0xfc401244
y.create.l HWIO_GCC_PNOC_BUS_TIMEOUT0_BCR_ADDR A:0xfc401280
y.create.l HWIO_GCC_PNOC_BUS_TIMEOUT0_AHB_CBCR_ADDR A:0xfc401284
y.create.l HWIO_GCC_PNOC_BUS_TIMEOUT1_BCR_ADDR A:0xfc401288
y.create.l HWIO_GCC_PNOC_BUS_TIMEOUT1_AHB_CBCR_ADDR A:0xfc40128c
y.create.l HWIO_GCC_PNOC_BUS_TIMEOUT2_BCR_ADDR A:0xfc401290
y.create.l HWIO_GCC_PNOC_BUS_TIMEOUT2_AHB_CBCR_ADDR A:0xfc401294
y.create.l HWIO_GCC_PNOC_BUS_TIMEOUT3_BCR_ADDR A:0xfc401298
y.create.l HWIO_GCC_PNOC_BUS_TIMEOUT3_AHB_CBCR_ADDR A:0xfc40129c
y.create.l HWIO_GCC_PNOC_BUS_TIMEOUT4_BCR_ADDR A:0xfc4012a0
y.create.l HWIO_GCC_PNOC_BUS_TIMEOUT4_AHB_CBCR_ADDR A:0xfc4012a4
y.create.l HWIO_GCC_CNOC_BUS_TIMEOUT0_BCR_ADDR A:0xfc4012c0
y.create.l HWIO_GCC_CNOC_BUS_TIMEOUT0_AHB_CBCR_ADDR A:0xfc4012c4
y.create.l HWIO_GCC_CNOC_BUS_TIMEOUT1_BCR_ADDR A:0xfc4012c8
y.create.l HWIO_GCC_CNOC_BUS_TIMEOUT1_AHB_CBCR_ADDR A:0xfc4012cc
y.create.l HWIO_GCC_CNOC_BUS_TIMEOUT2_BCR_ADDR A:0xfc4012d0
y.create.l HWIO_GCC_CNOC_BUS_TIMEOUT2_AHB_CBCR_ADDR A:0xfc4012d4
y.create.l HWIO_GCC_CNOC_BUS_TIMEOUT3_BCR_ADDR A:0xfc4012d8
y.create.l HWIO_GCC_CNOC_BUS_TIMEOUT3_AHB_CBCR_ADDR A:0xfc4012dc
y.create.l HWIO_GCC_CNOC_BUS_TIMEOUT4_BCR_ADDR A:0xfc4012e0
y.create.l HWIO_GCC_CNOC_BUS_TIMEOUT4_AHB_CBCR_ADDR A:0xfc4012e4
y.create.l HWIO_GCC_CNOC_BUS_TIMEOUT5_BCR_ADDR A:0xfc4012e8
y.create.l HWIO_GCC_CNOC_BUS_TIMEOUT5_AHB_CBCR_ADDR A:0xfc4012ec
y.create.l HWIO_GCC_CNOC_BUS_TIMEOUT6_BCR_ADDR A:0xfc4012f0
y.create.l HWIO_GCC_CNOC_BUS_TIMEOUT6_AHB_CBCR_ADDR A:0xfc4012f4
y.create.l HWIO_GCC_DEHR_BCR_ADDR A:0xfc401300
y.create.l HWIO_GCC_DEHR_CBCR_ADDR A:0xfc401304
y.create.l HWIO_GCC_PERIPH_NOC_MPU_CFG_AHB_CBCR_ADDR A:0xfc401340
y.create.l HWIO_GCC_RBCPR_BCR_ADDR A:0xfc401380
y.create.l HWIO_GCC_RBCPR_CBCR_ADDR A:0xfc401384
y.create.l HWIO_GCC_RBCPR_AHB_CBCR_ADDR A:0xfc401388
y.create.l HWIO_GCC_RBCPR_CMD_RCGR_ADDR A:0xfc40138c
y.create.l HWIO_GCC_RBCPR_CFG_RCGR_ADDR A:0xfc401390
y.create.l HWIO_GCC_RPM_GPLL_ENA_VOTE_ADDR A:0xfc401440
y.create.l HWIO_GCC_RPM_CLOCK_BRANCH_ENA_VOTE_ADDR A:0xfc401444
y.create.l HWIO_GCC_RPM_CLOCK_SLEEP_ENA_VOTE_ADDR A:0xfc401448
y.create.l HWIO_GCC_APCS_GPLL_ENA_VOTE_ADDR A:0xfc401480
y.create.l HWIO_GCC_APCS_CLOCK_BRANCH_ENA_VOTE_ADDR A:0xfc401484
y.create.l HWIO_GCC_APCS_CLOCK_SLEEP_ENA_VOTE_ADDR A:0xfc401488
y.create.l HWIO_GCC_APCS_TZ_GPLL_ENA_VOTE_ADDR A:0xfc4014c0
y.create.l HWIO_GCC_APCS_TZ_CLOCK_BRANCH_ENA_VOTE_ADDR A:0xfc4014c4
y.create.l HWIO_GCC_APCS_TZ_CLOCK_SLEEP_ENA_VOTE_ADDR A:0xfc4014c8
y.create.l HWIO_GCC_MSS_Q6_GPLL_ENA_VOTE_ADDR A:0xfc401500
y.create.l HWIO_GCC_MSS_Q6_CLOCK_BRANCH_ENA_VOTE_ADDR A:0xfc401504
y.create.l HWIO_GCC_MSS_Q6_CLOCK_SLEEP_ENA_VOTE_ADDR A:0xfc401508
y.create.l HWIO_GCC_LPASS_DSP_GPLL_ENA_VOTE_ADDR A:0xfc401540
y.create.l HWIO_GCC_LPASS_DSP_CLOCK_BRANCH_ENA_VOTE_ADDR A:0xfc401544
y.create.l HWIO_GCC_LPASS_DSP_CLOCK_SLEEP_ENA_VOTE_ADDR A:0xfc401548
y.create.l HWIO_GCC_SPARE_GPLL_ENA_VOTE_ADDR A:0xfc4015c0
y.create.l HWIO_GCC_SPARE_CLOCK_BRANCH_ENA_VOTE_ADDR A:0xfc4015c4
y.create.l HWIO_GCC_QDSS_STM_EVENT0_CTL_REG_ADDR A:0xfc401600
y.create.l HWIO_GCC_QDSS_STM_EVENT1_CTL_REG_ADDR A:0xfc401604
y.create.l HWIO_GCC_QDSS_STM_EVENT2_CTL_REG_ADDR A:0xfc401608
y.create.l HWIO_GCC_QDSS_STM_EVENT3_CTL_REG_ADDR A:0xfc40160c
y.create.l HWIO_GCC_QDSS_STM_EVENT4_CTL_REG_ADDR A:0xfc401610
y.create.l HWIO_GCC_QDSS_STM_EVENT5_CTL_REG_ADDR A:0xfc401614
y.create.l HWIO_GCC_QDSS_STM_EVENT6_CTL_REG_ADDR A:0xfc401618
y.create.l HWIO_GCC_QDSS_STM_EVENT7_CTL_REG_ADDR A:0xfc40161c
y.create.l HWIO_GCC_QDSS_STM_EVENT8_CTL_REG_ADDR A:0xfc401620
y.create.l HWIO_GCC_QDSS_STM_EVENT9_CTL_REG_ADDR A:0xfc401624
y.create.l HWIO_GCC_QDSS_STM_EVENT10_CTL_REG_ADDR A:0xfc401628
y.create.l HWIO_GCC_QDSS_STM_EVENT11_CTL_REG_ADDR A:0xfc40162c
y.create.l HWIO_GCC_QDSS_STM_EVENT12_CTL_REG_ADDR A:0xfc401630
y.create.l HWIO_GCC_QDSS_STM_EVENT13_CTL_REG_ADDR A:0xfc401634
y.create.l HWIO_GCC_QDSS_STM_EVENT14_CTL_REG_ADDR A:0xfc401638
y.create.l HWIO_GCC_QDSS_STM_EVENT15_CTL_REG_ADDR A:0xfc40163c
y.create.l HWIO_GCC_QDSS_STM_EVENT16_CTL_REG_ADDR A:0xfc401640
y.create.l HWIO_GCC_QDSS_STM_EVENT17_CTL_REG_ADDR A:0xfc401644
y.create.l HWIO_GCC_QDSS_STM_EVENT18_CTL_REG_ADDR A:0xfc401648
y.create.l HWIO_GCC_QDSS_STM_EVENT19_CTL_REG_ADDR A:0xfc40164c
y.create.l HWIO_GCC_QDSS_STM_EVENT20_CTL_REG_ADDR A:0xfc401650
y.create.l HWIO_GCC_QDSS_STM_EVENT21_CTL_REG_ADDR A:0xfc401654
y.create.l HWIO_GCC_QDSS_STM_EVENT22_CTL_REG_ADDR A:0xfc401658
y.create.l HWIO_GCC_QDSS_STM_EVENT23_CTL_REG_ADDR A:0xfc40165c
y.create.l HWIO_GCC_QDSS_STM_EVENT24_CTL_REG_ADDR A:0xfc401660
y.create.l HWIO_GCC_QDSS_STM_EVENT25_CTL_REG_ADDR A:0xfc401664
y.create.l HWIO_GCC_QDSS_STM_EVENT26_CTL_REG_ADDR A:0xfc401668
y.create.l HWIO_GCC_QDSS_STM_EVENT27_CTL_REG_ADDR A:0xfc40166c
y.create.l HWIO_GCC_QDSS_STM_EVENT28_CTL_REG_ADDR A:0xfc401670
y.create.l HWIO_GCC_QDSS_STM_EVENT29_CTL_REG_ADDR A:0xfc401674
y.create.l HWIO_GCC_QDSS_STM_EVENT30_CTL_REG_ADDR A:0xfc401678
y.create.l HWIO_GCC_QDSS_STM_EVENT31_CTL_REG_ADDR A:0xfc40167c
y.create.l HWIO_GCC_MSS_RESTART_ADDR A:0xfc401680
y.create.l HWIO_GCC_LPASS_RESTART_ADDR A:0xfc4016c0
y.create.l HWIO_GCC_WDOG_DEBUG_ADDR A:0xfc401780
y.create.l HWIO_GCC_RESET_STATUS_ADDR A:0xfc4017c0
y.create.l HWIO_GCC_SW_SRST_ADDR A:0xfc401800
y.create.l HWIO_GCC_PROC_HALT_ADDR A:0xfc401840
y.create.l HWIO_GCC_GCC_DEBUG_CLK_CTL_ADDR A:0xfc401880
y.create.l HWIO_GCC_CLOCK_FRQ_MEASURE_CTL_ADDR A:0xfc401884
y.create.l HWIO_GCC_CLOCK_FRQ_MEASURE_STATUS_ADDR A:0xfc401888
y.create.l HWIO_GCC_PLLTEST_PAD_CFG_ADDR A:0xfc40188c
y.create.l HWIO_GCC_JITTER_PROBE_CFG_ADDR A:0xfc401890
y.create.l HWIO_GCC_JITTER_PROBE_VAL_ADDR A:0xfc401894
y.create.l HWIO_GCC_GP1_CBCR_ADDR A:0xfc401900
y.create.l HWIO_GCC_GP1_CMD_RCGR_ADDR A:0xfc401904
y.create.l HWIO_GCC_GP1_CFG_RCGR_ADDR A:0xfc401908
y.create.l HWIO_GCC_GP1_M_ADDR A:0xfc40190c
y.create.l HWIO_GCC_GP1_N_ADDR A:0xfc401910
y.create.l HWIO_GCC_GP1_D_ADDR A:0xfc401914
y.create.l HWIO_GCC_GP2_CBCR_ADDR A:0xfc401940
y.create.l HWIO_GCC_GP2_CMD_RCGR_ADDR A:0xfc401944
y.create.l HWIO_GCC_GP2_CFG_RCGR_ADDR A:0xfc401948
y.create.l HWIO_GCC_GP2_M_ADDR A:0xfc40194c
y.create.l HWIO_GCC_GP2_N_ADDR A:0xfc401950
y.create.l HWIO_GCC_GP2_D_ADDR A:0xfc401954
y.create.l HWIO_GCC_GP3_CBCR_ADDR A:0xfc401980
y.create.l HWIO_GCC_GP3_CMD_RCGR_ADDR A:0xfc401984
y.create.l HWIO_GCC_GP3_CFG_RCGR_ADDR A:0xfc401988
y.create.l HWIO_GCC_GP3_M_ADDR A:0xfc40198c
y.create.l HWIO_GCC_GP3_N_ADDR A:0xfc401990
y.create.l HWIO_GCC_GP3_D_ADDR A:0xfc401994
y.create.l HWIO_GCC_KPSS_BOOT_CLOCK_CTL_ADDR A:0xfc4019c0
y.create.l HWIO_GCC_USB_BOOT_CLOCK_CTL_ADDR A:0xfc401a00
y.create.l HWIO_GCC_QPIC_BCR_ADDR A:0xfc401a40
y.create.l HWIO_GCC_QPIC_CMD_RCGR_ADDR A:0xfc401a50
y.create.l HWIO_GCC_QPIC_CFG_RCGR_ADDR A:0xfc401a54
y.create.l HWIO_GCC_QPIC_M_ADDR A:0xfc401a58
y.create.l HWIO_GCC_QPIC_N_ADDR A:0xfc401a5c
y.create.l HWIO_GCC_QPIC_D_ADDR A:0xfc401a60
y.create.l HWIO_GCC_QPIC_CBCR_ADDR A:0xfc401a44
y.create.l HWIO_GCC_QPIC_AHB_CBCR_ADDR A:0xfc401a48
y.create.l HWIO_GCC_QPIC_SYSTEM_CBCR_ADDR A:0xfc401a4c
y.create.l HWIO_GCC_IPA_BCR_ADDR A:0xfc401a80
y.create.l HWIO_GCC_IPA_CMD_RCGR_ADDR A:0xfc401a90
y.create.l HWIO_GCC_IPA_CFG_RCGR_ADDR A:0xfc401a94
y.create.l HWIO_GCC_IPA_M_ADDR A:0xfc401a98
y.create.l HWIO_GCC_IPA_N_ADDR A:0xfc401a9c
y.create.l HWIO_GCC_IPA_D_ADDR A:0xfc401aa0
y.create.l HWIO_GCC_IPA_CBCR_ADDR A:0xfc401a84
y.create.l HWIO_GCC_IPA_CNOC_CBCR_ADDR A:0xfc401a88
y.create.l HWIO_GCC_IPA_SLEEP_CBCR_ADDR A:0xfc401a8c
y.create.l HWIO_GCC_DCS_BCR_ADDR A:0xfc401ac0
y.create.l HWIO_GCC_DCS_CBCR_ADDR A:0xfc401ac4
y.create.l HWIO_GCC_RPU_XPU_SCR_ADDR A:0xfc410000
y.create.l HWIO_GCC_RPU_XPU_SWDR_ADDR A:0xfc410004
y.create.l HWIO_GCC_RPU_XPU_SEAR0_ADDR A:0xfc410040
y.create.l HWIO_GCC_RPU_XPU_SESR_ADDR A:0xfc410048
y.create.l HWIO_GCC_RPU_XPU_SESRRESTORE_ADDR A:0xfc41004c
y.create.l HWIO_GCC_RPU_XPU_SESYNR0_ADDR A:0xfc410050
y.create.l HWIO_GCC_RPU_XPU_SESYNR1_ADDR A:0xfc410054
y.create.l HWIO_GCC_RPU_XPU_SESYNR2_ADDR A:0xfc410058
y.create.l HWIO_GCC_RPU_XPU_MCR_ADDR A:0xfc410100
y.create.l HWIO_GCC_RPU_XPU_MEAR0_ADDR A:0xfc410140
y.create.l HWIO_GCC_RPU_XPU_MESR_ADDR A:0xfc410148
y.create.l HWIO_GCC_RPU_XPU_MESRRESTORE_ADDR A:0xfc41014c
y.create.l HWIO_GCC_RPU_XPU_MESYNR0_ADDR A:0xfc410150
y.create.l HWIO_GCC_RPU_XPU_MESYNR1_ADDR A:0xfc410154
y.create.l HWIO_GCC_RPU_XPU_MESYNR2_ADDR A:0xfc410158
y.create.l HWIO_GCC_RPU_XPU_CR_ADDR A:0xfc410080
y.create.l HWIO_GCC_RPU_XPU_RPU_ACR0_ADDR A:0xfc4100a0
y.create.l HWIO_GCC_RPU_XPU_EAR0_ADDR A:0xfc4100c0
y.create.l HWIO_GCC_RPU_XPU_ESR_ADDR A:0xfc4100c8
y.create.l HWIO_GCC_RPU_XPU_ESRRESTORE_ADDR A:0xfc4100cc
y.create.l HWIO_GCC_RPU_XPU_ESYNR0_ADDR A:0xfc4100d0
y.create.l HWIO_GCC_RPU_XPU_ESYNR1_ADDR A:0xfc4100d4
y.create.l HWIO_GCC_RPU_XPU_ESYNR2_ADDR A:0xfc4100d8
y.create.l HWIO_GCC_RPU_XPU_IDR0_ADDR A:0xfc410074
y.create.l HWIO_GCC_RPU_XPU_IDR1_ADDR A:0xfc410078
y.create.l HWIO_GCC_RPU_XPU_REV_ADDR A:0xfc41007c
y.create.l HWIO_GCC_RPU_XPU_RG0_RACR0_ADDR A:0xfc410200
y.create.l HWIO_GCC_RPU_XPU_RG1_RACR0_ADDR A:0xfc410280
y.create.l HWIO_GCC_RPU_XPU_RG2_RACR0_ADDR A:0xfc410300
y.create.l HWIO_GCC_RPU_XPU_RG3_RACR0_ADDR A:0xfc410380
y.create.l HWIO_GCC_RPU_XPU_RG4_RACR0_ADDR A:0xfc410400
y.create.l HWIO_GCC_RPU_XPU_RG5_RACR0_ADDR A:0xfc410480
y.create.l HWIO_GCC_RPU_XPU_RG6_RACR0_ADDR A:0xfc410500
y.create.l HWIO_GCC_RPU_XPU_RG7_RACR0_ADDR A:0xfc410580
y.create.l HWIO_GCC_RPU_XPU_RG8_RACR0_ADDR A:0xfc410600
y.create.l HWIO_GCC_RPU_XPU_RG9_RACR0_ADDR A:0xfc410680
y.create.l HWIO_GCC_RPU_XPU_RG0_SCR_ADDR A:0xfc410250
y.create.l HWIO_GCC_RPU_XPU_RG1_SCR_ADDR A:0xfc4102d0
y.create.l HWIO_GCC_RPU_XPU_RG2_SCR_ADDR A:0xfc410350
y.create.l HWIO_GCC_RPU_XPU_RG3_SCR_ADDR A:0xfc4103d0
y.create.l HWIO_GCC_RPU_XPU_RG4_SCR_ADDR A:0xfc410450
y.create.l HWIO_GCC_RPU_XPU_RG5_SCR_ADDR A:0xfc4104d0
y.create.l HWIO_GCC_RPU_XPU_RG6_SCR_ADDR A:0xfc410550
y.create.l HWIO_GCC_RPU_XPU_RG7_SCR_ADDR A:0xfc4105d0
y.create.l HWIO_GCC_RPU_XPU_RG8_SCR_ADDR A:0xfc410650
y.create.l HWIO_GCC_RPU_XPU_RG9_SCR_ADDR A:0xfc4106d0
y.create.l HWIO_GCC_RPU_XPU_RG0_MCR_ADDR A:0xfc410254
y.create.l HWIO_GCC_RPU_XPU_RG1_MCR_ADDR A:0xfc4102d4
y.create.l HWIO_GCC_RPU_XPU_RG2_MCR_ADDR A:0xfc410354
y.create.l HWIO_GCC_RPU_XPU_RG3_MCR_ADDR A:0xfc4103d4
y.create.l HWIO_GCC_RPU_XPU_RG4_MCR_ADDR A:0xfc410454
y.create.l HWIO_GCC_RPU_XPU_RG5_MCR_ADDR A:0xfc4104d4
y.create.l HWIO_GCC_RPU_XPU_RG6_MCR_ADDR A:0xfc410554
y.create.l HWIO_GCC_RPU_XPU_RG7_MCR_ADDR A:0xfc4105d4
y.create.l HWIO_GCC_RPU_XPU_RG8_MCR_ADDR A:0xfc410654
y.create.l HWIO_GCC_RPU_XPU_RG9_MCR_ADDR A:0xfc4106d4
y.create.l HWIO_CNOC_0_ABT_HW_VERSION_ADDR A:0xfc448000
y.create.l HWIO_CNOC_0_ABT_INST_ID_ADDR A:0xfc448004
y.create.l HWIO_CNOC_0_ABT_NUM_SLAVES_ADDR A:0xfc448008
y.create.l HWIO_CNOC_0_ABT_TIMER_LOADVAL_ADDR A:0xfc44800c
y.create.l HWIO_CNOC_0_ABT_TIMER_MODE_ADDR A:0xfc448010
y.create.l HWIO_CNOC_0_ABT_INTR_STATUS_ADDR A:0xfc448014
y.create.l HWIO_CNOC_0_ABT_INTR_CLEAR_ADDR A:0xfc448018
y.create.l HWIO_CNOC_0_ABT_INTR_ENABLE_ADDR A:0xfc44801c
y.create.l HWIO_CNOC_0_ABT_SYND_VALID_ADDR A:0xfc448020
y.create.l HWIO_CNOC_0_ABT_SYND_CLEAR_ADDR A:0xfc448024
y.create.l HWIO_CNOC_0_ABT_SYND_ID_ADDR A:0xfc448028
y.create.l HWIO_CNOC_0_ABT_SYND_ADDR0_ADDR A:0xfc44802c
y.create.l HWIO_CNOC_0_ABT_SYND_ADDR1_ADDR A:0xfc448030
y.create.l HWIO_CNOC_0_ABT_SYND_HREADY_ADDR A:0xfc448034
y.create.l HWIO_CNOC_1_ABT_HW_VERSION_ADDR A:0xfc449000
y.create.l HWIO_CNOC_1_ABT_INST_ID_ADDR A:0xfc449004
y.create.l HWIO_CNOC_1_ABT_NUM_SLAVES_ADDR A:0xfc449008
y.create.l HWIO_CNOC_1_ABT_TIMER_LOADVAL_ADDR A:0xfc44900c
y.create.l HWIO_CNOC_1_ABT_TIMER_MODE_ADDR A:0xfc449010
y.create.l HWIO_CNOC_1_ABT_INTR_STATUS_ADDR A:0xfc449014
y.create.l HWIO_CNOC_1_ABT_INTR_CLEAR_ADDR A:0xfc449018
y.create.l HWIO_CNOC_1_ABT_INTR_ENABLE_ADDR A:0xfc44901c
y.create.l HWIO_CNOC_1_ABT_SYND_VALID_ADDR A:0xfc449020
y.create.l HWIO_CNOC_1_ABT_SYND_CLEAR_ADDR A:0xfc449024
y.create.l HWIO_CNOC_1_ABT_SYND_ID_ADDR A:0xfc449028
y.create.l HWIO_CNOC_1_ABT_SYND_ADDR0_ADDR A:0xfc44902c
y.create.l HWIO_CNOC_1_ABT_SYND_ADDR1_ADDR A:0xfc449030
y.create.l HWIO_CNOC_1_ABT_SYND_HREADY_ADDR A:0xfc449034
y.create.l HWIO_CNOC_2_ABT_HW_VERSION_ADDR A:0xfc44a000
y.create.l HWIO_CNOC_2_ABT_INST_ID_ADDR A:0xfc44a004
y.create.l HWIO_CNOC_2_ABT_NUM_SLAVES_ADDR A:0xfc44a008
y.create.l HWIO_CNOC_2_ABT_TIMER_LOADVAL_ADDR A:0xfc44a00c
y.create.l HWIO_CNOC_2_ABT_TIMER_MODE_ADDR A:0xfc44a010
y.create.l HWIO_CNOC_2_ABT_INTR_STATUS_ADDR A:0xfc44a014
y.create.l HWIO_CNOC_2_ABT_INTR_CLEAR_ADDR A:0xfc44a018
y.create.l HWIO_CNOC_2_ABT_INTR_ENABLE_ADDR A:0xfc44a01c
y.create.l HWIO_CNOC_2_ABT_SYND_VALID_ADDR A:0xfc44a020
y.create.l HWIO_CNOC_2_ABT_SYND_CLEAR_ADDR A:0xfc44a024
y.create.l HWIO_CNOC_2_ABT_SYND_ID_ADDR A:0xfc44a028
y.create.l HWIO_CNOC_2_ABT_SYND_ADDR0_ADDR A:0xfc44a02c
y.create.l HWIO_CNOC_2_ABT_SYND_ADDR1_ADDR A:0xfc44a030
y.create.l HWIO_CNOC_2_ABT_SYND_HREADY_ADDR A:0xfc44a034
y.create.l HWIO_CNOC_3_ABT_HW_VERSION_ADDR A:0xfc44b000
y.create.l HWIO_CNOC_3_ABT_INST_ID_ADDR A:0xfc44b004
y.create.l HWIO_CNOC_3_ABT_NUM_SLAVES_ADDR A:0xfc44b008
y.create.l HWIO_CNOC_3_ABT_TIMER_LOADVAL_ADDR A:0xfc44b00c
y.create.l HWIO_CNOC_3_ABT_TIMER_MODE_ADDR A:0xfc44b010
y.create.l HWIO_CNOC_3_ABT_INTR_STATUS_ADDR A:0xfc44b014
y.create.l HWIO_CNOC_3_ABT_INTR_CLEAR_ADDR A:0xfc44b018
y.create.l HWIO_CNOC_3_ABT_INTR_ENABLE_ADDR A:0xfc44b01c
y.create.l HWIO_CNOC_3_ABT_SYND_VALID_ADDR A:0xfc44b020
y.create.l HWIO_CNOC_3_ABT_SYND_CLEAR_ADDR A:0xfc44b024
y.create.l HWIO_CNOC_3_ABT_SYND_ID_ADDR A:0xfc44b028
y.create.l HWIO_CNOC_3_ABT_SYND_ADDR0_ADDR A:0xfc44b02c
y.create.l HWIO_CNOC_3_ABT_SYND_ADDR1_ADDR A:0xfc44b030
y.create.l HWIO_CNOC_3_ABT_SYND_HREADY_ADDR A:0xfc44b034
y.create.l HWIO_CNOC_4_ABT_HW_VERSION_ADDR A:0xfc44c000
y.create.l HWIO_CNOC_4_ABT_INST_ID_ADDR A:0xfc44c004
y.create.l HWIO_CNOC_4_ABT_NUM_SLAVES_ADDR A:0xfc44c008
y.create.l HWIO_CNOC_4_ABT_TIMER_LOADVAL_ADDR A:0xfc44c00c
y.create.l HWIO_CNOC_4_ABT_TIMER_MODE_ADDR A:0xfc44c010
y.create.l HWIO_CNOC_4_ABT_INTR_STATUS_ADDR A:0xfc44c014
y.create.l HWIO_CNOC_4_ABT_INTR_CLEAR_ADDR A:0xfc44c018
y.create.l HWIO_CNOC_4_ABT_INTR_ENABLE_ADDR A:0xfc44c01c
y.create.l HWIO_CNOC_4_ABT_SYND_VALID_ADDR A:0xfc44c020
y.create.l HWIO_CNOC_4_ABT_SYND_CLEAR_ADDR A:0xfc44c024
y.create.l HWIO_CNOC_4_ABT_SYND_ID_ADDR A:0xfc44c028
y.create.l HWIO_CNOC_4_ABT_SYND_ADDR0_ADDR A:0xfc44c02c
y.create.l HWIO_CNOC_4_ABT_SYND_ADDR1_ADDR A:0xfc44c030
y.create.l HWIO_CNOC_4_ABT_SYND_HREADY_ADDR A:0xfc44c034
y.create.l HWIO_CNOC_5_ABT_HW_VERSION_ADDR A:0xfc44d000
y.create.l HWIO_CNOC_5_ABT_INST_ID_ADDR A:0xfc44d004
y.create.l HWIO_CNOC_5_ABT_NUM_SLAVES_ADDR A:0xfc44d008
y.create.l HWIO_CNOC_5_ABT_TIMER_LOADVAL_ADDR A:0xfc44d00c
y.create.l HWIO_CNOC_5_ABT_TIMER_MODE_ADDR A:0xfc44d010
y.create.l HWIO_CNOC_5_ABT_INTR_STATUS_ADDR A:0xfc44d014
y.create.l HWIO_CNOC_5_ABT_INTR_CLEAR_ADDR A:0xfc44d018
y.create.l HWIO_CNOC_5_ABT_INTR_ENABLE_ADDR A:0xfc44d01c
y.create.l HWIO_CNOC_5_ABT_SYND_VALID_ADDR A:0xfc44d020
y.create.l HWIO_CNOC_5_ABT_SYND_CLEAR_ADDR A:0xfc44d024
y.create.l HWIO_CNOC_5_ABT_SYND_ID_ADDR A:0xfc44d028
y.create.l HWIO_CNOC_5_ABT_SYND_ADDR0_ADDR A:0xfc44d02c
y.create.l HWIO_CNOC_5_ABT_SYND_ADDR1_ADDR A:0xfc44d030
y.create.l HWIO_CNOC_5_ABT_SYND_HREADY_ADDR A:0xfc44d034
y.create.l HWIO_CNOC_6_ABT_HW_VERSION_ADDR A:0xfc44e000
y.create.l HWIO_CNOC_6_ABT_INST_ID_ADDR A:0xfc44e004
y.create.l HWIO_CNOC_6_ABT_NUM_SLAVES_ADDR A:0xfc44e008
y.create.l HWIO_CNOC_6_ABT_TIMER_LOADVAL_ADDR A:0xfc44e00c
y.create.l HWIO_CNOC_6_ABT_TIMER_MODE_ADDR A:0xfc44e010
y.create.l HWIO_CNOC_6_ABT_INTR_STATUS_ADDR A:0xfc44e014
y.create.l HWIO_CNOC_6_ABT_INTR_CLEAR_ADDR A:0xfc44e018
y.create.l HWIO_CNOC_6_ABT_INTR_ENABLE_ADDR A:0xfc44e01c
y.create.l HWIO_CNOC_6_ABT_SYND_VALID_ADDR A:0xfc44e020
y.create.l HWIO_CNOC_6_ABT_SYND_CLEAR_ADDR A:0xfc44e024
y.create.l HWIO_CNOC_6_ABT_SYND_ID_ADDR A:0xfc44e028
y.create.l HWIO_CNOC_6_ABT_SYND_ADDR0_ADDR A:0xfc44e02c
y.create.l HWIO_CNOC_6_ABT_SYND_ADDR1_ADDR A:0xfc44e030
y.create.l HWIO_CNOC_6_ABT_SYND_HREADY_ADDR A:0xfc44e034
y.create.l HWIO_CNOC_OBS_ID_COREID_ADDR A:0xfc480000
y.create.l HWIO_CNOC_OBS_ID_REVISIONID_ADDR A:0xfc480004
y.create.l HWIO_CNOC_OBS_ERRCTL_ADDR A:0xfc480008
y.create.l HWIO_CNOC_OBS_ERRSTATUS_ADDR A:0xfc48000c
y.create.l HWIO_CNOC_OBS_ERRLOG0_ADDR A:0xfc480010
y.create.l HWIO_CNOC_OBS_ERRLOG1_ADDR A:0xfc480014
y.create.l HWIO_CNOC_OBS_ERRLOG2_ADDR A:0xfc480018
y.create.l HWIO_CNOC_OBS_ERRLOG5_ADDR A:0xfc480024
y.create.l HWIO_PERIPH_SS_SDC3_SDCC_MCI_POWER_ADDR A:0xf9864000
y.create.l HWIO_PERIPH_SS_SDC3_SDCC_MCI_CLK_ADDR A:0xf9864004
y.create.l HWIO_PERIPH_SS_SDC3_SDCC_MCI_ARGUMENT_ADDR A:0xf9864008
y.create.l HWIO_PERIPH_SS_SDC3_SDCC_MCI_CMD_ADDR A:0xf986400c
y.create.l HWIO_PERIPH_SS_SDC3_SDCC_MCI_RESP_CMD_ADDR A:0xf9864010
y.create.l HWIO_PERIPH_SS_SDC3_SDCC_MCI_RESP0_ADDR A:0xf9864014
y.create.l HWIO_PERIPH_SS_SDC3_SDCC_MCI_RESP1_ADDR A:0xf9864018
y.create.l HWIO_PERIPH_SS_SDC3_SDCC_MCI_RESP2_ADDR A:0xf986401c
y.create.l HWIO_PERIPH_SS_SDC3_SDCC_MCI_RESP3_ADDR A:0xf9864020
y.create.l HWIO_PERIPH_SS_SDC3_SDCC_MCI_DATA_TIMER_ADDR A:0xf9864024
y.create.l HWIO_PERIPH_SS_SDC3_SDCC_MCI_DATA_LENGTH_ADDR A:0xf9864028
y.create.l HWIO_PERIPH_SS_SDC3_SDCC_MCI_DATA_CTL_ADDR A:0xf986402c
y.create.l HWIO_PERIPH_SS_SDC3_SDCC_MCI_DATA_COUNT_ADDR A:0xf9864030
y.create.l HWIO_PERIPH_SS_SDC3_SDCC_MCI_STATUS_ADDR A:0xf9864034
y.create.l HWIO_PERIPH_SS_SDC3_SDCC_MCI_CLEAR_ADDR A:0xf9864038
y.create.l HWIO_PERIPH_SS_SDC3_SDCC_MCI_INT_MASK0_ADDR A:0xf986403c
y.create.l HWIO_PERIPH_SS_SDC3_SDCC_MCI_INT_MASK1_ADDR A:0xf9864040
y.create.l HWIO_PERIPH_SS_SDC3_SDCC_MCI_FIFO_COUNT_ADDR A:0xf9864044
y.create.l HWIO_PERIPH_SS_SDC3_SDCC_MCI_BOOT_ADDR A:0xf9864048
y.create.l HWIO_PERIPH_SS_SDC3_SDCC_MCI_BOOT_ACK_TIMER_ADDR A:0xf986404c
y.create.l HWIO_PERIPH_SS_SDC3_SDCC_MCI_VERSION_ADDR A:0xf9864050
y.create.l HWIO_PERIPH_SS_SDC3_SDCC_MCI_EMULATION_DLY_LINE_ADDR A:0xf9864054
y.create.l HWIO_PERIPH_SS_SDC3_SDCC_MCI_CCS_TIMER_ADDR A:0xf9864058
y.create.l HWIO_PERIPH_SS_SDC3_SDCC_MCI_RESPONSE_MASK_ADDR A:0xf986405c
y.create.l HWIO_PERIPH_SS_SDC3_SDCC_MCI_DLL_CONFIG_ADDR A:0xf9864060
y.create.l HWIO_PERIPH_SS_SDC3_SDCC_MCI_DLL_TEST_CTL_ADDR A:0xf9864064
y.create.l HWIO_PERIPH_SS_SDC3_SDCC_MCI_DLL_STATUS_ADDR A:0xf9864068
y.create.l HWIO_PERIPH_SS_SDC3_SDCC_MCI_STATUS2_ADDR A:0xf986406c
y.create.l HWIO_PERIPH_SS_SDC3_SDCC_MCI_GENERICS_ADDR A:0xf9864070
y.create.l HWIO_PERIPH_SS_SDC3_SDCC_MCI_FIFO_STATUS_ADDR A:0xf9864074
y.create.l HWIO_PERIPH_SS_SDC3_SDCC_MCI_HC_MODE_ADDR A:0xf9864078
y.create.l HWIO_PERIPH_SS_SDC3_SDCC_MCI_FIFO0_ADDR A:0xf9864080
y.create.l HWIO_PERIPH_SS_SDC3_SDCC_MCI_FIFO1_ADDR A:0xf9864084
y.create.l HWIO_PERIPH_SS_SDC3_SDCC_MCI_FIFO2_ADDR A:0xf9864088
y.create.l HWIO_PERIPH_SS_SDC3_SDCC_MCI_FIFO3_ADDR A:0xf986408c
y.create.l HWIO_PERIPH_SS_SDC3_SDCC_MCI_FIFO4_ADDR A:0xf9864090
y.create.l HWIO_PERIPH_SS_SDC3_SDCC_MCI_FIFO5_ADDR A:0xf9864094
y.create.l HWIO_PERIPH_SS_SDC3_SDCC_MCI_FIFO6_ADDR A:0xf9864098
y.create.l HWIO_PERIPH_SS_SDC3_SDCC_MCI_FIFO7_ADDR A:0xf986409c
y.create.l HWIO_PERIPH_SS_SDC3_SDCC_MCI_FIFO8_ADDR A:0xf98640a0
y.create.l HWIO_PERIPH_SS_SDC3_SDCC_MCI_FIFO9_ADDR A:0xf98640a4
y.create.l HWIO_PERIPH_SS_SDC3_SDCC_MCI_TESTBUS_CONFIG_ADDR A:0xf98640cc
y.create.l HWIO_PERIPH_SS_SDC3_SDCC_MCI_TEST_CTL_ADDR A:0xf98640d0
y.create.l HWIO_PERIPH_SS_SDC3_SDCC_MCI_TEST_INPUT_ADDR A:0xf98640d4
y.create.l HWIO_PERIPH_SS_SDC3_SDCC_MCI_TEST_OUT_ADDR A:0xf98640d8
y.create.l HWIO_PERIPH_SS_SDC3_SDCC_MCI_PWRCTL_STATUS_REG_ADDR A:0xf98640dc
y.create.l HWIO_PERIPH_SS_SDC3_SDCC_MCI_PWRCTL_MASK_REG_ADDR A:0xf98640e0
y.create.l HWIO_PERIPH_SS_SDC3_SDCC_MCI_PWRCTL_CLEAR_REG_ADDR A:0xf98640e4
y.create.l HWIO_PERIPH_SS_SDC3_SDCC_MCI_PWRCTL_CTL_REG_ADDR A:0xf98640e8
y.create.l HWIO_PERIPH_SS_SDC3_SDCC_MCI_CLEAR2_ADDR A:0xf98640ec
y.create.l HWIO_PERIPH_SS_SDC3_SDCC_MCI_INT_MASKINT2_0_ADDR A:0xf98640f0
y.create.l HWIO_PERIPH_SS_SDC3_SDCC_MCI_INT_MASKINT2_1_ADDR A:0xf98640f4
y.create.l HWIO_PERIPH_SS_SDC3_SDCC_CHAR_CFG_ADDR A:0xf98640fc
y.create.l HWIO_PERIPH_SS_SDC3_SDCC_CHAR_CMD_ADDR A:0xf9864100
y.create.l HWIO_PERIPH_SS_SDC3_SDCC_CHAR_DATA_0_ADDR A:0xf9864104
y.create.l HWIO_PERIPH_SS_SDC3_SDCC_CHAR_DATA_1_ADDR A:0xf9864108
y.create.l HWIO_PERIPH_SS_SDC3_SDCC_CHAR_DATA_2_ADDR A:0xf986410c
y.create.l HWIO_PERIPH_SS_SDC3_SDCC_CHAR_DATA_3_ADDR A:0xf9864110
y.create.l HWIO_PERIPH_SS_SDC3_SDCC_CHAR_DATA_4_ADDR A:0xf9864114
y.create.l HWIO_PERIPH_SS_SDC3_SDCC_CHAR_DATA_5_ADDR A:0xf9864118
y.create.l HWIO_PERIPH_SS_SDC3_SDCC_CHAR_DATA_6_ADDR A:0xf986411c
y.create.l HWIO_PERIPH_SS_SDC3_SDCC_CHAR_DATA_7_ADDR A:0xf9864120
y.create.l HWIO_PERIPH_SS_SDC3_SDCC_DEBUG_REG_ADDR A:0xf9864124
y.create.l HWIO_PERIPH_SS_SDC3_SDCC_IP_CATALOG_ADDR A:0xf9864128
y.create.l HWIO_PERIPH_SS_SDC3_SDCC_MCI_FIFO_ALT0_ADDR A:0xf9864400
y.create.l HWIO_PERIPH_SS_SDC3_SDCC_MCI_FIFO_ALT1_ADDR A:0xf9864404
y.create.l HWIO_PERIPH_SS_SDC3_SDCC_MCI_FIFO_ALT2_ADDR A:0xf9864408
y.create.l HWIO_PERIPH_SS_SDC3_SDCC_MCI_FIFO_ALT3_ADDR A:0xf986440c
y.create.l HWIO_PERIPH_SS_SDC3_SDCC_MCI_FIFO_ALT4_ADDR A:0xf9864410
y.create.l HWIO_PERIPH_SS_SDC3_SDCC_MCI_FIFO_ALT5_ADDR A:0xf9864414
y.create.l HWIO_PERIPH_SS_SDC3_SDCC_MCI_FIFO_ALT6_ADDR A:0xf9864418
y.create.l HWIO_PERIPH_SS_SDC3_SDCC_MCI_FIFO_ALT7_ADDR A:0xf986441c
y.create.l HWIO_PERIPH_SS_SDC3_SDCC_MCI_FIFO_ALT8_ADDR A:0xf9864420
y.create.l HWIO_PERIPH_SS_SDC3_SDCC_MCI_FIFO_ALT9_ADDR A:0xf9864424
y.create.l HWIO_PERIPH_SS_SDC3_SDCC_DML_CONFIG_ADDR A:0xf9864800
y.create.l HWIO_PERIPH_SS_SDC3_SDCC_DML_STATUS_ADDR A:0xf9864804
y.create.l HWIO_PERIPH_SS_SDC3_SDCC_DML_SW_RESET_ADDR A:0xf9864808
y.create.l HWIO_PERIPH_SS_SDC3_SDCC_DML_PRODUCER_START_ADDR A:0xf986480c
y.create.l HWIO_PERIPH_SS_SDC3_SDCC_DML_CONSUMER_START_ADDR A:0xf9864810
y.create.l HWIO_PERIPH_SS_SDC3_SDCC_DML_PRODUCER_PIPE_LOGICAL_SIZE_ADDR A:0xf9864814
y.create.l HWIO_PERIPH_SS_SDC3_SDCC_DML_CONSUMER_PIPE_LOGICAL_SIZE_ADDR A:0xf9864818
y.create.l HWIO_PERIPH_SS_SDC3_SDCC_DML_PIPE_ID_ADDR A:0xf986481c
y.create.l HWIO_PERIPH_SS_SDC3_SDCC_DML_PRODUCER_TRACKERS_ADDR A:0xf9864820
y.create.l HWIO_PERIPH_SS_SDC3_SDCC_DML_PRODUCER_BAM_BLOCK_SIZE_ADDR A:0xf9864824
y.create.l HWIO_PERIPH_SS_SDC3_SDCC_DML_PRODUCER_BAM_TRANS_SIZE_ADDR A:0xf9864828
y.create.l HWIO_PERIPH_SS_SDC3_SDCC_DML_DIRECT_MODE_BASE_ADDR_ADDR A:0xf986482c
y.create.l HWIO_PERIPH_SS_SDC3_SDCC_DML_DEBUG_ADDR A:0xf9864830
y.create.l HWIO_PERIPH_SS_SDC3_SDCC_DML_BAM_SIDE_STATUS_1_ADDR A:0xf9864834
y.create.l HWIO_PERIPH_SS_SDC3_SDCC_DML_BAM_SIDE_STATUS_2_ADDR A:0xf9864838
y.create.l HWIO_PERIPH_SS_SDC3_SDCC_DML_RTL_GENERICS_1_ADDR A:0xf986483c
y.create.l HWIO_PERIPH_SS_SDC3_SDCC_DML_RTL_GENERICS_2_ADDR A:0xf9864840
y.create.l HWIO_PERIPH_SS_SDC3_SDCC_DML_RTL_GENERICS_3_ADDR A:0xf9864844
y.create.l HWIO_PERIPH_SS_SDC3_SDCC_DML_INTERRUPT_ENABLE_ADDR A:0xf9864848
y.create.l HWIO_PERIPH_SS_SDC3_SDCC_DML_INTERRUPT_CLEAR_ADDR A:0xf986484c
y.create.l HWIO_PERIPH_SS_SDC3_SDCC_HC_REG_0_2_ADDR A:0xf9864900
y.create.l HWIO_PERIPH_SS_SDC3_SDCC_HC_REG_4_6_ADDR A:0xf9864904
y.create.l HWIO_PERIPH_SS_SDC3_SDCC_HC_REG_8_A_ADDR A:0xf9864908
y.create.l HWIO_PERIPH_SS_SDC3_SDCC_HC_REG_C_E_ADDR A:0xf986490c
y.create.l HWIO_PERIPH_SS_SDC3_SDCC_HC_REG_10_12_ADDR A:0xf9864910
y.create.l HWIO_PERIPH_SS_SDC3_SDCC_HC_REG_14_16_ADDR A:0xf9864914
y.create.l HWIO_PERIPH_SS_SDC3_SDCC_HC_REG_18_1A_ADDR A:0xf9864918
y.create.l HWIO_PERIPH_SS_SDC3_SDCC_HC_REG_1C_1E_ADDR A:0xf986491c
y.create.l HWIO_PERIPH_SS_SDC3_SDCC_HC_REG_20_22_ADDR A:0xf9864920
y.create.l HWIO_PERIPH_SS_SDC3_SDCC_HC_REG_24_26_ADDR A:0xf9864924
y.create.l HWIO_PERIPH_SS_SDC3_SDCC_HC_REG_28_2A_ADDR A:0xf9864928
y.create.l HWIO_PERIPH_SS_SDC3_SDCC_HC_REG_2C_2E_ADDR A:0xf986492c
y.create.l HWIO_PERIPH_SS_SDC3_SDCC_HC_REG_30_32_ADDR A:0xf9864930
y.create.l HWIO_PERIPH_SS_SDC3_SDCC_HC_REG_34_36_ADDR A:0xf9864934
y.create.l HWIO_PERIPH_SS_SDC3_SDCC_HC_REG_38_3A_ADDR A:0xf9864938
y.create.l HWIO_PERIPH_SS_SDC3_SDCC_HC_REG_3C_3E_ADDR A:0xf986493c
y.create.l HWIO_PERIPH_SS_SDC3_SDCC_HC_REG_40_42_ADDR A:0xf9864940
y.create.l HWIO_PERIPH_SS_SDC3_SDCC_HC_REG_44_46_ADDR A:0xf9864944
y.create.l HWIO_PERIPH_SS_SDC3_SDCC_HC_REG_48_4A_ADDR A:0xf9864948
y.create.l HWIO_PERIPH_SS_SDC3_SDCC_HC_REG_50_52_ADDR A:0xf9864950
y.create.l HWIO_PERIPH_SS_SDC3_SDCC_HC_REG_54_56_ADDR A:0xf9864954
y.create.l HWIO_PERIPH_SS_SDC3_SDCC_HC_REG_58_5A_ADDR A:0xf9864958
y.create.l HWIO_PERIPH_SS_SDC3_SDCC_HC_REG_5C_5E_ADDR A:0xf986495c
y.create.l HWIO_PERIPH_SS_SDC3_SDCC_HC_REG_60_62_ADDR A:0xf9864960
y.create.l HWIO_PERIPH_SS_SDC3_SDCC_HC_REG_64_66_ADDR A:0xf9864964
y.create.l HWIO_PERIPH_SS_SDC3_SDCC_HC_REG_68_6A_ADDR A:0xf9864968
y.create.l HWIO_PERIPH_SS_SDC3_SDCC_HC_REG_6C_6E_ADDR A:0xf986496c
y.create.l HWIO_PERIPH_SS_SDC3_SDCC_HC_REG_E0_E2_ADDR A:0xf98649e0
y.create.l HWIO_PERIPH_SS_SDC3_SDCC_HC_REG_FC_FE_ADDR A:0xf98649fc
y.create.l HWIO_PERIPH_SS_SDC3_SDCC_HC_REG_DLL_CONFIG_ADDR A:0xf9864a00
y.create.l HWIO_PERIPH_SS_SDC3_SDCC_HC_REG_DLL_TEST_CTL_ADDR A:0xf9864a04
y.create.l HWIO_PERIPH_SS_SDC3_SDCC_HC_REG_DLL_STATUS_ADDR A:0xf9864a08
y.create.l HWIO_PERIPH_SS_SDC3_SDCC_HC_VENDOR_SPECIFIC_FUNC_ADDR A:0xf9864a0c
y.create.l HWIO_PERIPH_SS_SDC3_SDCC_HC_VENDOR_SPECIFIC_ADMA_ERR_ADDR0_ADDR A:0xf9864a14
y.create.l HWIO_PERIPH_SS_SDC3_SDCC_HC_VENDOR_SPECIFIC_ADMA_ERR_ADDR1_ADDR A:0xf9864a18
y.create.l HWIO_PERIPH_SS_SDC3_SDCC_BAM_CTRL_ADDR A:0xf9844000
y.create.l HWIO_PERIPH_SS_SDC3_SDCC_BAM_REVISION_ADDR A:0xf9844004
y.create.l HWIO_PERIPH_SS_SDC3_SDCC_BAM_SW_VERSION_ADDR A:0xf9844080
y.create.l HWIO_PERIPH_SS_SDC3_SDCC_BAM_NUM_PIPES_ADDR A:0xf984403c
y.create.l HWIO_PERIPH_SS_SDC3_SDCC_BAM_TIMER_ADDR A:0xf9844040
y.create.l HWIO_PERIPH_SS_SDC3_SDCC_BAM_TIMER_CTRL_ADDR A:0xf9844044
y.create.l HWIO_PERIPH_SS_SDC3_SDCC_BAM_DESC_CNT_TRSHLD_ADDR A:0xf9844008
y.create.l HWIO_PERIPH_SS_SDC3_SDCC_BAM_IRQ_SRCS_ADDR A:0xf984400c
y.create.l HWIO_PERIPH_SS_SDC3_SDCC_BAM_IRQ_SRCS_MSK_ADDR A:0xf9844010
y.create.l HWIO_PERIPH_SS_SDC3_SDCC_BAM_IRQ_SRCS_UNMASKED_ADDR A:0xf9844030
y.create.l HWIO_PERIPH_SS_SDC3_SDCC_BAM_IRQ_STTS_ADDR A:0xf9844014
y.create.l HWIO_PERIPH_SS_SDC3_SDCC_BAM_IRQ_CLR_ADDR A:0xf9844018
y.create.l HWIO_PERIPH_SS_SDC3_SDCC_BAM_IRQ_EN_ADDR A:0xf984401c
y.create.l HWIO_PERIPH_SS_SDC3_SDCC_BAM_AHB_MASTER_ERR_CTRLS_ADDR A:0xf9844024
y.create.l HWIO_PERIPH_SS_SDC3_SDCC_BAM_AHB_MASTER_ERR_ADDR_ADDR A:0xf9844028
y.create.l HWIO_PERIPH_SS_SDC3_SDCC_BAM_AHB_MASTER_ERR_DATA_ADDR A:0xf984402c
y.create.l HWIO_PERIPH_SS_SDC3_SDCC_BAM_TRUST_REG_ADDR A:0xf9844070
y.create.l HWIO_PERIPH_SS_SDC3_SDCC_BAM_TEST_BUS_SEL_ADDR A:0xf9844074
y.create.l HWIO_PERIPH_SS_SDC3_SDCC_BAM_TEST_BUS_REG_ADDR A:0xf9844078
y.create.l HWIO_PERIPH_SS_SDC3_SDCC_BAM_CNFG_BITS_ADDR A:0xf984407c
y.create.l HWIO_PERIPH_SS_SDC3_SDCC_BAM_IRQ_SRCS_EE0_ADDR A:0xf9844800
y.create.l HWIO_PERIPH_SS_SDC3_SDCC_BAM_IRQ_SRCS_EE1_ADDR A:0xf9844880
y.create.l HWIO_PERIPH_SS_SDC3_SDCC_BAM_IRQ_SRCS_EE2_ADDR A:0xf9844900
y.create.l HWIO_PERIPH_SS_SDC3_SDCC_BAM_IRQ_SRCS_EE3_ADDR A:0xf9844980
y.create.l HWIO_PERIPH_SS_SDC3_SDCC_BAM_IRQ_SRCS_EE4_ADDR A:0xf9844a00
y.create.l HWIO_PERIPH_SS_SDC3_SDCC_BAM_IRQ_SRCS_EE5_ADDR A:0xf9844a80
y.create.l HWIO_PERIPH_SS_SDC3_SDCC_BAM_IRQ_SRCS_EE6_ADDR A:0xf9844b00
y.create.l HWIO_PERIPH_SS_SDC3_SDCC_BAM_IRQ_SRCS_EE7_ADDR A:0xf9844b80
y.create.l HWIO_PERIPH_SS_SDC3_SDCC_BAM_IRQ_SRCS_MSK_EE0_ADDR A:0xf9844804
y.create.l HWIO_PERIPH_SS_SDC3_SDCC_BAM_IRQ_SRCS_MSK_EE1_ADDR A:0xf9844884
y.create.l HWIO_PERIPH_SS_SDC3_SDCC_BAM_IRQ_SRCS_MSK_EE2_ADDR A:0xf9844904
y.create.l HWIO_PERIPH_SS_SDC3_SDCC_BAM_IRQ_SRCS_MSK_EE3_ADDR A:0xf9844984
y.create.l HWIO_PERIPH_SS_SDC3_SDCC_BAM_IRQ_SRCS_MSK_EE4_ADDR A:0xf9844a04
y.create.l HWIO_PERIPH_SS_SDC3_SDCC_BAM_IRQ_SRCS_MSK_EE5_ADDR A:0xf9844a84
y.create.l HWIO_PERIPH_SS_SDC3_SDCC_BAM_IRQ_SRCS_MSK_EE6_ADDR A:0xf9844b04
y.create.l HWIO_PERIPH_SS_SDC3_SDCC_BAM_IRQ_SRCS_MSK_EE7_ADDR A:0xf9844b84
y.create.l HWIO_PERIPH_SS_SDC3_SDCC_BAM_IRQ_SRCS_UNMASKED_EE0_ADDR A:0xf9844808
y.create.l HWIO_PERIPH_SS_SDC3_SDCC_BAM_IRQ_SRCS_UNMASKED_EE1_ADDR A:0xf9844888
y.create.l HWIO_PERIPH_SS_SDC3_SDCC_BAM_IRQ_SRCS_UNMASKED_EE2_ADDR A:0xf9844908
y.create.l HWIO_PERIPH_SS_SDC3_SDCC_BAM_IRQ_SRCS_UNMASKED_EE3_ADDR A:0xf9844988
y.create.l HWIO_PERIPH_SS_SDC3_SDCC_BAM_IRQ_SRCS_UNMASKED_EE4_ADDR A:0xf9844a08
y.create.l HWIO_PERIPH_SS_SDC3_SDCC_BAM_IRQ_SRCS_UNMASKED_EE5_ADDR A:0xf9844a88
y.create.l HWIO_PERIPH_SS_SDC3_SDCC_BAM_IRQ_SRCS_UNMASKED_EE6_ADDR A:0xf9844b08
y.create.l HWIO_PERIPH_SS_SDC3_SDCC_BAM_IRQ_SRCS_UNMASKED_EE7_ADDR A:0xf9844b88
y.create.l HWIO_PERIPH_SS_SDC3_SDCC_BAM_P_CTRL0_ADDR A:0xf9845000
y.create.l HWIO_PERIPH_SS_SDC3_SDCC_BAM_P_CTRL1_ADDR A:0xf9846000
y.create.l HWIO_PERIPH_SS_SDC3_SDCC_BAM_P_CTRL2_ADDR A:0xf9847000
y.create.l HWIO_PERIPH_SS_SDC3_SDCC_BAM_P_CTRL3_ADDR A:0xf9848000
y.create.l HWIO_PERIPH_SS_SDC3_SDCC_BAM_P_CTRL4_ADDR A:0xf9849000
y.create.l HWIO_PERIPH_SS_SDC3_SDCC_BAM_P_CTRL5_ADDR A:0xf984a000
y.create.l HWIO_PERIPH_SS_SDC3_SDCC_BAM_P_RST0_ADDR A:0xf9845004
y.create.l HWIO_PERIPH_SS_SDC3_SDCC_BAM_P_RST1_ADDR A:0xf9846004
y.create.l HWIO_PERIPH_SS_SDC3_SDCC_BAM_P_RST2_ADDR A:0xf9847004
y.create.l HWIO_PERIPH_SS_SDC3_SDCC_BAM_P_RST3_ADDR A:0xf9848004
y.create.l HWIO_PERIPH_SS_SDC3_SDCC_BAM_P_RST4_ADDR A:0xf9849004
y.create.l HWIO_PERIPH_SS_SDC3_SDCC_BAM_P_RST5_ADDR A:0xf984a004
y.create.l HWIO_PERIPH_SS_SDC3_SDCC_BAM_P_HALT0_ADDR A:0xf9845008
y.create.l HWIO_PERIPH_SS_SDC3_SDCC_BAM_P_HALT1_ADDR A:0xf9846008
y.create.l HWIO_PERIPH_SS_SDC3_SDCC_BAM_P_HALT2_ADDR A:0xf9847008
y.create.l HWIO_PERIPH_SS_SDC3_SDCC_BAM_P_HALT3_ADDR A:0xf9848008
y.create.l HWIO_PERIPH_SS_SDC3_SDCC_BAM_P_HALT4_ADDR A:0xf9849008
y.create.l HWIO_PERIPH_SS_SDC3_SDCC_BAM_P_HALT5_ADDR A:0xf984a008
y.create.l HWIO_PERIPH_SS_SDC3_SDCC_BAM_P_TRUST_REG0_ADDR A:0xf9845030
y.create.l HWIO_PERIPH_SS_SDC3_SDCC_BAM_P_TRUST_REG1_ADDR A:0xf9846030
y.create.l HWIO_PERIPH_SS_SDC3_SDCC_BAM_P_TRUST_REG2_ADDR A:0xf9847030
y.create.l HWIO_PERIPH_SS_SDC3_SDCC_BAM_P_TRUST_REG3_ADDR A:0xf9848030
y.create.l HWIO_PERIPH_SS_SDC3_SDCC_BAM_P_TRUST_REG4_ADDR A:0xf9849030
y.create.l HWIO_PERIPH_SS_SDC3_SDCC_BAM_P_TRUST_REG5_ADDR A:0xf984a030
y.create.l HWIO_PERIPH_SS_SDC3_SDCC_BAM_P_IRQ_STTS0_ADDR A:0xf9845010
y.create.l HWIO_PERIPH_SS_SDC3_SDCC_BAM_P_IRQ_STTS1_ADDR A:0xf9846010
y.create.l HWIO_PERIPH_SS_SDC3_SDCC_BAM_P_IRQ_STTS2_ADDR A:0xf9847010
y.create.l HWIO_PERIPH_SS_SDC3_SDCC_BAM_P_IRQ_STTS3_ADDR A:0xf9848010
y.create.l HWIO_PERIPH_SS_SDC3_SDCC_BAM_P_IRQ_STTS4_ADDR A:0xf9849010
y.create.l HWIO_PERIPH_SS_SDC3_SDCC_BAM_P_IRQ_STTS5_ADDR A:0xf984a010
y.create.l HWIO_PERIPH_SS_SDC3_SDCC_BAM_P_IRQ_CLR0_ADDR A:0xf9845014
y.create.l HWIO_PERIPH_SS_SDC3_SDCC_BAM_P_IRQ_CLR1_ADDR A:0xf9846014
y.create.l HWIO_PERIPH_SS_SDC3_SDCC_BAM_P_IRQ_CLR2_ADDR A:0xf9847014
y.create.l HWIO_PERIPH_SS_SDC3_SDCC_BAM_P_IRQ_CLR3_ADDR A:0xf9848014
y.create.l HWIO_PERIPH_SS_SDC3_SDCC_BAM_P_IRQ_CLR4_ADDR A:0xf9849014
y.create.l HWIO_PERIPH_SS_SDC3_SDCC_BAM_P_IRQ_CLR5_ADDR A:0xf984a014
y.create.l HWIO_PERIPH_SS_SDC3_SDCC_BAM_P_IRQ_EN0_ADDR A:0xf9845018
y.create.l HWIO_PERIPH_SS_SDC3_SDCC_BAM_P_IRQ_EN1_ADDR A:0xf9846018
y.create.l HWIO_PERIPH_SS_SDC3_SDCC_BAM_P_IRQ_EN2_ADDR A:0xf9847018
y.create.l HWIO_PERIPH_SS_SDC3_SDCC_BAM_P_IRQ_EN3_ADDR A:0xf9848018
y.create.l HWIO_PERIPH_SS_SDC3_SDCC_BAM_P_IRQ_EN4_ADDR A:0xf9849018
y.create.l HWIO_PERIPH_SS_SDC3_SDCC_BAM_P_IRQ_EN5_ADDR A:0xf984a018
y.create.l HWIO_PERIPH_SS_SDC3_SDCC_BAM_P_TIMER0_ADDR A:0xf984501c
y.create.l HWIO_PERIPH_SS_SDC3_SDCC_BAM_P_TIMER1_ADDR A:0xf984601c
y.create.l HWIO_PERIPH_SS_SDC3_SDCC_BAM_P_TIMER2_ADDR A:0xf984701c
y.create.l HWIO_PERIPH_SS_SDC3_SDCC_BAM_P_TIMER3_ADDR A:0xf984801c
y.create.l HWIO_PERIPH_SS_SDC3_SDCC_BAM_P_TIMER4_ADDR A:0xf984901c
y.create.l HWIO_PERIPH_SS_SDC3_SDCC_BAM_P_TIMER5_ADDR A:0xf984a01c
y.create.l HWIO_PERIPH_SS_SDC3_SDCC_BAM_P_TIMER_CTRL0_ADDR A:0xf9845020
y.create.l HWIO_PERIPH_SS_SDC3_SDCC_BAM_P_TIMER_CTRL1_ADDR A:0xf9846020
y.create.l HWIO_PERIPH_SS_SDC3_SDCC_BAM_P_TIMER_CTRL2_ADDR A:0xf9847020
y.create.l HWIO_PERIPH_SS_SDC3_SDCC_BAM_P_TIMER_CTRL3_ADDR A:0xf9848020
y.create.l HWIO_PERIPH_SS_SDC3_SDCC_BAM_P_TIMER_CTRL4_ADDR A:0xf9849020
y.create.l HWIO_PERIPH_SS_SDC3_SDCC_BAM_P_TIMER_CTRL5_ADDR A:0xf984a020
y.create.l HWIO_PERIPH_SS_SDC3_SDCC_BAM_P_PRDCR_SDBND0_ADDR A:0xf9845024
y.create.l HWIO_PERIPH_SS_SDC3_SDCC_BAM_P_PRDCR_SDBND1_ADDR A:0xf9846024
y.create.l HWIO_PERIPH_SS_SDC3_SDCC_BAM_P_PRDCR_SDBND2_ADDR A:0xf9847024
y.create.l HWIO_PERIPH_SS_SDC3_SDCC_BAM_P_PRDCR_SDBND3_ADDR A:0xf9848024
y.create.l HWIO_PERIPH_SS_SDC3_SDCC_BAM_P_PRDCR_SDBND4_ADDR A:0xf9849024
y.create.l HWIO_PERIPH_SS_SDC3_SDCC_BAM_P_PRDCR_SDBND5_ADDR A:0xf984a024
y.create.l HWIO_PERIPH_SS_SDC3_SDCC_BAM_P_CNSMR_SDBND0_ADDR A:0xf9845028
y.create.l HWIO_PERIPH_SS_SDC3_SDCC_BAM_P_CNSMR_SDBND1_ADDR A:0xf9846028
y.create.l HWIO_PERIPH_SS_SDC3_SDCC_BAM_P_CNSMR_SDBND2_ADDR A:0xf9847028
y.create.l HWIO_PERIPH_SS_SDC3_SDCC_BAM_P_CNSMR_SDBND3_ADDR A:0xf9848028
y.create.l HWIO_PERIPH_SS_SDC3_SDCC_BAM_P_CNSMR_SDBND4_ADDR A:0xf9849028
y.create.l HWIO_PERIPH_SS_SDC3_SDCC_BAM_P_CNSMR_SDBND5_ADDR A:0xf984a028
y.create.l HWIO_PERIPH_SS_SDC3_SDCC_BAM_P_EVNT_DEST_ADDR0_ADDR A:0xf984582c
y.create.l HWIO_PERIPH_SS_SDC3_SDCC_BAM_P_EVNT_DEST_ADDR1_ADDR A:0xf984682c
y.create.l HWIO_PERIPH_SS_SDC3_SDCC_BAM_P_EVNT_DEST_ADDR2_ADDR A:0xf984782c
y.create.l HWIO_PERIPH_SS_SDC3_SDCC_BAM_P_EVNT_DEST_ADDR3_ADDR A:0xf984882c
y.create.l HWIO_PERIPH_SS_SDC3_SDCC_BAM_P_EVNT_DEST_ADDR4_ADDR A:0xf984982c
y.create.l HWIO_PERIPH_SS_SDC3_SDCC_BAM_P_EVNT_DEST_ADDR5_ADDR A:0xf984a82c
y.create.l HWIO_PERIPH_SS_SDC3_SDCC_BAM_P_EVNT_REG0_ADDR A:0xf9845818
y.create.l HWIO_PERIPH_SS_SDC3_SDCC_BAM_P_EVNT_REG1_ADDR A:0xf9846818
y.create.l HWIO_PERIPH_SS_SDC3_SDCC_BAM_P_EVNT_REG2_ADDR A:0xf9847818
y.create.l HWIO_PERIPH_SS_SDC3_SDCC_BAM_P_EVNT_REG3_ADDR A:0xf9848818
y.create.l HWIO_PERIPH_SS_SDC3_SDCC_BAM_P_EVNT_REG4_ADDR A:0xf9849818
y.create.l HWIO_PERIPH_SS_SDC3_SDCC_BAM_P_EVNT_REG5_ADDR A:0xf984a818
y.create.l HWIO_PERIPH_SS_SDC3_SDCC_BAM_P_SW_OFSTS0_ADDR A:0xf9845800
y.create.l HWIO_PERIPH_SS_SDC3_SDCC_BAM_P_SW_OFSTS1_ADDR A:0xf9846800
y.create.l HWIO_PERIPH_SS_SDC3_SDCC_BAM_P_SW_OFSTS2_ADDR A:0xf9847800
y.create.l HWIO_PERIPH_SS_SDC3_SDCC_BAM_P_SW_OFSTS3_ADDR A:0xf9848800
y.create.l HWIO_PERIPH_SS_SDC3_SDCC_BAM_P_SW_OFSTS4_ADDR A:0xf9849800
y.create.l HWIO_PERIPH_SS_SDC3_SDCC_BAM_P_SW_OFSTS5_ADDR A:0xf984a800
y.create.l HWIO_PERIPH_SS_SDC3_SDCC_BAM_P_DATA_FIFO_ADDR0_ADDR A:0xf9845824
y.create.l HWIO_PERIPH_SS_SDC3_SDCC_BAM_P_DATA_FIFO_ADDR1_ADDR A:0xf9846824
y.create.l HWIO_PERIPH_SS_SDC3_SDCC_BAM_P_DATA_FIFO_ADDR2_ADDR A:0xf9847824
y.create.l HWIO_PERIPH_SS_SDC3_SDCC_BAM_P_DATA_FIFO_ADDR3_ADDR A:0xf9848824
y.create.l HWIO_PERIPH_SS_SDC3_SDCC_BAM_P_DATA_FIFO_ADDR4_ADDR A:0xf9849824
y.create.l HWIO_PERIPH_SS_SDC3_SDCC_BAM_P_DATA_FIFO_ADDR5_ADDR A:0xf984a824
y.create.l HWIO_PERIPH_SS_SDC3_SDCC_BAM_P_DESC_FIFO_ADDR0_ADDR A:0xf984581c
y.create.l HWIO_PERIPH_SS_SDC3_SDCC_BAM_P_DESC_FIFO_ADDR1_ADDR A:0xf984681c
y.create.l HWIO_PERIPH_SS_SDC3_SDCC_BAM_P_DESC_FIFO_ADDR2_ADDR A:0xf984781c
y.create.l HWIO_PERIPH_SS_SDC3_SDCC_BAM_P_DESC_FIFO_ADDR3_ADDR A:0xf984881c
y.create.l HWIO_PERIPH_SS_SDC3_SDCC_BAM_P_DESC_FIFO_ADDR4_ADDR A:0xf984981c
y.create.l HWIO_PERIPH_SS_SDC3_SDCC_BAM_P_DESC_FIFO_ADDR5_ADDR A:0xf984a81c
y.create.l HWIO_PERIPH_SS_SDC3_SDCC_BAM_P_EVNT_GEN_TRSHLD0_ADDR A:0xf9845828
y.create.l HWIO_PERIPH_SS_SDC3_SDCC_BAM_P_EVNT_GEN_TRSHLD1_ADDR A:0xf9846828
y.create.l HWIO_PERIPH_SS_SDC3_SDCC_BAM_P_EVNT_GEN_TRSHLD2_ADDR A:0xf9847828
y.create.l HWIO_PERIPH_SS_SDC3_SDCC_BAM_P_EVNT_GEN_TRSHLD3_ADDR A:0xf9848828
y.create.l HWIO_PERIPH_SS_SDC3_SDCC_BAM_P_EVNT_GEN_TRSHLD4_ADDR A:0xf9849828
y.create.l HWIO_PERIPH_SS_SDC3_SDCC_BAM_P_EVNT_GEN_TRSHLD5_ADDR A:0xf984a828
y.create.l HWIO_PERIPH_SS_SDC3_SDCC_BAM_P_FIFO_SIZES0_ADDR A:0xf9845820
y.create.l HWIO_PERIPH_SS_SDC3_SDCC_BAM_P_FIFO_SIZES1_ADDR A:0xf9846820
y.create.l HWIO_PERIPH_SS_SDC3_SDCC_BAM_P_FIFO_SIZES2_ADDR A:0xf9847820
y.create.l HWIO_PERIPH_SS_SDC3_SDCC_BAM_P_FIFO_SIZES3_ADDR A:0xf9848820
y.create.l HWIO_PERIPH_SS_SDC3_SDCC_BAM_P_FIFO_SIZES4_ADDR A:0xf9849820
y.create.l HWIO_PERIPH_SS_SDC3_SDCC_BAM_P_FIFO_SIZES5_ADDR A:0xf984a820
y.create.l HWIO_PERIPH_SS_SDC3_SDCC_BAM_P_RETR_CNTXT_0_ADDR A:0xf9845834
y.create.l HWIO_PERIPH_SS_SDC3_SDCC_BAM_P_RETR_CNTXT_1_ADDR A:0xf9846834
y.create.l HWIO_PERIPH_SS_SDC3_SDCC_BAM_P_RETR_CNTXT_2_ADDR A:0xf9847834
y.create.l HWIO_PERIPH_SS_SDC3_SDCC_BAM_P_RETR_CNTXT_3_ADDR A:0xf9848834
y.create.l HWIO_PERIPH_SS_SDC3_SDCC_BAM_P_RETR_CNTXT_4_ADDR A:0xf9849834
y.create.l HWIO_PERIPH_SS_SDC3_SDCC_BAM_P_RETR_CNTXT_5_ADDR A:0xf984a834
y.create.l HWIO_PERIPH_SS_SDC3_SDCC_BAM_P_SI_CNTXT_0_ADDR A:0xf9845838
y.create.l HWIO_PERIPH_SS_SDC3_SDCC_BAM_P_SI_CNTXT_1_ADDR A:0xf9846838
y.create.l HWIO_PERIPH_SS_SDC3_SDCC_BAM_P_SI_CNTXT_2_ADDR A:0xf9847838
y.create.l HWIO_PERIPH_SS_SDC3_SDCC_BAM_P_SI_CNTXT_3_ADDR A:0xf9848838
y.create.l HWIO_PERIPH_SS_SDC3_SDCC_BAM_P_SI_CNTXT_4_ADDR A:0xf9849838
y.create.l HWIO_PERIPH_SS_SDC3_SDCC_BAM_P_SI_CNTXT_5_ADDR A:0xf984a838
y.create.l HWIO_PERIPH_SS_SDC3_SDCC_BAM_P_DF_CNTXT_0_ADDR A:0xf9845830
y.create.l HWIO_PERIPH_SS_SDC3_SDCC_BAM_P_DF_CNTXT_1_ADDR A:0xf9846830
y.create.l HWIO_PERIPH_SS_SDC3_SDCC_BAM_P_DF_CNTXT_2_ADDR A:0xf9847830
y.create.l HWIO_PERIPH_SS_SDC3_SDCC_BAM_P_DF_CNTXT_3_ADDR A:0xf9848830
y.create.l HWIO_PERIPH_SS_SDC3_SDCC_BAM_P_DF_CNTXT_4_ADDR A:0xf9849830
y.create.l HWIO_PERIPH_SS_SDC3_SDCC_BAM_P_DF_CNTXT_5_ADDR A:0xf984a830
y.create.l HWIO_PERIPH_SS_SDC3_SDCC_BAM_P_AU_PSM_CNTXT_1_0_ADDR A:0xf9845804
y.create.l HWIO_PERIPH_SS_SDC3_SDCC_BAM_P_AU_PSM_CNTXT_1_1_ADDR A:0xf9846804
y.create.l HWIO_PERIPH_SS_SDC3_SDCC_BAM_P_AU_PSM_CNTXT_1_2_ADDR A:0xf9847804
y.create.l HWIO_PERIPH_SS_SDC3_SDCC_BAM_P_AU_PSM_CNTXT_1_3_ADDR A:0xf9848804
y.create.l HWIO_PERIPH_SS_SDC3_SDCC_BAM_P_AU_PSM_CNTXT_1_4_ADDR A:0xf9849804
y.create.l HWIO_PERIPH_SS_SDC3_SDCC_BAM_P_AU_PSM_CNTXT_1_5_ADDR A:0xf984a804
y.create.l HWIO_PERIPH_SS_SDC3_SDCC_BAM_P_PSM_CNTXT_2_0_ADDR A:0xf9845808
y.create.l HWIO_PERIPH_SS_SDC3_SDCC_BAM_P_PSM_CNTXT_2_1_ADDR A:0xf9846808
y.create.l HWIO_PERIPH_SS_SDC3_SDCC_BAM_P_PSM_CNTXT_2_2_ADDR A:0xf9847808
y.create.l HWIO_PERIPH_SS_SDC3_SDCC_BAM_P_PSM_CNTXT_2_3_ADDR A:0xf9848808
y.create.l HWIO_PERIPH_SS_SDC3_SDCC_BAM_P_PSM_CNTXT_2_4_ADDR A:0xf9849808
y.create.l HWIO_PERIPH_SS_SDC3_SDCC_BAM_P_PSM_CNTXT_2_5_ADDR A:0xf984a808
y.create.l HWIO_PERIPH_SS_SDC3_SDCC_BAM_P_PSM_CNTXT_3_0_ADDR A:0xf984580c
y.create.l HWIO_PERIPH_SS_SDC3_SDCC_BAM_P_PSM_CNTXT_3_1_ADDR A:0xf984680c
y.create.l HWIO_PERIPH_SS_SDC3_SDCC_BAM_P_PSM_CNTXT_3_2_ADDR A:0xf984780c
y.create.l HWIO_PERIPH_SS_SDC3_SDCC_BAM_P_PSM_CNTXT_3_3_ADDR A:0xf984880c
y.create.l HWIO_PERIPH_SS_SDC3_SDCC_BAM_P_PSM_CNTXT_3_4_ADDR A:0xf984980c
y.create.l HWIO_PERIPH_SS_SDC3_SDCC_BAM_P_PSM_CNTXT_3_5_ADDR A:0xf984a80c
y.create.l HWIO_PERIPH_SS_SDC3_SDCC_BAM_P_PSM_CNTXT_4_0_ADDR A:0xf9845810
y.create.l HWIO_PERIPH_SS_SDC3_SDCC_BAM_P_PSM_CNTXT_4_1_ADDR A:0xf9846810
y.create.l HWIO_PERIPH_SS_SDC3_SDCC_BAM_P_PSM_CNTXT_4_2_ADDR A:0xf9847810
y.create.l HWIO_PERIPH_SS_SDC3_SDCC_BAM_P_PSM_CNTXT_4_3_ADDR A:0xf9848810
y.create.l HWIO_PERIPH_SS_SDC3_SDCC_BAM_P_PSM_CNTXT_4_4_ADDR A:0xf9849810
y.create.l HWIO_PERIPH_SS_SDC3_SDCC_BAM_P_PSM_CNTXT_4_5_ADDR A:0xf984a810
y.create.l HWIO_PERIPH_SS_SDC3_SDCC_BAM_P_PSM_CNTXT_5_0_ADDR A:0xf9845814
y.create.l HWIO_PERIPH_SS_SDC3_SDCC_BAM_P_PSM_CNTXT_5_1_ADDR A:0xf9846814
y.create.l HWIO_PERIPH_SS_SDC3_SDCC_BAM_P_PSM_CNTXT_5_2_ADDR A:0xf9847814
y.create.l HWIO_PERIPH_SS_SDC3_SDCC_BAM_P_PSM_CNTXT_5_3_ADDR A:0xf9848814
y.create.l HWIO_PERIPH_SS_SDC3_SDCC_BAM_P_PSM_CNTXT_5_4_ADDR A:0xf9849814
y.create.l HWIO_PERIPH_SS_SDC3_SDCC_BAM_P_PSM_CNTXT_5_5_ADDR A:0xf984a814
y.create.l HWIO_PERIPH_SS_SDC3_SDCC_XPU_SCR_ADDR A:0xf9842000
y.create.l HWIO_PERIPH_SS_SDC3_SDCC_XPU_SWDR_ADDR A:0xf9842004
y.create.l HWIO_PERIPH_SS_SDC3_SDCC_XPU_SEAR0_ADDR A:0xf9842040
y.create.l HWIO_PERIPH_SS_SDC3_SDCC_XPU_SESR_ADDR A:0xf9842048
y.create.l HWIO_PERIPH_SS_SDC3_SDCC_XPU_SESRRESTORE_ADDR A:0xf984204c
y.create.l HWIO_PERIPH_SS_SDC3_SDCC_XPU_SESYNR0_ADDR A:0xf9842050
y.create.l HWIO_PERIPH_SS_SDC3_SDCC_XPU_SESYNR1_ADDR A:0xf9842054
y.create.l HWIO_PERIPH_SS_SDC3_SDCC_XPU_SESYNR2_ADDR A:0xf9842058
y.create.l HWIO_PERIPH_SS_SDC3_SDCC_XPU_MCR_ADDR A:0xf9842100
y.create.l HWIO_PERIPH_SS_SDC3_SDCC_XPU_MEAR0_ADDR A:0xf9842140
y.create.l HWIO_PERIPH_SS_SDC3_SDCC_XPU_MESR_ADDR A:0xf9842148
y.create.l HWIO_PERIPH_SS_SDC3_SDCC_XPU_MESRRESTORE_ADDR A:0xf984214c
y.create.l HWIO_PERIPH_SS_SDC3_SDCC_XPU_MESYNR0_ADDR A:0xf9842150
y.create.l HWIO_PERIPH_SS_SDC3_SDCC_XPU_MESYNR1_ADDR A:0xf9842154
y.create.l HWIO_PERIPH_SS_SDC3_SDCC_XPU_MESYNR2_ADDR A:0xf9842158
y.create.l HWIO_PERIPH_SS_SDC3_SDCC_XPU_CR_ADDR A:0xf9842080
y.create.l HWIO_PERIPH_SS_SDC3_SDCC_XPU_RPU_ACR0_ADDR A:0xf98420a0
y.create.l HWIO_PERIPH_SS_SDC3_SDCC_XPU_EAR0_ADDR A:0xf98420c0
y.create.l HWIO_PERIPH_SS_SDC3_SDCC_XPU_ESR_ADDR A:0xf98420c8
y.create.l HWIO_PERIPH_SS_SDC3_SDCC_XPU_ESRRESTORE_ADDR A:0xf98420cc
y.create.l HWIO_PERIPH_SS_SDC3_SDCC_XPU_ESYNR0_ADDR A:0xf98420d0
y.create.l HWIO_PERIPH_SS_SDC3_SDCC_XPU_ESYNR1_ADDR A:0xf98420d4
y.create.l HWIO_PERIPH_SS_SDC3_SDCC_XPU_ESYNR2_ADDR A:0xf98420d8
y.create.l HWIO_PERIPH_SS_SDC3_SDCC_XPU_IDR0_ADDR A:0xf9842074
y.create.l HWIO_PERIPH_SS_SDC3_SDCC_XPU_IDR1_ADDR A:0xf9842078
y.create.l HWIO_PERIPH_SS_SDC3_SDCC_XPU_REV_ADDR A:0xf984207c
y.create.l HWIO_PERIPH_SS_SDC3_SDCC_XPU_RG0_RACR0_ADDR A:0xf9842200
y.create.l HWIO_PERIPH_SS_SDC3_SDCC_XPU_RG1_RACR0_ADDR A:0xf9842280
y.create.l HWIO_PERIPH_SS_SDC3_SDCC_XPU_RG2_RACR0_ADDR A:0xf9842300
y.create.l HWIO_PERIPH_SS_SDC3_SDCC_XPU_RG3_RACR0_ADDR A:0xf9842380
y.create.l HWIO_PERIPH_SS_SDC3_SDCC_XPU_RG4_RACR0_ADDR A:0xf9842400
y.create.l HWIO_PERIPH_SS_SDC3_SDCC_XPU_RG5_RACR0_ADDR A:0xf9842480
y.create.l HWIO_PERIPH_SS_SDC3_SDCC_XPU_RG6_RACR0_ADDR A:0xf9842500
y.create.l HWIO_PERIPH_SS_SDC3_SDCC_XPU_RG7_RACR0_ADDR A:0xf9842580
y.create.l HWIO_PERIPH_SS_SDC3_SDCC_XPU_RG8_RACR0_ADDR A:0xf9842600
y.create.l HWIO_PERIPH_SS_SDC3_SDCC_XPU_RG9_RACR0_ADDR A:0xf9842680
y.create.l HWIO_PERIPH_SS_SDC3_SDCC_XPU_RG0_SCR_ADDR A:0xf9842250
y.create.l HWIO_PERIPH_SS_SDC3_SDCC_XPU_RG1_SCR_ADDR A:0xf98422d0
y.create.l HWIO_PERIPH_SS_SDC3_SDCC_XPU_RG2_SCR_ADDR A:0xf9842350
y.create.l HWIO_PERIPH_SS_SDC3_SDCC_XPU_RG3_SCR_ADDR A:0xf98423d0
y.create.l HWIO_PERIPH_SS_SDC3_SDCC_XPU_RG4_SCR_ADDR A:0xf9842450
y.create.l HWIO_PERIPH_SS_SDC3_SDCC_XPU_RG5_SCR_ADDR A:0xf98424d0
y.create.l HWIO_PERIPH_SS_SDC3_SDCC_XPU_RG6_SCR_ADDR A:0xf9842550
y.create.l HWIO_PERIPH_SS_SDC3_SDCC_XPU_RG7_SCR_ADDR A:0xf98425d0
y.create.l HWIO_PERIPH_SS_SDC3_SDCC_XPU_RG8_SCR_ADDR A:0xf9842650
y.create.l HWIO_PERIPH_SS_SDC3_SDCC_XPU_RG9_SCR_ADDR A:0xf98426d0
y.create.l HWIO_PERIPH_SS_SDC3_SDCC_XPU_RG0_MCR_ADDR A:0xf9842254
y.create.l HWIO_PERIPH_SS_SDC3_SDCC_XPU_RG1_MCR_ADDR A:0xf98422d4
y.create.l HWIO_PERIPH_SS_SDC3_SDCC_XPU_RG2_MCR_ADDR A:0xf9842354
y.create.l HWIO_PERIPH_SS_SDC3_SDCC_XPU_RG3_MCR_ADDR A:0xf98423d4
y.create.l HWIO_PERIPH_SS_SDC3_SDCC_XPU_RG4_MCR_ADDR A:0xf9842454
y.create.l HWIO_PERIPH_SS_SDC3_SDCC_XPU_RG5_MCR_ADDR A:0xf98424d4
y.create.l HWIO_PERIPH_SS_SDC3_SDCC_XPU_RG6_MCR_ADDR A:0xf9842554
y.create.l HWIO_PERIPH_SS_SDC3_SDCC_XPU_RG7_MCR_ADDR A:0xf98425d4
y.create.l HWIO_PERIPH_SS_SDC3_SDCC_XPU_RG8_MCR_ADDR A:0xf9842654
y.create.l HWIO_PERIPH_SS_SDC3_SDCC_XPU_RG9_MCR_ADDR A:0xf98426d4
y.create.l HWIO_PERIPH_SS_SDC3_SDCC_VMIDMT_SCR0_ADDR A:0xf9840000
y.create.l HWIO_PERIPH_SS_SDC3_SDCC_VMIDMT_SCR1_ADDR A:0xf9840004
y.create.l HWIO_PERIPH_SS_SDC3_SDCC_VMIDMT_SCR2_ADDR A:0xf9840008
y.create.l HWIO_PERIPH_SS_SDC3_SDCC_VMIDMT_SACR_ADDR A:0xf9840010
y.create.l HWIO_PERIPH_SS_SDC3_SDCC_VMIDMT_SIDR0_ADDR A:0xf9840020
y.create.l HWIO_PERIPH_SS_SDC3_SDCC_VMIDMT_SIDR1_ADDR A:0xf9840024
y.create.l HWIO_PERIPH_SS_SDC3_SDCC_VMIDMT_SIDR2_ADDR A:0xf9840028
y.create.l HWIO_PERIPH_SS_SDC3_SDCC_VMIDMT_SIDR4_ADDR A:0xf9840030
y.create.l HWIO_PERIPH_SS_SDC3_SDCC_VMIDMT_SIDR5_ADDR A:0xf9840034
y.create.l HWIO_PERIPH_SS_SDC3_SDCC_VMIDMT_SIDR7_ADDR A:0xf984003c
y.create.l HWIO_PERIPH_SS_SDC3_SDCC_VMIDMT_SGFAR0_ADDR A:0xf9840040
y.create.l HWIO_PERIPH_SS_SDC3_SDCC_VMIDMT_SGFSR_ADDR A:0xf9840048
y.create.l HWIO_PERIPH_SS_SDC3_SDCC_VMIDMT_SGFSRRESTORE_ADDR A:0xf984004c
y.create.l HWIO_PERIPH_SS_SDC3_SDCC_VMIDMT_SGFSYNDR0_ADDR A:0xf9840050
y.create.l HWIO_PERIPH_SS_SDC3_SDCC_VMIDMT_SGFSYNDR1_ADDR A:0xf9840054
y.create.l HWIO_PERIPH_SS_SDC3_SDCC_VMIDMT_SGFSYNDR2_ADDR A:0xf9840058
y.create.l HWIO_PERIPH_SS_SDC3_SDCC_VMIDMT_VMIDMTSCR0_ADDR A:0xf9840090
y.create.l HWIO_PERIPH_SS_SDC3_SDCC_VMIDMT_CR0_ADDR A:0xf9840000
y.create.l HWIO_PERIPH_SS_SDC3_SDCC_VMIDMT_CR2_ADDR A:0xf9840008
y.create.l HWIO_PERIPH_SS_SDC3_SDCC_VMIDMT_ACR_ADDR A:0xf9840010
y.create.l HWIO_PERIPH_SS_SDC3_SDCC_VMIDMT_IDR0_ADDR A:0xf9840020
y.create.l HWIO_PERIPH_SS_SDC3_SDCC_VMIDMT_IDR1_ADDR A:0xf9840024
y.create.l HWIO_PERIPH_SS_SDC3_SDCC_VMIDMT_IDR2_ADDR A:0xf9840028
y.create.l HWIO_PERIPH_SS_SDC3_SDCC_VMIDMT_IDR4_ADDR A:0xf9840030
y.create.l HWIO_PERIPH_SS_SDC3_SDCC_VMIDMT_IDR5_ADDR A:0xf9840034
y.create.l HWIO_PERIPH_SS_SDC3_SDCC_VMIDMT_IDR7_ADDR A:0xf984003c
y.create.l HWIO_PERIPH_SS_SDC3_SDCC_VMIDMT_GFAR0_ADDR A:0xf9840040
y.create.l HWIO_PERIPH_SS_SDC3_SDCC_VMIDMT_GFSR_ADDR A:0xf9840048
y.create.l HWIO_PERIPH_SS_SDC3_SDCC_VMIDMT_GFSRRESTORE_ADDR A:0xf984004c
y.create.l HWIO_PERIPH_SS_SDC3_SDCC_VMIDMT_GFSYNDR0_ADDR A:0xf9840050
y.create.l HWIO_PERIPH_SS_SDC3_SDCC_VMIDMT_GFSYNDR1_ADDR A:0xf9840054
y.create.l HWIO_PERIPH_SS_SDC3_SDCC_VMIDMT_GFSYNDR2_ADDR A:0xf9840058
y.create.l HWIO_PERIPH_SS_SDC3_SDCC_VMIDMT_VMIDMTCR0_ADDR A:0xf9840090
y.create.l HWIO_PERIPH_SS_SDC3_SDCC_VMIDMT_VMIDMTACR_ADDR A:0xf984009c
y.create.l HWIO_PERIPH_SS_SDC3_SDCC_VMIDMT_NSCR0_ADDR A:0xf9840400
y.create.l HWIO_PERIPH_SS_SDC3_SDCC_VMIDMT_NSCR2_ADDR A:0xf9840408
y.create.l HWIO_PERIPH_SS_SDC3_SDCC_VMIDMT_NSACR_ADDR A:0xf9840410
y.create.l HWIO_PERIPH_SS_SDC3_SDCC_VMIDMT_NSGFAR0_ADDR A:0xf9840440
y.create.l HWIO_PERIPH_SS_SDC3_SDCC_VMIDMT_NSGFSR_ADDR A:0xf9840448
y.create.l HWIO_PERIPH_SS_SDC3_SDCC_VMIDMT_NSGFSRRESTORE_ADDR A:0xf984044c
y.create.l HWIO_PERIPH_SS_SDC3_SDCC_VMIDMT_NSGFSYNDR0_ADDR A:0xf9840450
y.create.l HWIO_PERIPH_SS_SDC3_SDCC_VMIDMT_NSGFSYNDR1_ADDR A:0xf9840454
y.create.l HWIO_PERIPH_SS_SDC3_SDCC_VMIDMT_NSGFSYNDR2_ADDR A:0xf9840458
y.create.l HWIO_PERIPH_SS_SDC3_SDCC_VMIDMT_NSVMIDMTCR0_ADDR A:0xf9840490
y.create.l HWIO_PERIPH_SS_SDC3_SDCC_VMIDMT_SSDR0_ADDR A:0xf9840080
y.create.l HWIO_PERIPH_SS_SDC3_SDCC_VMIDMT_MSDR0_ADDR A:0xf9840480
y.create.l HWIO_PERIPH_SS_SDC3_SDCC_VMIDMT_MCR_ADDR A:0xf9840494
y.create.l HWIO_PERIPH_SS_SDC3_SDCC_VMIDMT_S2VR0_ADDR A:0xf9840c00
y.create.l HWIO_PERIPH_SS_SDC3_SDCC_VMIDMT_S2VR1_ADDR A:0xf9840c04
y.create.l HWIO_PERIPH_SS_SDC3_SDCC_VMIDMT_S2VR2_ADDR A:0xf9840c08
y.create.l HWIO_PERIPH_SS_SDC3_SDCC_VMIDMT_S2VR3_ADDR A:0xf9840c0c
y.create.l HWIO_PERIPH_SS_SDC3_SDCC_VMIDMT_S2VR4_ADDR A:0xf9840c10
y.create.l HWIO_PERIPH_SS_SDC3_SDCC_VMIDMT_S2VR5_ADDR A:0xf9840c14
y.create.l HWIO_PERIPH_SS_SDC3_SDCC_VMIDMT_S2VR6_ADDR A:0xf9840c18
y.create.l HWIO_PERIPH_SS_SDC3_SDCC_VMIDMT_AS2VR0_ADDR A:0xf9840e00
y.create.l HWIO_PERIPH_SS_SDC3_SDCC_VMIDMT_AS2VR1_ADDR A:0xf9840e04
y.create.l HWIO_PERIPH_SS_SDC3_SDCC_VMIDMT_AS2VR2_ADDR A:0xf9840e08
y.create.l HWIO_PERIPH_SS_SDC3_SDCC_VMIDMT_AS2VR3_ADDR A:0xf9840e0c
y.create.l HWIO_PERIPH_SS_SDC3_SDCC_VMIDMT_AS2VR4_ADDR A:0xf9840e10
y.create.l HWIO_PERIPH_SS_SDC3_SDCC_VMIDMT_AS2VR5_ADDR A:0xf9840e14
y.create.l HWIO_PERIPH_SS_SDC3_SDCC_VMIDMT_AS2VR6_ADDR A:0xf9840e18
y.create.l HWIO_PERIPH_SS_SDC3_SDCC_VMIDMT_SMR0_ADDR A:0xf9840800
y.create.l HWIO_PERIPH_SS_SDC3_SDCC_VMIDMT_SMR1_ADDR A:0xf9840804
y.create.l HWIO_PERIPH_SS_SDC3_SDCC_VMIDMT_SMR2_ADDR A:0xf9840808
y.create.l HWIO_PERIPH_SS_SDC3_SDCC_VMIDMT_SMR3_ADDR A:0xf984080c
y.create.l HWIO_PERIPH_SS_SDC3_SDCC_VMIDMT_SMR4_ADDR A:0xf9840810
y.create.l HWIO_PERIPH_SS_SDC3_SDCC_VMIDMT_SMR5_ADDR A:0xf9840814
y.create.l HWIO_PERIPH_SS_SDC3_SDCC_VMIDMT_SMR6_ADDR A:0xf9840818
y.create.l HWIO_PERIPH_SS_SDC2_SDCC_MCI_POWER_ADDR A:0xf98a4000
y.create.l HWIO_PERIPH_SS_SDC2_SDCC_MCI_CLK_ADDR A:0xf98a4004
y.create.l HWIO_PERIPH_SS_SDC2_SDCC_MCI_ARGUMENT_ADDR A:0xf98a4008
y.create.l HWIO_PERIPH_SS_SDC2_SDCC_MCI_CMD_ADDR A:0xf98a400c
y.create.l HWIO_PERIPH_SS_SDC2_SDCC_MCI_RESP_CMD_ADDR A:0xf98a4010
y.create.l HWIO_PERIPH_SS_SDC2_SDCC_MCI_RESP0_ADDR A:0xf98a4014
y.create.l HWIO_PERIPH_SS_SDC2_SDCC_MCI_RESP1_ADDR A:0xf98a4018
y.create.l HWIO_PERIPH_SS_SDC2_SDCC_MCI_RESP2_ADDR A:0xf98a401c
y.create.l HWIO_PERIPH_SS_SDC2_SDCC_MCI_RESP3_ADDR A:0xf98a4020
y.create.l HWIO_PERIPH_SS_SDC2_SDCC_MCI_DATA_TIMER_ADDR A:0xf98a4024
y.create.l HWIO_PERIPH_SS_SDC2_SDCC_MCI_DATA_LENGTH_ADDR A:0xf98a4028
y.create.l HWIO_PERIPH_SS_SDC2_SDCC_MCI_DATA_CTL_ADDR A:0xf98a402c
y.create.l HWIO_PERIPH_SS_SDC2_SDCC_MCI_DATA_COUNT_ADDR A:0xf98a4030
y.create.l HWIO_PERIPH_SS_SDC2_SDCC_MCI_STATUS_ADDR A:0xf98a4034
y.create.l HWIO_PERIPH_SS_SDC2_SDCC_MCI_CLEAR_ADDR A:0xf98a4038
y.create.l HWIO_PERIPH_SS_SDC2_SDCC_MCI_INT_MASK0_ADDR A:0xf98a403c
y.create.l HWIO_PERIPH_SS_SDC2_SDCC_MCI_INT_MASK1_ADDR A:0xf98a4040
y.create.l HWIO_PERIPH_SS_SDC2_SDCC_MCI_FIFO_COUNT_ADDR A:0xf98a4044
y.create.l HWIO_PERIPH_SS_SDC2_SDCC_MCI_BOOT_ADDR A:0xf98a4048
y.create.l HWIO_PERIPH_SS_SDC2_SDCC_MCI_BOOT_ACK_TIMER_ADDR A:0xf98a404c
y.create.l HWIO_PERIPH_SS_SDC2_SDCC_MCI_VERSION_ADDR A:0xf98a4050
y.create.l HWIO_PERIPH_SS_SDC2_SDCC_MCI_EMULATION_DLY_LINE_ADDR A:0xf98a4054
y.create.l HWIO_PERIPH_SS_SDC2_SDCC_MCI_CCS_TIMER_ADDR A:0xf98a4058
y.create.l HWIO_PERIPH_SS_SDC2_SDCC_MCI_RESPONSE_MASK_ADDR A:0xf98a405c
y.create.l HWIO_PERIPH_SS_SDC2_SDCC_MCI_DLL_CONFIG_ADDR A:0xf98a4060
y.create.l HWIO_PERIPH_SS_SDC2_SDCC_MCI_DLL_TEST_CTL_ADDR A:0xf98a4064
y.create.l HWIO_PERIPH_SS_SDC2_SDCC_MCI_DLL_STATUS_ADDR A:0xf98a4068
y.create.l HWIO_PERIPH_SS_SDC2_SDCC_MCI_STATUS2_ADDR A:0xf98a406c
y.create.l HWIO_PERIPH_SS_SDC2_SDCC_MCI_GENERICS_ADDR A:0xf98a4070
y.create.l HWIO_PERIPH_SS_SDC2_SDCC_MCI_FIFO_STATUS_ADDR A:0xf98a4074
y.create.l HWIO_PERIPH_SS_SDC2_SDCC_MCI_HC_MODE_ADDR A:0xf98a4078
y.create.l HWIO_PERIPH_SS_SDC2_SDCC_MCI_FIFO0_ADDR A:0xf98a4080
y.create.l HWIO_PERIPH_SS_SDC2_SDCC_MCI_FIFO1_ADDR A:0xf98a4084
y.create.l HWIO_PERIPH_SS_SDC2_SDCC_MCI_FIFO2_ADDR A:0xf98a4088
y.create.l HWIO_PERIPH_SS_SDC2_SDCC_MCI_FIFO3_ADDR A:0xf98a408c
y.create.l HWIO_PERIPH_SS_SDC2_SDCC_MCI_FIFO4_ADDR A:0xf98a4090
y.create.l HWIO_PERIPH_SS_SDC2_SDCC_MCI_FIFO5_ADDR A:0xf98a4094
y.create.l HWIO_PERIPH_SS_SDC2_SDCC_MCI_FIFO6_ADDR A:0xf98a4098
y.create.l HWIO_PERIPH_SS_SDC2_SDCC_MCI_FIFO7_ADDR A:0xf98a409c
y.create.l HWIO_PERIPH_SS_SDC2_SDCC_MCI_FIFO8_ADDR A:0xf98a40a0
y.create.l HWIO_PERIPH_SS_SDC2_SDCC_MCI_FIFO9_ADDR A:0xf98a40a4
y.create.l HWIO_PERIPH_SS_SDC2_SDCC_MCI_TESTBUS_CONFIG_ADDR A:0xf98a40cc
y.create.l HWIO_PERIPH_SS_SDC2_SDCC_MCI_TEST_CTL_ADDR A:0xf98a40d0
y.create.l HWIO_PERIPH_SS_SDC2_SDCC_MCI_TEST_INPUT_ADDR A:0xf98a40d4
y.create.l HWIO_PERIPH_SS_SDC2_SDCC_MCI_TEST_OUT_ADDR A:0xf98a40d8
y.create.l HWIO_PERIPH_SS_SDC2_SDCC_MCI_PWRCTL_STATUS_REG_ADDR A:0xf98a40dc
y.create.l HWIO_PERIPH_SS_SDC2_SDCC_MCI_PWRCTL_MASK_REG_ADDR A:0xf98a40e0
y.create.l HWIO_PERIPH_SS_SDC2_SDCC_MCI_PWRCTL_CLEAR_REG_ADDR A:0xf98a40e4
y.create.l HWIO_PERIPH_SS_SDC2_SDCC_MCI_PWRCTL_CTL_REG_ADDR A:0xf98a40e8
y.create.l HWIO_PERIPH_SS_SDC2_SDCC_MCI_CLEAR2_ADDR A:0xf98a40ec
y.create.l HWIO_PERIPH_SS_SDC2_SDCC_MCI_INT_MASKINT2_0_ADDR A:0xf98a40f0
y.create.l HWIO_PERIPH_SS_SDC2_SDCC_MCI_INT_MASKINT2_1_ADDR A:0xf98a40f4
y.create.l HWIO_PERIPH_SS_SDC2_SDCC_CHAR_CFG_ADDR A:0xf98a40fc
y.create.l HWIO_PERIPH_SS_SDC2_SDCC_CHAR_CMD_ADDR A:0xf98a4100
y.create.l HWIO_PERIPH_SS_SDC2_SDCC_CHAR_DATA_0_ADDR A:0xf98a4104
y.create.l HWIO_PERIPH_SS_SDC2_SDCC_CHAR_DATA_1_ADDR A:0xf98a4108
y.create.l HWIO_PERIPH_SS_SDC2_SDCC_CHAR_DATA_2_ADDR A:0xf98a410c
y.create.l HWIO_PERIPH_SS_SDC2_SDCC_CHAR_DATA_3_ADDR A:0xf98a4110
y.create.l HWIO_PERIPH_SS_SDC2_SDCC_CHAR_DATA_4_ADDR A:0xf98a4114
y.create.l HWIO_PERIPH_SS_SDC2_SDCC_CHAR_DATA_5_ADDR A:0xf98a4118
y.create.l HWIO_PERIPH_SS_SDC2_SDCC_CHAR_DATA_6_ADDR A:0xf98a411c
y.create.l HWIO_PERIPH_SS_SDC2_SDCC_CHAR_DATA_7_ADDR A:0xf98a4120
y.create.l HWIO_PERIPH_SS_SDC2_SDCC_DEBUG_REG_ADDR A:0xf98a4124
y.create.l HWIO_PERIPH_SS_SDC2_SDCC_IP_CATALOG_ADDR A:0xf98a4128
y.create.l HWIO_PERIPH_SS_SDC2_SDCC_MCI_FIFO_ALT0_ADDR A:0xf98a4400
y.create.l HWIO_PERIPH_SS_SDC2_SDCC_MCI_FIFO_ALT1_ADDR A:0xf98a4404
y.create.l HWIO_PERIPH_SS_SDC2_SDCC_MCI_FIFO_ALT2_ADDR A:0xf98a4408
y.create.l HWIO_PERIPH_SS_SDC2_SDCC_MCI_FIFO_ALT3_ADDR A:0xf98a440c
y.create.l HWIO_PERIPH_SS_SDC2_SDCC_MCI_FIFO_ALT4_ADDR A:0xf98a4410
y.create.l HWIO_PERIPH_SS_SDC2_SDCC_MCI_FIFO_ALT5_ADDR A:0xf98a4414
y.create.l HWIO_PERIPH_SS_SDC2_SDCC_MCI_FIFO_ALT6_ADDR A:0xf98a4418
y.create.l HWIO_PERIPH_SS_SDC2_SDCC_MCI_FIFO_ALT7_ADDR A:0xf98a441c
y.create.l HWIO_PERIPH_SS_SDC2_SDCC_MCI_FIFO_ALT8_ADDR A:0xf98a4420
y.create.l HWIO_PERIPH_SS_SDC2_SDCC_MCI_FIFO_ALT9_ADDR A:0xf98a4424
y.create.l HWIO_PERIPH_SS_SDC2_SDCC_DML_CONFIG_ADDR A:0xf98a4800
y.create.l HWIO_PERIPH_SS_SDC2_SDCC_DML_STATUS_ADDR A:0xf98a4804
y.create.l HWIO_PERIPH_SS_SDC2_SDCC_DML_SW_RESET_ADDR A:0xf98a4808
y.create.l HWIO_PERIPH_SS_SDC2_SDCC_DML_PRODUCER_START_ADDR A:0xf98a480c
y.create.l HWIO_PERIPH_SS_SDC2_SDCC_DML_CONSUMER_START_ADDR A:0xf98a4810
y.create.l HWIO_PERIPH_SS_SDC2_SDCC_DML_PRODUCER_PIPE_LOGICAL_SIZE_ADDR A:0xf98a4814
y.create.l HWIO_PERIPH_SS_SDC2_SDCC_DML_CONSUMER_PIPE_LOGICAL_SIZE_ADDR A:0xf98a4818
y.create.l HWIO_PERIPH_SS_SDC2_SDCC_DML_PIPE_ID_ADDR A:0xf98a481c
y.create.l HWIO_PERIPH_SS_SDC2_SDCC_DML_PRODUCER_TRACKERS_ADDR A:0xf98a4820
y.create.l HWIO_PERIPH_SS_SDC2_SDCC_DML_PRODUCER_BAM_BLOCK_SIZE_ADDR A:0xf98a4824
y.create.l HWIO_PERIPH_SS_SDC2_SDCC_DML_PRODUCER_BAM_TRANS_SIZE_ADDR A:0xf98a4828
y.create.l HWIO_PERIPH_SS_SDC2_SDCC_DML_DIRECT_MODE_BASE_ADDR_ADDR A:0xf98a482c
y.create.l HWIO_PERIPH_SS_SDC2_SDCC_DML_DEBUG_ADDR A:0xf98a4830
y.create.l HWIO_PERIPH_SS_SDC2_SDCC_DML_BAM_SIDE_STATUS_1_ADDR A:0xf98a4834
y.create.l HWIO_PERIPH_SS_SDC2_SDCC_DML_BAM_SIDE_STATUS_2_ADDR A:0xf98a4838
y.create.l HWIO_PERIPH_SS_SDC2_SDCC_DML_RTL_GENERICS_1_ADDR A:0xf98a483c
y.create.l HWIO_PERIPH_SS_SDC2_SDCC_DML_RTL_GENERICS_2_ADDR A:0xf98a4840
y.create.l HWIO_PERIPH_SS_SDC2_SDCC_DML_RTL_GENERICS_3_ADDR A:0xf98a4844
y.create.l HWIO_PERIPH_SS_SDC2_SDCC_DML_INTERRUPT_ENABLE_ADDR A:0xf98a4848
y.create.l HWIO_PERIPH_SS_SDC2_SDCC_DML_INTERRUPT_CLEAR_ADDR A:0xf98a484c
y.create.l HWIO_PERIPH_SS_SDC2_SDCC_HC_REG_0_2_ADDR A:0xf98a4900
y.create.l HWIO_PERIPH_SS_SDC2_SDCC_HC_REG_4_6_ADDR A:0xf98a4904
y.create.l HWIO_PERIPH_SS_SDC2_SDCC_HC_REG_8_A_ADDR A:0xf98a4908
y.create.l HWIO_PERIPH_SS_SDC2_SDCC_HC_REG_C_E_ADDR A:0xf98a490c
y.create.l HWIO_PERIPH_SS_SDC2_SDCC_HC_REG_10_12_ADDR A:0xf98a4910
y.create.l HWIO_PERIPH_SS_SDC2_SDCC_HC_REG_14_16_ADDR A:0xf98a4914
y.create.l HWIO_PERIPH_SS_SDC2_SDCC_HC_REG_18_1A_ADDR A:0xf98a4918
y.create.l HWIO_PERIPH_SS_SDC2_SDCC_HC_REG_1C_1E_ADDR A:0xf98a491c
y.create.l HWIO_PERIPH_SS_SDC2_SDCC_HC_REG_20_22_ADDR A:0xf98a4920
y.create.l HWIO_PERIPH_SS_SDC2_SDCC_HC_REG_24_26_ADDR A:0xf98a4924
y.create.l HWIO_PERIPH_SS_SDC2_SDCC_HC_REG_28_2A_ADDR A:0xf98a4928
y.create.l HWIO_PERIPH_SS_SDC2_SDCC_HC_REG_2C_2E_ADDR A:0xf98a492c
y.create.l HWIO_PERIPH_SS_SDC2_SDCC_HC_REG_30_32_ADDR A:0xf98a4930
y.create.l HWIO_PERIPH_SS_SDC2_SDCC_HC_REG_34_36_ADDR A:0xf98a4934
y.create.l HWIO_PERIPH_SS_SDC2_SDCC_HC_REG_38_3A_ADDR A:0xf98a4938
y.create.l HWIO_PERIPH_SS_SDC2_SDCC_HC_REG_3C_3E_ADDR A:0xf98a493c
y.create.l HWIO_PERIPH_SS_SDC2_SDCC_HC_REG_40_42_ADDR A:0xf98a4940
y.create.l HWIO_PERIPH_SS_SDC2_SDCC_HC_REG_44_46_ADDR A:0xf98a4944
y.create.l HWIO_PERIPH_SS_SDC2_SDCC_HC_REG_48_4A_ADDR A:0xf98a4948
y.create.l HWIO_PERIPH_SS_SDC2_SDCC_HC_REG_50_52_ADDR A:0xf98a4950
y.create.l HWIO_PERIPH_SS_SDC2_SDCC_HC_REG_54_56_ADDR A:0xf98a4954
y.create.l HWIO_PERIPH_SS_SDC2_SDCC_HC_REG_58_5A_ADDR A:0xf98a4958
y.create.l HWIO_PERIPH_SS_SDC2_SDCC_HC_REG_5C_5E_ADDR A:0xf98a495c
y.create.l HWIO_PERIPH_SS_SDC2_SDCC_HC_REG_60_62_ADDR A:0xf98a4960
y.create.l HWIO_PERIPH_SS_SDC2_SDCC_HC_REG_64_66_ADDR A:0xf98a4964
y.create.l HWIO_PERIPH_SS_SDC2_SDCC_HC_REG_68_6A_ADDR A:0xf98a4968
y.create.l HWIO_PERIPH_SS_SDC2_SDCC_HC_REG_6C_6E_ADDR A:0xf98a496c
y.create.l HWIO_PERIPH_SS_SDC2_SDCC_HC_REG_E0_E2_ADDR A:0xf98a49e0
y.create.l HWIO_PERIPH_SS_SDC2_SDCC_HC_REG_FC_FE_ADDR A:0xf98a49fc
y.create.l HWIO_PERIPH_SS_SDC2_SDCC_HC_REG_DLL_CONFIG_ADDR A:0xf98a4a00
y.create.l HWIO_PERIPH_SS_SDC2_SDCC_HC_REG_DLL_TEST_CTL_ADDR A:0xf98a4a04
y.create.l HWIO_PERIPH_SS_SDC2_SDCC_HC_REG_DLL_STATUS_ADDR A:0xf98a4a08
y.create.l HWIO_PERIPH_SS_SDC2_SDCC_HC_VENDOR_SPECIFIC_FUNC_ADDR A:0xf98a4a0c
y.create.l HWIO_PERIPH_SS_SDC2_SDCC_HC_VENDOR_SPECIFIC_ADMA_ERR_ADDR0_ADDR A:0xf98a4a14
y.create.l HWIO_PERIPH_SS_SDC2_SDCC_HC_VENDOR_SPECIFIC_ADMA_ERR_ADDR1_ADDR A:0xf98a4a18
y.create.l HWIO_PERIPH_SS_SDC2_SDCC_BAM_CTRL_ADDR A:0xf9884000
y.create.l HWIO_PERIPH_SS_SDC2_SDCC_BAM_REVISION_ADDR A:0xf9884004
y.create.l HWIO_PERIPH_SS_SDC2_SDCC_BAM_SW_VERSION_ADDR A:0xf9884080
y.create.l HWIO_PERIPH_SS_SDC2_SDCC_BAM_NUM_PIPES_ADDR A:0xf988403c
y.create.l HWIO_PERIPH_SS_SDC2_SDCC_BAM_TIMER_ADDR A:0xf9884040
y.create.l HWIO_PERIPH_SS_SDC2_SDCC_BAM_TIMER_CTRL_ADDR A:0xf9884044
y.create.l HWIO_PERIPH_SS_SDC2_SDCC_BAM_DESC_CNT_TRSHLD_ADDR A:0xf9884008
y.create.l HWIO_PERIPH_SS_SDC2_SDCC_BAM_IRQ_SRCS_ADDR A:0xf988400c
y.create.l HWIO_PERIPH_SS_SDC2_SDCC_BAM_IRQ_SRCS_MSK_ADDR A:0xf9884010
y.create.l HWIO_PERIPH_SS_SDC2_SDCC_BAM_IRQ_SRCS_UNMASKED_ADDR A:0xf9884030
y.create.l HWIO_PERIPH_SS_SDC2_SDCC_BAM_IRQ_STTS_ADDR A:0xf9884014
y.create.l HWIO_PERIPH_SS_SDC2_SDCC_BAM_IRQ_CLR_ADDR A:0xf9884018
y.create.l HWIO_PERIPH_SS_SDC2_SDCC_BAM_IRQ_EN_ADDR A:0xf988401c
y.create.l HWIO_PERIPH_SS_SDC2_SDCC_BAM_AHB_MASTER_ERR_CTRLS_ADDR A:0xf9884024
y.create.l HWIO_PERIPH_SS_SDC2_SDCC_BAM_AHB_MASTER_ERR_ADDR_ADDR A:0xf9884028
y.create.l HWIO_PERIPH_SS_SDC2_SDCC_BAM_AHB_MASTER_ERR_DATA_ADDR A:0xf988402c
y.create.l HWIO_PERIPH_SS_SDC2_SDCC_BAM_TRUST_REG_ADDR A:0xf9884070
y.create.l HWIO_PERIPH_SS_SDC2_SDCC_BAM_TEST_BUS_SEL_ADDR A:0xf9884074
y.create.l HWIO_PERIPH_SS_SDC2_SDCC_BAM_TEST_BUS_REG_ADDR A:0xf9884078
y.create.l HWIO_PERIPH_SS_SDC2_SDCC_BAM_CNFG_BITS_ADDR A:0xf988407c
y.create.l HWIO_PERIPH_SS_SDC2_SDCC_BAM_IRQ_SRCS_EE0_ADDR A:0xf9884800
y.create.l HWIO_PERIPH_SS_SDC2_SDCC_BAM_IRQ_SRCS_EE1_ADDR A:0xf9884880
y.create.l HWIO_PERIPH_SS_SDC2_SDCC_BAM_IRQ_SRCS_EE2_ADDR A:0xf9884900
y.create.l HWIO_PERIPH_SS_SDC2_SDCC_BAM_IRQ_SRCS_EE3_ADDR A:0xf9884980
y.create.l HWIO_PERIPH_SS_SDC2_SDCC_BAM_IRQ_SRCS_EE4_ADDR A:0xf9884a00
y.create.l HWIO_PERIPH_SS_SDC2_SDCC_BAM_IRQ_SRCS_EE5_ADDR A:0xf9884a80
y.create.l HWIO_PERIPH_SS_SDC2_SDCC_BAM_IRQ_SRCS_EE6_ADDR A:0xf9884b00
y.create.l HWIO_PERIPH_SS_SDC2_SDCC_BAM_IRQ_SRCS_EE7_ADDR A:0xf9884b80
y.create.l HWIO_PERIPH_SS_SDC2_SDCC_BAM_IRQ_SRCS_MSK_EE0_ADDR A:0xf9884804
y.create.l HWIO_PERIPH_SS_SDC2_SDCC_BAM_IRQ_SRCS_MSK_EE1_ADDR A:0xf9884884
y.create.l HWIO_PERIPH_SS_SDC2_SDCC_BAM_IRQ_SRCS_MSK_EE2_ADDR A:0xf9884904
y.create.l HWIO_PERIPH_SS_SDC2_SDCC_BAM_IRQ_SRCS_MSK_EE3_ADDR A:0xf9884984
y.create.l HWIO_PERIPH_SS_SDC2_SDCC_BAM_IRQ_SRCS_MSK_EE4_ADDR A:0xf9884a04
y.create.l HWIO_PERIPH_SS_SDC2_SDCC_BAM_IRQ_SRCS_MSK_EE5_ADDR A:0xf9884a84
y.create.l HWIO_PERIPH_SS_SDC2_SDCC_BAM_IRQ_SRCS_MSK_EE6_ADDR A:0xf9884b04
y.create.l HWIO_PERIPH_SS_SDC2_SDCC_BAM_IRQ_SRCS_MSK_EE7_ADDR A:0xf9884b84
y.create.l HWIO_PERIPH_SS_SDC2_SDCC_BAM_IRQ_SRCS_UNMASKED_EE0_ADDR A:0xf9884808
y.create.l HWIO_PERIPH_SS_SDC2_SDCC_BAM_IRQ_SRCS_UNMASKED_EE1_ADDR A:0xf9884888
y.create.l HWIO_PERIPH_SS_SDC2_SDCC_BAM_IRQ_SRCS_UNMASKED_EE2_ADDR A:0xf9884908
y.create.l HWIO_PERIPH_SS_SDC2_SDCC_BAM_IRQ_SRCS_UNMASKED_EE3_ADDR A:0xf9884988
y.create.l HWIO_PERIPH_SS_SDC2_SDCC_BAM_IRQ_SRCS_UNMASKED_EE4_ADDR A:0xf9884a08
y.create.l HWIO_PERIPH_SS_SDC2_SDCC_BAM_IRQ_SRCS_UNMASKED_EE5_ADDR A:0xf9884a88
y.create.l HWIO_PERIPH_SS_SDC2_SDCC_BAM_IRQ_SRCS_UNMASKED_EE6_ADDR A:0xf9884b08
y.create.l HWIO_PERIPH_SS_SDC2_SDCC_BAM_IRQ_SRCS_UNMASKED_EE7_ADDR A:0xf9884b88
y.create.l HWIO_PERIPH_SS_SDC2_SDCC_BAM_P_CTRL0_ADDR A:0xf9885000
y.create.l HWIO_PERIPH_SS_SDC2_SDCC_BAM_P_CTRL1_ADDR A:0xf9886000
y.create.l HWIO_PERIPH_SS_SDC2_SDCC_BAM_P_CTRL2_ADDR A:0xf9887000
y.create.l HWIO_PERIPH_SS_SDC2_SDCC_BAM_P_CTRL3_ADDR A:0xf9888000
y.create.l HWIO_PERIPH_SS_SDC2_SDCC_BAM_P_CTRL4_ADDR A:0xf9889000
y.create.l HWIO_PERIPH_SS_SDC2_SDCC_BAM_P_CTRL5_ADDR A:0xf988a000
y.create.l HWIO_PERIPH_SS_SDC2_SDCC_BAM_P_RST0_ADDR A:0xf9885004
y.create.l HWIO_PERIPH_SS_SDC2_SDCC_BAM_P_RST1_ADDR A:0xf9886004
y.create.l HWIO_PERIPH_SS_SDC2_SDCC_BAM_P_RST2_ADDR A:0xf9887004
y.create.l HWIO_PERIPH_SS_SDC2_SDCC_BAM_P_RST3_ADDR A:0xf9888004
y.create.l HWIO_PERIPH_SS_SDC2_SDCC_BAM_P_RST4_ADDR A:0xf9889004
y.create.l HWIO_PERIPH_SS_SDC2_SDCC_BAM_P_RST5_ADDR A:0xf988a004
y.create.l HWIO_PERIPH_SS_SDC2_SDCC_BAM_P_HALT0_ADDR A:0xf9885008
y.create.l HWIO_PERIPH_SS_SDC2_SDCC_BAM_P_HALT1_ADDR A:0xf9886008
y.create.l HWIO_PERIPH_SS_SDC2_SDCC_BAM_P_HALT2_ADDR A:0xf9887008
y.create.l HWIO_PERIPH_SS_SDC2_SDCC_BAM_P_HALT3_ADDR A:0xf9888008
y.create.l HWIO_PERIPH_SS_SDC2_SDCC_BAM_P_HALT4_ADDR A:0xf9889008
y.create.l HWIO_PERIPH_SS_SDC2_SDCC_BAM_P_HALT5_ADDR A:0xf988a008
y.create.l HWIO_PERIPH_SS_SDC2_SDCC_BAM_P_TRUST_REG0_ADDR A:0xf9885030
y.create.l HWIO_PERIPH_SS_SDC2_SDCC_BAM_P_TRUST_REG1_ADDR A:0xf9886030
y.create.l HWIO_PERIPH_SS_SDC2_SDCC_BAM_P_TRUST_REG2_ADDR A:0xf9887030
y.create.l HWIO_PERIPH_SS_SDC2_SDCC_BAM_P_TRUST_REG3_ADDR A:0xf9888030
y.create.l HWIO_PERIPH_SS_SDC2_SDCC_BAM_P_TRUST_REG4_ADDR A:0xf9889030
y.create.l HWIO_PERIPH_SS_SDC2_SDCC_BAM_P_TRUST_REG5_ADDR A:0xf988a030
y.create.l HWIO_PERIPH_SS_SDC2_SDCC_BAM_P_IRQ_STTS0_ADDR A:0xf9885010
y.create.l HWIO_PERIPH_SS_SDC2_SDCC_BAM_P_IRQ_STTS1_ADDR A:0xf9886010
y.create.l HWIO_PERIPH_SS_SDC2_SDCC_BAM_P_IRQ_STTS2_ADDR A:0xf9887010
y.create.l HWIO_PERIPH_SS_SDC2_SDCC_BAM_P_IRQ_STTS3_ADDR A:0xf9888010
y.create.l HWIO_PERIPH_SS_SDC2_SDCC_BAM_P_IRQ_STTS4_ADDR A:0xf9889010
y.create.l HWIO_PERIPH_SS_SDC2_SDCC_BAM_P_IRQ_STTS5_ADDR A:0xf988a010
y.create.l HWIO_PERIPH_SS_SDC2_SDCC_BAM_P_IRQ_CLR0_ADDR A:0xf9885014
y.create.l HWIO_PERIPH_SS_SDC2_SDCC_BAM_P_IRQ_CLR1_ADDR A:0xf9886014
y.create.l HWIO_PERIPH_SS_SDC2_SDCC_BAM_P_IRQ_CLR2_ADDR A:0xf9887014
y.create.l HWIO_PERIPH_SS_SDC2_SDCC_BAM_P_IRQ_CLR3_ADDR A:0xf9888014
y.create.l HWIO_PERIPH_SS_SDC2_SDCC_BAM_P_IRQ_CLR4_ADDR A:0xf9889014
y.create.l HWIO_PERIPH_SS_SDC2_SDCC_BAM_P_IRQ_CLR5_ADDR A:0xf988a014
y.create.l HWIO_PERIPH_SS_SDC2_SDCC_BAM_P_IRQ_EN0_ADDR A:0xf9885018
y.create.l HWIO_PERIPH_SS_SDC2_SDCC_BAM_P_IRQ_EN1_ADDR A:0xf9886018
y.create.l HWIO_PERIPH_SS_SDC2_SDCC_BAM_P_IRQ_EN2_ADDR A:0xf9887018
y.create.l HWIO_PERIPH_SS_SDC2_SDCC_BAM_P_IRQ_EN3_ADDR A:0xf9888018
y.create.l HWIO_PERIPH_SS_SDC2_SDCC_BAM_P_IRQ_EN4_ADDR A:0xf9889018
y.create.l HWIO_PERIPH_SS_SDC2_SDCC_BAM_P_IRQ_EN5_ADDR A:0xf988a018
y.create.l HWIO_PERIPH_SS_SDC2_SDCC_BAM_P_TIMER0_ADDR A:0xf988501c
y.create.l HWIO_PERIPH_SS_SDC2_SDCC_BAM_P_TIMER1_ADDR A:0xf988601c
y.create.l HWIO_PERIPH_SS_SDC2_SDCC_BAM_P_TIMER2_ADDR A:0xf988701c
y.create.l HWIO_PERIPH_SS_SDC2_SDCC_BAM_P_TIMER3_ADDR A:0xf988801c
y.create.l HWIO_PERIPH_SS_SDC2_SDCC_BAM_P_TIMER4_ADDR A:0xf988901c
y.create.l HWIO_PERIPH_SS_SDC2_SDCC_BAM_P_TIMER5_ADDR A:0xf988a01c
y.create.l HWIO_PERIPH_SS_SDC2_SDCC_BAM_P_TIMER_CTRL0_ADDR A:0xf9885020
y.create.l HWIO_PERIPH_SS_SDC2_SDCC_BAM_P_TIMER_CTRL1_ADDR A:0xf9886020
y.create.l HWIO_PERIPH_SS_SDC2_SDCC_BAM_P_TIMER_CTRL2_ADDR A:0xf9887020
y.create.l HWIO_PERIPH_SS_SDC2_SDCC_BAM_P_TIMER_CTRL3_ADDR A:0xf9888020
y.create.l HWIO_PERIPH_SS_SDC2_SDCC_BAM_P_TIMER_CTRL4_ADDR A:0xf9889020
y.create.l HWIO_PERIPH_SS_SDC2_SDCC_BAM_P_TIMER_CTRL5_ADDR A:0xf988a020
y.create.l HWIO_PERIPH_SS_SDC2_SDCC_BAM_P_PRDCR_SDBND0_ADDR A:0xf9885024
y.create.l HWIO_PERIPH_SS_SDC2_SDCC_BAM_P_PRDCR_SDBND1_ADDR A:0xf9886024
y.create.l HWIO_PERIPH_SS_SDC2_SDCC_BAM_P_PRDCR_SDBND2_ADDR A:0xf9887024
y.create.l HWIO_PERIPH_SS_SDC2_SDCC_BAM_P_PRDCR_SDBND3_ADDR A:0xf9888024
y.create.l HWIO_PERIPH_SS_SDC2_SDCC_BAM_P_PRDCR_SDBND4_ADDR A:0xf9889024
y.create.l HWIO_PERIPH_SS_SDC2_SDCC_BAM_P_PRDCR_SDBND5_ADDR A:0xf988a024
y.create.l HWIO_PERIPH_SS_SDC2_SDCC_BAM_P_CNSMR_SDBND0_ADDR A:0xf9885028
y.create.l HWIO_PERIPH_SS_SDC2_SDCC_BAM_P_CNSMR_SDBND1_ADDR A:0xf9886028
y.create.l HWIO_PERIPH_SS_SDC2_SDCC_BAM_P_CNSMR_SDBND2_ADDR A:0xf9887028
y.create.l HWIO_PERIPH_SS_SDC2_SDCC_BAM_P_CNSMR_SDBND3_ADDR A:0xf9888028
y.create.l HWIO_PERIPH_SS_SDC2_SDCC_BAM_P_CNSMR_SDBND4_ADDR A:0xf9889028
y.create.l HWIO_PERIPH_SS_SDC2_SDCC_BAM_P_CNSMR_SDBND5_ADDR A:0xf988a028
y.create.l HWIO_PERIPH_SS_SDC2_SDCC_BAM_P_EVNT_DEST_ADDR0_ADDR A:0xf988582c
y.create.l HWIO_PERIPH_SS_SDC2_SDCC_BAM_P_EVNT_DEST_ADDR1_ADDR A:0xf988682c
y.create.l HWIO_PERIPH_SS_SDC2_SDCC_BAM_P_EVNT_DEST_ADDR2_ADDR A:0xf988782c
y.create.l HWIO_PERIPH_SS_SDC2_SDCC_BAM_P_EVNT_DEST_ADDR3_ADDR A:0xf988882c
y.create.l HWIO_PERIPH_SS_SDC2_SDCC_BAM_P_EVNT_DEST_ADDR4_ADDR A:0xf988982c
y.create.l HWIO_PERIPH_SS_SDC2_SDCC_BAM_P_EVNT_DEST_ADDR5_ADDR A:0xf988a82c
y.create.l HWIO_PERIPH_SS_SDC2_SDCC_BAM_P_EVNT_REG0_ADDR A:0xf9885818
y.create.l HWIO_PERIPH_SS_SDC2_SDCC_BAM_P_EVNT_REG1_ADDR A:0xf9886818
y.create.l HWIO_PERIPH_SS_SDC2_SDCC_BAM_P_EVNT_REG2_ADDR A:0xf9887818
y.create.l HWIO_PERIPH_SS_SDC2_SDCC_BAM_P_EVNT_REG3_ADDR A:0xf9888818
y.create.l HWIO_PERIPH_SS_SDC2_SDCC_BAM_P_EVNT_REG4_ADDR A:0xf9889818
y.create.l HWIO_PERIPH_SS_SDC2_SDCC_BAM_P_EVNT_REG5_ADDR A:0xf988a818
y.create.l HWIO_PERIPH_SS_SDC2_SDCC_BAM_P_SW_OFSTS0_ADDR A:0xf9885800
y.create.l HWIO_PERIPH_SS_SDC2_SDCC_BAM_P_SW_OFSTS1_ADDR A:0xf9886800
y.create.l HWIO_PERIPH_SS_SDC2_SDCC_BAM_P_SW_OFSTS2_ADDR A:0xf9887800
y.create.l HWIO_PERIPH_SS_SDC2_SDCC_BAM_P_SW_OFSTS3_ADDR A:0xf9888800
y.create.l HWIO_PERIPH_SS_SDC2_SDCC_BAM_P_SW_OFSTS4_ADDR A:0xf9889800
y.create.l HWIO_PERIPH_SS_SDC2_SDCC_BAM_P_SW_OFSTS5_ADDR A:0xf988a800
y.create.l HWIO_PERIPH_SS_SDC2_SDCC_BAM_P_DATA_FIFO_ADDR0_ADDR A:0xf9885824
y.create.l HWIO_PERIPH_SS_SDC2_SDCC_BAM_P_DATA_FIFO_ADDR1_ADDR A:0xf9886824
y.create.l HWIO_PERIPH_SS_SDC2_SDCC_BAM_P_DATA_FIFO_ADDR2_ADDR A:0xf9887824
y.create.l HWIO_PERIPH_SS_SDC2_SDCC_BAM_P_DATA_FIFO_ADDR3_ADDR A:0xf9888824
y.create.l HWIO_PERIPH_SS_SDC2_SDCC_BAM_P_DATA_FIFO_ADDR4_ADDR A:0xf9889824
y.create.l HWIO_PERIPH_SS_SDC2_SDCC_BAM_P_DATA_FIFO_ADDR5_ADDR A:0xf988a824
y.create.l HWIO_PERIPH_SS_SDC2_SDCC_BAM_P_DESC_FIFO_ADDR0_ADDR A:0xf988581c
y.create.l HWIO_PERIPH_SS_SDC2_SDCC_BAM_P_DESC_FIFO_ADDR1_ADDR A:0xf988681c
y.create.l HWIO_PERIPH_SS_SDC2_SDCC_BAM_P_DESC_FIFO_ADDR2_ADDR A:0xf988781c
y.create.l HWIO_PERIPH_SS_SDC2_SDCC_BAM_P_DESC_FIFO_ADDR3_ADDR A:0xf988881c
y.create.l HWIO_PERIPH_SS_SDC2_SDCC_BAM_P_DESC_FIFO_ADDR4_ADDR A:0xf988981c
y.create.l HWIO_PERIPH_SS_SDC2_SDCC_BAM_P_DESC_FIFO_ADDR5_ADDR A:0xf988a81c
y.create.l HWIO_PERIPH_SS_SDC2_SDCC_BAM_P_EVNT_GEN_TRSHLD0_ADDR A:0xf9885828
y.create.l HWIO_PERIPH_SS_SDC2_SDCC_BAM_P_EVNT_GEN_TRSHLD1_ADDR A:0xf9886828
y.create.l HWIO_PERIPH_SS_SDC2_SDCC_BAM_P_EVNT_GEN_TRSHLD2_ADDR A:0xf9887828
y.create.l HWIO_PERIPH_SS_SDC2_SDCC_BAM_P_EVNT_GEN_TRSHLD3_ADDR A:0xf9888828
y.create.l HWIO_PERIPH_SS_SDC2_SDCC_BAM_P_EVNT_GEN_TRSHLD4_ADDR A:0xf9889828
y.create.l HWIO_PERIPH_SS_SDC2_SDCC_BAM_P_EVNT_GEN_TRSHLD5_ADDR A:0xf988a828
y.create.l HWIO_PERIPH_SS_SDC2_SDCC_BAM_P_FIFO_SIZES0_ADDR A:0xf9885820
y.create.l HWIO_PERIPH_SS_SDC2_SDCC_BAM_P_FIFO_SIZES1_ADDR A:0xf9886820
y.create.l HWIO_PERIPH_SS_SDC2_SDCC_BAM_P_FIFO_SIZES2_ADDR A:0xf9887820
y.create.l HWIO_PERIPH_SS_SDC2_SDCC_BAM_P_FIFO_SIZES3_ADDR A:0xf9888820
y.create.l HWIO_PERIPH_SS_SDC2_SDCC_BAM_P_FIFO_SIZES4_ADDR A:0xf9889820
y.create.l HWIO_PERIPH_SS_SDC2_SDCC_BAM_P_FIFO_SIZES5_ADDR A:0xf988a820
y.create.l HWIO_PERIPH_SS_SDC2_SDCC_BAM_P_RETR_CNTXT_0_ADDR A:0xf9885834
y.create.l HWIO_PERIPH_SS_SDC2_SDCC_BAM_P_RETR_CNTXT_1_ADDR A:0xf9886834
y.create.l HWIO_PERIPH_SS_SDC2_SDCC_BAM_P_RETR_CNTXT_2_ADDR A:0xf9887834
y.create.l HWIO_PERIPH_SS_SDC2_SDCC_BAM_P_RETR_CNTXT_3_ADDR A:0xf9888834
y.create.l HWIO_PERIPH_SS_SDC2_SDCC_BAM_P_RETR_CNTXT_4_ADDR A:0xf9889834
y.create.l HWIO_PERIPH_SS_SDC2_SDCC_BAM_P_RETR_CNTXT_5_ADDR A:0xf988a834
y.create.l HWIO_PERIPH_SS_SDC2_SDCC_BAM_P_SI_CNTXT_0_ADDR A:0xf9885838
y.create.l HWIO_PERIPH_SS_SDC2_SDCC_BAM_P_SI_CNTXT_1_ADDR A:0xf9886838
y.create.l HWIO_PERIPH_SS_SDC2_SDCC_BAM_P_SI_CNTXT_2_ADDR A:0xf9887838
y.create.l HWIO_PERIPH_SS_SDC2_SDCC_BAM_P_SI_CNTXT_3_ADDR A:0xf9888838
y.create.l HWIO_PERIPH_SS_SDC2_SDCC_BAM_P_SI_CNTXT_4_ADDR A:0xf9889838
y.create.l HWIO_PERIPH_SS_SDC2_SDCC_BAM_P_SI_CNTXT_5_ADDR A:0xf988a838
y.create.l HWIO_PERIPH_SS_SDC2_SDCC_BAM_P_DF_CNTXT_0_ADDR A:0xf9885830
y.create.l HWIO_PERIPH_SS_SDC2_SDCC_BAM_P_DF_CNTXT_1_ADDR A:0xf9886830
y.create.l HWIO_PERIPH_SS_SDC2_SDCC_BAM_P_DF_CNTXT_2_ADDR A:0xf9887830
y.create.l HWIO_PERIPH_SS_SDC2_SDCC_BAM_P_DF_CNTXT_3_ADDR A:0xf9888830
y.create.l HWIO_PERIPH_SS_SDC2_SDCC_BAM_P_DF_CNTXT_4_ADDR A:0xf9889830
y.create.l HWIO_PERIPH_SS_SDC2_SDCC_BAM_P_DF_CNTXT_5_ADDR A:0xf988a830
y.create.l HWIO_PERIPH_SS_SDC2_SDCC_BAM_P_AU_PSM_CNTXT_1_0_ADDR A:0xf9885804
y.create.l HWIO_PERIPH_SS_SDC2_SDCC_BAM_P_AU_PSM_CNTXT_1_1_ADDR A:0xf9886804
y.create.l HWIO_PERIPH_SS_SDC2_SDCC_BAM_P_AU_PSM_CNTXT_1_2_ADDR A:0xf9887804
y.create.l HWIO_PERIPH_SS_SDC2_SDCC_BAM_P_AU_PSM_CNTXT_1_3_ADDR A:0xf9888804
y.create.l HWIO_PERIPH_SS_SDC2_SDCC_BAM_P_AU_PSM_CNTXT_1_4_ADDR A:0xf9889804
y.create.l HWIO_PERIPH_SS_SDC2_SDCC_BAM_P_AU_PSM_CNTXT_1_5_ADDR A:0xf988a804
y.create.l HWIO_PERIPH_SS_SDC2_SDCC_BAM_P_PSM_CNTXT_2_0_ADDR A:0xf9885808
y.create.l HWIO_PERIPH_SS_SDC2_SDCC_BAM_P_PSM_CNTXT_2_1_ADDR A:0xf9886808
y.create.l HWIO_PERIPH_SS_SDC2_SDCC_BAM_P_PSM_CNTXT_2_2_ADDR A:0xf9887808
y.create.l HWIO_PERIPH_SS_SDC2_SDCC_BAM_P_PSM_CNTXT_2_3_ADDR A:0xf9888808
y.create.l HWIO_PERIPH_SS_SDC2_SDCC_BAM_P_PSM_CNTXT_2_4_ADDR A:0xf9889808
y.create.l HWIO_PERIPH_SS_SDC2_SDCC_BAM_P_PSM_CNTXT_2_5_ADDR A:0xf988a808
y.create.l HWIO_PERIPH_SS_SDC2_SDCC_BAM_P_PSM_CNTXT_3_0_ADDR A:0xf988580c
y.create.l HWIO_PERIPH_SS_SDC2_SDCC_BAM_P_PSM_CNTXT_3_1_ADDR A:0xf988680c
y.create.l HWIO_PERIPH_SS_SDC2_SDCC_BAM_P_PSM_CNTXT_3_2_ADDR A:0xf988780c
y.create.l HWIO_PERIPH_SS_SDC2_SDCC_BAM_P_PSM_CNTXT_3_3_ADDR A:0xf988880c
y.create.l HWIO_PERIPH_SS_SDC2_SDCC_BAM_P_PSM_CNTXT_3_4_ADDR A:0xf988980c
y.create.l HWIO_PERIPH_SS_SDC2_SDCC_BAM_P_PSM_CNTXT_3_5_ADDR A:0xf988a80c
y.create.l HWIO_PERIPH_SS_SDC2_SDCC_BAM_P_PSM_CNTXT_4_0_ADDR A:0xf9885810
y.create.l HWIO_PERIPH_SS_SDC2_SDCC_BAM_P_PSM_CNTXT_4_1_ADDR A:0xf9886810
y.create.l HWIO_PERIPH_SS_SDC2_SDCC_BAM_P_PSM_CNTXT_4_2_ADDR A:0xf9887810
y.create.l HWIO_PERIPH_SS_SDC2_SDCC_BAM_P_PSM_CNTXT_4_3_ADDR A:0xf9888810
y.create.l HWIO_PERIPH_SS_SDC2_SDCC_BAM_P_PSM_CNTXT_4_4_ADDR A:0xf9889810
y.create.l HWIO_PERIPH_SS_SDC2_SDCC_BAM_P_PSM_CNTXT_4_5_ADDR A:0xf988a810
y.create.l HWIO_PERIPH_SS_SDC2_SDCC_BAM_P_PSM_CNTXT_5_0_ADDR A:0xf9885814
y.create.l HWIO_PERIPH_SS_SDC2_SDCC_BAM_P_PSM_CNTXT_5_1_ADDR A:0xf9886814
y.create.l HWIO_PERIPH_SS_SDC2_SDCC_BAM_P_PSM_CNTXT_5_2_ADDR A:0xf9887814
y.create.l HWIO_PERIPH_SS_SDC2_SDCC_BAM_P_PSM_CNTXT_5_3_ADDR A:0xf9888814
y.create.l HWIO_PERIPH_SS_SDC2_SDCC_BAM_P_PSM_CNTXT_5_4_ADDR A:0xf9889814
y.create.l HWIO_PERIPH_SS_SDC2_SDCC_BAM_P_PSM_CNTXT_5_5_ADDR A:0xf988a814
y.create.l HWIO_PERIPH_SS_SDC2_SDCC_XPU_SCR_ADDR A:0xf9882000
y.create.l HWIO_PERIPH_SS_SDC2_SDCC_XPU_SWDR_ADDR A:0xf9882004
y.create.l HWIO_PERIPH_SS_SDC2_SDCC_XPU_SEAR0_ADDR A:0xf9882040
y.create.l HWIO_PERIPH_SS_SDC2_SDCC_XPU_SESR_ADDR A:0xf9882048
y.create.l HWIO_PERIPH_SS_SDC2_SDCC_XPU_SESRRESTORE_ADDR A:0xf988204c
y.create.l HWIO_PERIPH_SS_SDC2_SDCC_XPU_SESYNR0_ADDR A:0xf9882050
y.create.l HWIO_PERIPH_SS_SDC2_SDCC_XPU_SESYNR1_ADDR A:0xf9882054
y.create.l HWIO_PERIPH_SS_SDC2_SDCC_XPU_SESYNR2_ADDR A:0xf9882058
y.create.l HWIO_PERIPH_SS_SDC2_SDCC_XPU_MCR_ADDR A:0xf9882100
y.create.l HWIO_PERIPH_SS_SDC2_SDCC_XPU_MEAR0_ADDR A:0xf9882140
y.create.l HWIO_PERIPH_SS_SDC2_SDCC_XPU_MESR_ADDR A:0xf9882148
y.create.l HWIO_PERIPH_SS_SDC2_SDCC_XPU_MESRRESTORE_ADDR A:0xf988214c
y.create.l HWIO_PERIPH_SS_SDC2_SDCC_XPU_MESYNR0_ADDR A:0xf9882150
y.create.l HWIO_PERIPH_SS_SDC2_SDCC_XPU_MESYNR1_ADDR A:0xf9882154
y.create.l HWIO_PERIPH_SS_SDC2_SDCC_XPU_MESYNR2_ADDR A:0xf9882158
y.create.l HWIO_PERIPH_SS_SDC2_SDCC_XPU_CR_ADDR A:0xf9882080
y.create.l HWIO_PERIPH_SS_SDC2_SDCC_XPU_RPU_ACR0_ADDR A:0xf98820a0
y.create.l HWIO_PERIPH_SS_SDC2_SDCC_XPU_EAR0_ADDR A:0xf98820c0
y.create.l HWIO_PERIPH_SS_SDC2_SDCC_XPU_ESR_ADDR A:0xf98820c8
y.create.l HWIO_PERIPH_SS_SDC2_SDCC_XPU_ESRRESTORE_ADDR A:0xf98820cc
y.create.l HWIO_PERIPH_SS_SDC2_SDCC_XPU_ESYNR0_ADDR A:0xf98820d0
y.create.l HWIO_PERIPH_SS_SDC2_SDCC_XPU_ESYNR1_ADDR A:0xf98820d4
y.create.l HWIO_PERIPH_SS_SDC2_SDCC_XPU_ESYNR2_ADDR A:0xf98820d8
y.create.l HWIO_PERIPH_SS_SDC2_SDCC_XPU_IDR0_ADDR A:0xf9882074
y.create.l HWIO_PERIPH_SS_SDC2_SDCC_XPU_IDR1_ADDR A:0xf9882078
y.create.l HWIO_PERIPH_SS_SDC2_SDCC_XPU_REV_ADDR A:0xf988207c
y.create.l HWIO_PERIPH_SS_SDC2_SDCC_XPU_RG0_RACR0_ADDR A:0xf9882200
y.create.l HWIO_PERIPH_SS_SDC2_SDCC_XPU_RG1_RACR0_ADDR A:0xf9882280
y.create.l HWIO_PERIPH_SS_SDC2_SDCC_XPU_RG2_RACR0_ADDR A:0xf9882300
y.create.l HWIO_PERIPH_SS_SDC2_SDCC_XPU_RG3_RACR0_ADDR A:0xf9882380
y.create.l HWIO_PERIPH_SS_SDC2_SDCC_XPU_RG4_RACR0_ADDR A:0xf9882400
y.create.l HWIO_PERIPH_SS_SDC2_SDCC_XPU_RG5_RACR0_ADDR A:0xf9882480
y.create.l HWIO_PERIPH_SS_SDC2_SDCC_XPU_RG6_RACR0_ADDR A:0xf9882500
y.create.l HWIO_PERIPH_SS_SDC2_SDCC_XPU_RG7_RACR0_ADDR A:0xf9882580
y.create.l HWIO_PERIPH_SS_SDC2_SDCC_XPU_RG8_RACR0_ADDR A:0xf9882600
y.create.l HWIO_PERIPH_SS_SDC2_SDCC_XPU_RG9_RACR0_ADDR A:0xf9882680
y.create.l HWIO_PERIPH_SS_SDC2_SDCC_XPU_RG0_SCR_ADDR A:0xf9882250
y.create.l HWIO_PERIPH_SS_SDC2_SDCC_XPU_RG1_SCR_ADDR A:0xf98822d0
y.create.l HWIO_PERIPH_SS_SDC2_SDCC_XPU_RG2_SCR_ADDR A:0xf9882350
y.create.l HWIO_PERIPH_SS_SDC2_SDCC_XPU_RG3_SCR_ADDR A:0xf98823d0
y.create.l HWIO_PERIPH_SS_SDC2_SDCC_XPU_RG4_SCR_ADDR A:0xf9882450
y.create.l HWIO_PERIPH_SS_SDC2_SDCC_XPU_RG5_SCR_ADDR A:0xf98824d0
y.create.l HWIO_PERIPH_SS_SDC2_SDCC_XPU_RG6_SCR_ADDR A:0xf9882550
y.create.l HWIO_PERIPH_SS_SDC2_SDCC_XPU_RG7_SCR_ADDR A:0xf98825d0
y.create.l HWIO_PERIPH_SS_SDC2_SDCC_XPU_RG8_SCR_ADDR A:0xf9882650
y.create.l HWIO_PERIPH_SS_SDC2_SDCC_XPU_RG9_SCR_ADDR A:0xf98826d0
y.create.l HWIO_PERIPH_SS_SDC2_SDCC_XPU_RG0_MCR_ADDR A:0xf9882254
y.create.l HWIO_PERIPH_SS_SDC2_SDCC_XPU_RG1_MCR_ADDR A:0xf98822d4
y.create.l HWIO_PERIPH_SS_SDC2_SDCC_XPU_RG2_MCR_ADDR A:0xf9882354
y.create.l HWIO_PERIPH_SS_SDC2_SDCC_XPU_RG3_MCR_ADDR A:0xf98823d4
y.create.l HWIO_PERIPH_SS_SDC2_SDCC_XPU_RG4_MCR_ADDR A:0xf9882454
y.create.l HWIO_PERIPH_SS_SDC2_SDCC_XPU_RG5_MCR_ADDR A:0xf98824d4
y.create.l HWIO_PERIPH_SS_SDC2_SDCC_XPU_RG6_MCR_ADDR A:0xf9882554
y.create.l HWIO_PERIPH_SS_SDC2_SDCC_XPU_RG7_MCR_ADDR A:0xf98825d4
y.create.l HWIO_PERIPH_SS_SDC2_SDCC_XPU_RG8_MCR_ADDR A:0xf9882654
y.create.l HWIO_PERIPH_SS_SDC2_SDCC_XPU_RG9_MCR_ADDR A:0xf98826d4
y.create.l HWIO_PERIPH_SS_SDC2_SDCC_VMIDMT_SCR0_ADDR A:0xf9880000
y.create.l HWIO_PERIPH_SS_SDC2_SDCC_VMIDMT_SCR1_ADDR A:0xf9880004
y.create.l HWIO_PERIPH_SS_SDC2_SDCC_VMIDMT_SCR2_ADDR A:0xf9880008
y.create.l HWIO_PERIPH_SS_SDC2_SDCC_VMIDMT_SACR_ADDR A:0xf9880010
y.create.l HWIO_PERIPH_SS_SDC2_SDCC_VMIDMT_SIDR0_ADDR A:0xf9880020
y.create.l HWIO_PERIPH_SS_SDC2_SDCC_VMIDMT_SIDR1_ADDR A:0xf9880024
y.create.l HWIO_PERIPH_SS_SDC2_SDCC_VMIDMT_SIDR2_ADDR A:0xf9880028
y.create.l HWIO_PERIPH_SS_SDC2_SDCC_VMIDMT_SIDR4_ADDR A:0xf9880030
y.create.l HWIO_PERIPH_SS_SDC2_SDCC_VMIDMT_SIDR5_ADDR A:0xf9880034
y.create.l HWIO_PERIPH_SS_SDC2_SDCC_VMIDMT_SIDR7_ADDR A:0xf988003c
y.create.l HWIO_PERIPH_SS_SDC2_SDCC_VMIDMT_SGFAR0_ADDR A:0xf9880040
y.create.l HWIO_PERIPH_SS_SDC2_SDCC_VMIDMT_SGFSR_ADDR A:0xf9880048
y.create.l HWIO_PERIPH_SS_SDC2_SDCC_VMIDMT_SGFSRRESTORE_ADDR A:0xf988004c
y.create.l HWIO_PERIPH_SS_SDC2_SDCC_VMIDMT_SGFSYNDR0_ADDR A:0xf9880050
y.create.l HWIO_PERIPH_SS_SDC2_SDCC_VMIDMT_SGFSYNDR1_ADDR A:0xf9880054
y.create.l HWIO_PERIPH_SS_SDC2_SDCC_VMIDMT_SGFSYNDR2_ADDR A:0xf9880058
y.create.l HWIO_PERIPH_SS_SDC2_SDCC_VMIDMT_VMIDMTSCR0_ADDR A:0xf9880090
y.create.l HWIO_PERIPH_SS_SDC2_SDCC_VMIDMT_CR0_ADDR A:0xf9880000
y.create.l HWIO_PERIPH_SS_SDC2_SDCC_VMIDMT_CR2_ADDR A:0xf9880008
y.create.l HWIO_PERIPH_SS_SDC2_SDCC_VMIDMT_ACR_ADDR A:0xf9880010
y.create.l HWIO_PERIPH_SS_SDC2_SDCC_VMIDMT_IDR0_ADDR A:0xf9880020
y.create.l HWIO_PERIPH_SS_SDC2_SDCC_VMIDMT_IDR1_ADDR A:0xf9880024
y.create.l HWIO_PERIPH_SS_SDC2_SDCC_VMIDMT_IDR2_ADDR A:0xf9880028
y.create.l HWIO_PERIPH_SS_SDC2_SDCC_VMIDMT_IDR4_ADDR A:0xf9880030
y.create.l HWIO_PERIPH_SS_SDC2_SDCC_VMIDMT_IDR5_ADDR A:0xf9880034
y.create.l HWIO_PERIPH_SS_SDC2_SDCC_VMIDMT_IDR7_ADDR A:0xf988003c
y.create.l HWIO_PERIPH_SS_SDC2_SDCC_VMIDMT_GFAR0_ADDR A:0xf9880040
y.create.l HWIO_PERIPH_SS_SDC2_SDCC_VMIDMT_GFSR_ADDR A:0xf9880048
y.create.l HWIO_PERIPH_SS_SDC2_SDCC_VMIDMT_GFSRRESTORE_ADDR A:0xf988004c
y.create.l HWIO_PERIPH_SS_SDC2_SDCC_VMIDMT_GFSYNDR0_ADDR A:0xf9880050
y.create.l HWIO_PERIPH_SS_SDC2_SDCC_VMIDMT_GFSYNDR1_ADDR A:0xf9880054
y.create.l HWIO_PERIPH_SS_SDC2_SDCC_VMIDMT_GFSYNDR2_ADDR A:0xf9880058
y.create.l HWIO_PERIPH_SS_SDC2_SDCC_VMIDMT_VMIDMTCR0_ADDR A:0xf9880090
y.create.l HWIO_PERIPH_SS_SDC2_SDCC_VMIDMT_VMIDMTACR_ADDR A:0xf988009c
y.create.l HWIO_PERIPH_SS_SDC2_SDCC_VMIDMT_NSCR0_ADDR A:0xf9880400
y.create.l HWIO_PERIPH_SS_SDC2_SDCC_VMIDMT_NSCR2_ADDR A:0xf9880408
y.create.l HWIO_PERIPH_SS_SDC2_SDCC_VMIDMT_NSACR_ADDR A:0xf9880410
y.create.l HWIO_PERIPH_SS_SDC2_SDCC_VMIDMT_NSGFAR0_ADDR A:0xf9880440
y.create.l HWIO_PERIPH_SS_SDC2_SDCC_VMIDMT_NSGFSR_ADDR A:0xf9880448
y.create.l HWIO_PERIPH_SS_SDC2_SDCC_VMIDMT_NSGFSRRESTORE_ADDR A:0xf988044c
y.create.l HWIO_PERIPH_SS_SDC2_SDCC_VMIDMT_NSGFSYNDR0_ADDR A:0xf9880450
y.create.l HWIO_PERIPH_SS_SDC2_SDCC_VMIDMT_NSGFSYNDR1_ADDR A:0xf9880454
y.create.l HWIO_PERIPH_SS_SDC2_SDCC_VMIDMT_NSGFSYNDR2_ADDR A:0xf9880458
y.create.l HWIO_PERIPH_SS_SDC2_SDCC_VMIDMT_NSVMIDMTCR0_ADDR A:0xf9880490
y.create.l HWIO_PERIPH_SS_SDC2_SDCC_VMIDMT_SSDR0_ADDR A:0xf9880080
y.create.l HWIO_PERIPH_SS_SDC2_SDCC_VMIDMT_MSDR0_ADDR A:0xf9880480
y.create.l HWIO_PERIPH_SS_SDC2_SDCC_VMIDMT_MCR_ADDR A:0xf9880494
y.create.l HWIO_PERIPH_SS_SDC2_SDCC_VMIDMT_S2VR0_ADDR A:0xf9880c00
y.create.l HWIO_PERIPH_SS_SDC2_SDCC_VMIDMT_S2VR1_ADDR A:0xf9880c04
y.create.l HWIO_PERIPH_SS_SDC2_SDCC_VMIDMT_S2VR2_ADDR A:0xf9880c08
y.create.l HWIO_PERIPH_SS_SDC2_SDCC_VMIDMT_S2VR3_ADDR A:0xf9880c0c
y.create.l HWIO_PERIPH_SS_SDC2_SDCC_VMIDMT_S2VR4_ADDR A:0xf9880c10
y.create.l HWIO_PERIPH_SS_SDC2_SDCC_VMIDMT_S2VR5_ADDR A:0xf9880c14
y.create.l HWIO_PERIPH_SS_SDC2_SDCC_VMIDMT_S2VR6_ADDR A:0xf9880c18
y.create.l HWIO_PERIPH_SS_SDC2_SDCC_VMIDMT_AS2VR0_ADDR A:0xf9880e00
y.create.l HWIO_PERIPH_SS_SDC2_SDCC_VMIDMT_AS2VR1_ADDR A:0xf9880e04
y.create.l HWIO_PERIPH_SS_SDC2_SDCC_VMIDMT_AS2VR2_ADDR A:0xf9880e08
y.create.l HWIO_PERIPH_SS_SDC2_SDCC_VMIDMT_AS2VR3_ADDR A:0xf9880e0c
y.create.l HWIO_PERIPH_SS_SDC2_SDCC_VMIDMT_AS2VR4_ADDR A:0xf9880e10
y.create.l HWIO_PERIPH_SS_SDC2_SDCC_VMIDMT_AS2VR5_ADDR A:0xf9880e14
y.create.l HWIO_PERIPH_SS_SDC2_SDCC_VMIDMT_AS2VR6_ADDR A:0xf9880e18
y.create.l HWIO_PERIPH_SS_SDC2_SDCC_VMIDMT_SMR0_ADDR A:0xf9880800
y.create.l HWIO_PERIPH_SS_SDC2_SDCC_VMIDMT_SMR1_ADDR A:0xf9880804
y.create.l HWIO_PERIPH_SS_SDC2_SDCC_VMIDMT_SMR2_ADDR A:0xf9880808
y.create.l HWIO_PERIPH_SS_SDC2_SDCC_VMIDMT_SMR3_ADDR A:0xf988080c
y.create.l HWIO_PERIPH_SS_SDC2_SDCC_VMIDMT_SMR4_ADDR A:0xf9880810
y.create.l HWIO_PERIPH_SS_SDC2_SDCC_VMIDMT_SMR5_ADDR A:0xf9880814
y.create.l HWIO_PERIPH_SS_SDC2_SDCC_VMIDMT_SMR6_ADDR A:0xf9880818
y.create.l HWIO_PERIPH_SS_BLSP1_BLSP_BAM_BAM_CTRL_ADDR A:0xf9904000
y.create.l HWIO_PERIPH_SS_BLSP1_BLSP_BAM_BAM_REVISION_ADDR A:0xf9904004
y.create.l HWIO_PERIPH_SS_BLSP1_BLSP_BAM_BAM_SW_VERSION_ADDR A:0xf9904080
y.create.l HWIO_PERIPH_SS_BLSP1_BLSP_BAM_BAM_NUM_PIPES_ADDR A:0xf990403c
y.create.l HWIO_PERIPH_SS_BLSP1_BLSP_BAM_BAM_TIMER_ADDR A:0xf9904040
y.create.l HWIO_PERIPH_SS_BLSP1_BLSP_BAM_BAM_TIMER_CTRL_ADDR A:0xf9904044
y.create.l HWIO_PERIPH_SS_BLSP1_BLSP_BAM_BAM_DESC_CNT_TRSHLD_ADDR A:0xf9904008
y.create.l HWIO_PERIPH_SS_BLSP1_BLSP_BAM_BAM_IRQ_SRCS_ADDR A:0xf990400c
y.create.l HWIO_PERIPH_SS_BLSP1_BLSP_BAM_BAM_IRQ_SRCS_MSK_ADDR A:0xf9904010
y.create.l HWIO_PERIPH_SS_BLSP1_BLSP_BAM_BAM_IRQ_SRCS_UNMASKED_ADDR A:0xf9904030
y.create.l HWIO_PERIPH_SS_BLSP1_BLSP_BAM_BAM_IRQ_STTS_ADDR A:0xf9904014
y.create.l HWIO_PERIPH_SS_BLSP1_BLSP_BAM_BAM_IRQ_CLR_ADDR A:0xf9904018
y.create.l HWIO_PERIPH_SS_BLSP1_BLSP_BAM_BAM_IRQ_EN_ADDR A:0xf990401c
y.create.l HWIO_PERIPH_SS_BLSP1_BLSP_BAM_BAM_AHB_MASTER_ERR_CTRLS_ADDR A:0xf9904024
y.create.l HWIO_PERIPH_SS_BLSP1_BLSP_BAM_BAM_AHB_MASTER_ERR_ADDR_ADDR A:0xf9904028
y.create.l HWIO_PERIPH_SS_BLSP1_BLSP_BAM_BAM_AHB_MASTER_ERR_DATA_ADDR A:0xf990402c
y.create.l HWIO_PERIPH_SS_BLSP1_BLSP_BAM_BAM_TRUST_REG_ADDR A:0xf9904070
y.create.l HWIO_PERIPH_SS_BLSP1_BLSP_BAM_BAM_TEST_BUS_SEL_ADDR A:0xf9904074
y.create.l HWIO_PERIPH_SS_BLSP1_BLSP_BAM_BAM_TEST_BUS_REG_ADDR A:0xf9904078
y.create.l HWIO_PERIPH_SS_BLSP1_BLSP_BAM_BAM_CNFG_BITS_ADDR A:0xf990407c
y.create.l HWIO_PERIPH_SS_BLSP1_BLSP_BAM_BAM_IRQ_SRCS_EE0_ADDR A:0xf9904800
y.create.l HWIO_PERIPH_SS_BLSP1_BLSP_BAM_BAM_IRQ_SRCS_EE1_ADDR A:0xf9904880
y.create.l HWIO_PERIPH_SS_BLSP1_BLSP_BAM_BAM_IRQ_SRCS_EE2_ADDR A:0xf9904900
y.create.l HWIO_PERIPH_SS_BLSP1_BLSP_BAM_BAM_IRQ_SRCS_EE3_ADDR A:0xf9904980
y.create.l HWIO_PERIPH_SS_BLSP1_BLSP_BAM_BAM_IRQ_SRCS_EE4_ADDR A:0xf9904a00
y.create.l HWIO_PERIPH_SS_BLSP1_BLSP_BAM_BAM_IRQ_SRCS_EE5_ADDR A:0xf9904a80
y.create.l HWIO_PERIPH_SS_BLSP1_BLSP_BAM_BAM_IRQ_SRCS_EE6_ADDR A:0xf9904b00
y.create.l HWIO_PERIPH_SS_BLSP1_BLSP_BAM_BAM_IRQ_SRCS_EE7_ADDR A:0xf9904b80
y.create.l HWIO_PERIPH_SS_BLSP1_BLSP_BAM_BAM_IRQ_SRCS_MSK_EE0_ADDR A:0xf9904804
y.create.l HWIO_PERIPH_SS_BLSP1_BLSP_BAM_BAM_IRQ_SRCS_MSK_EE1_ADDR A:0xf9904884
y.create.l HWIO_PERIPH_SS_BLSP1_BLSP_BAM_BAM_IRQ_SRCS_MSK_EE2_ADDR A:0xf9904904
y.create.l HWIO_PERIPH_SS_BLSP1_BLSP_BAM_BAM_IRQ_SRCS_MSK_EE3_ADDR A:0xf9904984
y.create.l HWIO_PERIPH_SS_BLSP1_BLSP_BAM_BAM_IRQ_SRCS_MSK_EE4_ADDR A:0xf9904a04
y.create.l HWIO_PERIPH_SS_BLSP1_BLSP_BAM_BAM_IRQ_SRCS_MSK_EE5_ADDR A:0xf9904a84
y.create.l HWIO_PERIPH_SS_BLSP1_BLSP_BAM_BAM_IRQ_SRCS_MSK_EE6_ADDR A:0xf9904b04
y.create.l HWIO_PERIPH_SS_BLSP1_BLSP_BAM_BAM_IRQ_SRCS_MSK_EE7_ADDR A:0xf9904b84
y.create.l HWIO_PERIPH_SS_BLSP1_BLSP_BAM_BAM_IRQ_SRCS_UNMASKED_EE0_ADDR A:0xf9904808
y.create.l HWIO_PERIPH_SS_BLSP1_BLSP_BAM_BAM_IRQ_SRCS_UNMASKED_EE1_ADDR A:0xf9904888
y.create.l HWIO_PERIPH_SS_BLSP1_BLSP_BAM_BAM_IRQ_SRCS_UNMASKED_EE2_ADDR A:0xf9904908
y.create.l HWIO_PERIPH_SS_BLSP1_BLSP_BAM_BAM_IRQ_SRCS_UNMASKED_EE3_ADDR A:0xf9904988
y.create.l HWIO_PERIPH_SS_BLSP1_BLSP_BAM_BAM_IRQ_SRCS_UNMASKED_EE4_ADDR A:0xf9904a08
y.create.l HWIO_PERIPH_SS_BLSP1_BLSP_BAM_BAM_IRQ_SRCS_UNMASKED_EE5_ADDR A:0xf9904a88
y.create.l HWIO_PERIPH_SS_BLSP1_BLSP_BAM_BAM_IRQ_SRCS_UNMASKED_EE6_ADDR A:0xf9904b08
y.create.l HWIO_PERIPH_SS_BLSP1_BLSP_BAM_BAM_IRQ_SRCS_UNMASKED_EE7_ADDR A:0xf9904b88
y.create.l HWIO_PERIPH_SS_BLSP1_BLSP_BAM_BAM_P_CTRL0_ADDR A:0xf9905000
y.create.l HWIO_PERIPH_SS_BLSP1_BLSP_BAM_BAM_P_CTRL1_ADDR A:0xf9906000
y.create.l HWIO_PERIPH_SS_BLSP1_BLSP_BAM_BAM_P_CTRL2_ADDR A:0xf9907000
y.create.l HWIO_PERIPH_SS_BLSP1_BLSP_BAM_BAM_P_CTRL3_ADDR A:0xf9908000
y.create.l HWIO_PERIPH_SS_BLSP1_BLSP_BAM_BAM_P_CTRL4_ADDR A:0xf9909000
y.create.l HWIO_PERIPH_SS_BLSP1_BLSP_BAM_BAM_P_CTRL5_ADDR A:0xf990a000
y.create.l HWIO_PERIPH_SS_BLSP1_BLSP_BAM_BAM_P_CTRL6_ADDR A:0xf990b000
y.create.l HWIO_PERIPH_SS_BLSP1_BLSP_BAM_BAM_P_CTRL7_ADDR A:0xf990c000
y.create.l HWIO_PERIPH_SS_BLSP1_BLSP_BAM_BAM_P_CTRL8_ADDR A:0xf990d000
y.create.l HWIO_PERIPH_SS_BLSP1_BLSP_BAM_BAM_P_CTRL9_ADDR A:0xf990e000
y.create.l HWIO_PERIPH_SS_BLSP1_BLSP_BAM_BAM_P_RST0_ADDR A:0xf9905004
y.create.l HWIO_PERIPH_SS_BLSP1_BLSP_BAM_BAM_P_RST1_ADDR A:0xf9906004
y.create.l HWIO_PERIPH_SS_BLSP1_BLSP_BAM_BAM_P_RST2_ADDR A:0xf9907004
y.create.l HWIO_PERIPH_SS_BLSP1_BLSP_BAM_BAM_P_RST3_ADDR A:0xf9908004
y.create.l HWIO_PERIPH_SS_BLSP1_BLSP_BAM_BAM_P_RST4_ADDR A:0xf9909004
y.create.l HWIO_PERIPH_SS_BLSP1_BLSP_BAM_BAM_P_RST5_ADDR A:0xf990a004
y.create.l HWIO_PERIPH_SS_BLSP1_BLSP_BAM_BAM_P_RST6_ADDR A:0xf990b004
y.create.l HWIO_PERIPH_SS_BLSP1_BLSP_BAM_BAM_P_RST7_ADDR A:0xf990c004
y.create.l HWIO_PERIPH_SS_BLSP1_BLSP_BAM_BAM_P_RST8_ADDR A:0xf990d004
y.create.l HWIO_PERIPH_SS_BLSP1_BLSP_BAM_BAM_P_RST9_ADDR A:0xf990e004
y.create.l HWIO_PERIPH_SS_BLSP1_BLSP_BAM_BAM_P_HALT0_ADDR A:0xf9905008
y.create.l HWIO_PERIPH_SS_BLSP1_BLSP_BAM_BAM_P_HALT1_ADDR A:0xf9906008
y.create.l HWIO_PERIPH_SS_BLSP1_BLSP_BAM_BAM_P_HALT2_ADDR A:0xf9907008
y.create.l HWIO_PERIPH_SS_BLSP1_BLSP_BAM_BAM_P_HALT3_ADDR A:0xf9908008
y.create.l HWIO_PERIPH_SS_BLSP1_BLSP_BAM_BAM_P_HALT4_ADDR A:0xf9909008
y.create.l HWIO_PERIPH_SS_BLSP1_BLSP_BAM_BAM_P_HALT5_ADDR A:0xf990a008
y.create.l HWIO_PERIPH_SS_BLSP1_BLSP_BAM_BAM_P_HALT6_ADDR A:0xf990b008
y.create.l HWIO_PERIPH_SS_BLSP1_BLSP_BAM_BAM_P_HALT7_ADDR A:0xf990c008
y.create.l HWIO_PERIPH_SS_BLSP1_BLSP_BAM_BAM_P_HALT8_ADDR A:0xf990d008
y.create.l HWIO_PERIPH_SS_BLSP1_BLSP_BAM_BAM_P_HALT9_ADDR A:0xf990e008
y.create.l HWIO_PERIPH_SS_BLSP1_BLSP_BAM_BAM_P_TRUST_REG0_ADDR A:0xf9905030
y.create.l HWIO_PERIPH_SS_BLSP1_BLSP_BAM_BAM_P_TRUST_REG1_ADDR A:0xf9906030
y.create.l HWIO_PERIPH_SS_BLSP1_BLSP_BAM_BAM_P_TRUST_REG2_ADDR A:0xf9907030
y.create.l HWIO_PERIPH_SS_BLSP1_BLSP_BAM_BAM_P_TRUST_REG3_ADDR A:0xf9908030
y.create.l HWIO_PERIPH_SS_BLSP1_BLSP_BAM_BAM_P_TRUST_REG4_ADDR A:0xf9909030
y.create.l HWIO_PERIPH_SS_BLSP1_BLSP_BAM_BAM_P_TRUST_REG5_ADDR A:0xf990a030
y.create.l HWIO_PERIPH_SS_BLSP1_BLSP_BAM_BAM_P_TRUST_REG6_ADDR A:0xf990b030
y.create.l HWIO_PERIPH_SS_BLSP1_BLSP_BAM_BAM_P_TRUST_REG7_ADDR A:0xf990c030
y.create.l HWIO_PERIPH_SS_BLSP1_BLSP_BAM_BAM_P_TRUST_REG8_ADDR A:0xf990d030
y.create.l HWIO_PERIPH_SS_BLSP1_BLSP_BAM_BAM_P_TRUST_REG9_ADDR A:0xf990e030
y.create.l HWIO_PERIPH_SS_BLSP1_BLSP_BAM_BAM_P_IRQ_STTS0_ADDR A:0xf9905010
y.create.l HWIO_PERIPH_SS_BLSP1_BLSP_BAM_BAM_P_IRQ_STTS1_ADDR A:0xf9906010
y.create.l HWIO_PERIPH_SS_BLSP1_BLSP_BAM_BAM_P_IRQ_STTS2_ADDR A:0xf9907010
y.create.l HWIO_PERIPH_SS_BLSP1_BLSP_BAM_BAM_P_IRQ_STTS3_ADDR A:0xf9908010
y.create.l HWIO_PERIPH_SS_BLSP1_BLSP_BAM_BAM_P_IRQ_STTS4_ADDR A:0xf9909010
y.create.l HWIO_PERIPH_SS_BLSP1_BLSP_BAM_BAM_P_IRQ_STTS5_ADDR A:0xf990a010
y.create.l HWIO_PERIPH_SS_BLSP1_BLSP_BAM_BAM_P_IRQ_STTS6_ADDR A:0xf990b010
y.create.l HWIO_PERIPH_SS_BLSP1_BLSP_BAM_BAM_P_IRQ_STTS7_ADDR A:0xf990c010
y.create.l HWIO_PERIPH_SS_BLSP1_BLSP_BAM_BAM_P_IRQ_STTS8_ADDR A:0xf990d010
y.create.l HWIO_PERIPH_SS_BLSP1_BLSP_BAM_BAM_P_IRQ_STTS9_ADDR A:0xf990e010
y.create.l HWIO_PERIPH_SS_BLSP1_BLSP_BAM_BAM_P_IRQ_CLR0_ADDR A:0xf9905014
y.create.l HWIO_PERIPH_SS_BLSP1_BLSP_BAM_BAM_P_IRQ_CLR1_ADDR A:0xf9906014
y.create.l HWIO_PERIPH_SS_BLSP1_BLSP_BAM_BAM_P_IRQ_CLR2_ADDR A:0xf9907014
y.create.l HWIO_PERIPH_SS_BLSP1_BLSP_BAM_BAM_P_IRQ_CLR3_ADDR A:0xf9908014
y.create.l HWIO_PERIPH_SS_BLSP1_BLSP_BAM_BAM_P_IRQ_CLR4_ADDR A:0xf9909014
y.create.l HWIO_PERIPH_SS_BLSP1_BLSP_BAM_BAM_P_IRQ_CLR5_ADDR A:0xf990a014
y.create.l HWIO_PERIPH_SS_BLSP1_BLSP_BAM_BAM_P_IRQ_CLR6_ADDR A:0xf990b014
y.create.l HWIO_PERIPH_SS_BLSP1_BLSP_BAM_BAM_P_IRQ_CLR7_ADDR A:0xf990c014
y.create.l HWIO_PERIPH_SS_BLSP1_BLSP_BAM_BAM_P_IRQ_CLR8_ADDR A:0xf990d014
y.create.l HWIO_PERIPH_SS_BLSP1_BLSP_BAM_BAM_P_IRQ_CLR9_ADDR A:0xf990e014
y.create.l HWIO_PERIPH_SS_BLSP1_BLSP_BAM_BAM_P_IRQ_EN0_ADDR A:0xf9905018
y.create.l HWIO_PERIPH_SS_BLSP1_BLSP_BAM_BAM_P_IRQ_EN1_ADDR A:0xf9906018
y.create.l HWIO_PERIPH_SS_BLSP1_BLSP_BAM_BAM_P_IRQ_EN2_ADDR A:0xf9907018
y.create.l HWIO_PERIPH_SS_BLSP1_BLSP_BAM_BAM_P_IRQ_EN3_ADDR A:0xf9908018
y.create.l HWIO_PERIPH_SS_BLSP1_BLSP_BAM_BAM_P_IRQ_EN4_ADDR A:0xf9909018
y.create.l HWIO_PERIPH_SS_BLSP1_BLSP_BAM_BAM_P_IRQ_EN5_ADDR A:0xf990a018
y.create.l HWIO_PERIPH_SS_BLSP1_BLSP_BAM_BAM_P_IRQ_EN6_ADDR A:0xf990b018
y.create.l HWIO_PERIPH_SS_BLSP1_BLSP_BAM_BAM_P_IRQ_EN7_ADDR A:0xf990c018
y.create.l HWIO_PERIPH_SS_BLSP1_BLSP_BAM_BAM_P_IRQ_EN8_ADDR A:0xf990d018
y.create.l HWIO_PERIPH_SS_BLSP1_BLSP_BAM_BAM_P_IRQ_EN9_ADDR A:0xf990e018
y.create.l HWIO_PERIPH_SS_BLSP1_BLSP_BAM_BAM_P_TIMER0_ADDR A:0xf990501c
y.create.l HWIO_PERIPH_SS_BLSP1_BLSP_BAM_BAM_P_TIMER1_ADDR A:0xf990601c
y.create.l HWIO_PERIPH_SS_BLSP1_BLSP_BAM_BAM_P_TIMER2_ADDR A:0xf990701c
y.create.l HWIO_PERIPH_SS_BLSP1_BLSP_BAM_BAM_P_TIMER3_ADDR A:0xf990801c
y.create.l HWIO_PERIPH_SS_BLSP1_BLSP_BAM_BAM_P_TIMER4_ADDR A:0xf990901c
y.create.l HWIO_PERIPH_SS_BLSP1_BLSP_BAM_BAM_P_TIMER5_ADDR A:0xf990a01c
y.create.l HWIO_PERIPH_SS_BLSP1_BLSP_BAM_BAM_P_TIMER6_ADDR A:0xf990b01c
y.create.l HWIO_PERIPH_SS_BLSP1_BLSP_BAM_BAM_P_TIMER7_ADDR A:0xf990c01c
y.create.l HWIO_PERIPH_SS_BLSP1_BLSP_BAM_BAM_P_TIMER8_ADDR A:0xf990d01c
y.create.l HWIO_PERIPH_SS_BLSP1_BLSP_BAM_BAM_P_TIMER9_ADDR A:0xf990e01c
y.create.l HWIO_PERIPH_SS_BLSP1_BLSP_BAM_BAM_P_TIMER_CTRL0_ADDR A:0xf9905020
y.create.l HWIO_PERIPH_SS_BLSP1_BLSP_BAM_BAM_P_TIMER_CTRL1_ADDR A:0xf9906020
y.create.l HWIO_PERIPH_SS_BLSP1_BLSP_BAM_BAM_P_TIMER_CTRL2_ADDR A:0xf9907020
y.create.l HWIO_PERIPH_SS_BLSP1_BLSP_BAM_BAM_P_TIMER_CTRL3_ADDR A:0xf9908020
y.create.l HWIO_PERIPH_SS_BLSP1_BLSP_BAM_BAM_P_TIMER_CTRL4_ADDR A:0xf9909020
y.create.l HWIO_PERIPH_SS_BLSP1_BLSP_BAM_BAM_P_TIMER_CTRL5_ADDR A:0xf990a020
y.create.l HWIO_PERIPH_SS_BLSP1_BLSP_BAM_BAM_P_TIMER_CTRL6_ADDR A:0xf990b020
y.create.l HWIO_PERIPH_SS_BLSP1_BLSP_BAM_BAM_P_TIMER_CTRL7_ADDR A:0xf990c020
y.create.l HWIO_PERIPH_SS_BLSP1_BLSP_BAM_BAM_P_TIMER_CTRL8_ADDR A:0xf990d020
y.create.l HWIO_PERIPH_SS_BLSP1_BLSP_BAM_BAM_P_TIMER_CTRL9_ADDR A:0xf990e020
y.create.l HWIO_PERIPH_SS_BLSP1_BLSP_BAM_BAM_P_PRDCR_SDBND0_ADDR A:0xf9905024
y.create.l HWIO_PERIPH_SS_BLSP1_BLSP_BAM_BAM_P_PRDCR_SDBND1_ADDR A:0xf9906024
y.create.l HWIO_PERIPH_SS_BLSP1_BLSP_BAM_BAM_P_PRDCR_SDBND2_ADDR A:0xf9907024
y.create.l HWIO_PERIPH_SS_BLSP1_BLSP_BAM_BAM_P_PRDCR_SDBND3_ADDR A:0xf9908024
y.create.l HWIO_PERIPH_SS_BLSP1_BLSP_BAM_BAM_P_PRDCR_SDBND4_ADDR A:0xf9909024
y.create.l HWIO_PERIPH_SS_BLSP1_BLSP_BAM_BAM_P_PRDCR_SDBND5_ADDR A:0xf990a024
y.create.l HWIO_PERIPH_SS_BLSP1_BLSP_BAM_BAM_P_PRDCR_SDBND6_ADDR A:0xf990b024
y.create.l HWIO_PERIPH_SS_BLSP1_BLSP_BAM_BAM_P_PRDCR_SDBND7_ADDR A:0xf990c024
y.create.l HWIO_PERIPH_SS_BLSP1_BLSP_BAM_BAM_P_PRDCR_SDBND8_ADDR A:0xf990d024
y.create.l HWIO_PERIPH_SS_BLSP1_BLSP_BAM_BAM_P_PRDCR_SDBND9_ADDR A:0xf990e024
y.create.l HWIO_PERIPH_SS_BLSP1_BLSP_BAM_BAM_P_CNSMR_SDBND0_ADDR A:0xf9905028
y.create.l HWIO_PERIPH_SS_BLSP1_BLSP_BAM_BAM_P_CNSMR_SDBND1_ADDR A:0xf9906028
y.create.l HWIO_PERIPH_SS_BLSP1_BLSP_BAM_BAM_P_CNSMR_SDBND2_ADDR A:0xf9907028
y.create.l HWIO_PERIPH_SS_BLSP1_BLSP_BAM_BAM_P_CNSMR_SDBND3_ADDR A:0xf9908028
y.create.l HWIO_PERIPH_SS_BLSP1_BLSP_BAM_BAM_P_CNSMR_SDBND4_ADDR A:0xf9909028
y.create.l HWIO_PERIPH_SS_BLSP1_BLSP_BAM_BAM_P_CNSMR_SDBND5_ADDR A:0xf990a028
y.create.l HWIO_PERIPH_SS_BLSP1_BLSP_BAM_BAM_P_CNSMR_SDBND6_ADDR A:0xf990b028
y.create.l HWIO_PERIPH_SS_BLSP1_BLSP_BAM_BAM_P_CNSMR_SDBND7_ADDR A:0xf990c028
y.create.l HWIO_PERIPH_SS_BLSP1_BLSP_BAM_BAM_P_CNSMR_SDBND8_ADDR A:0xf990d028
y.create.l HWIO_PERIPH_SS_BLSP1_BLSP_BAM_BAM_P_CNSMR_SDBND9_ADDR A:0xf990e028
y.create.l HWIO_PERIPH_SS_BLSP1_BLSP_BAM_BAM_P_EVNT_DEST_ADDR0_ADDR A:0xf990582c
y.create.l HWIO_PERIPH_SS_BLSP1_BLSP_BAM_BAM_P_EVNT_DEST_ADDR1_ADDR A:0xf990682c
y.create.l HWIO_PERIPH_SS_BLSP1_BLSP_BAM_BAM_P_EVNT_DEST_ADDR2_ADDR A:0xf990782c
y.create.l HWIO_PERIPH_SS_BLSP1_BLSP_BAM_BAM_P_EVNT_DEST_ADDR3_ADDR A:0xf990882c
y.create.l HWIO_PERIPH_SS_BLSP1_BLSP_BAM_BAM_P_EVNT_DEST_ADDR4_ADDR A:0xf990982c
y.create.l HWIO_PERIPH_SS_BLSP1_BLSP_BAM_BAM_P_EVNT_DEST_ADDR5_ADDR A:0xf990a82c
y.create.l HWIO_PERIPH_SS_BLSP1_BLSP_BAM_BAM_P_EVNT_DEST_ADDR6_ADDR A:0xf990b82c
y.create.l HWIO_PERIPH_SS_BLSP1_BLSP_BAM_BAM_P_EVNT_DEST_ADDR7_ADDR A:0xf990c82c
y.create.l HWIO_PERIPH_SS_BLSP1_BLSP_BAM_BAM_P_EVNT_DEST_ADDR8_ADDR A:0xf990d82c
y.create.l HWIO_PERIPH_SS_BLSP1_BLSP_BAM_BAM_P_EVNT_DEST_ADDR9_ADDR A:0xf990e82c
y.create.l HWIO_PERIPH_SS_BLSP1_BLSP_BAM_BAM_P_EVNT_REG0_ADDR A:0xf9905818
y.create.l HWIO_PERIPH_SS_BLSP1_BLSP_BAM_BAM_P_EVNT_REG1_ADDR A:0xf9906818
y.create.l HWIO_PERIPH_SS_BLSP1_BLSP_BAM_BAM_P_EVNT_REG2_ADDR A:0xf9907818
y.create.l HWIO_PERIPH_SS_BLSP1_BLSP_BAM_BAM_P_EVNT_REG3_ADDR A:0xf9908818
y.create.l HWIO_PERIPH_SS_BLSP1_BLSP_BAM_BAM_P_EVNT_REG4_ADDR A:0xf9909818
y.create.l HWIO_PERIPH_SS_BLSP1_BLSP_BAM_BAM_P_EVNT_REG5_ADDR A:0xf990a818
y.create.l HWIO_PERIPH_SS_BLSP1_BLSP_BAM_BAM_P_EVNT_REG6_ADDR A:0xf990b818
y.create.l HWIO_PERIPH_SS_BLSP1_BLSP_BAM_BAM_P_EVNT_REG7_ADDR A:0xf990c818
y.create.l HWIO_PERIPH_SS_BLSP1_BLSP_BAM_BAM_P_EVNT_REG8_ADDR A:0xf990d818
y.create.l HWIO_PERIPH_SS_BLSP1_BLSP_BAM_BAM_P_EVNT_REG9_ADDR A:0xf990e818
y.create.l HWIO_PERIPH_SS_BLSP1_BLSP_BAM_BAM_P_SW_OFSTS0_ADDR A:0xf9905800
y.create.l HWIO_PERIPH_SS_BLSP1_BLSP_BAM_BAM_P_SW_OFSTS1_ADDR A:0xf9906800
y.create.l HWIO_PERIPH_SS_BLSP1_BLSP_BAM_BAM_P_SW_OFSTS2_ADDR A:0xf9907800
y.create.l HWIO_PERIPH_SS_BLSP1_BLSP_BAM_BAM_P_SW_OFSTS3_ADDR A:0xf9908800
y.create.l HWIO_PERIPH_SS_BLSP1_BLSP_BAM_BAM_P_SW_OFSTS4_ADDR A:0xf9909800
y.create.l HWIO_PERIPH_SS_BLSP1_BLSP_BAM_BAM_P_SW_OFSTS5_ADDR A:0xf990a800
y.create.l HWIO_PERIPH_SS_BLSP1_BLSP_BAM_BAM_P_SW_OFSTS6_ADDR A:0xf990b800
y.create.l HWIO_PERIPH_SS_BLSP1_BLSP_BAM_BAM_P_SW_OFSTS7_ADDR A:0xf990c800
y.create.l HWIO_PERIPH_SS_BLSP1_BLSP_BAM_BAM_P_SW_OFSTS8_ADDR A:0xf990d800
y.create.l HWIO_PERIPH_SS_BLSP1_BLSP_BAM_BAM_P_SW_OFSTS9_ADDR A:0xf990e800
y.create.l HWIO_PERIPH_SS_BLSP1_BLSP_BAM_BAM_P_DATA_FIFO_ADDR0_ADDR A:0xf9905824
y.create.l HWIO_PERIPH_SS_BLSP1_BLSP_BAM_BAM_P_DATA_FIFO_ADDR1_ADDR A:0xf9906824
y.create.l HWIO_PERIPH_SS_BLSP1_BLSP_BAM_BAM_P_DATA_FIFO_ADDR2_ADDR A:0xf9907824
y.create.l HWIO_PERIPH_SS_BLSP1_BLSP_BAM_BAM_P_DATA_FIFO_ADDR3_ADDR A:0xf9908824
y.create.l HWIO_PERIPH_SS_BLSP1_BLSP_BAM_BAM_P_DATA_FIFO_ADDR4_ADDR A:0xf9909824
y.create.l HWIO_PERIPH_SS_BLSP1_BLSP_BAM_BAM_P_DATA_FIFO_ADDR5_ADDR A:0xf990a824
y.create.l HWIO_PERIPH_SS_BLSP1_BLSP_BAM_BAM_P_DATA_FIFO_ADDR6_ADDR A:0xf990b824
y.create.l HWIO_PERIPH_SS_BLSP1_BLSP_BAM_BAM_P_DATA_FIFO_ADDR7_ADDR A:0xf990c824
y.create.l HWIO_PERIPH_SS_BLSP1_BLSP_BAM_BAM_P_DATA_FIFO_ADDR8_ADDR A:0xf990d824
y.create.l HWIO_PERIPH_SS_BLSP1_BLSP_BAM_BAM_P_DATA_FIFO_ADDR9_ADDR A:0xf990e824
y.create.l HWIO_PERIPH_SS_BLSP1_BLSP_BAM_BAM_P_DESC_FIFO_ADDR0_ADDR A:0xf990581c
y.create.l HWIO_PERIPH_SS_BLSP1_BLSP_BAM_BAM_P_DESC_FIFO_ADDR1_ADDR A:0xf990681c
y.create.l HWIO_PERIPH_SS_BLSP1_BLSP_BAM_BAM_P_DESC_FIFO_ADDR2_ADDR A:0xf990781c
y.create.l HWIO_PERIPH_SS_BLSP1_BLSP_BAM_BAM_P_DESC_FIFO_ADDR3_ADDR A:0xf990881c
y.create.l HWIO_PERIPH_SS_BLSP1_BLSP_BAM_BAM_P_DESC_FIFO_ADDR4_ADDR A:0xf990981c
y.create.l HWIO_PERIPH_SS_BLSP1_BLSP_BAM_BAM_P_DESC_FIFO_ADDR5_ADDR A:0xf990a81c
y.create.l HWIO_PERIPH_SS_BLSP1_BLSP_BAM_BAM_P_DESC_FIFO_ADDR6_ADDR A:0xf990b81c
y.create.l HWIO_PERIPH_SS_BLSP1_BLSP_BAM_BAM_P_DESC_FIFO_ADDR7_ADDR A:0xf990c81c
y.create.l HWIO_PERIPH_SS_BLSP1_BLSP_BAM_BAM_P_DESC_FIFO_ADDR8_ADDR A:0xf990d81c
y.create.l HWIO_PERIPH_SS_BLSP1_BLSP_BAM_BAM_P_DESC_FIFO_ADDR9_ADDR A:0xf990e81c
y.create.l HWIO_PERIPH_SS_BLSP1_BLSP_BAM_BAM_P_EVNT_GEN_TRSHLD0_ADDR A:0xf9905828
y.create.l HWIO_PERIPH_SS_BLSP1_BLSP_BAM_BAM_P_EVNT_GEN_TRSHLD1_ADDR A:0xf9906828
y.create.l HWIO_PERIPH_SS_BLSP1_BLSP_BAM_BAM_P_EVNT_GEN_TRSHLD2_ADDR A:0xf9907828
y.create.l HWIO_PERIPH_SS_BLSP1_BLSP_BAM_BAM_P_EVNT_GEN_TRSHLD3_ADDR A:0xf9908828
y.create.l HWIO_PERIPH_SS_BLSP1_BLSP_BAM_BAM_P_EVNT_GEN_TRSHLD4_ADDR A:0xf9909828
y.create.l HWIO_PERIPH_SS_BLSP1_BLSP_BAM_BAM_P_EVNT_GEN_TRSHLD5_ADDR A:0xf990a828
y.create.l HWIO_PERIPH_SS_BLSP1_BLSP_BAM_BAM_P_EVNT_GEN_TRSHLD6_ADDR A:0xf990b828
y.create.l HWIO_PERIPH_SS_BLSP1_BLSP_BAM_BAM_P_EVNT_GEN_TRSHLD7_ADDR A:0xf990c828
y.create.l HWIO_PERIPH_SS_BLSP1_BLSP_BAM_BAM_P_EVNT_GEN_TRSHLD8_ADDR A:0xf990d828
y.create.l HWIO_PERIPH_SS_BLSP1_BLSP_BAM_BAM_P_EVNT_GEN_TRSHLD9_ADDR A:0xf990e828
y.create.l HWIO_PERIPH_SS_BLSP1_BLSP_BAM_BAM_P_FIFO_SIZES0_ADDR A:0xf9905820
y.create.l HWIO_PERIPH_SS_BLSP1_BLSP_BAM_BAM_P_FIFO_SIZES1_ADDR A:0xf9906820
y.create.l HWIO_PERIPH_SS_BLSP1_BLSP_BAM_BAM_P_FIFO_SIZES2_ADDR A:0xf9907820
y.create.l HWIO_PERIPH_SS_BLSP1_BLSP_BAM_BAM_P_FIFO_SIZES3_ADDR A:0xf9908820
y.create.l HWIO_PERIPH_SS_BLSP1_BLSP_BAM_BAM_P_FIFO_SIZES4_ADDR A:0xf9909820
y.create.l HWIO_PERIPH_SS_BLSP1_BLSP_BAM_BAM_P_FIFO_SIZES5_ADDR A:0xf990a820
y.create.l HWIO_PERIPH_SS_BLSP1_BLSP_BAM_BAM_P_FIFO_SIZES6_ADDR A:0xf990b820
y.create.l HWIO_PERIPH_SS_BLSP1_BLSP_BAM_BAM_P_FIFO_SIZES7_ADDR A:0xf990c820
y.create.l HWIO_PERIPH_SS_BLSP1_BLSP_BAM_BAM_P_FIFO_SIZES8_ADDR A:0xf990d820
y.create.l HWIO_PERIPH_SS_BLSP1_BLSP_BAM_BAM_P_FIFO_SIZES9_ADDR A:0xf990e820
y.create.l HWIO_PERIPH_SS_BLSP1_BLSP_BAM_BAM_P_RETR_CNTXT_0_ADDR A:0xf9905834
y.create.l HWIO_PERIPH_SS_BLSP1_BLSP_BAM_BAM_P_RETR_CNTXT_1_ADDR A:0xf9906834
y.create.l HWIO_PERIPH_SS_BLSP1_BLSP_BAM_BAM_P_RETR_CNTXT_2_ADDR A:0xf9907834
y.create.l HWIO_PERIPH_SS_BLSP1_BLSP_BAM_BAM_P_RETR_CNTXT_3_ADDR A:0xf9908834
y.create.l HWIO_PERIPH_SS_BLSP1_BLSP_BAM_BAM_P_RETR_CNTXT_4_ADDR A:0xf9909834
y.create.l HWIO_PERIPH_SS_BLSP1_BLSP_BAM_BAM_P_RETR_CNTXT_5_ADDR A:0xf990a834
y.create.l HWIO_PERIPH_SS_BLSP1_BLSP_BAM_BAM_P_RETR_CNTXT_6_ADDR A:0xf990b834
y.create.l HWIO_PERIPH_SS_BLSP1_BLSP_BAM_BAM_P_RETR_CNTXT_7_ADDR A:0xf990c834
y.create.l HWIO_PERIPH_SS_BLSP1_BLSP_BAM_BAM_P_RETR_CNTXT_8_ADDR A:0xf990d834
y.create.l HWIO_PERIPH_SS_BLSP1_BLSP_BAM_BAM_P_RETR_CNTXT_9_ADDR A:0xf990e834
y.create.l HWIO_PERIPH_SS_BLSP1_BLSP_BAM_BAM_P_SI_CNTXT_0_ADDR A:0xf9905838
y.create.l HWIO_PERIPH_SS_BLSP1_BLSP_BAM_BAM_P_SI_CNTXT_1_ADDR A:0xf9906838
y.create.l HWIO_PERIPH_SS_BLSP1_BLSP_BAM_BAM_P_SI_CNTXT_2_ADDR A:0xf9907838
y.create.l HWIO_PERIPH_SS_BLSP1_BLSP_BAM_BAM_P_SI_CNTXT_3_ADDR A:0xf9908838
y.create.l HWIO_PERIPH_SS_BLSP1_BLSP_BAM_BAM_P_SI_CNTXT_4_ADDR A:0xf9909838
y.create.l HWIO_PERIPH_SS_BLSP1_BLSP_BAM_BAM_P_SI_CNTXT_5_ADDR A:0xf990a838
y.create.l HWIO_PERIPH_SS_BLSP1_BLSP_BAM_BAM_P_SI_CNTXT_6_ADDR A:0xf990b838
y.create.l HWIO_PERIPH_SS_BLSP1_BLSP_BAM_BAM_P_SI_CNTXT_7_ADDR A:0xf990c838
y.create.l HWIO_PERIPH_SS_BLSP1_BLSP_BAM_BAM_P_SI_CNTXT_8_ADDR A:0xf990d838
y.create.l HWIO_PERIPH_SS_BLSP1_BLSP_BAM_BAM_P_SI_CNTXT_9_ADDR A:0xf990e838
y.create.l HWIO_PERIPH_SS_BLSP1_BLSP_BAM_BAM_P_DF_CNTXT_0_ADDR A:0xf9905830
y.create.l HWIO_PERIPH_SS_BLSP1_BLSP_BAM_BAM_P_DF_CNTXT_1_ADDR A:0xf9906830
y.create.l HWIO_PERIPH_SS_BLSP1_BLSP_BAM_BAM_P_DF_CNTXT_2_ADDR A:0xf9907830
y.create.l HWIO_PERIPH_SS_BLSP1_BLSP_BAM_BAM_P_DF_CNTXT_3_ADDR A:0xf9908830
y.create.l HWIO_PERIPH_SS_BLSP1_BLSP_BAM_BAM_P_DF_CNTXT_4_ADDR A:0xf9909830
y.create.l HWIO_PERIPH_SS_BLSP1_BLSP_BAM_BAM_P_DF_CNTXT_5_ADDR A:0xf990a830
y.create.l HWIO_PERIPH_SS_BLSP1_BLSP_BAM_BAM_P_DF_CNTXT_6_ADDR A:0xf990b830
y.create.l HWIO_PERIPH_SS_BLSP1_BLSP_BAM_BAM_P_DF_CNTXT_7_ADDR A:0xf990c830
y.create.l HWIO_PERIPH_SS_BLSP1_BLSP_BAM_BAM_P_DF_CNTXT_8_ADDR A:0xf990d830
y.create.l HWIO_PERIPH_SS_BLSP1_BLSP_BAM_BAM_P_DF_CNTXT_9_ADDR A:0xf990e830
y.create.l HWIO_PERIPH_SS_BLSP1_BLSP_BAM_BAM_P_AU_PSM_CNTXT_1_0_ADDR A:0xf9905804
y.create.l HWIO_PERIPH_SS_BLSP1_BLSP_BAM_BAM_P_AU_PSM_CNTXT_1_1_ADDR A:0xf9906804
y.create.l HWIO_PERIPH_SS_BLSP1_BLSP_BAM_BAM_P_AU_PSM_CNTXT_1_2_ADDR A:0xf9907804
y.create.l HWIO_PERIPH_SS_BLSP1_BLSP_BAM_BAM_P_AU_PSM_CNTXT_1_3_ADDR A:0xf9908804
y.create.l HWIO_PERIPH_SS_BLSP1_BLSP_BAM_BAM_P_AU_PSM_CNTXT_1_4_ADDR A:0xf9909804
y.create.l HWIO_PERIPH_SS_BLSP1_BLSP_BAM_BAM_P_AU_PSM_CNTXT_1_5_ADDR A:0xf990a804
y.create.l HWIO_PERIPH_SS_BLSP1_BLSP_BAM_BAM_P_AU_PSM_CNTXT_1_6_ADDR A:0xf990b804
y.create.l HWIO_PERIPH_SS_BLSP1_BLSP_BAM_BAM_P_AU_PSM_CNTXT_1_7_ADDR A:0xf990c804
y.create.l HWIO_PERIPH_SS_BLSP1_BLSP_BAM_BAM_P_AU_PSM_CNTXT_1_8_ADDR A:0xf990d804
y.create.l HWIO_PERIPH_SS_BLSP1_BLSP_BAM_BAM_P_AU_PSM_CNTXT_1_9_ADDR A:0xf990e804
y.create.l HWIO_PERIPH_SS_BLSP1_BLSP_BAM_BAM_P_PSM_CNTXT_2_0_ADDR A:0xf9905808
y.create.l HWIO_PERIPH_SS_BLSP1_BLSP_BAM_BAM_P_PSM_CNTXT_2_1_ADDR A:0xf9906808
y.create.l HWIO_PERIPH_SS_BLSP1_BLSP_BAM_BAM_P_PSM_CNTXT_2_2_ADDR A:0xf9907808
y.create.l HWIO_PERIPH_SS_BLSP1_BLSP_BAM_BAM_P_PSM_CNTXT_2_3_ADDR A:0xf9908808
y.create.l HWIO_PERIPH_SS_BLSP1_BLSP_BAM_BAM_P_PSM_CNTXT_2_4_ADDR A:0xf9909808
y.create.l HWIO_PERIPH_SS_BLSP1_BLSP_BAM_BAM_P_PSM_CNTXT_2_5_ADDR A:0xf990a808
y.create.l HWIO_PERIPH_SS_BLSP1_BLSP_BAM_BAM_P_PSM_CNTXT_2_6_ADDR A:0xf990b808
y.create.l HWIO_PERIPH_SS_BLSP1_BLSP_BAM_BAM_P_PSM_CNTXT_2_7_ADDR A:0xf990c808
y.create.l HWIO_PERIPH_SS_BLSP1_BLSP_BAM_BAM_P_PSM_CNTXT_2_8_ADDR A:0xf990d808
y.create.l HWIO_PERIPH_SS_BLSP1_BLSP_BAM_BAM_P_PSM_CNTXT_2_9_ADDR A:0xf990e808
y.create.l HWIO_PERIPH_SS_BLSP1_BLSP_BAM_BAM_P_PSM_CNTXT_3_0_ADDR A:0xf990580c
y.create.l HWIO_PERIPH_SS_BLSP1_BLSP_BAM_BAM_P_PSM_CNTXT_3_1_ADDR A:0xf990680c
y.create.l HWIO_PERIPH_SS_BLSP1_BLSP_BAM_BAM_P_PSM_CNTXT_3_2_ADDR A:0xf990780c
y.create.l HWIO_PERIPH_SS_BLSP1_BLSP_BAM_BAM_P_PSM_CNTXT_3_3_ADDR A:0xf990880c
y.create.l HWIO_PERIPH_SS_BLSP1_BLSP_BAM_BAM_P_PSM_CNTXT_3_4_ADDR A:0xf990980c
y.create.l HWIO_PERIPH_SS_BLSP1_BLSP_BAM_BAM_P_PSM_CNTXT_3_5_ADDR A:0xf990a80c
y.create.l HWIO_PERIPH_SS_BLSP1_BLSP_BAM_BAM_P_PSM_CNTXT_3_6_ADDR A:0xf990b80c
y.create.l HWIO_PERIPH_SS_BLSP1_BLSP_BAM_BAM_P_PSM_CNTXT_3_7_ADDR A:0xf990c80c
y.create.l HWIO_PERIPH_SS_BLSP1_BLSP_BAM_BAM_P_PSM_CNTXT_3_8_ADDR A:0xf990d80c
y.create.l HWIO_PERIPH_SS_BLSP1_BLSP_BAM_BAM_P_PSM_CNTXT_3_9_ADDR A:0xf990e80c
y.create.l HWIO_PERIPH_SS_BLSP1_BLSP_BAM_BAM_P_PSM_CNTXT_4_0_ADDR A:0xf9905810
y.create.l HWIO_PERIPH_SS_BLSP1_BLSP_BAM_BAM_P_PSM_CNTXT_4_1_ADDR A:0xf9906810
y.create.l HWIO_PERIPH_SS_BLSP1_BLSP_BAM_BAM_P_PSM_CNTXT_4_2_ADDR A:0xf9907810
y.create.l HWIO_PERIPH_SS_BLSP1_BLSP_BAM_BAM_P_PSM_CNTXT_4_3_ADDR A:0xf9908810
y.create.l HWIO_PERIPH_SS_BLSP1_BLSP_BAM_BAM_P_PSM_CNTXT_4_4_ADDR A:0xf9909810
y.create.l HWIO_PERIPH_SS_BLSP1_BLSP_BAM_BAM_P_PSM_CNTXT_4_5_ADDR A:0xf990a810
y.create.l HWIO_PERIPH_SS_BLSP1_BLSP_BAM_BAM_P_PSM_CNTXT_4_6_ADDR A:0xf990b810
y.create.l HWIO_PERIPH_SS_BLSP1_BLSP_BAM_BAM_P_PSM_CNTXT_4_7_ADDR A:0xf990c810
y.create.l HWIO_PERIPH_SS_BLSP1_BLSP_BAM_BAM_P_PSM_CNTXT_4_8_ADDR A:0xf990d810
y.create.l HWIO_PERIPH_SS_BLSP1_BLSP_BAM_BAM_P_PSM_CNTXT_4_9_ADDR A:0xf990e810
y.create.l HWIO_PERIPH_SS_BLSP1_BLSP_BAM_BAM_P_PSM_CNTXT_5_0_ADDR A:0xf9905814
y.create.l HWIO_PERIPH_SS_BLSP1_BLSP_BAM_BAM_P_PSM_CNTXT_5_1_ADDR A:0xf9906814
y.create.l HWIO_PERIPH_SS_BLSP1_BLSP_BAM_BAM_P_PSM_CNTXT_5_2_ADDR A:0xf9907814
y.create.l HWIO_PERIPH_SS_BLSP1_BLSP_BAM_BAM_P_PSM_CNTXT_5_3_ADDR A:0xf9908814
y.create.l HWIO_PERIPH_SS_BLSP1_BLSP_BAM_BAM_P_PSM_CNTXT_5_4_ADDR A:0xf9909814
y.create.l HWIO_PERIPH_SS_BLSP1_BLSP_BAM_BAM_P_PSM_CNTXT_5_5_ADDR A:0xf990a814
y.create.l HWIO_PERIPH_SS_BLSP1_BLSP_BAM_BAM_P_PSM_CNTXT_5_6_ADDR A:0xf990b814
y.create.l HWIO_PERIPH_SS_BLSP1_BLSP_BAM_BAM_P_PSM_CNTXT_5_7_ADDR A:0xf990c814
y.create.l HWIO_PERIPH_SS_BLSP1_BLSP_BAM_BAM_P_PSM_CNTXT_5_8_ADDR A:0xf990d814
y.create.l HWIO_PERIPH_SS_BLSP1_BLSP_BAM_BAM_P_PSM_CNTXT_5_9_ADDR A:0xf990e814
y.create.l HWIO_PERIPH_SS_BLSP1_BLSP_BAM_XPU_SCR_ADDR A:0xf9902000
y.create.l HWIO_PERIPH_SS_BLSP1_BLSP_BAM_XPU_SWDR_ADDR A:0xf9902004
y.create.l HWIO_PERIPH_SS_BLSP1_BLSP_BAM_XPU_SEAR0_ADDR A:0xf9902040
y.create.l HWIO_PERIPH_SS_BLSP1_BLSP_BAM_XPU_SESR_ADDR A:0xf9902048
y.create.l HWIO_PERIPH_SS_BLSP1_BLSP_BAM_XPU_SESRRESTORE_ADDR A:0xf990204c
y.create.l HWIO_PERIPH_SS_BLSP1_BLSP_BAM_XPU_SESYNR0_ADDR A:0xf9902050
y.create.l HWIO_PERIPH_SS_BLSP1_BLSP_BAM_XPU_SESYNR1_ADDR A:0xf9902054
y.create.l HWIO_PERIPH_SS_BLSP1_BLSP_BAM_XPU_SESYNR2_ADDR A:0xf9902058
y.create.l HWIO_PERIPH_SS_BLSP1_BLSP_BAM_XPU_MCR_ADDR A:0xf9902100
y.create.l HWIO_PERIPH_SS_BLSP1_BLSP_BAM_XPU_MEAR0_ADDR A:0xf9902140
y.create.l HWIO_PERIPH_SS_BLSP1_BLSP_BAM_XPU_MESR_ADDR A:0xf9902148
y.create.l HWIO_PERIPH_SS_BLSP1_BLSP_BAM_XPU_MESRRESTORE_ADDR A:0xf990214c
y.create.l HWIO_PERIPH_SS_BLSP1_BLSP_BAM_XPU_MESYNR0_ADDR A:0xf9902150
y.create.l HWIO_PERIPH_SS_BLSP1_BLSP_BAM_XPU_MESYNR1_ADDR A:0xf9902154
y.create.l HWIO_PERIPH_SS_BLSP1_BLSP_BAM_XPU_MESYNR2_ADDR A:0xf9902158
y.create.l HWIO_PERIPH_SS_BLSP1_BLSP_BAM_XPU_CR_ADDR A:0xf9902080
y.create.l HWIO_PERIPH_SS_BLSP1_BLSP_BAM_XPU_RPU_ACR0_ADDR A:0xf99020a0
y.create.l HWIO_PERIPH_SS_BLSP1_BLSP_BAM_XPU_EAR0_ADDR A:0xf99020c0
y.create.l HWIO_PERIPH_SS_BLSP1_BLSP_BAM_XPU_ESR_ADDR A:0xf99020c8
y.create.l HWIO_PERIPH_SS_BLSP1_BLSP_BAM_XPU_ESRRESTORE_ADDR A:0xf99020cc
y.create.l HWIO_PERIPH_SS_BLSP1_BLSP_BAM_XPU_ESYNR0_ADDR A:0xf99020d0
y.create.l HWIO_PERIPH_SS_BLSP1_BLSP_BAM_XPU_ESYNR1_ADDR A:0xf99020d4
y.create.l HWIO_PERIPH_SS_BLSP1_BLSP_BAM_XPU_ESYNR2_ADDR A:0xf99020d8
y.create.l HWIO_PERIPH_SS_BLSP1_BLSP_BAM_XPU_IDR0_ADDR A:0xf9902074
y.create.l HWIO_PERIPH_SS_BLSP1_BLSP_BAM_XPU_IDR1_ADDR A:0xf9902078
y.create.l HWIO_PERIPH_SS_BLSP1_BLSP_BAM_XPU_REV_ADDR A:0xf990207c
y.create.l HWIO_PERIPH_SS_BLSP1_BLSP_BAM_XPU_RG0_RACR0_ADDR A:0xf9902200
y.create.l HWIO_PERIPH_SS_BLSP1_BLSP_BAM_XPU_RG1_RACR0_ADDR A:0xf9902280
y.create.l HWIO_PERIPH_SS_BLSP1_BLSP_BAM_XPU_RG2_RACR0_ADDR A:0xf9902300
y.create.l HWIO_PERIPH_SS_BLSP1_BLSP_BAM_XPU_RG3_RACR0_ADDR A:0xf9902380
y.create.l HWIO_PERIPH_SS_BLSP1_BLSP_BAM_XPU_RG4_RACR0_ADDR A:0xf9902400
y.create.l HWIO_PERIPH_SS_BLSP1_BLSP_BAM_XPU_RG5_RACR0_ADDR A:0xf9902480
y.create.l HWIO_PERIPH_SS_BLSP1_BLSP_BAM_XPU_RG6_RACR0_ADDR A:0xf9902500
y.create.l HWIO_PERIPH_SS_BLSP1_BLSP_BAM_XPU_RG7_RACR0_ADDR A:0xf9902580
y.create.l HWIO_PERIPH_SS_BLSP1_BLSP_BAM_XPU_RG8_RACR0_ADDR A:0xf9902600
y.create.l HWIO_PERIPH_SS_BLSP1_BLSP_BAM_XPU_RG9_RACR0_ADDR A:0xf9902680
y.create.l HWIO_PERIPH_SS_BLSP1_BLSP_BAM_XPU_RG0_SCR_ADDR A:0xf9902250
y.create.l HWIO_PERIPH_SS_BLSP1_BLSP_BAM_XPU_RG1_SCR_ADDR A:0xf99022d0
y.create.l HWIO_PERIPH_SS_BLSP1_BLSP_BAM_XPU_RG2_SCR_ADDR A:0xf9902350
y.create.l HWIO_PERIPH_SS_BLSP1_BLSP_BAM_XPU_RG3_SCR_ADDR A:0xf99023d0
y.create.l HWIO_PERIPH_SS_BLSP1_BLSP_BAM_XPU_RG4_SCR_ADDR A:0xf9902450
y.create.l HWIO_PERIPH_SS_BLSP1_BLSP_BAM_XPU_RG5_SCR_ADDR A:0xf99024d0
y.create.l HWIO_PERIPH_SS_BLSP1_BLSP_BAM_XPU_RG6_SCR_ADDR A:0xf9902550
y.create.l HWIO_PERIPH_SS_BLSP1_BLSP_BAM_XPU_RG7_SCR_ADDR A:0xf99025d0
y.create.l HWIO_PERIPH_SS_BLSP1_BLSP_BAM_XPU_RG8_SCR_ADDR A:0xf9902650
y.create.l HWIO_PERIPH_SS_BLSP1_BLSP_BAM_XPU_RG9_SCR_ADDR A:0xf99026d0
y.create.l HWIO_PERIPH_SS_BLSP1_BLSP_BAM_XPU_RG0_MCR_ADDR A:0xf9902254
y.create.l HWIO_PERIPH_SS_BLSP1_BLSP_BAM_XPU_RG1_MCR_ADDR A:0xf99022d4
y.create.l HWIO_PERIPH_SS_BLSP1_BLSP_BAM_XPU_RG2_MCR_ADDR A:0xf9902354
y.create.l HWIO_PERIPH_SS_BLSP1_BLSP_BAM_XPU_RG3_MCR_ADDR A:0xf99023d4
y.create.l HWIO_PERIPH_SS_BLSP1_BLSP_BAM_XPU_RG4_MCR_ADDR A:0xf9902454
y.create.l HWIO_PERIPH_SS_BLSP1_BLSP_BAM_XPU_RG5_MCR_ADDR A:0xf99024d4
y.create.l HWIO_PERIPH_SS_BLSP1_BLSP_BAM_XPU_RG6_MCR_ADDR A:0xf9902554
y.create.l HWIO_PERIPH_SS_BLSP1_BLSP_BAM_XPU_RG7_MCR_ADDR A:0xf99025d4
y.create.l HWIO_PERIPH_SS_BLSP1_BLSP_BAM_XPU_RG8_MCR_ADDR A:0xf9902654
y.create.l HWIO_PERIPH_SS_BLSP1_BLSP_BAM_XPU_RG9_MCR_ADDR A:0xf99026d4
y.create.l HWIO_PERIPH_SS_BLSP1_BLSP_BAM_VMIDMT_SCR0_ADDR A:0xf9900000
y.create.l HWIO_PERIPH_SS_BLSP1_BLSP_BAM_VMIDMT_SCR1_ADDR A:0xf9900004
y.create.l HWIO_PERIPH_SS_BLSP1_BLSP_BAM_VMIDMT_SCR2_ADDR A:0xf9900008
y.create.l HWIO_PERIPH_SS_BLSP1_BLSP_BAM_VMIDMT_SACR_ADDR A:0xf9900010
y.create.l HWIO_PERIPH_SS_BLSP1_BLSP_BAM_VMIDMT_SIDR0_ADDR A:0xf9900020
y.create.l HWIO_PERIPH_SS_BLSP1_BLSP_BAM_VMIDMT_SIDR1_ADDR A:0xf9900024
y.create.l HWIO_PERIPH_SS_BLSP1_BLSP_BAM_VMIDMT_SIDR2_ADDR A:0xf9900028
y.create.l HWIO_PERIPH_SS_BLSP1_BLSP_BAM_VMIDMT_SIDR4_ADDR A:0xf9900030
y.create.l HWIO_PERIPH_SS_BLSP1_BLSP_BAM_VMIDMT_SIDR5_ADDR A:0xf9900034
y.create.l HWIO_PERIPH_SS_BLSP1_BLSP_BAM_VMIDMT_SIDR7_ADDR A:0xf990003c
y.create.l HWIO_PERIPH_SS_BLSP1_BLSP_BAM_VMIDMT_SGFAR0_ADDR A:0xf9900040
y.create.l HWIO_PERIPH_SS_BLSP1_BLSP_BAM_VMIDMT_SGFSR_ADDR A:0xf9900048
y.create.l HWIO_PERIPH_SS_BLSP1_BLSP_BAM_VMIDMT_SGFSRRESTORE_ADDR A:0xf990004c
y.create.l HWIO_PERIPH_SS_BLSP1_BLSP_BAM_VMIDMT_SGFSYNDR0_ADDR A:0xf9900050
y.create.l HWIO_PERIPH_SS_BLSP1_BLSP_BAM_VMIDMT_SGFSYNDR1_ADDR A:0xf9900054
y.create.l HWIO_PERIPH_SS_BLSP1_BLSP_BAM_VMIDMT_SGFSYNDR2_ADDR A:0xf9900058
y.create.l HWIO_PERIPH_SS_BLSP1_BLSP_BAM_VMIDMT_VMIDMTSCR0_ADDR A:0xf9900090
y.create.l HWIO_PERIPH_SS_BLSP1_BLSP_BAM_VMIDMT_CR0_ADDR A:0xf9900000
y.create.l HWIO_PERIPH_SS_BLSP1_BLSP_BAM_VMIDMT_CR2_ADDR A:0xf9900008
y.create.l HWIO_PERIPH_SS_BLSP1_BLSP_BAM_VMIDMT_ACR_ADDR A:0xf9900010
y.create.l HWIO_PERIPH_SS_BLSP1_BLSP_BAM_VMIDMT_IDR0_ADDR A:0xf9900020
y.create.l HWIO_PERIPH_SS_BLSP1_BLSP_BAM_VMIDMT_IDR1_ADDR A:0xf9900024
y.create.l HWIO_PERIPH_SS_BLSP1_BLSP_BAM_VMIDMT_IDR2_ADDR A:0xf9900028
y.create.l HWIO_PERIPH_SS_BLSP1_BLSP_BAM_VMIDMT_IDR4_ADDR A:0xf9900030
y.create.l HWIO_PERIPH_SS_BLSP1_BLSP_BAM_VMIDMT_IDR5_ADDR A:0xf9900034
y.create.l HWIO_PERIPH_SS_BLSP1_BLSP_BAM_VMIDMT_IDR7_ADDR A:0xf990003c
y.create.l HWIO_PERIPH_SS_BLSP1_BLSP_BAM_VMIDMT_GFAR0_ADDR A:0xf9900040
y.create.l HWIO_PERIPH_SS_BLSP1_BLSP_BAM_VMIDMT_GFSR_ADDR A:0xf9900048
y.create.l HWIO_PERIPH_SS_BLSP1_BLSP_BAM_VMIDMT_GFSRRESTORE_ADDR A:0xf990004c
y.create.l HWIO_PERIPH_SS_BLSP1_BLSP_BAM_VMIDMT_GFSYNDR0_ADDR A:0xf9900050
y.create.l HWIO_PERIPH_SS_BLSP1_BLSP_BAM_VMIDMT_GFSYNDR1_ADDR A:0xf9900054
y.create.l HWIO_PERIPH_SS_BLSP1_BLSP_BAM_VMIDMT_GFSYNDR2_ADDR A:0xf9900058
y.create.l HWIO_PERIPH_SS_BLSP1_BLSP_BAM_VMIDMT_VMIDMTCR0_ADDR A:0xf9900090
y.create.l HWIO_PERIPH_SS_BLSP1_BLSP_BAM_VMIDMT_VMIDMTACR_ADDR A:0xf990009c
y.create.l HWIO_PERIPH_SS_BLSP1_BLSP_BAM_VMIDMT_NSCR0_ADDR A:0xf9900400
y.create.l HWIO_PERIPH_SS_BLSP1_BLSP_BAM_VMIDMT_NSCR2_ADDR A:0xf9900408
y.create.l HWIO_PERIPH_SS_BLSP1_BLSP_BAM_VMIDMT_NSACR_ADDR A:0xf9900410
y.create.l HWIO_PERIPH_SS_BLSP1_BLSP_BAM_VMIDMT_NSGFAR0_ADDR A:0xf9900440
y.create.l HWIO_PERIPH_SS_BLSP1_BLSP_BAM_VMIDMT_NSGFSR_ADDR A:0xf9900448
y.create.l HWIO_PERIPH_SS_BLSP1_BLSP_BAM_VMIDMT_NSGFSRRESTORE_ADDR A:0xf990044c
y.create.l HWIO_PERIPH_SS_BLSP1_BLSP_BAM_VMIDMT_NSGFSYNDR0_ADDR A:0xf9900450
y.create.l HWIO_PERIPH_SS_BLSP1_BLSP_BAM_VMIDMT_NSGFSYNDR1_ADDR A:0xf9900454
y.create.l HWIO_PERIPH_SS_BLSP1_BLSP_BAM_VMIDMT_NSGFSYNDR2_ADDR A:0xf9900458
y.create.l HWIO_PERIPH_SS_BLSP1_BLSP_BAM_VMIDMT_NSVMIDMTCR0_ADDR A:0xf9900490
y.create.l HWIO_PERIPH_SS_BLSP1_BLSP_BAM_VMIDMT_SSDR0_ADDR A:0xf9900080
y.create.l HWIO_PERIPH_SS_BLSP1_BLSP_BAM_VMIDMT_MSDR0_ADDR A:0xf9900480
y.create.l HWIO_PERIPH_SS_BLSP1_BLSP_BAM_VMIDMT_MCR_ADDR A:0xf9900494
y.create.l HWIO_PERIPH_SS_BLSP1_BLSP_BAM_VMIDMT_S2VR0_ADDR A:0xf9900c00
y.create.l HWIO_PERIPH_SS_BLSP1_BLSP_BAM_VMIDMT_S2VR1_ADDR A:0xf9900c04
y.create.l HWIO_PERIPH_SS_BLSP1_BLSP_BAM_VMIDMT_S2VR2_ADDR A:0xf9900c08
y.create.l HWIO_PERIPH_SS_BLSP1_BLSP_BAM_VMIDMT_S2VR3_ADDR A:0xf9900c0c
y.create.l HWIO_PERIPH_SS_BLSP1_BLSP_BAM_VMIDMT_S2VR4_ADDR A:0xf9900c10
y.create.l HWIO_PERIPH_SS_BLSP1_BLSP_BAM_VMIDMT_S2VR5_ADDR A:0xf9900c14
y.create.l HWIO_PERIPH_SS_BLSP1_BLSP_BAM_VMIDMT_S2VR6_ADDR A:0xf9900c18
y.create.l HWIO_PERIPH_SS_BLSP1_BLSP_BAM_VMIDMT_S2VR7_ADDR A:0xf9900c1c
y.create.l HWIO_PERIPH_SS_BLSP1_BLSP_BAM_VMIDMT_S2VR8_ADDR A:0xf9900c20
y.create.l HWIO_PERIPH_SS_BLSP1_BLSP_BAM_VMIDMT_S2VR9_ADDR A:0xf9900c24
y.create.l HWIO_PERIPH_SS_BLSP1_BLSP_BAM_VMIDMT_AS2VR0_ADDR A:0xf9900e00
y.create.l HWIO_PERIPH_SS_BLSP1_BLSP_BAM_VMIDMT_AS2VR1_ADDR A:0xf9900e04
y.create.l HWIO_PERIPH_SS_BLSP1_BLSP_BAM_VMIDMT_AS2VR2_ADDR A:0xf9900e08
y.create.l HWIO_PERIPH_SS_BLSP1_BLSP_BAM_VMIDMT_AS2VR3_ADDR A:0xf9900e0c
y.create.l HWIO_PERIPH_SS_BLSP1_BLSP_BAM_VMIDMT_AS2VR4_ADDR A:0xf9900e10
y.create.l HWIO_PERIPH_SS_BLSP1_BLSP_BAM_VMIDMT_AS2VR5_ADDR A:0xf9900e14
y.create.l HWIO_PERIPH_SS_BLSP1_BLSP_BAM_VMIDMT_AS2VR6_ADDR A:0xf9900e18
y.create.l HWIO_PERIPH_SS_BLSP1_BLSP_BAM_VMIDMT_AS2VR7_ADDR A:0xf9900e1c
y.create.l HWIO_PERIPH_SS_BLSP1_BLSP_BAM_VMIDMT_AS2VR8_ADDR A:0xf9900e20
y.create.l HWIO_PERIPH_SS_BLSP1_BLSP_BAM_VMIDMT_AS2VR9_ADDR A:0xf9900e24
y.create.l HWIO_PERIPH_SS_BLSP1_BLSP_BAM_VMIDMT_SMR0_ADDR A:0xf9900800
y.create.l HWIO_PERIPH_SS_BLSP1_BLSP_BAM_VMIDMT_SMR1_ADDR A:0xf9900804
y.create.l HWIO_PERIPH_SS_BLSP1_BLSP_BAM_VMIDMT_SMR2_ADDR A:0xf9900808
y.create.l HWIO_PERIPH_SS_BLSP1_BLSP_BAM_VMIDMT_SMR3_ADDR A:0xf990080c
y.create.l HWIO_PERIPH_SS_BLSP1_BLSP_BAM_VMIDMT_SMR4_ADDR A:0xf9900810
y.create.l HWIO_PERIPH_SS_BLSP1_BLSP_BAM_VMIDMT_SMR5_ADDR A:0xf9900814
y.create.l HWIO_PERIPH_SS_BLSP1_BLSP_BAM_VMIDMT_SMR6_ADDR A:0xf9900818
y.create.l HWIO_PERIPH_SS_BLSP1_BLSP_BAM_VMIDMT_SMR7_ADDR A:0xf990081c
y.create.l HWIO_PERIPH_SS_BLSP1_BLSP_BAM_VMIDMT_SMR8_ADDR A:0xf9900820
y.create.l HWIO_PERIPH_SS_BLSP1_BLSP_BAM_VMIDMT_SMR9_ADDR A:0xf9900824
y.create.l HWIO_PERIPH_SS_BLSP1_BLSP_UART0_UART_DM_MR1_ADDR A:0xf991d000
y.create.l HWIO_PERIPH_SS_BLSP1_BLSP_UART0_UART_DM_MR2_ADDR A:0xf991d004
y.create.l HWIO_PERIPH_SS_BLSP1_BLSP_UART0_UART_DM_CSR_SR_DEPRECATED_ADDR A:0xf991d008
y.create.l HWIO_PERIPH_SS_BLSP1_BLSP_UART0_UART_DM_CR_MISR_DEPRECATED_ADDR A:0xf991d010
y.create.l HWIO_PERIPH_SS_BLSP1_BLSP_UART0_UART_DM_IMR_ISR_DEPRECATED_ADDR A:0xf991d014
y.create.l HWIO_PERIPH_SS_BLSP1_BLSP_UART0_UART_DM_IPR_ADDR A:0xf991d018
y.create.l HWIO_PERIPH_SS_BLSP1_BLSP_UART0_UART_DM_TFWR_ADDR A:0xf991d01c
y.create.l HWIO_PERIPH_SS_BLSP1_BLSP_UART0_UART_DM_RFWR_ADDR A:0xf991d020
y.create.l HWIO_PERIPH_SS_BLSP1_BLSP_UART0_UART_DM_HCR_ADDR A:0xf991d024
y.create.l HWIO_PERIPH_SS_BLSP1_BLSP_UART0_UART_DM_DMRX_ADDR A:0xf991d034
y.create.l HWIO_PERIPH_SS_BLSP1_BLSP_UART0_UART_DM_IRDA_RX_TOTAL_SNAP_DEPRECATED_ADDR A:0xf991d038
y.create.l HWIO_PERIPH_SS_BLSP1_BLSP_UART0_UART_DM_DMEN_ADDR A:0xf991d03c
y.create.l HWIO_PERIPH_SS_BLSP1_BLSP_UART0_UART_DM_NO_CHARS_FOR_TX_ADDR A:0xf991d040
y.create.l HWIO_PERIPH_SS_BLSP1_BLSP_UART0_UART_DM_BADR_ADDR A:0xf991d044
y.create.l HWIO_PERIPH_SS_BLSP1_BLSP_UART0_UART_DM_TESTSL_ADDR A:0xf991d048
y.create.l HWIO_PERIPH_SS_BLSP1_BLSP_UART0_UART_DM_TXFS_ADDR A:0xf991d04c
y.create.l HWIO_PERIPH_SS_BLSP1_BLSP_UART0_UART_DM_RXFS_ADDR A:0xf991d050
y.create.l HWIO_PERIPH_SS_BLSP1_BLSP_UART0_UART_DM_MISR_MODE_ADDR A:0xf991d060
y.create.l HWIO_PERIPH_SS_BLSP1_BLSP_UART0_UART_DM_MISR_RESET_ADDR A:0xf991d064
y.create.l HWIO_PERIPH_SS_BLSP1_BLSP_UART0_UART_DM_MISR_EXPORT_ADDR A:0xf991d068
y.create.l HWIO_PERIPH_SS_BLSP1_BLSP_UART0_UART_DM_MISR_VAL_ADDR A:0xf991d06c
y.create.l HWIO_PERIPH_SS_BLSP1_BLSP_UART0_UART_DM_TF_RF_DEPRECATED_ADDR A:0xf991d070
y.create.l HWIO_PERIPH_SS_BLSP1_BLSP_UART0_UART_DM_TF_RF_2_DEPRECATED_ADDR A:0xf991d074
y.create.l HWIO_PERIPH_SS_BLSP1_BLSP_UART0_UART_DM_TF_RF_3_DEPRECATED_ADDR A:0xf991d078
y.create.l HWIO_PERIPH_SS_BLSP1_BLSP_UART0_UART_DM_TF_RF_4_DEPRECATED_ADDR A:0xf991d07c
y.create.l HWIO_PERIPH_SS_BLSP1_BLSP_UART0_UART_DM_SIM_CFG_ADDR A:0xf991d080
y.create.l HWIO_PERIPH_SS_BLSP1_BLSP_UART0_UART_DM_TEST_WR_ADDR_ADDR A:0xf991d084
y.create.l HWIO_PERIPH_SS_BLSP1_BLSP_UART0_UART_DM_TEST_WR_DATA_ADDR A:0xf991d088
y.create.l HWIO_PERIPH_SS_BLSP1_BLSP_UART0_UART_DM_TEST_RD_ADDR_ADDR A:0xf991d08c
y.create.l HWIO_PERIPH_SS_BLSP1_BLSP_UART0_UART_DM_TEST_RD_DATA_ADDR A:0xf991d090
y.create.l HWIO_PERIPH_SS_BLSP1_BLSP_UART0_UART_DM_CSR_ADDR A:0xf991d0a0
y.create.l HWIO_PERIPH_SS_BLSP1_BLSP_UART0_UART_DM_SR_ADDR A:0xf991d0a4
y.create.l HWIO_PERIPH_SS_BLSP1_BLSP_UART0_UART_DM_CR_ADDR A:0xf991d0a8
y.create.l HWIO_PERIPH_SS_BLSP1_BLSP_UART0_UART_DM_MISR_ADDR A:0xf991d0ac
y.create.l HWIO_PERIPH_SS_BLSP1_BLSP_UART0_UART_DM_IMR_ADDR A:0xf991d0b0
y.create.l HWIO_PERIPH_SS_BLSP1_BLSP_UART0_UART_DM_ISR_ADDR A:0xf991d0b4
y.create.l HWIO_PERIPH_SS_BLSP1_BLSP_UART0_UART_DM_IRDA_ADDR A:0xf991d0b8
y.create.l HWIO_PERIPH_SS_BLSP1_BLSP_UART0_UART_DM_RX_TOTAL_SNAP_ADDR A:0xf991d0bc
y.create.l HWIO_PERIPH_SS_BLSP1_BLSP_UART0_UART_DM_WWT_TIMEOUT_ADDR A:0xf991d0c0
y.create.l HWIO_PERIPH_SS_BLSP1_BLSP_UART0_UART_DM_CLK_CTRL_ADDR A:0xf991d0c4
y.create.l HWIO_PERIPH_SS_BLSP1_BLSP_UART0_UART_DM_BCR_ADDR A:0xf991d0c8
y.create.l HWIO_PERIPH_SS_BLSP1_BLSP_UART0_UART_DM_RX_TRANS_CTRL_ADDR A:0xf991d0cc
y.create.l HWIO_PERIPH_SS_BLSP1_BLSP_UART0_UART_DM_DMRX_DBG_ADDR A:0xf991d0d0
y.create.l HWIO_PERIPH_SS_BLSP1_BLSP_UART0_UART_DM_FSM_STATUS_ADDR A:0xf991d0d4
y.create.l HWIO_PERIPH_SS_BLSP1_BLSP_UART0_UART_DM_HW_VERSION_ADDR A:0xf991d0d8
y.create.l HWIO_PERIPH_SS_BLSP1_BLSP_UART0_UART_DM_GENERICS_ADDR A:0xf991d0dc
y.create.l HWIO_PERIPH_SS_BLSP1_BLSP_UART0_UART_DM_TF_ADDR A:0xf991d100
y.create.l HWIO_PERIPH_SS_BLSP1_BLSP_UART0_UART_DM_TF_2_ADDR A:0xf991d104
y.create.l HWIO_PERIPH_SS_BLSP1_BLSP_UART0_UART_DM_TF_3_ADDR A:0xf991d108
y.create.l HWIO_PERIPH_SS_BLSP1_BLSP_UART0_UART_DM_TF_4_ADDR A:0xf991d10c
y.create.l HWIO_PERIPH_SS_BLSP1_BLSP_UART0_UART_DM_TF_5_ADDR A:0xf991d110
y.create.l HWIO_PERIPH_SS_BLSP1_BLSP_UART0_UART_DM_TF_6_ADDR A:0xf991d114
y.create.l HWIO_PERIPH_SS_BLSP1_BLSP_UART0_UART_DM_TF_7_ADDR A:0xf991d118
y.create.l HWIO_PERIPH_SS_BLSP1_BLSP_UART0_UART_DM_TF_8_ADDR A:0xf991d11c
y.create.l HWIO_PERIPH_SS_BLSP1_BLSP_UART0_UART_DM_TF_9_ADDR A:0xf991d120
y.create.l HWIO_PERIPH_SS_BLSP1_BLSP_UART0_UART_DM_TF_10_ADDR A:0xf991d124
y.create.l HWIO_PERIPH_SS_BLSP1_BLSP_UART0_UART_DM_TF_11_ADDR A:0xf991d128
y.create.l HWIO_PERIPH_SS_BLSP1_BLSP_UART0_UART_DM_TF_12_ADDR A:0xf991d12c
y.create.l HWIO_PERIPH_SS_BLSP1_BLSP_UART0_UART_DM_TF_13_ADDR A:0xf991d130
y.create.l HWIO_PERIPH_SS_BLSP1_BLSP_UART0_UART_DM_TF_14_ADDR A:0xf991d134
y.create.l HWIO_PERIPH_SS_BLSP1_BLSP_UART0_UART_DM_TF_15_ADDR A:0xf991d138
y.create.l HWIO_PERIPH_SS_BLSP1_BLSP_UART0_UART_DM_TF_16_ADDR A:0xf991d13c
y.create.l HWIO_PERIPH_SS_BLSP1_BLSP_UART0_UART_DM_RF_ADDR A:0xf991d140
y.create.l HWIO_PERIPH_SS_BLSP1_BLSP_UART0_UART_DM_RF_2_ADDR A:0xf991d144
y.create.l HWIO_PERIPH_SS_BLSP1_BLSP_UART0_UART_DM_RF_3_ADDR A:0xf991d148
y.create.l HWIO_PERIPH_SS_BLSP1_BLSP_UART0_UART_DM_RF_4_ADDR A:0xf991d14c
y.create.l HWIO_PERIPH_SS_BLSP1_BLSP_UART0_UART_DM_RF_5_ADDR A:0xf991d150
y.create.l HWIO_PERIPH_SS_BLSP1_BLSP_UART0_UART_DM_RF_6_ADDR A:0xf991d154
y.create.l HWIO_PERIPH_SS_BLSP1_BLSP_UART0_UART_DM_RF_7_ADDR A:0xf991d158
y.create.l HWIO_PERIPH_SS_BLSP1_BLSP_UART0_UART_DM_RF_8_ADDR A:0xf991d15c
y.create.l HWIO_PERIPH_SS_BLSP1_BLSP_UART0_UART_DM_RF_9_ADDR A:0xf991d160
y.create.l HWIO_PERIPH_SS_BLSP1_BLSP_UART0_UART_DM_RF_10_ADDR A:0xf991d164
y.create.l HWIO_PERIPH_SS_BLSP1_BLSP_UART0_UART_DM_RF_11_ADDR A:0xf991d168
y.create.l HWIO_PERIPH_SS_BLSP1_BLSP_UART0_UART_DM_RF_12_ADDR A:0xf991d16c
y.create.l HWIO_PERIPH_SS_BLSP1_BLSP_UART0_UART_DM_RF_13_ADDR A:0xf991d170
y.create.l HWIO_PERIPH_SS_BLSP1_BLSP_UART0_UART_DM_RF_14_ADDR A:0xf991d174
y.create.l HWIO_PERIPH_SS_BLSP1_BLSP_UART0_UART_DM_RF_15_ADDR A:0xf991d178
y.create.l HWIO_PERIPH_SS_BLSP1_BLSP_UART0_UART_DM_RF_16_ADDR A:0xf991d17c
y.create.l HWIO_PERIPH_SS_BLSP1_BLSP_UART0_UART_DM_UIM_CFG_ADDR A:0xf991d180
y.create.l HWIO_PERIPH_SS_BLSP1_BLSP_UART0_UART_DM_UIM_CMD_ADDR A:0xf991d184
y.create.l HWIO_PERIPH_SS_BLSP1_BLSP_UART0_UART_DM_UIM_IO_STATUS_ADDR A:0xf991d188
y.create.l HWIO_PERIPH_SS_BLSP1_BLSP_UART0_UART_DM_UIM_IRQ_ISR_ADDR A:0xf991d18c
y.create.l HWIO_PERIPH_SS_BLSP1_BLSP_UART0_UART_DM_UIM_IRQ_MISR_ADDR A:0xf991d190
y.create.l HWIO_PERIPH_SS_BLSP1_BLSP_UART0_UART_DM_UIM_IRQ_CLR_ADDR A:0xf991d194
y.create.l HWIO_PERIPH_SS_BLSP1_BLSP_UART0_UART_DM_UIM_IRQ_IMR_ADDR A:0xf991d198
y.create.l HWIO_PERIPH_SS_BLSP1_BLSP_UART0_UART_DM_UIM_IRQ_IMR_SET_ADDR A:0xf991d19c
y.create.l HWIO_PERIPH_SS_BLSP1_BLSP_UART0_UART_DM_UIM_IRQ_IMR_CLR_ADDR A:0xf991d1a0
y.create.l HWIO_PERIPH_SS_BLSP1_BLSP_UART1_UART_DM_MR1_ADDR A:0xf991e000
y.create.l HWIO_PERIPH_SS_BLSP1_BLSP_UART1_UART_DM_MR2_ADDR A:0xf991e004
y.create.l HWIO_PERIPH_SS_BLSP1_BLSP_UART1_UART_DM_CSR_SR_DEPRECATED_ADDR A:0xf991e008
y.create.l HWIO_PERIPH_SS_BLSP1_BLSP_UART1_UART_DM_CR_MISR_DEPRECATED_ADDR A:0xf991e010
y.create.l HWIO_PERIPH_SS_BLSP1_BLSP_UART1_UART_DM_IMR_ISR_DEPRECATED_ADDR A:0xf991e014
y.create.l HWIO_PERIPH_SS_BLSP1_BLSP_UART1_UART_DM_IPR_ADDR A:0xf991e018
y.create.l HWIO_PERIPH_SS_BLSP1_BLSP_UART1_UART_DM_TFWR_ADDR A:0xf991e01c
y.create.l HWIO_PERIPH_SS_BLSP1_BLSP_UART1_UART_DM_RFWR_ADDR A:0xf991e020
y.create.l HWIO_PERIPH_SS_BLSP1_BLSP_UART1_UART_DM_HCR_ADDR A:0xf991e024
y.create.l HWIO_PERIPH_SS_BLSP1_BLSP_UART1_UART_DM_DMRX_ADDR A:0xf991e034
y.create.l HWIO_PERIPH_SS_BLSP1_BLSP_UART1_UART_DM_IRDA_RX_TOTAL_SNAP_DEPRECATED_ADDR A:0xf991e038
y.create.l HWIO_PERIPH_SS_BLSP1_BLSP_UART1_UART_DM_DMEN_ADDR A:0xf991e03c
y.create.l HWIO_PERIPH_SS_BLSP1_BLSP_UART1_UART_DM_NO_CHARS_FOR_TX_ADDR A:0xf991e040
y.create.l HWIO_PERIPH_SS_BLSP1_BLSP_UART1_UART_DM_BADR_ADDR A:0xf991e044
y.create.l HWIO_PERIPH_SS_BLSP1_BLSP_UART1_UART_DM_TESTSL_ADDR A:0xf991e048
y.create.l HWIO_PERIPH_SS_BLSP1_BLSP_UART1_UART_DM_TXFS_ADDR A:0xf991e04c
y.create.l HWIO_PERIPH_SS_BLSP1_BLSP_UART1_UART_DM_RXFS_ADDR A:0xf991e050
y.create.l HWIO_PERIPH_SS_BLSP1_BLSP_UART1_UART_DM_MISR_MODE_ADDR A:0xf991e060
y.create.l HWIO_PERIPH_SS_BLSP1_BLSP_UART1_UART_DM_MISR_RESET_ADDR A:0xf991e064
y.create.l HWIO_PERIPH_SS_BLSP1_BLSP_UART1_UART_DM_MISR_EXPORT_ADDR A:0xf991e068
y.create.l HWIO_PERIPH_SS_BLSP1_BLSP_UART1_UART_DM_MISR_VAL_ADDR A:0xf991e06c
y.create.l HWIO_PERIPH_SS_BLSP1_BLSP_UART1_UART_DM_TF_RF_DEPRECATED_ADDR A:0xf991e070
y.create.l HWIO_PERIPH_SS_BLSP1_BLSP_UART1_UART_DM_TF_RF_2_DEPRECATED_ADDR A:0xf991e074
y.create.l HWIO_PERIPH_SS_BLSP1_BLSP_UART1_UART_DM_TF_RF_3_DEPRECATED_ADDR A:0xf991e078
y.create.l HWIO_PERIPH_SS_BLSP1_BLSP_UART1_UART_DM_TF_RF_4_DEPRECATED_ADDR A:0xf991e07c
y.create.l HWIO_PERIPH_SS_BLSP1_BLSP_UART1_UART_DM_SIM_CFG_ADDR A:0xf991e080
y.create.l HWIO_PERIPH_SS_BLSP1_BLSP_UART1_UART_DM_TEST_WR_ADDR_ADDR A:0xf991e084
y.create.l HWIO_PERIPH_SS_BLSP1_BLSP_UART1_UART_DM_TEST_WR_DATA_ADDR A:0xf991e088
y.create.l HWIO_PERIPH_SS_BLSP1_BLSP_UART1_UART_DM_TEST_RD_ADDR_ADDR A:0xf991e08c
y.create.l HWIO_PERIPH_SS_BLSP1_BLSP_UART1_UART_DM_TEST_RD_DATA_ADDR A:0xf991e090
y.create.l HWIO_PERIPH_SS_BLSP1_BLSP_UART1_UART_DM_CSR_ADDR A:0xf991e0a0
y.create.l HWIO_PERIPH_SS_BLSP1_BLSP_UART1_UART_DM_SR_ADDR A:0xf991e0a4
y.create.l HWIO_PERIPH_SS_BLSP1_BLSP_UART1_UART_DM_CR_ADDR A:0xf991e0a8
y.create.l HWIO_PERIPH_SS_BLSP1_BLSP_UART1_UART_DM_MISR_ADDR A:0xf991e0ac
y.create.l HWIO_PERIPH_SS_BLSP1_BLSP_UART1_UART_DM_IMR_ADDR A:0xf991e0b0
y.create.l HWIO_PERIPH_SS_BLSP1_BLSP_UART1_UART_DM_ISR_ADDR A:0xf991e0b4
y.create.l HWIO_PERIPH_SS_BLSP1_BLSP_UART1_UART_DM_IRDA_ADDR A:0xf991e0b8
y.create.l HWIO_PERIPH_SS_BLSP1_BLSP_UART1_UART_DM_RX_TOTAL_SNAP_ADDR A:0xf991e0bc
y.create.l HWIO_PERIPH_SS_BLSP1_BLSP_UART1_UART_DM_WWT_TIMEOUT_ADDR A:0xf991e0c0
y.create.l HWIO_PERIPH_SS_BLSP1_BLSP_UART1_UART_DM_CLK_CTRL_ADDR A:0xf991e0c4
y.create.l HWIO_PERIPH_SS_BLSP1_BLSP_UART1_UART_DM_BCR_ADDR A:0xf991e0c8
y.create.l HWIO_PERIPH_SS_BLSP1_BLSP_UART1_UART_DM_RX_TRANS_CTRL_ADDR A:0xf991e0cc
y.create.l HWIO_PERIPH_SS_BLSP1_BLSP_UART1_UART_DM_DMRX_DBG_ADDR A:0xf991e0d0
y.create.l HWIO_PERIPH_SS_BLSP1_BLSP_UART1_UART_DM_FSM_STATUS_ADDR A:0xf991e0d4
y.create.l HWIO_PERIPH_SS_BLSP1_BLSP_UART1_UART_DM_HW_VERSION_ADDR A:0xf991e0d8
y.create.l HWIO_PERIPH_SS_BLSP1_BLSP_UART1_UART_DM_GENERICS_ADDR A:0xf991e0dc
y.create.l HWIO_PERIPH_SS_BLSP1_BLSP_UART1_UART_DM_TF_ADDR A:0xf991e100
y.create.l HWIO_PERIPH_SS_BLSP1_BLSP_UART1_UART_DM_TF_2_ADDR A:0xf991e104
y.create.l HWIO_PERIPH_SS_BLSP1_BLSP_UART1_UART_DM_TF_3_ADDR A:0xf991e108
y.create.l HWIO_PERIPH_SS_BLSP1_BLSP_UART1_UART_DM_TF_4_ADDR A:0xf991e10c
y.create.l HWIO_PERIPH_SS_BLSP1_BLSP_UART1_UART_DM_TF_5_ADDR A:0xf991e110
y.create.l HWIO_PERIPH_SS_BLSP1_BLSP_UART1_UART_DM_TF_6_ADDR A:0xf991e114
y.create.l HWIO_PERIPH_SS_BLSP1_BLSP_UART1_UART_DM_TF_7_ADDR A:0xf991e118
y.create.l HWIO_PERIPH_SS_BLSP1_BLSP_UART1_UART_DM_TF_8_ADDR A:0xf991e11c
y.create.l HWIO_PERIPH_SS_BLSP1_BLSP_UART1_UART_DM_TF_9_ADDR A:0xf991e120
y.create.l HWIO_PERIPH_SS_BLSP1_BLSP_UART1_UART_DM_TF_10_ADDR A:0xf991e124
y.create.l HWIO_PERIPH_SS_BLSP1_BLSP_UART1_UART_DM_TF_11_ADDR A:0xf991e128
y.create.l HWIO_PERIPH_SS_BLSP1_BLSP_UART1_UART_DM_TF_12_ADDR A:0xf991e12c
y.create.l HWIO_PERIPH_SS_BLSP1_BLSP_UART1_UART_DM_TF_13_ADDR A:0xf991e130
y.create.l HWIO_PERIPH_SS_BLSP1_BLSP_UART1_UART_DM_TF_14_ADDR A:0xf991e134
y.create.l HWIO_PERIPH_SS_BLSP1_BLSP_UART1_UART_DM_TF_15_ADDR A:0xf991e138
y.create.l HWIO_PERIPH_SS_BLSP1_BLSP_UART1_UART_DM_TF_16_ADDR A:0xf991e13c
y.create.l HWIO_PERIPH_SS_BLSP1_BLSP_UART1_UART_DM_RF_ADDR A:0xf991e140
y.create.l HWIO_PERIPH_SS_BLSP1_BLSP_UART1_UART_DM_RF_2_ADDR A:0xf991e144
y.create.l HWIO_PERIPH_SS_BLSP1_BLSP_UART1_UART_DM_RF_3_ADDR A:0xf991e148
y.create.l HWIO_PERIPH_SS_BLSP1_BLSP_UART1_UART_DM_RF_4_ADDR A:0xf991e14c
y.create.l HWIO_PERIPH_SS_BLSP1_BLSP_UART1_UART_DM_RF_5_ADDR A:0xf991e150
y.create.l HWIO_PERIPH_SS_BLSP1_BLSP_UART1_UART_DM_RF_6_ADDR A:0xf991e154
y.create.l HWIO_PERIPH_SS_BLSP1_BLSP_UART1_UART_DM_RF_7_ADDR A:0xf991e158
y.create.l HWIO_PERIPH_SS_BLSP1_BLSP_UART1_UART_DM_RF_8_ADDR A:0xf991e15c
y.create.l HWIO_PERIPH_SS_BLSP1_BLSP_UART1_UART_DM_RF_9_ADDR A:0xf991e160
y.create.l HWIO_PERIPH_SS_BLSP1_BLSP_UART1_UART_DM_RF_10_ADDR A:0xf991e164
y.create.l HWIO_PERIPH_SS_BLSP1_BLSP_UART1_UART_DM_RF_11_ADDR A:0xf991e168
y.create.l HWIO_PERIPH_SS_BLSP1_BLSP_UART1_UART_DM_RF_12_ADDR A:0xf991e16c
y.create.l HWIO_PERIPH_SS_BLSP1_BLSP_UART1_UART_DM_RF_13_ADDR A:0xf991e170
y.create.l HWIO_PERIPH_SS_BLSP1_BLSP_UART1_UART_DM_RF_14_ADDR A:0xf991e174
y.create.l HWIO_PERIPH_SS_BLSP1_BLSP_UART1_UART_DM_RF_15_ADDR A:0xf991e178
y.create.l HWIO_PERIPH_SS_BLSP1_BLSP_UART1_UART_DM_RF_16_ADDR A:0xf991e17c
y.create.l HWIO_PERIPH_SS_BLSP1_BLSP_UART1_UART_DM_UIM_CFG_ADDR A:0xf991e180
y.create.l HWIO_PERIPH_SS_BLSP1_BLSP_UART1_UART_DM_UIM_CMD_ADDR A:0xf991e184
y.create.l HWIO_PERIPH_SS_BLSP1_BLSP_UART1_UART_DM_UIM_IO_STATUS_ADDR A:0xf991e188
y.create.l HWIO_PERIPH_SS_BLSP1_BLSP_UART1_UART_DM_UIM_IRQ_ISR_ADDR A:0xf991e18c
y.create.l HWIO_PERIPH_SS_BLSP1_BLSP_UART1_UART_DM_UIM_IRQ_MISR_ADDR A:0xf991e190
y.create.l HWIO_PERIPH_SS_BLSP1_BLSP_UART1_UART_DM_UIM_IRQ_CLR_ADDR A:0xf991e194
y.create.l HWIO_PERIPH_SS_BLSP1_BLSP_UART1_UART_DM_UIM_IRQ_IMR_ADDR A:0xf991e198
y.create.l HWIO_PERIPH_SS_BLSP1_BLSP_UART1_UART_DM_UIM_IRQ_IMR_SET_ADDR A:0xf991e19c
y.create.l HWIO_PERIPH_SS_BLSP1_BLSP_UART1_UART_DM_UIM_IRQ_IMR_CLR_ADDR A:0xf991e1a0
y.create.l HWIO_PERIPH_SS_BLSP1_BLSP_UART2_UART_DM_MR1_ADDR A:0xf991f000
y.create.l HWIO_PERIPH_SS_BLSP1_BLSP_UART2_UART_DM_MR2_ADDR A:0xf991f004
y.create.l HWIO_PERIPH_SS_BLSP1_BLSP_UART2_UART_DM_CSR_SR_DEPRECATED_ADDR A:0xf991f008
y.create.l HWIO_PERIPH_SS_BLSP1_BLSP_UART2_UART_DM_CR_MISR_DEPRECATED_ADDR A:0xf991f010
y.create.l HWIO_PERIPH_SS_BLSP1_BLSP_UART2_UART_DM_IMR_ISR_DEPRECATED_ADDR A:0xf991f014
y.create.l HWIO_PERIPH_SS_BLSP1_BLSP_UART2_UART_DM_IPR_ADDR A:0xf991f018
y.create.l HWIO_PERIPH_SS_BLSP1_BLSP_UART2_UART_DM_TFWR_ADDR A:0xf991f01c
y.create.l HWIO_PERIPH_SS_BLSP1_BLSP_UART2_UART_DM_RFWR_ADDR A:0xf991f020
y.create.l HWIO_PERIPH_SS_BLSP1_BLSP_UART2_UART_DM_HCR_ADDR A:0xf991f024
y.create.l HWIO_PERIPH_SS_BLSP1_BLSP_UART2_UART_DM_DMRX_ADDR A:0xf991f034
y.create.l HWIO_PERIPH_SS_BLSP1_BLSP_UART2_UART_DM_IRDA_RX_TOTAL_SNAP_DEPRECATED_ADDR A:0xf991f038
y.create.l HWIO_PERIPH_SS_BLSP1_BLSP_UART2_UART_DM_DMEN_ADDR A:0xf991f03c
y.create.l HWIO_PERIPH_SS_BLSP1_BLSP_UART2_UART_DM_NO_CHARS_FOR_TX_ADDR A:0xf991f040
y.create.l HWIO_PERIPH_SS_BLSP1_BLSP_UART2_UART_DM_BADR_ADDR A:0xf991f044
y.create.l HWIO_PERIPH_SS_BLSP1_BLSP_UART2_UART_DM_TESTSL_ADDR A:0xf991f048
y.create.l HWIO_PERIPH_SS_BLSP1_BLSP_UART2_UART_DM_TXFS_ADDR A:0xf991f04c
y.create.l HWIO_PERIPH_SS_BLSP1_BLSP_UART2_UART_DM_RXFS_ADDR A:0xf991f050
y.create.l HWIO_PERIPH_SS_BLSP1_BLSP_UART2_UART_DM_MISR_MODE_ADDR A:0xf991f060
y.create.l HWIO_PERIPH_SS_BLSP1_BLSP_UART2_UART_DM_MISR_RESET_ADDR A:0xf991f064
y.create.l HWIO_PERIPH_SS_BLSP1_BLSP_UART2_UART_DM_MISR_EXPORT_ADDR A:0xf991f068
y.create.l HWIO_PERIPH_SS_BLSP1_BLSP_UART2_UART_DM_MISR_VAL_ADDR A:0xf991f06c
y.create.l HWIO_PERIPH_SS_BLSP1_BLSP_UART2_UART_DM_TF_RF_DEPRECATED_ADDR A:0xf991f070
y.create.l HWIO_PERIPH_SS_BLSP1_BLSP_UART2_UART_DM_TF_RF_2_DEPRECATED_ADDR A:0xf991f074
y.create.l HWIO_PERIPH_SS_BLSP1_BLSP_UART2_UART_DM_TF_RF_3_DEPRECATED_ADDR A:0xf991f078
y.create.l HWIO_PERIPH_SS_BLSP1_BLSP_UART2_UART_DM_TF_RF_4_DEPRECATED_ADDR A:0xf991f07c
y.create.l HWIO_PERIPH_SS_BLSP1_BLSP_UART2_UART_DM_SIM_CFG_ADDR A:0xf991f080
y.create.l HWIO_PERIPH_SS_BLSP1_BLSP_UART2_UART_DM_TEST_WR_ADDR_ADDR A:0xf991f084
y.create.l HWIO_PERIPH_SS_BLSP1_BLSP_UART2_UART_DM_TEST_WR_DATA_ADDR A:0xf991f088
y.create.l HWIO_PERIPH_SS_BLSP1_BLSP_UART2_UART_DM_TEST_RD_ADDR_ADDR A:0xf991f08c
y.create.l HWIO_PERIPH_SS_BLSP1_BLSP_UART2_UART_DM_TEST_RD_DATA_ADDR A:0xf991f090
y.create.l HWIO_PERIPH_SS_BLSP1_BLSP_UART2_UART_DM_CSR_ADDR A:0xf991f0a0
y.create.l HWIO_PERIPH_SS_BLSP1_BLSP_UART2_UART_DM_SR_ADDR A:0xf991f0a4
y.create.l HWIO_PERIPH_SS_BLSP1_BLSP_UART2_UART_DM_CR_ADDR A:0xf991f0a8
y.create.l HWIO_PERIPH_SS_BLSP1_BLSP_UART2_UART_DM_MISR_ADDR A:0xf991f0ac
y.create.l HWIO_PERIPH_SS_BLSP1_BLSP_UART2_UART_DM_IMR_ADDR A:0xf991f0b0
y.create.l HWIO_PERIPH_SS_BLSP1_BLSP_UART2_UART_DM_ISR_ADDR A:0xf991f0b4
y.create.l HWIO_PERIPH_SS_BLSP1_BLSP_UART2_UART_DM_IRDA_ADDR A:0xf991f0b8
y.create.l HWIO_PERIPH_SS_BLSP1_BLSP_UART2_UART_DM_RX_TOTAL_SNAP_ADDR A:0xf991f0bc
y.create.l HWIO_PERIPH_SS_BLSP1_BLSP_UART2_UART_DM_WWT_TIMEOUT_ADDR A:0xf991f0c0
y.create.l HWIO_PERIPH_SS_BLSP1_BLSP_UART2_UART_DM_CLK_CTRL_ADDR A:0xf991f0c4
y.create.l HWIO_PERIPH_SS_BLSP1_BLSP_UART2_UART_DM_BCR_ADDR A:0xf991f0c8
y.create.l HWIO_PERIPH_SS_BLSP1_BLSP_UART2_UART_DM_RX_TRANS_CTRL_ADDR A:0xf991f0cc
y.create.l HWIO_PERIPH_SS_BLSP1_BLSP_UART2_UART_DM_DMRX_DBG_ADDR A:0xf991f0d0
y.create.l HWIO_PERIPH_SS_BLSP1_BLSP_UART2_UART_DM_FSM_STATUS_ADDR A:0xf991f0d4
y.create.l HWIO_PERIPH_SS_BLSP1_BLSP_UART2_UART_DM_HW_VERSION_ADDR A:0xf991f0d8
y.create.l HWIO_PERIPH_SS_BLSP1_BLSP_UART2_UART_DM_GENERICS_ADDR A:0xf991f0dc
y.create.l HWIO_PERIPH_SS_BLSP1_BLSP_UART2_UART_DM_TF_ADDR A:0xf991f100
y.create.l HWIO_PERIPH_SS_BLSP1_BLSP_UART2_UART_DM_TF_2_ADDR A:0xf991f104
y.create.l HWIO_PERIPH_SS_BLSP1_BLSP_UART2_UART_DM_TF_3_ADDR A:0xf991f108
y.create.l HWIO_PERIPH_SS_BLSP1_BLSP_UART2_UART_DM_TF_4_ADDR A:0xf991f10c
y.create.l HWIO_PERIPH_SS_BLSP1_BLSP_UART2_UART_DM_TF_5_ADDR A:0xf991f110
y.create.l HWIO_PERIPH_SS_BLSP1_BLSP_UART2_UART_DM_TF_6_ADDR A:0xf991f114
y.create.l HWIO_PERIPH_SS_BLSP1_BLSP_UART2_UART_DM_TF_7_ADDR A:0xf991f118
y.create.l HWIO_PERIPH_SS_BLSP1_BLSP_UART2_UART_DM_TF_8_ADDR A:0xf991f11c
y.create.l HWIO_PERIPH_SS_BLSP1_BLSP_UART2_UART_DM_TF_9_ADDR A:0xf991f120
y.create.l HWIO_PERIPH_SS_BLSP1_BLSP_UART2_UART_DM_TF_10_ADDR A:0xf991f124
y.create.l HWIO_PERIPH_SS_BLSP1_BLSP_UART2_UART_DM_TF_11_ADDR A:0xf991f128
y.create.l HWIO_PERIPH_SS_BLSP1_BLSP_UART2_UART_DM_TF_12_ADDR A:0xf991f12c
y.create.l HWIO_PERIPH_SS_BLSP1_BLSP_UART2_UART_DM_TF_13_ADDR A:0xf991f130
y.create.l HWIO_PERIPH_SS_BLSP1_BLSP_UART2_UART_DM_TF_14_ADDR A:0xf991f134
y.create.l HWIO_PERIPH_SS_BLSP1_BLSP_UART2_UART_DM_TF_15_ADDR A:0xf991f138
y.create.l HWIO_PERIPH_SS_BLSP1_BLSP_UART2_UART_DM_TF_16_ADDR A:0xf991f13c
y.create.l HWIO_PERIPH_SS_BLSP1_BLSP_UART2_UART_DM_RF_ADDR A:0xf991f140
y.create.l HWIO_PERIPH_SS_BLSP1_BLSP_UART2_UART_DM_RF_2_ADDR A:0xf991f144
y.create.l HWIO_PERIPH_SS_BLSP1_BLSP_UART2_UART_DM_RF_3_ADDR A:0xf991f148
y.create.l HWIO_PERIPH_SS_BLSP1_BLSP_UART2_UART_DM_RF_4_ADDR A:0xf991f14c
y.create.l HWIO_PERIPH_SS_BLSP1_BLSP_UART2_UART_DM_RF_5_ADDR A:0xf991f150
y.create.l HWIO_PERIPH_SS_BLSP1_BLSP_UART2_UART_DM_RF_6_ADDR A:0xf991f154
y.create.l HWIO_PERIPH_SS_BLSP1_BLSP_UART2_UART_DM_RF_7_ADDR A:0xf991f158
y.create.l HWIO_PERIPH_SS_BLSP1_BLSP_UART2_UART_DM_RF_8_ADDR A:0xf991f15c
y.create.l HWIO_PERIPH_SS_BLSP1_BLSP_UART2_UART_DM_RF_9_ADDR A:0xf991f160
y.create.l HWIO_PERIPH_SS_BLSP1_BLSP_UART2_UART_DM_RF_10_ADDR A:0xf991f164
y.create.l HWIO_PERIPH_SS_BLSP1_BLSP_UART2_UART_DM_RF_11_ADDR A:0xf991f168
y.create.l HWIO_PERIPH_SS_BLSP1_BLSP_UART2_UART_DM_RF_12_ADDR A:0xf991f16c
y.create.l HWIO_PERIPH_SS_BLSP1_BLSP_UART2_UART_DM_RF_13_ADDR A:0xf991f170
y.create.l HWIO_PERIPH_SS_BLSP1_BLSP_UART2_UART_DM_RF_14_ADDR A:0xf991f174
y.create.l HWIO_PERIPH_SS_BLSP1_BLSP_UART2_UART_DM_RF_15_ADDR A:0xf991f178
y.create.l HWIO_PERIPH_SS_BLSP1_BLSP_UART2_UART_DM_RF_16_ADDR A:0xf991f17c
y.create.l HWIO_PERIPH_SS_BLSP1_BLSP_UART2_UART_DM_UIM_CFG_ADDR A:0xf991f180
y.create.l HWIO_PERIPH_SS_BLSP1_BLSP_UART2_UART_DM_UIM_CMD_ADDR A:0xf991f184
y.create.l HWIO_PERIPH_SS_BLSP1_BLSP_UART2_UART_DM_UIM_IO_STATUS_ADDR A:0xf991f188
y.create.l HWIO_PERIPH_SS_BLSP1_BLSP_UART2_UART_DM_UIM_IRQ_ISR_ADDR A:0xf991f18c
y.create.l HWIO_PERIPH_SS_BLSP1_BLSP_UART2_UART_DM_UIM_IRQ_MISR_ADDR A:0xf991f190
y.create.l HWIO_PERIPH_SS_BLSP1_BLSP_UART2_UART_DM_UIM_IRQ_CLR_ADDR A:0xf991f194
y.create.l HWIO_PERIPH_SS_BLSP1_BLSP_UART2_UART_DM_UIM_IRQ_IMR_ADDR A:0xf991f198
y.create.l HWIO_PERIPH_SS_BLSP1_BLSP_UART2_UART_DM_UIM_IRQ_IMR_SET_ADDR A:0xf991f19c
y.create.l HWIO_PERIPH_SS_BLSP1_BLSP_UART2_UART_DM_UIM_IRQ_IMR_CLR_ADDR A:0xf991f1a0
y.create.l HWIO_PERIPH_SS_BLSP1_BLSP_UART3_UART_DM_MR1_ADDR A:0xf9920000
y.create.l HWIO_PERIPH_SS_BLSP1_BLSP_UART3_UART_DM_MR2_ADDR A:0xf9920004
y.create.l HWIO_PERIPH_SS_BLSP1_BLSP_UART3_UART_DM_CSR_SR_DEPRECATED_ADDR A:0xf9920008
y.create.l HWIO_PERIPH_SS_BLSP1_BLSP_UART3_UART_DM_CR_MISR_DEPRECATED_ADDR A:0xf9920010
y.create.l HWIO_PERIPH_SS_BLSP1_BLSP_UART3_UART_DM_IMR_ISR_DEPRECATED_ADDR A:0xf9920014
y.create.l HWIO_PERIPH_SS_BLSP1_BLSP_UART3_UART_DM_IPR_ADDR A:0xf9920018
y.create.l HWIO_PERIPH_SS_BLSP1_BLSP_UART3_UART_DM_TFWR_ADDR A:0xf992001c
y.create.l HWIO_PERIPH_SS_BLSP1_BLSP_UART3_UART_DM_RFWR_ADDR A:0xf9920020
y.create.l HWIO_PERIPH_SS_BLSP1_BLSP_UART3_UART_DM_HCR_ADDR A:0xf9920024
y.create.l HWIO_PERIPH_SS_BLSP1_BLSP_UART3_UART_DM_DMRX_ADDR A:0xf9920034
y.create.l HWIO_PERIPH_SS_BLSP1_BLSP_UART3_UART_DM_IRDA_RX_TOTAL_SNAP_DEPRECATED_ADDR A:0xf9920038
y.create.l HWIO_PERIPH_SS_BLSP1_BLSP_UART3_UART_DM_DMEN_ADDR A:0xf992003c
y.create.l HWIO_PERIPH_SS_BLSP1_BLSP_UART3_UART_DM_NO_CHARS_FOR_TX_ADDR A:0xf9920040
y.create.l HWIO_PERIPH_SS_BLSP1_BLSP_UART3_UART_DM_BADR_ADDR A:0xf9920044
y.create.l HWIO_PERIPH_SS_BLSP1_BLSP_UART3_UART_DM_TESTSL_ADDR A:0xf9920048
y.create.l HWIO_PERIPH_SS_BLSP1_BLSP_UART3_UART_DM_TXFS_ADDR A:0xf992004c
y.create.l HWIO_PERIPH_SS_BLSP1_BLSP_UART3_UART_DM_RXFS_ADDR A:0xf9920050
y.create.l HWIO_PERIPH_SS_BLSP1_BLSP_UART3_UART_DM_MISR_MODE_ADDR A:0xf9920060
y.create.l HWIO_PERIPH_SS_BLSP1_BLSP_UART3_UART_DM_MISR_RESET_ADDR A:0xf9920064
y.create.l HWIO_PERIPH_SS_BLSP1_BLSP_UART3_UART_DM_MISR_EXPORT_ADDR A:0xf9920068
y.create.l HWIO_PERIPH_SS_BLSP1_BLSP_UART3_UART_DM_MISR_VAL_ADDR A:0xf992006c
y.create.l HWIO_PERIPH_SS_BLSP1_BLSP_UART3_UART_DM_TF_RF_DEPRECATED_ADDR A:0xf9920070
y.create.l HWIO_PERIPH_SS_BLSP1_BLSP_UART3_UART_DM_TF_RF_2_DEPRECATED_ADDR A:0xf9920074
y.create.l HWIO_PERIPH_SS_BLSP1_BLSP_UART3_UART_DM_TF_RF_3_DEPRECATED_ADDR A:0xf9920078
y.create.l HWIO_PERIPH_SS_BLSP1_BLSP_UART3_UART_DM_TF_RF_4_DEPRECATED_ADDR A:0xf992007c
y.create.l HWIO_PERIPH_SS_BLSP1_BLSP_UART3_UART_DM_SIM_CFG_ADDR A:0xf9920080
y.create.l HWIO_PERIPH_SS_BLSP1_BLSP_UART3_UART_DM_TEST_WR_ADDR_ADDR A:0xf9920084
y.create.l HWIO_PERIPH_SS_BLSP1_BLSP_UART3_UART_DM_TEST_WR_DATA_ADDR A:0xf9920088
y.create.l HWIO_PERIPH_SS_BLSP1_BLSP_UART3_UART_DM_TEST_RD_ADDR_ADDR A:0xf992008c
y.create.l HWIO_PERIPH_SS_BLSP1_BLSP_UART3_UART_DM_TEST_RD_DATA_ADDR A:0xf9920090
y.create.l HWIO_PERIPH_SS_BLSP1_BLSP_UART3_UART_DM_CSR_ADDR A:0xf99200a0
y.create.l HWIO_PERIPH_SS_BLSP1_BLSP_UART3_UART_DM_SR_ADDR A:0xf99200a4
y.create.l HWIO_PERIPH_SS_BLSP1_BLSP_UART3_UART_DM_CR_ADDR A:0xf99200a8
y.create.l HWIO_PERIPH_SS_BLSP1_BLSP_UART3_UART_DM_MISR_ADDR A:0xf99200ac
y.create.l HWIO_PERIPH_SS_BLSP1_BLSP_UART3_UART_DM_IMR_ADDR A:0xf99200b0
y.create.l HWIO_PERIPH_SS_BLSP1_BLSP_UART3_UART_DM_ISR_ADDR A:0xf99200b4
y.create.l HWIO_PERIPH_SS_BLSP1_BLSP_UART3_UART_DM_IRDA_ADDR A:0xf99200b8
y.create.l HWIO_PERIPH_SS_BLSP1_BLSP_UART3_UART_DM_RX_TOTAL_SNAP_ADDR A:0xf99200bc
y.create.l HWIO_PERIPH_SS_BLSP1_BLSP_UART3_UART_DM_WWT_TIMEOUT_ADDR A:0xf99200c0
y.create.l HWIO_PERIPH_SS_BLSP1_BLSP_UART3_UART_DM_CLK_CTRL_ADDR A:0xf99200c4
y.create.l HWIO_PERIPH_SS_BLSP1_BLSP_UART3_UART_DM_BCR_ADDR A:0xf99200c8
y.create.l HWIO_PERIPH_SS_BLSP1_BLSP_UART3_UART_DM_RX_TRANS_CTRL_ADDR A:0xf99200cc
y.create.l HWIO_PERIPH_SS_BLSP1_BLSP_UART3_UART_DM_DMRX_DBG_ADDR A:0xf99200d0
y.create.l HWIO_PERIPH_SS_BLSP1_BLSP_UART3_UART_DM_FSM_STATUS_ADDR A:0xf99200d4
y.create.l HWIO_PERIPH_SS_BLSP1_BLSP_UART3_UART_DM_HW_VERSION_ADDR A:0xf99200d8
y.create.l HWIO_PERIPH_SS_BLSP1_BLSP_UART3_UART_DM_GENERICS_ADDR A:0xf99200dc
y.create.l HWIO_PERIPH_SS_BLSP1_BLSP_UART3_UART_DM_TF_ADDR A:0xf9920100
y.create.l HWIO_PERIPH_SS_BLSP1_BLSP_UART3_UART_DM_TF_2_ADDR A:0xf9920104
y.create.l HWIO_PERIPH_SS_BLSP1_BLSP_UART3_UART_DM_TF_3_ADDR A:0xf9920108
y.create.l HWIO_PERIPH_SS_BLSP1_BLSP_UART3_UART_DM_TF_4_ADDR A:0xf992010c
y.create.l HWIO_PERIPH_SS_BLSP1_BLSP_UART3_UART_DM_TF_5_ADDR A:0xf9920110
y.create.l HWIO_PERIPH_SS_BLSP1_BLSP_UART3_UART_DM_TF_6_ADDR A:0xf9920114
y.create.l HWIO_PERIPH_SS_BLSP1_BLSP_UART3_UART_DM_TF_7_ADDR A:0xf9920118
y.create.l HWIO_PERIPH_SS_BLSP1_BLSP_UART3_UART_DM_TF_8_ADDR A:0xf992011c
y.create.l HWIO_PERIPH_SS_BLSP1_BLSP_UART3_UART_DM_TF_9_ADDR A:0xf9920120
y.create.l HWIO_PERIPH_SS_BLSP1_BLSP_UART3_UART_DM_TF_10_ADDR A:0xf9920124
y.create.l HWIO_PERIPH_SS_BLSP1_BLSP_UART3_UART_DM_TF_11_ADDR A:0xf9920128
y.create.l HWIO_PERIPH_SS_BLSP1_BLSP_UART3_UART_DM_TF_12_ADDR A:0xf992012c
y.create.l HWIO_PERIPH_SS_BLSP1_BLSP_UART3_UART_DM_TF_13_ADDR A:0xf9920130
y.create.l HWIO_PERIPH_SS_BLSP1_BLSP_UART3_UART_DM_TF_14_ADDR A:0xf9920134
y.create.l HWIO_PERIPH_SS_BLSP1_BLSP_UART3_UART_DM_TF_15_ADDR A:0xf9920138
y.create.l HWIO_PERIPH_SS_BLSP1_BLSP_UART3_UART_DM_TF_16_ADDR A:0xf992013c
y.create.l HWIO_PERIPH_SS_BLSP1_BLSP_UART3_UART_DM_RF_ADDR A:0xf9920140
y.create.l HWIO_PERIPH_SS_BLSP1_BLSP_UART3_UART_DM_RF_2_ADDR A:0xf9920144
y.create.l HWIO_PERIPH_SS_BLSP1_BLSP_UART3_UART_DM_RF_3_ADDR A:0xf9920148
y.create.l HWIO_PERIPH_SS_BLSP1_BLSP_UART3_UART_DM_RF_4_ADDR A:0xf992014c
y.create.l HWIO_PERIPH_SS_BLSP1_BLSP_UART3_UART_DM_RF_5_ADDR A:0xf9920150
y.create.l HWIO_PERIPH_SS_BLSP1_BLSP_UART3_UART_DM_RF_6_ADDR A:0xf9920154
y.create.l HWIO_PERIPH_SS_BLSP1_BLSP_UART3_UART_DM_RF_7_ADDR A:0xf9920158
y.create.l HWIO_PERIPH_SS_BLSP1_BLSP_UART3_UART_DM_RF_8_ADDR A:0xf992015c
y.create.l HWIO_PERIPH_SS_BLSP1_BLSP_UART3_UART_DM_RF_9_ADDR A:0xf9920160
y.create.l HWIO_PERIPH_SS_BLSP1_BLSP_UART3_UART_DM_RF_10_ADDR A:0xf9920164
y.create.l HWIO_PERIPH_SS_BLSP1_BLSP_UART3_UART_DM_RF_11_ADDR A:0xf9920168
y.create.l HWIO_PERIPH_SS_BLSP1_BLSP_UART3_UART_DM_RF_12_ADDR A:0xf992016c
y.create.l HWIO_PERIPH_SS_BLSP1_BLSP_UART3_UART_DM_RF_13_ADDR A:0xf9920170
y.create.l HWIO_PERIPH_SS_BLSP1_BLSP_UART3_UART_DM_RF_14_ADDR A:0xf9920174
y.create.l HWIO_PERIPH_SS_BLSP1_BLSP_UART3_UART_DM_RF_15_ADDR A:0xf9920178
y.create.l HWIO_PERIPH_SS_BLSP1_BLSP_UART3_UART_DM_RF_16_ADDR A:0xf992017c
y.create.l HWIO_PERIPH_SS_BLSP1_BLSP_UART3_UART_DM_UIM_CFG_ADDR A:0xf9920180
y.create.l HWIO_PERIPH_SS_BLSP1_BLSP_UART3_UART_DM_UIM_CMD_ADDR A:0xf9920184
y.create.l HWIO_PERIPH_SS_BLSP1_BLSP_UART3_UART_DM_UIM_IO_STATUS_ADDR A:0xf9920188
y.create.l HWIO_PERIPH_SS_BLSP1_BLSP_UART3_UART_DM_UIM_IRQ_ISR_ADDR A:0xf992018c
y.create.l HWIO_PERIPH_SS_BLSP1_BLSP_UART3_UART_DM_UIM_IRQ_MISR_ADDR A:0xf9920190
y.create.l HWIO_PERIPH_SS_BLSP1_BLSP_UART3_UART_DM_UIM_IRQ_CLR_ADDR A:0xf9920194
y.create.l HWIO_PERIPH_SS_BLSP1_BLSP_UART3_UART_DM_UIM_IRQ_IMR_ADDR A:0xf9920198
y.create.l HWIO_PERIPH_SS_BLSP1_BLSP_UART3_UART_DM_UIM_IRQ_IMR_SET_ADDR A:0xf992019c
y.create.l HWIO_PERIPH_SS_BLSP1_BLSP_UART3_UART_DM_UIM_IRQ_IMR_CLR_ADDR A:0xf99201a0
y.create.l HWIO_PERIPH_SS_BLSP1_BLSP_UART4_UART_DM_MR1_ADDR A:0xf9921000
y.create.l HWIO_PERIPH_SS_BLSP1_BLSP_UART4_UART_DM_MR2_ADDR A:0xf9921004
y.create.l HWIO_PERIPH_SS_BLSP1_BLSP_UART4_UART_DM_CSR_SR_DEPRECATED_ADDR A:0xf9921008
y.create.l HWIO_PERIPH_SS_BLSP1_BLSP_UART4_UART_DM_CR_MISR_DEPRECATED_ADDR A:0xf9921010
y.create.l HWIO_PERIPH_SS_BLSP1_BLSP_UART4_UART_DM_IMR_ISR_DEPRECATED_ADDR A:0xf9921014
y.create.l HWIO_PERIPH_SS_BLSP1_BLSP_UART4_UART_DM_IPR_ADDR A:0xf9921018
y.create.l HWIO_PERIPH_SS_BLSP1_BLSP_UART4_UART_DM_TFWR_ADDR A:0xf992101c
y.create.l HWIO_PERIPH_SS_BLSP1_BLSP_UART4_UART_DM_RFWR_ADDR A:0xf9921020
y.create.l HWIO_PERIPH_SS_BLSP1_BLSP_UART4_UART_DM_HCR_ADDR A:0xf9921024
y.create.l HWIO_PERIPH_SS_BLSP1_BLSP_UART4_UART_DM_DMRX_ADDR A:0xf9921034
y.create.l HWIO_PERIPH_SS_BLSP1_BLSP_UART4_UART_DM_IRDA_RX_TOTAL_SNAP_DEPRECATED_ADDR A:0xf9921038
y.create.l HWIO_PERIPH_SS_BLSP1_BLSP_UART4_UART_DM_DMEN_ADDR A:0xf992103c
y.create.l HWIO_PERIPH_SS_BLSP1_BLSP_UART4_UART_DM_NO_CHARS_FOR_TX_ADDR A:0xf9921040
y.create.l HWIO_PERIPH_SS_BLSP1_BLSP_UART4_UART_DM_BADR_ADDR A:0xf9921044
y.create.l HWIO_PERIPH_SS_BLSP1_BLSP_UART4_UART_DM_TESTSL_ADDR A:0xf9921048
y.create.l HWIO_PERIPH_SS_BLSP1_BLSP_UART4_UART_DM_TXFS_ADDR A:0xf992104c
y.create.l HWIO_PERIPH_SS_BLSP1_BLSP_UART4_UART_DM_RXFS_ADDR A:0xf9921050
y.create.l HWIO_PERIPH_SS_BLSP1_BLSP_UART4_UART_DM_MISR_MODE_ADDR A:0xf9921060
y.create.l HWIO_PERIPH_SS_BLSP1_BLSP_UART4_UART_DM_MISR_RESET_ADDR A:0xf9921064
y.create.l HWIO_PERIPH_SS_BLSP1_BLSP_UART4_UART_DM_MISR_EXPORT_ADDR A:0xf9921068
y.create.l HWIO_PERIPH_SS_BLSP1_BLSP_UART4_UART_DM_MISR_VAL_ADDR A:0xf992106c
y.create.l HWIO_PERIPH_SS_BLSP1_BLSP_UART4_UART_DM_TF_RF_DEPRECATED_ADDR A:0xf9921070
y.create.l HWIO_PERIPH_SS_BLSP1_BLSP_UART4_UART_DM_TF_RF_2_DEPRECATED_ADDR A:0xf9921074
y.create.l HWIO_PERIPH_SS_BLSP1_BLSP_UART4_UART_DM_TF_RF_3_DEPRECATED_ADDR A:0xf9921078
y.create.l HWIO_PERIPH_SS_BLSP1_BLSP_UART4_UART_DM_TF_RF_4_DEPRECATED_ADDR A:0xf992107c
y.create.l HWIO_PERIPH_SS_BLSP1_BLSP_UART4_UART_DM_SIM_CFG_ADDR A:0xf9921080
y.create.l HWIO_PERIPH_SS_BLSP1_BLSP_UART4_UART_DM_TEST_WR_ADDR_ADDR A:0xf9921084
y.create.l HWIO_PERIPH_SS_BLSP1_BLSP_UART4_UART_DM_TEST_WR_DATA_ADDR A:0xf9921088
y.create.l HWIO_PERIPH_SS_BLSP1_BLSP_UART4_UART_DM_TEST_RD_ADDR_ADDR A:0xf992108c
y.create.l HWIO_PERIPH_SS_BLSP1_BLSP_UART4_UART_DM_TEST_RD_DATA_ADDR A:0xf9921090
y.create.l HWIO_PERIPH_SS_BLSP1_BLSP_UART4_UART_DM_CSR_ADDR A:0xf99210a0
y.create.l HWIO_PERIPH_SS_BLSP1_BLSP_UART4_UART_DM_SR_ADDR A:0xf99210a4
y.create.l HWIO_PERIPH_SS_BLSP1_BLSP_UART4_UART_DM_CR_ADDR A:0xf99210a8
y.create.l HWIO_PERIPH_SS_BLSP1_BLSP_UART4_UART_DM_MISR_ADDR A:0xf99210ac
y.create.l HWIO_PERIPH_SS_BLSP1_BLSP_UART4_UART_DM_IMR_ADDR A:0xf99210b0
y.create.l HWIO_PERIPH_SS_BLSP1_BLSP_UART4_UART_DM_ISR_ADDR A:0xf99210b4
y.create.l HWIO_PERIPH_SS_BLSP1_BLSP_UART4_UART_DM_IRDA_ADDR A:0xf99210b8
y.create.l HWIO_PERIPH_SS_BLSP1_BLSP_UART4_UART_DM_RX_TOTAL_SNAP_ADDR A:0xf99210bc
y.create.l HWIO_PERIPH_SS_BLSP1_BLSP_UART4_UART_DM_WWT_TIMEOUT_ADDR A:0xf99210c0
y.create.l HWIO_PERIPH_SS_BLSP1_BLSP_UART4_UART_DM_CLK_CTRL_ADDR A:0xf99210c4
y.create.l HWIO_PERIPH_SS_BLSP1_BLSP_UART4_UART_DM_BCR_ADDR A:0xf99210c8
y.create.l HWIO_PERIPH_SS_BLSP1_BLSP_UART4_UART_DM_RX_TRANS_CTRL_ADDR A:0xf99210cc
y.create.l HWIO_PERIPH_SS_BLSP1_BLSP_UART4_UART_DM_DMRX_DBG_ADDR A:0xf99210d0
y.create.l HWIO_PERIPH_SS_BLSP1_BLSP_UART4_UART_DM_FSM_STATUS_ADDR A:0xf99210d4
y.create.l HWIO_PERIPH_SS_BLSP1_BLSP_UART4_UART_DM_HW_VERSION_ADDR A:0xf99210d8
y.create.l HWIO_PERIPH_SS_BLSP1_BLSP_UART4_UART_DM_GENERICS_ADDR A:0xf99210dc
y.create.l HWIO_PERIPH_SS_BLSP1_BLSP_UART4_UART_DM_TF_ADDR A:0xf9921100
y.create.l HWIO_PERIPH_SS_BLSP1_BLSP_UART4_UART_DM_TF_2_ADDR A:0xf9921104
y.create.l HWIO_PERIPH_SS_BLSP1_BLSP_UART4_UART_DM_TF_3_ADDR A:0xf9921108
y.create.l HWIO_PERIPH_SS_BLSP1_BLSP_UART4_UART_DM_TF_4_ADDR A:0xf992110c
y.create.l HWIO_PERIPH_SS_BLSP1_BLSP_UART4_UART_DM_TF_5_ADDR A:0xf9921110
y.create.l HWIO_PERIPH_SS_BLSP1_BLSP_UART4_UART_DM_TF_6_ADDR A:0xf9921114
y.create.l HWIO_PERIPH_SS_BLSP1_BLSP_UART4_UART_DM_TF_7_ADDR A:0xf9921118
y.create.l HWIO_PERIPH_SS_BLSP1_BLSP_UART4_UART_DM_TF_8_ADDR A:0xf992111c
y.create.l HWIO_PERIPH_SS_BLSP1_BLSP_UART4_UART_DM_TF_9_ADDR A:0xf9921120
y.create.l HWIO_PERIPH_SS_BLSP1_BLSP_UART4_UART_DM_TF_10_ADDR A:0xf9921124
y.create.l HWIO_PERIPH_SS_BLSP1_BLSP_UART4_UART_DM_TF_11_ADDR A:0xf9921128
y.create.l HWIO_PERIPH_SS_BLSP1_BLSP_UART4_UART_DM_TF_12_ADDR A:0xf992112c
y.create.l HWIO_PERIPH_SS_BLSP1_BLSP_UART4_UART_DM_TF_13_ADDR A:0xf9921130
y.create.l HWIO_PERIPH_SS_BLSP1_BLSP_UART4_UART_DM_TF_14_ADDR A:0xf9921134
y.create.l HWIO_PERIPH_SS_BLSP1_BLSP_UART4_UART_DM_TF_15_ADDR A:0xf9921138
y.create.l HWIO_PERIPH_SS_BLSP1_BLSP_UART4_UART_DM_TF_16_ADDR A:0xf992113c
y.create.l HWIO_PERIPH_SS_BLSP1_BLSP_UART4_UART_DM_RF_ADDR A:0xf9921140
y.create.l HWIO_PERIPH_SS_BLSP1_BLSP_UART4_UART_DM_RF_2_ADDR A:0xf9921144
y.create.l HWIO_PERIPH_SS_BLSP1_BLSP_UART4_UART_DM_RF_3_ADDR A:0xf9921148
y.create.l HWIO_PERIPH_SS_BLSP1_BLSP_UART4_UART_DM_RF_4_ADDR A:0xf992114c
y.create.l HWIO_PERIPH_SS_BLSP1_BLSP_UART4_UART_DM_RF_5_ADDR A:0xf9921150
y.create.l HWIO_PERIPH_SS_BLSP1_BLSP_UART4_UART_DM_RF_6_ADDR A:0xf9921154
y.create.l HWIO_PERIPH_SS_BLSP1_BLSP_UART4_UART_DM_RF_7_ADDR A:0xf9921158
y.create.l HWIO_PERIPH_SS_BLSP1_BLSP_UART4_UART_DM_RF_8_ADDR A:0xf992115c
y.create.l HWIO_PERIPH_SS_BLSP1_BLSP_UART4_UART_DM_RF_9_ADDR A:0xf9921160
y.create.l HWIO_PERIPH_SS_BLSP1_BLSP_UART4_UART_DM_RF_10_ADDR A:0xf9921164
y.create.l HWIO_PERIPH_SS_BLSP1_BLSP_UART4_UART_DM_RF_11_ADDR A:0xf9921168
y.create.l HWIO_PERIPH_SS_BLSP1_BLSP_UART4_UART_DM_RF_12_ADDR A:0xf992116c
y.create.l HWIO_PERIPH_SS_BLSP1_BLSP_UART4_UART_DM_RF_13_ADDR A:0xf9921170
y.create.l HWIO_PERIPH_SS_BLSP1_BLSP_UART4_UART_DM_RF_14_ADDR A:0xf9921174
y.create.l HWIO_PERIPH_SS_BLSP1_BLSP_UART4_UART_DM_RF_15_ADDR A:0xf9921178
y.create.l HWIO_PERIPH_SS_BLSP1_BLSP_UART4_UART_DM_RF_16_ADDR A:0xf992117c
y.create.l HWIO_PERIPH_SS_BLSP1_BLSP_UART4_UART_DM_UIM_CFG_ADDR A:0xf9921180
y.create.l HWIO_PERIPH_SS_BLSP1_BLSP_UART4_UART_DM_UIM_CMD_ADDR A:0xf9921184
y.create.l HWIO_PERIPH_SS_BLSP1_BLSP_UART4_UART_DM_UIM_IO_STATUS_ADDR A:0xf9921188
y.create.l HWIO_PERIPH_SS_BLSP1_BLSP_UART4_UART_DM_UIM_IRQ_ISR_ADDR A:0xf992118c
y.create.l HWIO_PERIPH_SS_BLSP1_BLSP_UART4_UART_DM_UIM_IRQ_MISR_ADDR A:0xf9921190
y.create.l HWIO_PERIPH_SS_BLSP1_BLSP_UART4_UART_DM_UIM_IRQ_CLR_ADDR A:0xf9921194
y.create.l HWIO_PERIPH_SS_BLSP1_BLSP_UART4_UART_DM_UIM_IRQ_IMR_ADDR A:0xf9921198
y.create.l HWIO_PERIPH_SS_BLSP1_BLSP_UART4_UART_DM_UIM_IRQ_IMR_SET_ADDR A:0xf992119c
y.create.l HWIO_PERIPH_SS_BLSP1_BLSP_UART4_UART_DM_UIM_IRQ_IMR_CLR_ADDR A:0xf99211a0
y.create.l HWIO_PERIPH_SS_BLSP1_BLSP_UART5_UART_DM_MR1_ADDR A:0xf9922000
y.create.l HWIO_PERIPH_SS_BLSP1_BLSP_UART5_UART_DM_MR2_ADDR A:0xf9922004
y.create.l HWIO_PERIPH_SS_BLSP1_BLSP_UART5_UART_DM_CSR_SR_DEPRECATED_ADDR A:0xf9922008
y.create.l HWIO_PERIPH_SS_BLSP1_BLSP_UART5_UART_DM_CR_MISR_DEPRECATED_ADDR A:0xf9922010
y.create.l HWIO_PERIPH_SS_BLSP1_BLSP_UART5_UART_DM_IMR_ISR_DEPRECATED_ADDR A:0xf9922014
y.create.l HWIO_PERIPH_SS_BLSP1_BLSP_UART5_UART_DM_IPR_ADDR A:0xf9922018
y.create.l HWIO_PERIPH_SS_BLSP1_BLSP_UART5_UART_DM_TFWR_ADDR A:0xf992201c
y.create.l HWIO_PERIPH_SS_BLSP1_BLSP_UART5_UART_DM_RFWR_ADDR A:0xf9922020
y.create.l HWIO_PERIPH_SS_BLSP1_BLSP_UART5_UART_DM_HCR_ADDR A:0xf9922024
y.create.l HWIO_PERIPH_SS_BLSP1_BLSP_UART5_UART_DM_DMRX_ADDR A:0xf9922034
y.create.l HWIO_PERIPH_SS_BLSP1_BLSP_UART5_UART_DM_IRDA_RX_TOTAL_SNAP_DEPRECATED_ADDR A:0xf9922038
y.create.l HWIO_PERIPH_SS_BLSP1_BLSP_UART5_UART_DM_DMEN_ADDR A:0xf992203c
y.create.l HWIO_PERIPH_SS_BLSP1_BLSP_UART5_UART_DM_NO_CHARS_FOR_TX_ADDR A:0xf9922040
y.create.l HWIO_PERIPH_SS_BLSP1_BLSP_UART5_UART_DM_BADR_ADDR A:0xf9922044
y.create.l HWIO_PERIPH_SS_BLSP1_BLSP_UART5_UART_DM_TESTSL_ADDR A:0xf9922048
y.create.l HWIO_PERIPH_SS_BLSP1_BLSP_UART5_UART_DM_TXFS_ADDR A:0xf992204c
y.create.l HWIO_PERIPH_SS_BLSP1_BLSP_UART5_UART_DM_RXFS_ADDR A:0xf9922050
y.create.l HWIO_PERIPH_SS_BLSP1_BLSP_UART5_UART_DM_MISR_MODE_ADDR A:0xf9922060
y.create.l HWIO_PERIPH_SS_BLSP1_BLSP_UART5_UART_DM_MISR_RESET_ADDR A:0xf9922064
y.create.l HWIO_PERIPH_SS_BLSP1_BLSP_UART5_UART_DM_MISR_EXPORT_ADDR A:0xf9922068
y.create.l HWIO_PERIPH_SS_BLSP1_BLSP_UART5_UART_DM_MISR_VAL_ADDR A:0xf992206c
y.create.l HWIO_PERIPH_SS_BLSP1_BLSP_UART5_UART_DM_TF_RF_DEPRECATED_ADDR A:0xf9922070
y.create.l HWIO_PERIPH_SS_BLSP1_BLSP_UART5_UART_DM_TF_RF_2_DEPRECATED_ADDR A:0xf9922074
y.create.l HWIO_PERIPH_SS_BLSP1_BLSP_UART5_UART_DM_TF_RF_3_DEPRECATED_ADDR A:0xf9922078
y.create.l HWIO_PERIPH_SS_BLSP1_BLSP_UART5_UART_DM_TF_RF_4_DEPRECATED_ADDR A:0xf992207c
y.create.l HWIO_PERIPH_SS_BLSP1_BLSP_UART5_UART_DM_SIM_CFG_ADDR A:0xf9922080
y.create.l HWIO_PERIPH_SS_BLSP1_BLSP_UART5_UART_DM_TEST_WR_ADDR_ADDR A:0xf9922084
y.create.l HWIO_PERIPH_SS_BLSP1_BLSP_UART5_UART_DM_TEST_WR_DATA_ADDR A:0xf9922088
y.create.l HWIO_PERIPH_SS_BLSP1_BLSP_UART5_UART_DM_TEST_RD_ADDR_ADDR A:0xf992208c
y.create.l HWIO_PERIPH_SS_BLSP1_BLSP_UART5_UART_DM_TEST_RD_DATA_ADDR A:0xf9922090
y.create.l HWIO_PERIPH_SS_BLSP1_BLSP_UART5_UART_DM_CSR_ADDR A:0xf99220a0
y.create.l HWIO_PERIPH_SS_BLSP1_BLSP_UART5_UART_DM_SR_ADDR A:0xf99220a4
y.create.l HWIO_PERIPH_SS_BLSP1_BLSP_UART5_UART_DM_CR_ADDR A:0xf99220a8
y.create.l HWIO_PERIPH_SS_BLSP1_BLSP_UART5_UART_DM_MISR_ADDR A:0xf99220ac
y.create.l HWIO_PERIPH_SS_BLSP1_BLSP_UART5_UART_DM_IMR_ADDR A:0xf99220b0
y.create.l HWIO_PERIPH_SS_BLSP1_BLSP_UART5_UART_DM_ISR_ADDR A:0xf99220b4
y.create.l HWIO_PERIPH_SS_BLSP1_BLSP_UART5_UART_DM_IRDA_ADDR A:0xf99220b8
y.create.l HWIO_PERIPH_SS_BLSP1_BLSP_UART5_UART_DM_RX_TOTAL_SNAP_ADDR A:0xf99220bc
y.create.l HWIO_PERIPH_SS_BLSP1_BLSP_UART5_UART_DM_WWT_TIMEOUT_ADDR A:0xf99220c0
y.create.l HWIO_PERIPH_SS_BLSP1_BLSP_UART5_UART_DM_CLK_CTRL_ADDR A:0xf99220c4
y.create.l HWIO_PERIPH_SS_BLSP1_BLSP_UART5_UART_DM_BCR_ADDR A:0xf99220c8
y.create.l HWIO_PERIPH_SS_BLSP1_BLSP_UART5_UART_DM_RX_TRANS_CTRL_ADDR A:0xf99220cc
y.create.l HWIO_PERIPH_SS_BLSP1_BLSP_UART5_UART_DM_DMRX_DBG_ADDR A:0xf99220d0
y.create.l HWIO_PERIPH_SS_BLSP1_BLSP_UART5_UART_DM_FSM_STATUS_ADDR A:0xf99220d4
y.create.l HWIO_PERIPH_SS_BLSP1_BLSP_UART5_UART_DM_HW_VERSION_ADDR A:0xf99220d8
y.create.l HWIO_PERIPH_SS_BLSP1_BLSP_UART5_UART_DM_GENERICS_ADDR A:0xf99220dc
y.create.l HWIO_PERIPH_SS_BLSP1_BLSP_UART5_UART_DM_TF_ADDR A:0xf9922100
y.create.l HWIO_PERIPH_SS_BLSP1_BLSP_UART5_UART_DM_TF_2_ADDR A:0xf9922104
y.create.l HWIO_PERIPH_SS_BLSP1_BLSP_UART5_UART_DM_TF_3_ADDR A:0xf9922108
y.create.l HWIO_PERIPH_SS_BLSP1_BLSP_UART5_UART_DM_TF_4_ADDR A:0xf992210c
y.create.l HWIO_PERIPH_SS_BLSP1_BLSP_UART5_UART_DM_TF_5_ADDR A:0xf9922110
y.create.l HWIO_PERIPH_SS_BLSP1_BLSP_UART5_UART_DM_TF_6_ADDR A:0xf9922114
y.create.l HWIO_PERIPH_SS_BLSP1_BLSP_UART5_UART_DM_TF_7_ADDR A:0xf9922118
y.create.l HWIO_PERIPH_SS_BLSP1_BLSP_UART5_UART_DM_TF_8_ADDR A:0xf992211c
y.create.l HWIO_PERIPH_SS_BLSP1_BLSP_UART5_UART_DM_TF_9_ADDR A:0xf9922120
y.create.l HWIO_PERIPH_SS_BLSP1_BLSP_UART5_UART_DM_TF_10_ADDR A:0xf9922124
y.create.l HWIO_PERIPH_SS_BLSP1_BLSP_UART5_UART_DM_TF_11_ADDR A:0xf9922128
y.create.l HWIO_PERIPH_SS_BLSP1_BLSP_UART5_UART_DM_TF_12_ADDR A:0xf992212c
y.create.l HWIO_PERIPH_SS_BLSP1_BLSP_UART5_UART_DM_TF_13_ADDR A:0xf9922130
y.create.l HWIO_PERIPH_SS_BLSP1_BLSP_UART5_UART_DM_TF_14_ADDR A:0xf9922134
y.create.l HWIO_PERIPH_SS_BLSP1_BLSP_UART5_UART_DM_TF_15_ADDR A:0xf9922138
y.create.l HWIO_PERIPH_SS_BLSP1_BLSP_UART5_UART_DM_TF_16_ADDR A:0xf992213c
y.create.l HWIO_PERIPH_SS_BLSP1_BLSP_UART5_UART_DM_RF_ADDR A:0xf9922140
y.create.l HWIO_PERIPH_SS_BLSP1_BLSP_UART5_UART_DM_RF_2_ADDR A:0xf9922144
y.create.l HWIO_PERIPH_SS_BLSP1_BLSP_UART5_UART_DM_RF_3_ADDR A:0xf9922148
y.create.l HWIO_PERIPH_SS_BLSP1_BLSP_UART5_UART_DM_RF_4_ADDR A:0xf992214c
y.create.l HWIO_PERIPH_SS_BLSP1_BLSP_UART5_UART_DM_RF_5_ADDR A:0xf9922150
y.create.l HWIO_PERIPH_SS_BLSP1_BLSP_UART5_UART_DM_RF_6_ADDR A:0xf9922154
y.create.l HWIO_PERIPH_SS_BLSP1_BLSP_UART5_UART_DM_RF_7_ADDR A:0xf9922158
y.create.l HWIO_PERIPH_SS_BLSP1_BLSP_UART5_UART_DM_RF_8_ADDR A:0xf992215c
y.create.l HWIO_PERIPH_SS_BLSP1_BLSP_UART5_UART_DM_RF_9_ADDR A:0xf9922160
y.create.l HWIO_PERIPH_SS_BLSP1_BLSP_UART5_UART_DM_RF_10_ADDR A:0xf9922164
y.create.l HWIO_PERIPH_SS_BLSP1_BLSP_UART5_UART_DM_RF_11_ADDR A:0xf9922168
y.create.l HWIO_PERIPH_SS_BLSP1_BLSP_UART5_UART_DM_RF_12_ADDR A:0xf992216c
y.create.l HWIO_PERIPH_SS_BLSP1_BLSP_UART5_UART_DM_RF_13_ADDR A:0xf9922170
y.create.l HWIO_PERIPH_SS_BLSP1_BLSP_UART5_UART_DM_RF_14_ADDR A:0xf9922174
y.create.l HWIO_PERIPH_SS_BLSP1_BLSP_UART5_UART_DM_RF_15_ADDR A:0xf9922178
y.create.l HWIO_PERIPH_SS_BLSP1_BLSP_UART5_UART_DM_RF_16_ADDR A:0xf992217c
y.create.l HWIO_PERIPH_SS_BLSP1_BLSP_UART5_UART_DM_UIM_CFG_ADDR A:0xf9922180
y.create.l HWIO_PERIPH_SS_BLSP1_BLSP_UART5_UART_DM_UIM_CMD_ADDR A:0xf9922184
y.create.l HWIO_PERIPH_SS_BLSP1_BLSP_UART5_UART_DM_UIM_IO_STATUS_ADDR A:0xf9922188
y.create.l HWIO_PERIPH_SS_BLSP1_BLSP_UART5_UART_DM_UIM_IRQ_ISR_ADDR A:0xf992218c
y.create.l HWIO_PERIPH_SS_BLSP1_BLSP_UART5_UART_DM_UIM_IRQ_MISR_ADDR A:0xf9922190
y.create.l HWIO_PERIPH_SS_BLSP1_BLSP_UART5_UART_DM_UIM_IRQ_CLR_ADDR A:0xf9922194
y.create.l HWIO_PERIPH_SS_BLSP1_BLSP_UART5_UART_DM_UIM_IRQ_IMR_ADDR A:0xf9922198
y.create.l HWIO_PERIPH_SS_BLSP1_BLSP_UART5_UART_DM_UIM_IRQ_IMR_SET_ADDR A:0xf992219c
y.create.l HWIO_PERIPH_SS_BLSP1_BLSP_UART5_UART_DM_UIM_IRQ_IMR_CLR_ADDR A:0xf99221a0
y.create.l HWIO_PERIPH_SS_BLSP1_BLSP_QUP0_QUP_CONFIG_ADDR A:0xf9923000
y.create.l HWIO_PERIPH_SS_BLSP1_BLSP_QUP0_QUP_STATE_ADDR A:0xf9923004
y.create.l HWIO_PERIPH_SS_BLSP1_BLSP_QUP0_QUP_IO_MODES_ADDR A:0xf9923008
y.create.l HWIO_PERIPH_SS_BLSP1_BLSP_QUP0_QUP_SW_RESET_ADDR A:0xf992300c
y.create.l HWIO_PERIPH_SS_BLSP1_BLSP_QUP0_QUP_OPERATIONAL_ADDR A:0xf9923018
y.create.l HWIO_PERIPH_SS_BLSP1_BLSP_QUP0_QUP_ERROR_FLAGS_ADDR A:0xf992301c
y.create.l HWIO_PERIPH_SS_BLSP1_BLSP_QUP0_QUP_ERROR_FLAGS_EN_ADDR A:0xf9923020
y.create.l HWIO_PERIPH_SS_BLSP1_BLSP_QUP0_QUP_TEST_CTRL_ADDR A:0xf9923024
y.create.l HWIO_PERIPH_SS_BLSP1_BLSP_QUP0_QUP_OPERATIONAL_MASK_ADDR A:0xf9923028
y.create.l HWIO_PERIPH_SS_BLSP1_BLSP_QUP0_QUP_HW_VERSION_ADDR A:0xf9923030
y.create.l HWIO_PERIPH_SS_BLSP1_BLSP_QUP0_QUP_MX_OUTPUT_COUNT_ADDR A:0xf9923100
y.create.l HWIO_PERIPH_SS_BLSP1_BLSP_QUP0_QUP_MX_OUTPUT_CNT_CURRENT_ADDR A:0xf9923104
y.create.l HWIO_PERIPH_SS_BLSP1_BLSP_QUP0_QUP_OUTPUT_DEBUG_ADDR A:0xf9923108
y.create.l HWIO_PERIPH_SS_BLSP1_BLSP_QUP0_QUP_OUTPUT_FIFO_WORD_CNT_ADDR A:0xf992310c
y.create.l HWIO_PERIPH_SS_BLSP1_BLSP_QUP0_QUP_OUTPUT_FIFO0_ADDR A:0xf9923110
y.create.l HWIO_PERIPH_SS_BLSP1_BLSP_QUP0_QUP_OUTPUT_FIFO1_ADDR A:0xf9923114
y.create.l HWIO_PERIPH_SS_BLSP1_BLSP_QUP0_QUP_OUTPUT_FIFO2_ADDR A:0xf9923118
y.create.l HWIO_PERIPH_SS_BLSP1_BLSP_QUP0_QUP_OUTPUT_FIFO3_ADDR A:0xf992311c
y.create.l HWIO_PERIPH_SS_BLSP1_BLSP_QUP0_QUP_OUTPUT_FIFO4_ADDR A:0xf9923120
y.create.l HWIO_PERIPH_SS_BLSP1_BLSP_QUP0_QUP_OUTPUT_FIFO5_ADDR A:0xf9923124
y.create.l HWIO_PERIPH_SS_BLSP1_BLSP_QUP0_QUP_OUTPUT_FIFO6_ADDR A:0xf9923128
y.create.l HWIO_PERIPH_SS_BLSP1_BLSP_QUP0_QUP_OUTPUT_FIFO7_ADDR A:0xf992312c
y.create.l HWIO_PERIPH_SS_BLSP1_BLSP_QUP0_QUP_OUTPUT_FIFO8_ADDR A:0xf9923130
y.create.l HWIO_PERIPH_SS_BLSP1_BLSP_QUP0_QUP_OUTPUT_FIFO9_ADDR A:0xf9923134
y.create.l HWIO_PERIPH_SS_BLSP1_BLSP_QUP0_QUP_MX_WRITE_COUNT_ADDR A:0xf9923150
y.create.l HWIO_PERIPH_SS_BLSP1_BLSP_QUP0_QUP_MX_WRITE_CNT_CURRENT_ADDR A:0xf9923154
y.create.l HWIO_PERIPH_SS_BLSP1_BLSP_QUP0_QUP_MX_INPUT_COUNT_ADDR A:0xf9923200
y.create.l HWIO_PERIPH_SS_BLSP1_BLSP_QUP0_QUP_MX_INPUT_CNT_CURRENT_ADDR A:0xf9923204
y.create.l HWIO_PERIPH_SS_BLSP1_BLSP_QUP0_QUP_MX_READ_COUNT_ADDR A:0xf9923208
y.create.l HWIO_PERIPH_SS_BLSP1_BLSP_QUP0_QUP_MX_READ_CNT_CURRENT_ADDR A:0xf992320c
y.create.l HWIO_PERIPH_SS_BLSP1_BLSP_QUP0_QUP_INPUT_DEBUG_ADDR A:0xf9923210
y.create.l HWIO_PERIPH_SS_BLSP1_BLSP_QUP0_QUP_INPUT_FIFO_WORD_CNT_ADDR A:0xf9923214
y.create.l HWIO_PERIPH_SS_BLSP1_BLSP_QUP0_QUP_INPUT_FIFO0_ADDR A:0xf9923218
y.create.l HWIO_PERIPH_SS_BLSP1_BLSP_QUP0_QUP_INPUT_FIFO1_ADDR A:0xf992321c
y.create.l HWIO_PERIPH_SS_BLSP1_BLSP_QUP0_QUP_INPUT_FIFO2_ADDR A:0xf9923220
y.create.l HWIO_PERIPH_SS_BLSP1_BLSP_QUP0_QUP_INPUT_FIFO3_ADDR A:0xf9923224
y.create.l HWIO_PERIPH_SS_BLSP1_BLSP_QUP0_QUP_INPUT_FIFO4_ADDR A:0xf9923228
y.create.l HWIO_PERIPH_SS_BLSP1_BLSP_QUP0_QUP_INPUT_FIFO5_ADDR A:0xf992322c
y.create.l HWIO_PERIPH_SS_BLSP1_BLSP_QUP0_QUP_INPUT_FIFO6_ADDR A:0xf9923230
y.create.l HWIO_PERIPH_SS_BLSP1_BLSP_QUP0_QUP_INPUT_FIFO7_ADDR A:0xf9923234
y.create.l HWIO_PERIPH_SS_BLSP1_BLSP_QUP0_QUP_INPUT_FIFO8_ADDR A:0xf9923238
y.create.l HWIO_PERIPH_SS_BLSP1_BLSP_QUP0_QUP_INPUT_FIFO9_ADDR A:0xf992323c
y.create.l HWIO_PERIPH_SS_BLSP1_BLSP_QUP0_SPI_CONFIG_ADDR A:0xf9923300
y.create.l HWIO_PERIPH_SS_BLSP1_BLSP_QUP0_SPI_IO_CONTROL_ADDR A:0xf9923304
y.create.l HWIO_PERIPH_SS_BLSP1_BLSP_QUP0_SPI_ERROR_FLAGS_ADDR A:0xf9923308
y.create.l HWIO_PERIPH_SS_BLSP1_BLSP_QUP0_SPI_ERROR_FLAGS_EN_ADDR A:0xf992330c
y.create.l HWIO_PERIPH_SS_BLSP1_BLSP_QUP0_SPI_DEASSERT_WAIT_ADDR A:0xf9923310
y.create.l HWIO_PERIPH_SS_BLSP1_BLSP_QUP0_SPI_CHAR_CFG_ADDR A:0xf9923320
y.create.l HWIO_PERIPH_SS_BLSP1_BLSP_QUP0_SPI_CHAR_DATA_SPI_CS_ADDR A:0xf9923324
y.create.l HWIO_PERIPH_SS_BLSP1_BLSP_QUP0_SPI_CHAR_DATA_SPI_MOSI_ADDR A:0xf9923328
y.create.l HWIO_PERIPH_SS_BLSP1_BLSP_QUP0_SPI_CHAR_DATA_SPI_MISO_ADDR A:0xf992332c
y.create.l HWIO_PERIPH_SS_BLSP1_BLSP_QUP0_I2C_MASTER_CLK_CTL_ADDR A:0xf9923400
y.create.l HWIO_PERIPH_SS_BLSP1_BLSP_QUP0_I2C_MASTER_STATUS_ADDR A:0xf9923404
y.create.l HWIO_PERIPH_SS_BLSP1_BLSP_QUP0_I2C_MASTER_CONFIG_ADDR A:0xf9923408
y.create.l HWIO_PERIPH_SS_BLSP1_BLSP_QUP0_I2C_MASTER_BUS_CLEAR_ADDR A:0xf992340c
y.create.l HWIO_PERIPH_SS_BLSP1_BLSP_QUP0_I2C_MASTER_LOCAL_ID_ADDR A:0xf9923410
y.create.l HWIO_PERIPH_SS_BLSP1_BLSP_QUP1_QUP_CONFIG_ADDR A:0xf9924000
y.create.l HWIO_PERIPH_SS_BLSP1_BLSP_QUP1_QUP_STATE_ADDR A:0xf9924004
y.create.l HWIO_PERIPH_SS_BLSP1_BLSP_QUP1_QUP_IO_MODES_ADDR A:0xf9924008
y.create.l HWIO_PERIPH_SS_BLSP1_BLSP_QUP1_QUP_SW_RESET_ADDR A:0xf992400c
y.create.l HWIO_PERIPH_SS_BLSP1_BLSP_QUP1_QUP_OPERATIONAL_ADDR A:0xf9924018
y.create.l HWIO_PERIPH_SS_BLSP1_BLSP_QUP1_QUP_ERROR_FLAGS_ADDR A:0xf992401c
y.create.l HWIO_PERIPH_SS_BLSP1_BLSP_QUP1_QUP_ERROR_FLAGS_EN_ADDR A:0xf9924020
y.create.l HWIO_PERIPH_SS_BLSP1_BLSP_QUP1_QUP_TEST_CTRL_ADDR A:0xf9924024
y.create.l HWIO_PERIPH_SS_BLSP1_BLSP_QUP1_QUP_OPERATIONAL_MASK_ADDR A:0xf9924028
y.create.l HWIO_PERIPH_SS_BLSP1_BLSP_QUP1_QUP_HW_VERSION_ADDR A:0xf9924030
y.create.l HWIO_PERIPH_SS_BLSP1_BLSP_QUP1_QUP_MX_OUTPUT_COUNT_ADDR A:0xf9924100
y.create.l HWIO_PERIPH_SS_BLSP1_BLSP_QUP1_QUP_MX_OUTPUT_CNT_CURRENT_ADDR A:0xf9924104
y.create.l HWIO_PERIPH_SS_BLSP1_BLSP_QUP1_QUP_OUTPUT_DEBUG_ADDR A:0xf9924108
y.create.l HWIO_PERIPH_SS_BLSP1_BLSP_QUP1_QUP_OUTPUT_FIFO_WORD_CNT_ADDR A:0xf992410c
y.create.l HWIO_PERIPH_SS_BLSP1_BLSP_QUP1_QUP_OUTPUT_FIFO0_ADDR A:0xf9924110
y.create.l HWIO_PERIPH_SS_BLSP1_BLSP_QUP1_QUP_OUTPUT_FIFO1_ADDR A:0xf9924114
y.create.l HWIO_PERIPH_SS_BLSP1_BLSP_QUP1_QUP_OUTPUT_FIFO2_ADDR A:0xf9924118
y.create.l HWIO_PERIPH_SS_BLSP1_BLSP_QUP1_QUP_OUTPUT_FIFO3_ADDR A:0xf992411c
y.create.l HWIO_PERIPH_SS_BLSP1_BLSP_QUP1_QUP_OUTPUT_FIFO4_ADDR A:0xf9924120
y.create.l HWIO_PERIPH_SS_BLSP1_BLSP_QUP1_QUP_OUTPUT_FIFO5_ADDR A:0xf9924124
y.create.l HWIO_PERIPH_SS_BLSP1_BLSP_QUP1_QUP_OUTPUT_FIFO6_ADDR A:0xf9924128
y.create.l HWIO_PERIPH_SS_BLSP1_BLSP_QUP1_QUP_OUTPUT_FIFO7_ADDR A:0xf992412c
y.create.l HWIO_PERIPH_SS_BLSP1_BLSP_QUP1_QUP_OUTPUT_FIFO8_ADDR A:0xf9924130
y.create.l HWIO_PERIPH_SS_BLSP1_BLSP_QUP1_QUP_OUTPUT_FIFO9_ADDR A:0xf9924134
y.create.l HWIO_PERIPH_SS_BLSP1_BLSP_QUP1_QUP_MX_WRITE_COUNT_ADDR A:0xf9924150
y.create.l HWIO_PERIPH_SS_BLSP1_BLSP_QUP1_QUP_MX_WRITE_CNT_CURRENT_ADDR A:0xf9924154
y.create.l HWIO_PERIPH_SS_BLSP1_BLSP_QUP1_QUP_MX_INPUT_COUNT_ADDR A:0xf9924200
y.create.l HWIO_PERIPH_SS_BLSP1_BLSP_QUP1_QUP_MX_INPUT_CNT_CURRENT_ADDR A:0xf9924204
y.create.l HWIO_PERIPH_SS_BLSP1_BLSP_QUP1_QUP_MX_READ_COUNT_ADDR A:0xf9924208
y.create.l HWIO_PERIPH_SS_BLSP1_BLSP_QUP1_QUP_MX_READ_CNT_CURRENT_ADDR A:0xf992420c
y.create.l HWIO_PERIPH_SS_BLSP1_BLSP_QUP1_QUP_INPUT_DEBUG_ADDR A:0xf9924210
y.create.l HWIO_PERIPH_SS_BLSP1_BLSP_QUP1_QUP_INPUT_FIFO_WORD_CNT_ADDR A:0xf9924214
y.create.l HWIO_PERIPH_SS_BLSP1_BLSP_QUP1_QUP_INPUT_FIFO0_ADDR A:0xf9924218
y.create.l HWIO_PERIPH_SS_BLSP1_BLSP_QUP1_QUP_INPUT_FIFO1_ADDR A:0xf992421c
y.create.l HWIO_PERIPH_SS_BLSP1_BLSP_QUP1_QUP_INPUT_FIFO2_ADDR A:0xf9924220
y.create.l HWIO_PERIPH_SS_BLSP1_BLSP_QUP1_QUP_INPUT_FIFO3_ADDR A:0xf9924224
y.create.l HWIO_PERIPH_SS_BLSP1_BLSP_QUP1_QUP_INPUT_FIFO4_ADDR A:0xf9924228
y.create.l HWIO_PERIPH_SS_BLSP1_BLSP_QUP1_QUP_INPUT_FIFO5_ADDR A:0xf992422c
y.create.l HWIO_PERIPH_SS_BLSP1_BLSP_QUP1_QUP_INPUT_FIFO6_ADDR A:0xf9924230
y.create.l HWIO_PERIPH_SS_BLSP1_BLSP_QUP1_QUP_INPUT_FIFO7_ADDR A:0xf9924234
y.create.l HWIO_PERIPH_SS_BLSP1_BLSP_QUP1_QUP_INPUT_FIFO8_ADDR A:0xf9924238
y.create.l HWIO_PERIPH_SS_BLSP1_BLSP_QUP1_QUP_INPUT_FIFO9_ADDR A:0xf992423c
y.create.l HWIO_PERIPH_SS_BLSP1_BLSP_QUP1_SPI_CONFIG_ADDR A:0xf9924300
y.create.l HWIO_PERIPH_SS_BLSP1_BLSP_QUP1_SPI_IO_CONTROL_ADDR A:0xf9924304
y.create.l HWIO_PERIPH_SS_BLSP1_BLSP_QUP1_SPI_ERROR_FLAGS_ADDR A:0xf9924308
y.create.l HWIO_PERIPH_SS_BLSP1_BLSP_QUP1_SPI_ERROR_FLAGS_EN_ADDR A:0xf992430c
y.create.l HWIO_PERIPH_SS_BLSP1_BLSP_QUP1_SPI_DEASSERT_WAIT_ADDR A:0xf9924310
y.create.l HWIO_PERIPH_SS_BLSP1_BLSP_QUP1_SPI_CHAR_CFG_ADDR A:0xf9924320
y.create.l HWIO_PERIPH_SS_BLSP1_BLSP_QUP1_SPI_CHAR_DATA_SPI_CS_ADDR A:0xf9924324
y.create.l HWIO_PERIPH_SS_BLSP1_BLSP_QUP1_SPI_CHAR_DATA_SPI_MOSI_ADDR A:0xf9924328
y.create.l HWIO_PERIPH_SS_BLSP1_BLSP_QUP1_SPI_CHAR_DATA_SPI_MISO_ADDR A:0xf992432c
y.create.l HWIO_PERIPH_SS_BLSP1_BLSP_QUP1_I2C_MASTER_CLK_CTL_ADDR A:0xf9924400
y.create.l HWIO_PERIPH_SS_BLSP1_BLSP_QUP1_I2C_MASTER_STATUS_ADDR A:0xf9924404
y.create.l HWIO_PERIPH_SS_BLSP1_BLSP_QUP1_I2C_MASTER_CONFIG_ADDR A:0xf9924408
y.create.l HWIO_PERIPH_SS_BLSP1_BLSP_QUP1_I2C_MASTER_BUS_CLEAR_ADDR A:0xf992440c
y.create.l HWIO_PERIPH_SS_BLSP1_BLSP_QUP1_I2C_MASTER_LOCAL_ID_ADDR A:0xf9924410
y.create.l HWIO_PERIPH_SS_BLSP1_BLSP_QUP2_QUP_CONFIG_ADDR A:0xf9925000
y.create.l HWIO_PERIPH_SS_BLSP1_BLSP_QUP2_QUP_STATE_ADDR A:0xf9925004
y.create.l HWIO_PERIPH_SS_BLSP1_BLSP_QUP2_QUP_IO_MODES_ADDR A:0xf9925008
y.create.l HWIO_PERIPH_SS_BLSP1_BLSP_QUP2_QUP_SW_RESET_ADDR A:0xf992500c
y.create.l HWIO_PERIPH_SS_BLSP1_BLSP_QUP2_QUP_OPERATIONAL_ADDR A:0xf9925018
y.create.l HWIO_PERIPH_SS_BLSP1_BLSP_QUP2_QUP_ERROR_FLAGS_ADDR A:0xf992501c
y.create.l HWIO_PERIPH_SS_BLSP1_BLSP_QUP2_QUP_ERROR_FLAGS_EN_ADDR A:0xf9925020
y.create.l HWIO_PERIPH_SS_BLSP1_BLSP_QUP2_QUP_TEST_CTRL_ADDR A:0xf9925024
y.create.l HWIO_PERIPH_SS_BLSP1_BLSP_QUP2_QUP_OPERATIONAL_MASK_ADDR A:0xf9925028
y.create.l HWIO_PERIPH_SS_BLSP1_BLSP_QUP2_QUP_HW_VERSION_ADDR A:0xf9925030
y.create.l HWIO_PERIPH_SS_BLSP1_BLSP_QUP2_QUP_MX_OUTPUT_COUNT_ADDR A:0xf9925100
y.create.l HWIO_PERIPH_SS_BLSP1_BLSP_QUP2_QUP_MX_OUTPUT_CNT_CURRENT_ADDR A:0xf9925104
y.create.l HWIO_PERIPH_SS_BLSP1_BLSP_QUP2_QUP_OUTPUT_DEBUG_ADDR A:0xf9925108
y.create.l HWIO_PERIPH_SS_BLSP1_BLSP_QUP2_QUP_OUTPUT_FIFO_WORD_CNT_ADDR A:0xf992510c
y.create.l HWIO_PERIPH_SS_BLSP1_BLSP_QUP2_QUP_OUTPUT_FIFO0_ADDR A:0xf9925110
y.create.l HWIO_PERIPH_SS_BLSP1_BLSP_QUP2_QUP_OUTPUT_FIFO1_ADDR A:0xf9925114
y.create.l HWIO_PERIPH_SS_BLSP1_BLSP_QUP2_QUP_OUTPUT_FIFO2_ADDR A:0xf9925118
y.create.l HWIO_PERIPH_SS_BLSP1_BLSP_QUP2_QUP_OUTPUT_FIFO3_ADDR A:0xf992511c
y.create.l HWIO_PERIPH_SS_BLSP1_BLSP_QUP2_QUP_OUTPUT_FIFO4_ADDR A:0xf9925120
y.create.l HWIO_PERIPH_SS_BLSP1_BLSP_QUP2_QUP_OUTPUT_FIFO5_ADDR A:0xf9925124
y.create.l HWIO_PERIPH_SS_BLSP1_BLSP_QUP2_QUP_OUTPUT_FIFO6_ADDR A:0xf9925128
y.create.l HWIO_PERIPH_SS_BLSP1_BLSP_QUP2_QUP_OUTPUT_FIFO7_ADDR A:0xf992512c
y.create.l HWIO_PERIPH_SS_BLSP1_BLSP_QUP2_QUP_OUTPUT_FIFO8_ADDR A:0xf9925130
y.create.l HWIO_PERIPH_SS_BLSP1_BLSP_QUP2_QUP_OUTPUT_FIFO9_ADDR A:0xf9925134
y.create.l HWIO_PERIPH_SS_BLSP1_BLSP_QUP2_QUP_MX_WRITE_COUNT_ADDR A:0xf9925150
y.create.l HWIO_PERIPH_SS_BLSP1_BLSP_QUP2_QUP_MX_WRITE_CNT_CURRENT_ADDR A:0xf9925154
y.create.l HWIO_PERIPH_SS_BLSP1_BLSP_QUP2_QUP_MX_INPUT_COUNT_ADDR A:0xf9925200
y.create.l HWIO_PERIPH_SS_BLSP1_BLSP_QUP2_QUP_MX_INPUT_CNT_CURRENT_ADDR A:0xf9925204
y.create.l HWIO_PERIPH_SS_BLSP1_BLSP_QUP2_QUP_MX_READ_COUNT_ADDR A:0xf9925208
y.create.l HWIO_PERIPH_SS_BLSP1_BLSP_QUP2_QUP_MX_READ_CNT_CURRENT_ADDR A:0xf992520c
y.create.l HWIO_PERIPH_SS_BLSP1_BLSP_QUP2_QUP_INPUT_DEBUG_ADDR A:0xf9925210
y.create.l HWIO_PERIPH_SS_BLSP1_BLSP_QUP2_QUP_INPUT_FIFO_WORD_CNT_ADDR A:0xf9925214
y.create.l HWIO_PERIPH_SS_BLSP1_BLSP_QUP2_QUP_INPUT_FIFO0_ADDR A:0xf9925218
y.create.l HWIO_PERIPH_SS_BLSP1_BLSP_QUP2_QUP_INPUT_FIFO1_ADDR A:0xf992521c
y.create.l HWIO_PERIPH_SS_BLSP1_BLSP_QUP2_QUP_INPUT_FIFO2_ADDR A:0xf9925220
y.create.l HWIO_PERIPH_SS_BLSP1_BLSP_QUP2_QUP_INPUT_FIFO3_ADDR A:0xf9925224
y.create.l HWIO_PERIPH_SS_BLSP1_BLSP_QUP2_QUP_INPUT_FIFO4_ADDR A:0xf9925228
y.create.l HWIO_PERIPH_SS_BLSP1_BLSP_QUP2_QUP_INPUT_FIFO5_ADDR A:0xf992522c
y.create.l HWIO_PERIPH_SS_BLSP1_BLSP_QUP2_QUP_INPUT_FIFO6_ADDR A:0xf9925230
y.create.l HWIO_PERIPH_SS_BLSP1_BLSP_QUP2_QUP_INPUT_FIFO7_ADDR A:0xf9925234
y.create.l HWIO_PERIPH_SS_BLSP1_BLSP_QUP2_QUP_INPUT_FIFO8_ADDR A:0xf9925238
y.create.l HWIO_PERIPH_SS_BLSP1_BLSP_QUP2_QUP_INPUT_FIFO9_ADDR A:0xf992523c
y.create.l HWIO_PERIPH_SS_BLSP1_BLSP_QUP2_SPI_CONFIG_ADDR A:0xf9925300
y.create.l HWIO_PERIPH_SS_BLSP1_BLSP_QUP2_SPI_IO_CONTROL_ADDR A:0xf9925304
y.create.l HWIO_PERIPH_SS_BLSP1_BLSP_QUP2_SPI_ERROR_FLAGS_ADDR A:0xf9925308
y.create.l HWIO_PERIPH_SS_BLSP1_BLSP_QUP2_SPI_ERROR_FLAGS_EN_ADDR A:0xf992530c
y.create.l HWIO_PERIPH_SS_BLSP1_BLSP_QUP2_SPI_DEASSERT_WAIT_ADDR A:0xf9925310
y.create.l HWIO_PERIPH_SS_BLSP1_BLSP_QUP2_SPI_CHAR_CFG_ADDR A:0xf9925320
y.create.l HWIO_PERIPH_SS_BLSP1_BLSP_QUP2_SPI_CHAR_DATA_SPI_CS_ADDR A:0xf9925324
y.create.l HWIO_PERIPH_SS_BLSP1_BLSP_QUP2_SPI_CHAR_DATA_SPI_MOSI_ADDR A:0xf9925328
y.create.l HWIO_PERIPH_SS_BLSP1_BLSP_QUP2_SPI_CHAR_DATA_SPI_MISO_ADDR A:0xf992532c
y.create.l HWIO_PERIPH_SS_BLSP1_BLSP_QUP2_I2C_MASTER_CLK_CTL_ADDR A:0xf9925400
y.create.l HWIO_PERIPH_SS_BLSP1_BLSP_QUP2_I2C_MASTER_STATUS_ADDR A:0xf9925404
y.create.l HWIO_PERIPH_SS_BLSP1_BLSP_QUP2_I2C_MASTER_CONFIG_ADDR A:0xf9925408
y.create.l HWIO_PERIPH_SS_BLSP1_BLSP_QUP2_I2C_MASTER_BUS_CLEAR_ADDR A:0xf992540c
y.create.l HWIO_PERIPH_SS_BLSP1_BLSP_QUP2_I2C_MASTER_LOCAL_ID_ADDR A:0xf9925410
y.create.l HWIO_PERIPH_SS_BLSP1_BLSP_QUP3_QUP_CONFIG_ADDR A:0xf9926000
y.create.l HWIO_PERIPH_SS_BLSP1_BLSP_QUP3_QUP_STATE_ADDR A:0xf9926004
y.create.l HWIO_PERIPH_SS_BLSP1_BLSP_QUP3_QUP_IO_MODES_ADDR A:0xf9926008
y.create.l HWIO_PERIPH_SS_BLSP1_BLSP_QUP3_QUP_SW_RESET_ADDR A:0xf992600c
y.create.l HWIO_PERIPH_SS_BLSP1_BLSP_QUP3_QUP_OPERATIONAL_ADDR A:0xf9926018
y.create.l HWIO_PERIPH_SS_BLSP1_BLSP_QUP3_QUP_ERROR_FLAGS_ADDR A:0xf992601c
y.create.l HWIO_PERIPH_SS_BLSP1_BLSP_QUP3_QUP_ERROR_FLAGS_EN_ADDR A:0xf9926020
y.create.l HWIO_PERIPH_SS_BLSP1_BLSP_QUP3_QUP_TEST_CTRL_ADDR A:0xf9926024
y.create.l HWIO_PERIPH_SS_BLSP1_BLSP_QUP3_QUP_OPERATIONAL_MASK_ADDR A:0xf9926028
y.create.l HWIO_PERIPH_SS_BLSP1_BLSP_QUP3_QUP_HW_VERSION_ADDR A:0xf9926030
y.create.l HWIO_PERIPH_SS_BLSP1_BLSP_QUP3_QUP_MX_OUTPUT_COUNT_ADDR A:0xf9926100
y.create.l HWIO_PERIPH_SS_BLSP1_BLSP_QUP3_QUP_MX_OUTPUT_CNT_CURRENT_ADDR A:0xf9926104
y.create.l HWIO_PERIPH_SS_BLSP1_BLSP_QUP3_QUP_OUTPUT_DEBUG_ADDR A:0xf9926108
y.create.l HWIO_PERIPH_SS_BLSP1_BLSP_QUP3_QUP_OUTPUT_FIFO_WORD_CNT_ADDR A:0xf992610c
y.create.l HWIO_PERIPH_SS_BLSP1_BLSP_QUP3_QUP_OUTPUT_FIFO0_ADDR A:0xf9926110
y.create.l HWIO_PERIPH_SS_BLSP1_BLSP_QUP3_QUP_OUTPUT_FIFO1_ADDR A:0xf9926114
y.create.l HWIO_PERIPH_SS_BLSP1_BLSP_QUP3_QUP_OUTPUT_FIFO2_ADDR A:0xf9926118
y.create.l HWIO_PERIPH_SS_BLSP1_BLSP_QUP3_QUP_OUTPUT_FIFO3_ADDR A:0xf992611c
y.create.l HWIO_PERIPH_SS_BLSP1_BLSP_QUP3_QUP_OUTPUT_FIFO4_ADDR A:0xf9926120
y.create.l HWIO_PERIPH_SS_BLSP1_BLSP_QUP3_QUP_OUTPUT_FIFO5_ADDR A:0xf9926124
y.create.l HWIO_PERIPH_SS_BLSP1_BLSP_QUP3_QUP_OUTPUT_FIFO6_ADDR A:0xf9926128
y.create.l HWIO_PERIPH_SS_BLSP1_BLSP_QUP3_QUP_OUTPUT_FIFO7_ADDR A:0xf992612c
y.create.l HWIO_PERIPH_SS_BLSP1_BLSP_QUP3_QUP_OUTPUT_FIFO8_ADDR A:0xf9926130
y.create.l HWIO_PERIPH_SS_BLSP1_BLSP_QUP3_QUP_OUTPUT_FIFO9_ADDR A:0xf9926134
y.create.l HWIO_PERIPH_SS_BLSP1_BLSP_QUP3_QUP_MX_WRITE_COUNT_ADDR A:0xf9926150
y.create.l HWIO_PERIPH_SS_BLSP1_BLSP_QUP3_QUP_MX_WRITE_CNT_CURRENT_ADDR A:0xf9926154
y.create.l HWIO_PERIPH_SS_BLSP1_BLSP_QUP3_QUP_MX_INPUT_COUNT_ADDR A:0xf9926200
y.create.l HWIO_PERIPH_SS_BLSP1_BLSP_QUP3_QUP_MX_INPUT_CNT_CURRENT_ADDR A:0xf9926204
y.create.l HWIO_PERIPH_SS_BLSP1_BLSP_QUP3_QUP_MX_READ_COUNT_ADDR A:0xf9926208
y.create.l HWIO_PERIPH_SS_BLSP1_BLSP_QUP3_QUP_MX_READ_CNT_CURRENT_ADDR A:0xf992620c
y.create.l HWIO_PERIPH_SS_BLSP1_BLSP_QUP3_QUP_INPUT_DEBUG_ADDR A:0xf9926210
y.create.l HWIO_PERIPH_SS_BLSP1_BLSP_QUP3_QUP_INPUT_FIFO_WORD_CNT_ADDR A:0xf9926214
y.create.l HWIO_PERIPH_SS_BLSP1_BLSP_QUP3_QUP_INPUT_FIFO0_ADDR A:0xf9926218
y.create.l HWIO_PERIPH_SS_BLSP1_BLSP_QUP3_QUP_INPUT_FIFO1_ADDR A:0xf992621c
y.create.l HWIO_PERIPH_SS_BLSP1_BLSP_QUP3_QUP_INPUT_FIFO2_ADDR A:0xf9926220
y.create.l HWIO_PERIPH_SS_BLSP1_BLSP_QUP3_QUP_INPUT_FIFO3_ADDR A:0xf9926224
y.create.l HWIO_PERIPH_SS_BLSP1_BLSP_QUP3_QUP_INPUT_FIFO4_ADDR A:0xf9926228
y.create.l HWIO_PERIPH_SS_BLSP1_BLSP_QUP3_QUP_INPUT_FIFO5_ADDR A:0xf992622c
y.create.l HWIO_PERIPH_SS_BLSP1_BLSP_QUP3_QUP_INPUT_FIFO6_ADDR A:0xf9926230
y.create.l HWIO_PERIPH_SS_BLSP1_BLSP_QUP3_QUP_INPUT_FIFO7_ADDR A:0xf9926234
y.create.l HWIO_PERIPH_SS_BLSP1_BLSP_QUP3_QUP_INPUT_FIFO8_ADDR A:0xf9926238
y.create.l HWIO_PERIPH_SS_BLSP1_BLSP_QUP3_QUP_INPUT_FIFO9_ADDR A:0xf992623c
y.create.l HWIO_PERIPH_SS_BLSP1_BLSP_QUP3_SPI_CONFIG_ADDR A:0xf9926300
y.create.l HWIO_PERIPH_SS_BLSP1_BLSP_QUP3_SPI_IO_CONTROL_ADDR A:0xf9926304
y.create.l HWIO_PERIPH_SS_BLSP1_BLSP_QUP3_SPI_ERROR_FLAGS_ADDR A:0xf9926308
y.create.l HWIO_PERIPH_SS_BLSP1_BLSP_QUP3_SPI_ERROR_FLAGS_EN_ADDR A:0xf992630c
y.create.l HWIO_PERIPH_SS_BLSP1_BLSP_QUP3_SPI_DEASSERT_WAIT_ADDR A:0xf9926310
y.create.l HWIO_PERIPH_SS_BLSP1_BLSP_QUP3_SPI_CHAR_CFG_ADDR A:0xf9926320
y.create.l HWIO_PERIPH_SS_BLSP1_BLSP_QUP3_SPI_CHAR_DATA_SPI_CS_ADDR A:0xf9926324
y.create.l HWIO_PERIPH_SS_BLSP1_BLSP_QUP3_SPI_CHAR_DATA_SPI_MOSI_ADDR A:0xf9926328
y.create.l HWIO_PERIPH_SS_BLSP1_BLSP_QUP3_SPI_CHAR_DATA_SPI_MISO_ADDR A:0xf992632c
y.create.l HWIO_PERIPH_SS_BLSP1_BLSP_QUP3_I2C_MASTER_CLK_CTL_ADDR A:0xf9926400
y.create.l HWIO_PERIPH_SS_BLSP1_BLSP_QUP3_I2C_MASTER_STATUS_ADDR A:0xf9926404
y.create.l HWIO_PERIPH_SS_BLSP1_BLSP_QUP3_I2C_MASTER_CONFIG_ADDR A:0xf9926408
y.create.l HWIO_PERIPH_SS_BLSP1_BLSP_QUP3_I2C_MASTER_BUS_CLEAR_ADDR A:0xf992640c
y.create.l HWIO_PERIPH_SS_BLSP1_BLSP_QUP3_I2C_MASTER_LOCAL_ID_ADDR A:0xf9926410
y.create.l HWIO_PERIPH_SS_BLSP1_BLSP_QUP4_QUP_CONFIG_ADDR A:0xf9927000
y.create.l HWIO_PERIPH_SS_BLSP1_BLSP_QUP4_QUP_STATE_ADDR A:0xf9927004
y.create.l HWIO_PERIPH_SS_BLSP1_BLSP_QUP4_QUP_IO_MODES_ADDR A:0xf9927008
y.create.l HWIO_PERIPH_SS_BLSP1_BLSP_QUP4_QUP_SW_RESET_ADDR A:0xf992700c
y.create.l HWIO_PERIPH_SS_BLSP1_BLSP_QUP4_QUP_OPERATIONAL_ADDR A:0xf9927018
y.create.l HWIO_PERIPH_SS_BLSP1_BLSP_QUP4_QUP_ERROR_FLAGS_ADDR A:0xf992701c
y.create.l HWIO_PERIPH_SS_BLSP1_BLSP_QUP4_QUP_ERROR_FLAGS_EN_ADDR A:0xf9927020
y.create.l HWIO_PERIPH_SS_BLSP1_BLSP_QUP4_QUP_TEST_CTRL_ADDR A:0xf9927024
y.create.l HWIO_PERIPH_SS_BLSP1_BLSP_QUP4_QUP_OPERATIONAL_MASK_ADDR A:0xf9927028
y.create.l HWIO_PERIPH_SS_BLSP1_BLSP_QUP4_QUP_HW_VERSION_ADDR A:0xf9927030
y.create.l HWIO_PERIPH_SS_BLSP1_BLSP_QUP4_QUP_MX_OUTPUT_COUNT_ADDR A:0xf9927100
y.create.l HWIO_PERIPH_SS_BLSP1_BLSP_QUP4_QUP_MX_OUTPUT_CNT_CURRENT_ADDR A:0xf9927104
y.create.l HWIO_PERIPH_SS_BLSP1_BLSP_QUP4_QUP_OUTPUT_DEBUG_ADDR A:0xf9927108
y.create.l HWIO_PERIPH_SS_BLSP1_BLSP_QUP4_QUP_OUTPUT_FIFO_WORD_CNT_ADDR A:0xf992710c
y.create.l HWIO_PERIPH_SS_BLSP1_BLSP_QUP4_QUP_OUTPUT_FIFO0_ADDR A:0xf9927110
y.create.l HWIO_PERIPH_SS_BLSP1_BLSP_QUP4_QUP_OUTPUT_FIFO1_ADDR A:0xf9927114
y.create.l HWIO_PERIPH_SS_BLSP1_BLSP_QUP4_QUP_OUTPUT_FIFO2_ADDR A:0xf9927118
y.create.l HWIO_PERIPH_SS_BLSP1_BLSP_QUP4_QUP_OUTPUT_FIFO3_ADDR A:0xf992711c
y.create.l HWIO_PERIPH_SS_BLSP1_BLSP_QUP4_QUP_OUTPUT_FIFO4_ADDR A:0xf9927120
y.create.l HWIO_PERIPH_SS_BLSP1_BLSP_QUP4_QUP_OUTPUT_FIFO5_ADDR A:0xf9927124
y.create.l HWIO_PERIPH_SS_BLSP1_BLSP_QUP4_QUP_OUTPUT_FIFO6_ADDR A:0xf9927128
y.create.l HWIO_PERIPH_SS_BLSP1_BLSP_QUP4_QUP_OUTPUT_FIFO7_ADDR A:0xf992712c
y.create.l HWIO_PERIPH_SS_BLSP1_BLSP_QUP4_QUP_OUTPUT_FIFO8_ADDR A:0xf9927130
y.create.l HWIO_PERIPH_SS_BLSP1_BLSP_QUP4_QUP_OUTPUT_FIFO9_ADDR A:0xf9927134
y.create.l HWIO_PERIPH_SS_BLSP1_BLSP_QUP4_QUP_MX_WRITE_COUNT_ADDR A:0xf9927150
y.create.l HWIO_PERIPH_SS_BLSP1_BLSP_QUP4_QUP_MX_WRITE_CNT_CURRENT_ADDR A:0xf9927154
y.create.l HWIO_PERIPH_SS_BLSP1_BLSP_QUP4_QUP_MX_INPUT_COUNT_ADDR A:0xf9927200
y.create.l HWIO_PERIPH_SS_BLSP1_BLSP_QUP4_QUP_MX_INPUT_CNT_CURRENT_ADDR A:0xf9927204
y.create.l HWIO_PERIPH_SS_BLSP1_BLSP_QUP4_QUP_MX_READ_COUNT_ADDR A:0xf9927208
y.create.l HWIO_PERIPH_SS_BLSP1_BLSP_QUP4_QUP_MX_READ_CNT_CURRENT_ADDR A:0xf992720c
y.create.l HWIO_PERIPH_SS_BLSP1_BLSP_QUP4_QUP_INPUT_DEBUG_ADDR A:0xf9927210
y.create.l HWIO_PERIPH_SS_BLSP1_BLSP_QUP4_QUP_INPUT_FIFO_WORD_CNT_ADDR A:0xf9927214
y.create.l HWIO_PERIPH_SS_BLSP1_BLSP_QUP4_QUP_INPUT_FIFO0_ADDR A:0xf9927218
y.create.l HWIO_PERIPH_SS_BLSP1_BLSP_QUP4_QUP_INPUT_FIFO1_ADDR A:0xf992721c
y.create.l HWIO_PERIPH_SS_BLSP1_BLSP_QUP4_QUP_INPUT_FIFO2_ADDR A:0xf9927220
y.create.l HWIO_PERIPH_SS_BLSP1_BLSP_QUP4_QUP_INPUT_FIFO3_ADDR A:0xf9927224
y.create.l HWIO_PERIPH_SS_BLSP1_BLSP_QUP4_QUP_INPUT_FIFO4_ADDR A:0xf9927228
y.create.l HWIO_PERIPH_SS_BLSP1_BLSP_QUP4_QUP_INPUT_FIFO5_ADDR A:0xf992722c
y.create.l HWIO_PERIPH_SS_BLSP1_BLSP_QUP4_QUP_INPUT_FIFO6_ADDR A:0xf9927230
y.create.l HWIO_PERIPH_SS_BLSP1_BLSP_QUP4_QUP_INPUT_FIFO7_ADDR A:0xf9927234
y.create.l HWIO_PERIPH_SS_BLSP1_BLSP_QUP4_QUP_INPUT_FIFO8_ADDR A:0xf9927238
y.create.l HWIO_PERIPH_SS_BLSP1_BLSP_QUP4_QUP_INPUT_FIFO9_ADDR A:0xf992723c
y.create.l HWIO_PERIPH_SS_BLSP1_BLSP_QUP4_SPI_CONFIG_ADDR A:0xf9927300
y.create.l HWIO_PERIPH_SS_BLSP1_BLSP_QUP4_SPI_IO_CONTROL_ADDR A:0xf9927304
y.create.l HWIO_PERIPH_SS_BLSP1_BLSP_QUP4_SPI_ERROR_FLAGS_ADDR A:0xf9927308
y.create.l HWIO_PERIPH_SS_BLSP1_BLSP_QUP4_SPI_ERROR_FLAGS_EN_ADDR A:0xf992730c
y.create.l HWIO_PERIPH_SS_BLSP1_BLSP_QUP4_SPI_DEASSERT_WAIT_ADDR A:0xf9927310
y.create.l HWIO_PERIPH_SS_BLSP1_BLSP_QUP4_SPI_CHAR_CFG_ADDR A:0xf9927320
y.create.l HWIO_PERIPH_SS_BLSP1_BLSP_QUP4_SPI_CHAR_DATA_SPI_CS_ADDR A:0xf9927324
y.create.l HWIO_PERIPH_SS_BLSP1_BLSP_QUP4_SPI_CHAR_DATA_SPI_MOSI_ADDR A:0xf9927328
y.create.l HWIO_PERIPH_SS_BLSP1_BLSP_QUP4_SPI_CHAR_DATA_SPI_MISO_ADDR A:0xf992732c
y.create.l HWIO_PERIPH_SS_BLSP1_BLSP_QUP4_I2C_MASTER_CLK_CTL_ADDR A:0xf9927400
y.create.l HWIO_PERIPH_SS_BLSP1_BLSP_QUP4_I2C_MASTER_STATUS_ADDR A:0xf9927404
y.create.l HWIO_PERIPH_SS_BLSP1_BLSP_QUP4_I2C_MASTER_CONFIG_ADDR A:0xf9927408
y.create.l HWIO_PERIPH_SS_BLSP1_BLSP_QUP4_I2C_MASTER_BUS_CLEAR_ADDR A:0xf992740c
y.create.l HWIO_PERIPH_SS_BLSP1_BLSP_QUP4_I2C_MASTER_LOCAL_ID_ADDR A:0xf9927410
y.create.l HWIO_PERIPH_SS_BLSP1_BLSP_QUP5_QUP_CONFIG_ADDR A:0xf9928000
y.create.l HWIO_PERIPH_SS_BLSP1_BLSP_QUP5_QUP_STATE_ADDR A:0xf9928004
y.create.l HWIO_PERIPH_SS_BLSP1_BLSP_QUP5_QUP_IO_MODES_ADDR A:0xf9928008
y.create.l HWIO_PERIPH_SS_BLSP1_BLSP_QUP5_QUP_SW_RESET_ADDR A:0xf992800c
y.create.l HWIO_PERIPH_SS_BLSP1_BLSP_QUP5_QUP_OPERATIONAL_ADDR A:0xf9928018
y.create.l HWIO_PERIPH_SS_BLSP1_BLSP_QUP5_QUP_ERROR_FLAGS_ADDR A:0xf992801c
y.create.l HWIO_PERIPH_SS_BLSP1_BLSP_QUP5_QUP_ERROR_FLAGS_EN_ADDR A:0xf9928020
y.create.l HWIO_PERIPH_SS_BLSP1_BLSP_QUP5_QUP_TEST_CTRL_ADDR A:0xf9928024
y.create.l HWIO_PERIPH_SS_BLSP1_BLSP_QUP5_QUP_OPERATIONAL_MASK_ADDR A:0xf9928028
y.create.l HWIO_PERIPH_SS_BLSP1_BLSP_QUP5_QUP_HW_VERSION_ADDR A:0xf9928030
y.create.l HWIO_PERIPH_SS_BLSP1_BLSP_QUP5_QUP_MX_OUTPUT_COUNT_ADDR A:0xf9928100
y.create.l HWIO_PERIPH_SS_BLSP1_BLSP_QUP5_QUP_MX_OUTPUT_CNT_CURRENT_ADDR A:0xf9928104
y.create.l HWIO_PERIPH_SS_BLSP1_BLSP_QUP5_QUP_OUTPUT_DEBUG_ADDR A:0xf9928108
y.create.l HWIO_PERIPH_SS_BLSP1_BLSP_QUP5_QUP_OUTPUT_FIFO_WORD_CNT_ADDR A:0xf992810c
y.create.l HWIO_PERIPH_SS_BLSP1_BLSP_QUP5_QUP_OUTPUT_FIFO0_ADDR A:0xf9928110
y.create.l HWIO_PERIPH_SS_BLSP1_BLSP_QUP5_QUP_OUTPUT_FIFO1_ADDR A:0xf9928114
y.create.l HWIO_PERIPH_SS_BLSP1_BLSP_QUP5_QUP_OUTPUT_FIFO2_ADDR A:0xf9928118
y.create.l HWIO_PERIPH_SS_BLSP1_BLSP_QUP5_QUP_OUTPUT_FIFO3_ADDR A:0xf992811c
y.create.l HWIO_PERIPH_SS_BLSP1_BLSP_QUP5_QUP_OUTPUT_FIFO4_ADDR A:0xf9928120
y.create.l HWIO_PERIPH_SS_BLSP1_BLSP_QUP5_QUP_OUTPUT_FIFO5_ADDR A:0xf9928124
y.create.l HWIO_PERIPH_SS_BLSP1_BLSP_QUP5_QUP_OUTPUT_FIFO6_ADDR A:0xf9928128
y.create.l HWIO_PERIPH_SS_BLSP1_BLSP_QUP5_QUP_OUTPUT_FIFO7_ADDR A:0xf992812c
y.create.l HWIO_PERIPH_SS_BLSP1_BLSP_QUP5_QUP_OUTPUT_FIFO8_ADDR A:0xf9928130
y.create.l HWIO_PERIPH_SS_BLSP1_BLSP_QUP5_QUP_OUTPUT_FIFO9_ADDR A:0xf9928134
y.create.l HWIO_PERIPH_SS_BLSP1_BLSP_QUP5_QUP_MX_WRITE_COUNT_ADDR A:0xf9928150
y.create.l HWIO_PERIPH_SS_BLSP1_BLSP_QUP5_QUP_MX_WRITE_CNT_CURRENT_ADDR A:0xf9928154
y.create.l HWIO_PERIPH_SS_BLSP1_BLSP_QUP5_QUP_MX_INPUT_COUNT_ADDR A:0xf9928200
y.create.l HWIO_PERIPH_SS_BLSP1_BLSP_QUP5_QUP_MX_INPUT_CNT_CURRENT_ADDR A:0xf9928204
y.create.l HWIO_PERIPH_SS_BLSP1_BLSP_QUP5_QUP_MX_READ_COUNT_ADDR A:0xf9928208
y.create.l HWIO_PERIPH_SS_BLSP1_BLSP_QUP5_QUP_MX_READ_CNT_CURRENT_ADDR A:0xf992820c
y.create.l HWIO_PERIPH_SS_BLSP1_BLSP_QUP5_QUP_INPUT_DEBUG_ADDR A:0xf9928210
y.create.l HWIO_PERIPH_SS_BLSP1_BLSP_QUP5_QUP_INPUT_FIFO_WORD_CNT_ADDR A:0xf9928214
y.create.l HWIO_PERIPH_SS_BLSP1_BLSP_QUP5_QUP_INPUT_FIFO0_ADDR A:0xf9928218
y.create.l HWIO_PERIPH_SS_BLSP1_BLSP_QUP5_QUP_INPUT_FIFO1_ADDR A:0xf992821c
y.create.l HWIO_PERIPH_SS_BLSP1_BLSP_QUP5_QUP_INPUT_FIFO2_ADDR A:0xf9928220
y.create.l HWIO_PERIPH_SS_BLSP1_BLSP_QUP5_QUP_INPUT_FIFO3_ADDR A:0xf9928224
y.create.l HWIO_PERIPH_SS_BLSP1_BLSP_QUP5_QUP_INPUT_FIFO4_ADDR A:0xf9928228
y.create.l HWIO_PERIPH_SS_BLSP1_BLSP_QUP5_QUP_INPUT_FIFO5_ADDR A:0xf992822c
y.create.l HWIO_PERIPH_SS_BLSP1_BLSP_QUP5_QUP_INPUT_FIFO6_ADDR A:0xf9928230
y.create.l HWIO_PERIPH_SS_BLSP1_BLSP_QUP5_QUP_INPUT_FIFO7_ADDR A:0xf9928234
y.create.l HWIO_PERIPH_SS_BLSP1_BLSP_QUP5_QUP_INPUT_FIFO8_ADDR A:0xf9928238
y.create.l HWIO_PERIPH_SS_BLSP1_BLSP_QUP5_QUP_INPUT_FIFO9_ADDR A:0xf992823c
y.create.l HWIO_PERIPH_SS_BLSP1_BLSP_QUP5_SPI_CONFIG_ADDR A:0xf9928300
y.create.l HWIO_PERIPH_SS_BLSP1_BLSP_QUP5_SPI_IO_CONTROL_ADDR A:0xf9928304
y.create.l HWIO_PERIPH_SS_BLSP1_BLSP_QUP5_SPI_ERROR_FLAGS_ADDR A:0xf9928308
y.create.l HWIO_PERIPH_SS_BLSP1_BLSP_QUP5_SPI_ERROR_FLAGS_EN_ADDR A:0xf992830c
y.create.l HWIO_PERIPH_SS_BLSP1_BLSP_QUP5_SPI_DEASSERT_WAIT_ADDR A:0xf9928310
y.create.l HWIO_PERIPH_SS_BLSP1_BLSP_QUP5_SPI_CHAR_CFG_ADDR A:0xf9928320
y.create.l HWIO_PERIPH_SS_BLSP1_BLSP_QUP5_SPI_CHAR_DATA_SPI_CS_ADDR A:0xf9928324
y.create.l HWIO_PERIPH_SS_BLSP1_BLSP_QUP5_SPI_CHAR_DATA_SPI_MOSI_ADDR A:0xf9928328
y.create.l HWIO_PERIPH_SS_BLSP1_BLSP_QUP5_SPI_CHAR_DATA_SPI_MISO_ADDR A:0xf992832c
y.create.l HWIO_PERIPH_SS_BLSP1_BLSP_QUP5_I2C_MASTER_CLK_CTL_ADDR A:0xf9928400
y.create.l HWIO_PERIPH_SS_BLSP1_BLSP_QUP5_I2C_MASTER_STATUS_ADDR A:0xf9928404
y.create.l HWIO_PERIPH_SS_BLSP1_BLSP_QUP5_I2C_MASTER_CONFIG_ADDR A:0xf9928408
y.create.l HWIO_PERIPH_SS_BLSP1_BLSP_QUP5_I2C_MASTER_BUS_CLEAR_ADDR A:0xf992840c
y.create.l HWIO_PERIPH_SS_BLSP1_BLSP_QUP5_I2C_MASTER_LOCAL_ID_ADDR A:0xf9928410
y.create.l HWIO_PERIPH_SS_BAM_DMA_BAM_CTRL_ADDR A:0xf9984000
y.create.l HWIO_PERIPH_SS_BAM_DMA_BAM_REVISION_ADDR A:0xf9984004
y.create.l HWIO_PERIPH_SS_BAM_DMA_BAM_SW_VERSION_ADDR A:0xf9984080
y.create.l HWIO_PERIPH_SS_BAM_DMA_BAM_NUM_PIPES_ADDR A:0xf998403c
y.create.l HWIO_PERIPH_SS_BAM_DMA_BAM_TIMER_ADDR A:0xf9984040
y.create.l HWIO_PERIPH_SS_BAM_DMA_BAM_TIMER_CTRL_ADDR A:0xf9984044
y.create.l HWIO_PERIPH_SS_BAM_DMA_BAM_DESC_CNT_TRSHLD_ADDR A:0xf9984008
y.create.l HWIO_PERIPH_SS_BAM_DMA_BAM_IRQ_SRCS_ADDR A:0xf998400c
y.create.l HWIO_PERIPH_SS_BAM_DMA_BAM_IRQ_SRCS_MSK_ADDR A:0xf9984010
y.create.l HWIO_PERIPH_SS_BAM_DMA_BAM_IRQ_SRCS_UNMASKED_ADDR A:0xf9984030
y.create.l HWIO_PERIPH_SS_BAM_DMA_BAM_IRQ_STTS_ADDR A:0xf9984014
y.create.l HWIO_PERIPH_SS_BAM_DMA_BAM_IRQ_CLR_ADDR A:0xf9984018
y.create.l HWIO_PERIPH_SS_BAM_DMA_BAM_IRQ_EN_ADDR A:0xf998401c
y.create.l HWIO_PERIPH_SS_BAM_DMA_BAM_AHB_MASTER_ERR_CTRLS_ADDR A:0xf9984024
y.create.l HWIO_PERIPH_SS_BAM_DMA_BAM_AHB_MASTER_ERR_ADDR_ADDR A:0xf9984028
y.create.l HWIO_PERIPH_SS_BAM_DMA_BAM_AHB_MASTER_ERR_DATA_ADDR A:0xf998402c
y.create.l HWIO_PERIPH_SS_BAM_DMA_BAM_TRUST_REG_ADDR A:0xf9984070
y.create.l HWIO_PERIPH_SS_BAM_DMA_BAM_TEST_BUS_SEL_ADDR A:0xf9984074
y.create.l HWIO_PERIPH_SS_BAM_DMA_BAM_TEST_BUS_REG_ADDR A:0xf9984078
y.create.l HWIO_PERIPH_SS_BAM_DMA_BAM_CNFG_BITS_ADDR A:0xf998407c
y.create.l HWIO_PERIPH_SS_BAM_DMA_BAM_IRQ_SRCS_EE0_ADDR A:0xf9984800
y.create.l HWIO_PERIPH_SS_BAM_DMA_BAM_IRQ_SRCS_EE1_ADDR A:0xf9984880
y.create.l HWIO_PERIPH_SS_BAM_DMA_BAM_IRQ_SRCS_EE2_ADDR A:0xf9984900
y.create.l HWIO_PERIPH_SS_BAM_DMA_BAM_IRQ_SRCS_EE3_ADDR A:0xf9984980
y.create.l HWIO_PERIPH_SS_BAM_DMA_BAM_IRQ_SRCS_EE4_ADDR A:0xf9984a00
y.create.l HWIO_PERIPH_SS_BAM_DMA_BAM_IRQ_SRCS_EE5_ADDR A:0xf9984a80
y.create.l HWIO_PERIPH_SS_BAM_DMA_BAM_IRQ_SRCS_EE6_ADDR A:0xf9984b00
y.create.l HWIO_PERIPH_SS_BAM_DMA_BAM_IRQ_SRCS_EE7_ADDR A:0xf9984b80
y.create.l HWIO_PERIPH_SS_BAM_DMA_BAM_IRQ_SRCS_MSK_EE0_ADDR A:0xf9984804
y.create.l HWIO_PERIPH_SS_BAM_DMA_BAM_IRQ_SRCS_MSK_EE1_ADDR A:0xf9984884
y.create.l HWIO_PERIPH_SS_BAM_DMA_BAM_IRQ_SRCS_MSK_EE2_ADDR A:0xf9984904
y.create.l HWIO_PERIPH_SS_BAM_DMA_BAM_IRQ_SRCS_MSK_EE3_ADDR A:0xf9984984
y.create.l HWIO_PERIPH_SS_BAM_DMA_BAM_IRQ_SRCS_MSK_EE4_ADDR A:0xf9984a04
y.create.l HWIO_PERIPH_SS_BAM_DMA_BAM_IRQ_SRCS_MSK_EE5_ADDR A:0xf9984a84
y.create.l HWIO_PERIPH_SS_BAM_DMA_BAM_IRQ_SRCS_MSK_EE6_ADDR A:0xf9984b04
y.create.l HWIO_PERIPH_SS_BAM_DMA_BAM_IRQ_SRCS_MSK_EE7_ADDR A:0xf9984b84
y.create.l HWIO_PERIPH_SS_BAM_DMA_BAM_IRQ_SRCS_UNMASKED_EE0_ADDR A:0xf9984808
y.create.l HWIO_PERIPH_SS_BAM_DMA_BAM_IRQ_SRCS_UNMASKED_EE1_ADDR A:0xf9984888
y.create.l HWIO_PERIPH_SS_BAM_DMA_BAM_IRQ_SRCS_UNMASKED_EE2_ADDR A:0xf9984908
y.create.l HWIO_PERIPH_SS_BAM_DMA_BAM_IRQ_SRCS_UNMASKED_EE3_ADDR A:0xf9984988
y.create.l HWIO_PERIPH_SS_BAM_DMA_BAM_IRQ_SRCS_UNMASKED_EE4_ADDR A:0xf9984a08
y.create.l HWIO_PERIPH_SS_BAM_DMA_BAM_IRQ_SRCS_UNMASKED_EE5_ADDR A:0xf9984a88
y.create.l HWIO_PERIPH_SS_BAM_DMA_BAM_IRQ_SRCS_UNMASKED_EE6_ADDR A:0xf9984b08
y.create.l HWIO_PERIPH_SS_BAM_DMA_BAM_IRQ_SRCS_UNMASKED_EE7_ADDR A:0xf9984b88
y.create.l HWIO_PERIPH_SS_BAM_DMA_BAM_P_CTRL0_ADDR A:0xf9985000
y.create.l HWIO_PERIPH_SS_BAM_DMA_BAM_P_CTRL1_ADDR A:0xf9986000
y.create.l HWIO_PERIPH_SS_BAM_DMA_BAM_P_CTRL2_ADDR A:0xf9987000
y.create.l HWIO_PERIPH_SS_BAM_DMA_BAM_P_CTRL3_ADDR A:0xf9988000
y.create.l HWIO_PERIPH_SS_BAM_DMA_BAM_P_CTRL4_ADDR A:0xf9989000
y.create.l HWIO_PERIPH_SS_BAM_DMA_BAM_P_CTRL5_ADDR A:0xf998a000
y.create.l HWIO_PERIPH_SS_BAM_DMA_BAM_P_CTRL6_ADDR A:0xf998b000
y.create.l HWIO_PERIPH_SS_BAM_DMA_BAM_P_CTRL7_ADDR A:0xf998c000
y.create.l HWIO_PERIPH_SS_BAM_DMA_BAM_P_CTRL8_ADDR A:0xf998d000
y.create.l HWIO_PERIPH_SS_BAM_DMA_BAM_P_CTRL9_ADDR A:0xf998e000
y.create.l HWIO_PERIPH_SS_BAM_DMA_BAM_P_RST0_ADDR A:0xf9985004
y.create.l HWIO_PERIPH_SS_BAM_DMA_BAM_P_RST1_ADDR A:0xf9986004
y.create.l HWIO_PERIPH_SS_BAM_DMA_BAM_P_RST2_ADDR A:0xf9987004
y.create.l HWIO_PERIPH_SS_BAM_DMA_BAM_P_RST3_ADDR A:0xf9988004
y.create.l HWIO_PERIPH_SS_BAM_DMA_BAM_P_RST4_ADDR A:0xf9989004
y.create.l HWIO_PERIPH_SS_BAM_DMA_BAM_P_RST5_ADDR A:0xf998a004
y.create.l HWIO_PERIPH_SS_BAM_DMA_BAM_P_RST6_ADDR A:0xf998b004
y.create.l HWIO_PERIPH_SS_BAM_DMA_BAM_P_RST7_ADDR A:0xf998c004
y.create.l HWIO_PERIPH_SS_BAM_DMA_BAM_P_RST8_ADDR A:0xf998d004
y.create.l HWIO_PERIPH_SS_BAM_DMA_BAM_P_RST9_ADDR A:0xf998e004
y.create.l HWIO_PERIPH_SS_BAM_DMA_BAM_P_HALT0_ADDR A:0xf9985008
y.create.l HWIO_PERIPH_SS_BAM_DMA_BAM_P_HALT1_ADDR A:0xf9986008
y.create.l HWIO_PERIPH_SS_BAM_DMA_BAM_P_HALT2_ADDR A:0xf9987008
y.create.l HWIO_PERIPH_SS_BAM_DMA_BAM_P_HALT3_ADDR A:0xf9988008
y.create.l HWIO_PERIPH_SS_BAM_DMA_BAM_P_HALT4_ADDR A:0xf9989008
y.create.l HWIO_PERIPH_SS_BAM_DMA_BAM_P_HALT5_ADDR A:0xf998a008
y.create.l HWIO_PERIPH_SS_BAM_DMA_BAM_P_HALT6_ADDR A:0xf998b008
y.create.l HWIO_PERIPH_SS_BAM_DMA_BAM_P_HALT7_ADDR A:0xf998c008
y.create.l HWIO_PERIPH_SS_BAM_DMA_BAM_P_HALT8_ADDR A:0xf998d008
y.create.l HWIO_PERIPH_SS_BAM_DMA_BAM_P_HALT9_ADDR A:0xf998e008
y.create.l HWIO_PERIPH_SS_BAM_DMA_BAM_P_TRUST_REG0_ADDR A:0xf9985030
y.create.l HWIO_PERIPH_SS_BAM_DMA_BAM_P_TRUST_REG1_ADDR A:0xf9986030
y.create.l HWIO_PERIPH_SS_BAM_DMA_BAM_P_TRUST_REG2_ADDR A:0xf9987030
y.create.l HWIO_PERIPH_SS_BAM_DMA_BAM_P_TRUST_REG3_ADDR A:0xf9988030
y.create.l HWIO_PERIPH_SS_BAM_DMA_BAM_P_TRUST_REG4_ADDR A:0xf9989030
y.create.l HWIO_PERIPH_SS_BAM_DMA_BAM_P_TRUST_REG5_ADDR A:0xf998a030
y.create.l HWIO_PERIPH_SS_BAM_DMA_BAM_P_TRUST_REG6_ADDR A:0xf998b030
y.create.l HWIO_PERIPH_SS_BAM_DMA_BAM_P_TRUST_REG7_ADDR A:0xf998c030
y.create.l HWIO_PERIPH_SS_BAM_DMA_BAM_P_TRUST_REG8_ADDR A:0xf998d030
y.create.l HWIO_PERIPH_SS_BAM_DMA_BAM_P_TRUST_REG9_ADDR A:0xf998e030
y.create.l HWIO_PERIPH_SS_BAM_DMA_BAM_P_IRQ_STTS0_ADDR A:0xf9985010
y.create.l HWIO_PERIPH_SS_BAM_DMA_BAM_P_IRQ_STTS1_ADDR A:0xf9986010
y.create.l HWIO_PERIPH_SS_BAM_DMA_BAM_P_IRQ_STTS2_ADDR A:0xf9987010
y.create.l HWIO_PERIPH_SS_BAM_DMA_BAM_P_IRQ_STTS3_ADDR A:0xf9988010
y.create.l HWIO_PERIPH_SS_BAM_DMA_BAM_P_IRQ_STTS4_ADDR A:0xf9989010
y.create.l HWIO_PERIPH_SS_BAM_DMA_BAM_P_IRQ_STTS5_ADDR A:0xf998a010
y.create.l HWIO_PERIPH_SS_BAM_DMA_BAM_P_IRQ_STTS6_ADDR A:0xf998b010
y.create.l HWIO_PERIPH_SS_BAM_DMA_BAM_P_IRQ_STTS7_ADDR A:0xf998c010
y.create.l HWIO_PERIPH_SS_BAM_DMA_BAM_P_IRQ_STTS8_ADDR A:0xf998d010
y.create.l HWIO_PERIPH_SS_BAM_DMA_BAM_P_IRQ_STTS9_ADDR A:0xf998e010
y.create.l HWIO_PERIPH_SS_BAM_DMA_BAM_P_IRQ_CLR0_ADDR A:0xf9985014
y.create.l HWIO_PERIPH_SS_BAM_DMA_BAM_P_IRQ_CLR1_ADDR A:0xf9986014
y.create.l HWIO_PERIPH_SS_BAM_DMA_BAM_P_IRQ_CLR2_ADDR A:0xf9987014
y.create.l HWIO_PERIPH_SS_BAM_DMA_BAM_P_IRQ_CLR3_ADDR A:0xf9988014
y.create.l HWIO_PERIPH_SS_BAM_DMA_BAM_P_IRQ_CLR4_ADDR A:0xf9989014
y.create.l HWIO_PERIPH_SS_BAM_DMA_BAM_P_IRQ_CLR5_ADDR A:0xf998a014
y.create.l HWIO_PERIPH_SS_BAM_DMA_BAM_P_IRQ_CLR6_ADDR A:0xf998b014
y.create.l HWIO_PERIPH_SS_BAM_DMA_BAM_P_IRQ_CLR7_ADDR A:0xf998c014
y.create.l HWIO_PERIPH_SS_BAM_DMA_BAM_P_IRQ_CLR8_ADDR A:0xf998d014
y.create.l HWIO_PERIPH_SS_BAM_DMA_BAM_P_IRQ_CLR9_ADDR A:0xf998e014
y.create.l HWIO_PERIPH_SS_BAM_DMA_BAM_P_IRQ_EN0_ADDR A:0xf9985018
y.create.l HWIO_PERIPH_SS_BAM_DMA_BAM_P_IRQ_EN1_ADDR A:0xf9986018
y.create.l HWIO_PERIPH_SS_BAM_DMA_BAM_P_IRQ_EN2_ADDR A:0xf9987018
y.create.l HWIO_PERIPH_SS_BAM_DMA_BAM_P_IRQ_EN3_ADDR A:0xf9988018
y.create.l HWIO_PERIPH_SS_BAM_DMA_BAM_P_IRQ_EN4_ADDR A:0xf9989018
y.create.l HWIO_PERIPH_SS_BAM_DMA_BAM_P_IRQ_EN5_ADDR A:0xf998a018
y.create.l HWIO_PERIPH_SS_BAM_DMA_BAM_P_IRQ_EN6_ADDR A:0xf998b018
y.create.l HWIO_PERIPH_SS_BAM_DMA_BAM_P_IRQ_EN7_ADDR A:0xf998c018
y.create.l HWIO_PERIPH_SS_BAM_DMA_BAM_P_IRQ_EN8_ADDR A:0xf998d018
y.create.l HWIO_PERIPH_SS_BAM_DMA_BAM_P_IRQ_EN9_ADDR A:0xf998e018
y.create.l HWIO_PERIPH_SS_BAM_DMA_BAM_P_TIMER0_ADDR A:0xf998501c
y.create.l HWIO_PERIPH_SS_BAM_DMA_BAM_P_TIMER1_ADDR A:0xf998601c
y.create.l HWIO_PERIPH_SS_BAM_DMA_BAM_P_TIMER2_ADDR A:0xf998701c
y.create.l HWIO_PERIPH_SS_BAM_DMA_BAM_P_TIMER3_ADDR A:0xf998801c
y.create.l HWIO_PERIPH_SS_BAM_DMA_BAM_P_TIMER4_ADDR A:0xf998901c
y.create.l HWIO_PERIPH_SS_BAM_DMA_BAM_P_TIMER5_ADDR A:0xf998a01c
y.create.l HWIO_PERIPH_SS_BAM_DMA_BAM_P_TIMER6_ADDR A:0xf998b01c
y.create.l HWIO_PERIPH_SS_BAM_DMA_BAM_P_TIMER7_ADDR A:0xf998c01c
y.create.l HWIO_PERIPH_SS_BAM_DMA_BAM_P_TIMER8_ADDR A:0xf998d01c
y.create.l HWIO_PERIPH_SS_BAM_DMA_BAM_P_TIMER9_ADDR A:0xf998e01c
y.create.l HWIO_PERIPH_SS_BAM_DMA_BAM_P_TIMER_CTRL0_ADDR A:0xf9985020
y.create.l HWIO_PERIPH_SS_BAM_DMA_BAM_P_TIMER_CTRL1_ADDR A:0xf9986020
y.create.l HWIO_PERIPH_SS_BAM_DMA_BAM_P_TIMER_CTRL2_ADDR A:0xf9987020
y.create.l HWIO_PERIPH_SS_BAM_DMA_BAM_P_TIMER_CTRL3_ADDR A:0xf9988020
y.create.l HWIO_PERIPH_SS_BAM_DMA_BAM_P_TIMER_CTRL4_ADDR A:0xf9989020
y.create.l HWIO_PERIPH_SS_BAM_DMA_BAM_P_TIMER_CTRL5_ADDR A:0xf998a020
y.create.l HWIO_PERIPH_SS_BAM_DMA_BAM_P_TIMER_CTRL6_ADDR A:0xf998b020
y.create.l HWIO_PERIPH_SS_BAM_DMA_BAM_P_TIMER_CTRL7_ADDR A:0xf998c020
y.create.l HWIO_PERIPH_SS_BAM_DMA_BAM_P_TIMER_CTRL8_ADDR A:0xf998d020
y.create.l HWIO_PERIPH_SS_BAM_DMA_BAM_P_TIMER_CTRL9_ADDR A:0xf998e020
y.create.l HWIO_PERIPH_SS_BAM_DMA_BAM_P_PRDCR_SDBND0_ADDR A:0xf9985024
y.create.l HWIO_PERIPH_SS_BAM_DMA_BAM_P_PRDCR_SDBND1_ADDR A:0xf9986024
y.create.l HWIO_PERIPH_SS_BAM_DMA_BAM_P_PRDCR_SDBND2_ADDR A:0xf9987024
y.create.l HWIO_PERIPH_SS_BAM_DMA_BAM_P_PRDCR_SDBND3_ADDR A:0xf9988024
y.create.l HWIO_PERIPH_SS_BAM_DMA_BAM_P_PRDCR_SDBND4_ADDR A:0xf9989024
y.create.l HWIO_PERIPH_SS_BAM_DMA_BAM_P_PRDCR_SDBND5_ADDR A:0xf998a024
y.create.l HWIO_PERIPH_SS_BAM_DMA_BAM_P_PRDCR_SDBND6_ADDR A:0xf998b024
y.create.l HWIO_PERIPH_SS_BAM_DMA_BAM_P_PRDCR_SDBND7_ADDR A:0xf998c024
y.create.l HWIO_PERIPH_SS_BAM_DMA_BAM_P_PRDCR_SDBND8_ADDR A:0xf998d024
y.create.l HWIO_PERIPH_SS_BAM_DMA_BAM_P_PRDCR_SDBND9_ADDR A:0xf998e024
y.create.l HWIO_PERIPH_SS_BAM_DMA_BAM_P_CNSMR_SDBND0_ADDR A:0xf9985028
y.create.l HWIO_PERIPH_SS_BAM_DMA_BAM_P_CNSMR_SDBND1_ADDR A:0xf9986028
y.create.l HWIO_PERIPH_SS_BAM_DMA_BAM_P_CNSMR_SDBND2_ADDR A:0xf9987028
y.create.l HWIO_PERIPH_SS_BAM_DMA_BAM_P_CNSMR_SDBND3_ADDR A:0xf9988028
y.create.l HWIO_PERIPH_SS_BAM_DMA_BAM_P_CNSMR_SDBND4_ADDR A:0xf9989028
y.create.l HWIO_PERIPH_SS_BAM_DMA_BAM_P_CNSMR_SDBND5_ADDR A:0xf998a028
y.create.l HWIO_PERIPH_SS_BAM_DMA_BAM_P_CNSMR_SDBND6_ADDR A:0xf998b028
y.create.l HWIO_PERIPH_SS_BAM_DMA_BAM_P_CNSMR_SDBND7_ADDR A:0xf998c028
y.create.l HWIO_PERIPH_SS_BAM_DMA_BAM_P_CNSMR_SDBND8_ADDR A:0xf998d028
y.create.l HWIO_PERIPH_SS_BAM_DMA_BAM_P_CNSMR_SDBND9_ADDR A:0xf998e028
y.create.l HWIO_PERIPH_SS_BAM_DMA_BAM_P_EVNT_DEST_ADDR0_ADDR A:0xf998582c
y.create.l HWIO_PERIPH_SS_BAM_DMA_BAM_P_EVNT_DEST_ADDR1_ADDR A:0xf998682c
y.create.l HWIO_PERIPH_SS_BAM_DMA_BAM_P_EVNT_DEST_ADDR2_ADDR A:0xf998782c
y.create.l HWIO_PERIPH_SS_BAM_DMA_BAM_P_EVNT_DEST_ADDR3_ADDR A:0xf998882c
y.create.l HWIO_PERIPH_SS_BAM_DMA_BAM_P_EVNT_DEST_ADDR4_ADDR A:0xf998982c
y.create.l HWIO_PERIPH_SS_BAM_DMA_BAM_P_EVNT_DEST_ADDR5_ADDR A:0xf998a82c
y.create.l HWIO_PERIPH_SS_BAM_DMA_BAM_P_EVNT_DEST_ADDR6_ADDR A:0xf998b82c
y.create.l HWIO_PERIPH_SS_BAM_DMA_BAM_P_EVNT_DEST_ADDR7_ADDR A:0xf998c82c
y.create.l HWIO_PERIPH_SS_BAM_DMA_BAM_P_EVNT_DEST_ADDR8_ADDR A:0xf998d82c
y.create.l HWIO_PERIPH_SS_BAM_DMA_BAM_P_EVNT_DEST_ADDR9_ADDR A:0xf998e82c
y.create.l HWIO_PERIPH_SS_BAM_DMA_BAM_P_EVNT_REG0_ADDR A:0xf9985818
y.create.l HWIO_PERIPH_SS_BAM_DMA_BAM_P_EVNT_REG1_ADDR A:0xf9986818
y.create.l HWIO_PERIPH_SS_BAM_DMA_BAM_P_EVNT_REG2_ADDR A:0xf9987818
y.create.l HWIO_PERIPH_SS_BAM_DMA_BAM_P_EVNT_REG3_ADDR A:0xf9988818
y.create.l HWIO_PERIPH_SS_BAM_DMA_BAM_P_EVNT_REG4_ADDR A:0xf9989818
y.create.l HWIO_PERIPH_SS_BAM_DMA_BAM_P_EVNT_REG5_ADDR A:0xf998a818
y.create.l HWIO_PERIPH_SS_BAM_DMA_BAM_P_EVNT_REG6_ADDR A:0xf998b818
y.create.l HWIO_PERIPH_SS_BAM_DMA_BAM_P_EVNT_REG7_ADDR A:0xf998c818
y.create.l HWIO_PERIPH_SS_BAM_DMA_BAM_P_EVNT_REG8_ADDR A:0xf998d818
y.create.l HWIO_PERIPH_SS_BAM_DMA_BAM_P_EVNT_REG9_ADDR A:0xf998e818
y.create.l HWIO_PERIPH_SS_BAM_DMA_BAM_P_SW_OFSTS0_ADDR A:0xf9985800
y.create.l HWIO_PERIPH_SS_BAM_DMA_BAM_P_SW_OFSTS1_ADDR A:0xf9986800
y.create.l HWIO_PERIPH_SS_BAM_DMA_BAM_P_SW_OFSTS2_ADDR A:0xf9987800
y.create.l HWIO_PERIPH_SS_BAM_DMA_BAM_P_SW_OFSTS3_ADDR A:0xf9988800
y.create.l HWIO_PERIPH_SS_BAM_DMA_BAM_P_SW_OFSTS4_ADDR A:0xf9989800
y.create.l HWIO_PERIPH_SS_BAM_DMA_BAM_P_SW_OFSTS5_ADDR A:0xf998a800
y.create.l HWIO_PERIPH_SS_BAM_DMA_BAM_P_SW_OFSTS6_ADDR A:0xf998b800
y.create.l HWIO_PERIPH_SS_BAM_DMA_BAM_P_SW_OFSTS7_ADDR A:0xf998c800
y.create.l HWIO_PERIPH_SS_BAM_DMA_BAM_P_SW_OFSTS8_ADDR A:0xf998d800
y.create.l HWIO_PERIPH_SS_BAM_DMA_BAM_P_SW_OFSTS9_ADDR A:0xf998e800
y.create.l HWIO_PERIPH_SS_BAM_DMA_BAM_P_DATA_FIFO_ADDR0_ADDR A:0xf9985824
y.create.l HWIO_PERIPH_SS_BAM_DMA_BAM_P_DATA_FIFO_ADDR1_ADDR A:0xf9986824
y.create.l HWIO_PERIPH_SS_BAM_DMA_BAM_P_DATA_FIFO_ADDR2_ADDR A:0xf9987824
y.create.l HWIO_PERIPH_SS_BAM_DMA_BAM_P_DATA_FIFO_ADDR3_ADDR A:0xf9988824
y.create.l HWIO_PERIPH_SS_BAM_DMA_BAM_P_DATA_FIFO_ADDR4_ADDR A:0xf9989824
y.create.l HWIO_PERIPH_SS_BAM_DMA_BAM_P_DATA_FIFO_ADDR5_ADDR A:0xf998a824
y.create.l HWIO_PERIPH_SS_BAM_DMA_BAM_P_DATA_FIFO_ADDR6_ADDR A:0xf998b824
y.create.l HWIO_PERIPH_SS_BAM_DMA_BAM_P_DATA_FIFO_ADDR7_ADDR A:0xf998c824
y.create.l HWIO_PERIPH_SS_BAM_DMA_BAM_P_DATA_FIFO_ADDR8_ADDR A:0xf998d824
y.create.l HWIO_PERIPH_SS_BAM_DMA_BAM_P_DATA_FIFO_ADDR9_ADDR A:0xf998e824
y.create.l HWIO_PERIPH_SS_BAM_DMA_BAM_P_DESC_FIFO_ADDR0_ADDR A:0xf998581c
y.create.l HWIO_PERIPH_SS_BAM_DMA_BAM_P_DESC_FIFO_ADDR1_ADDR A:0xf998681c
y.create.l HWIO_PERIPH_SS_BAM_DMA_BAM_P_DESC_FIFO_ADDR2_ADDR A:0xf998781c
y.create.l HWIO_PERIPH_SS_BAM_DMA_BAM_P_DESC_FIFO_ADDR3_ADDR A:0xf998881c
y.create.l HWIO_PERIPH_SS_BAM_DMA_BAM_P_DESC_FIFO_ADDR4_ADDR A:0xf998981c
y.create.l HWIO_PERIPH_SS_BAM_DMA_BAM_P_DESC_FIFO_ADDR5_ADDR A:0xf998a81c
y.create.l HWIO_PERIPH_SS_BAM_DMA_BAM_P_DESC_FIFO_ADDR6_ADDR A:0xf998b81c
y.create.l HWIO_PERIPH_SS_BAM_DMA_BAM_P_DESC_FIFO_ADDR7_ADDR A:0xf998c81c
y.create.l HWIO_PERIPH_SS_BAM_DMA_BAM_P_DESC_FIFO_ADDR8_ADDR A:0xf998d81c
y.create.l HWIO_PERIPH_SS_BAM_DMA_BAM_P_DESC_FIFO_ADDR9_ADDR A:0xf998e81c
y.create.l HWIO_PERIPH_SS_BAM_DMA_BAM_P_EVNT_GEN_TRSHLD0_ADDR A:0xf9985828
y.create.l HWIO_PERIPH_SS_BAM_DMA_BAM_P_EVNT_GEN_TRSHLD1_ADDR A:0xf9986828
y.create.l HWIO_PERIPH_SS_BAM_DMA_BAM_P_EVNT_GEN_TRSHLD2_ADDR A:0xf9987828
y.create.l HWIO_PERIPH_SS_BAM_DMA_BAM_P_EVNT_GEN_TRSHLD3_ADDR A:0xf9988828
y.create.l HWIO_PERIPH_SS_BAM_DMA_BAM_P_EVNT_GEN_TRSHLD4_ADDR A:0xf9989828
y.create.l HWIO_PERIPH_SS_BAM_DMA_BAM_P_EVNT_GEN_TRSHLD5_ADDR A:0xf998a828
y.create.l HWIO_PERIPH_SS_BAM_DMA_BAM_P_EVNT_GEN_TRSHLD6_ADDR A:0xf998b828
y.create.l HWIO_PERIPH_SS_BAM_DMA_BAM_P_EVNT_GEN_TRSHLD7_ADDR A:0xf998c828
y.create.l HWIO_PERIPH_SS_BAM_DMA_BAM_P_EVNT_GEN_TRSHLD8_ADDR A:0xf998d828
y.create.l HWIO_PERIPH_SS_BAM_DMA_BAM_P_EVNT_GEN_TRSHLD9_ADDR A:0xf998e828
y.create.l HWIO_PERIPH_SS_BAM_DMA_BAM_P_FIFO_SIZES0_ADDR A:0xf9985820
y.create.l HWIO_PERIPH_SS_BAM_DMA_BAM_P_FIFO_SIZES1_ADDR A:0xf9986820
y.create.l HWIO_PERIPH_SS_BAM_DMA_BAM_P_FIFO_SIZES2_ADDR A:0xf9987820
y.create.l HWIO_PERIPH_SS_BAM_DMA_BAM_P_FIFO_SIZES3_ADDR A:0xf9988820
y.create.l HWIO_PERIPH_SS_BAM_DMA_BAM_P_FIFO_SIZES4_ADDR A:0xf9989820
y.create.l HWIO_PERIPH_SS_BAM_DMA_BAM_P_FIFO_SIZES5_ADDR A:0xf998a820
y.create.l HWIO_PERIPH_SS_BAM_DMA_BAM_P_FIFO_SIZES6_ADDR A:0xf998b820
y.create.l HWIO_PERIPH_SS_BAM_DMA_BAM_P_FIFO_SIZES7_ADDR A:0xf998c820
y.create.l HWIO_PERIPH_SS_BAM_DMA_BAM_P_FIFO_SIZES8_ADDR A:0xf998d820
y.create.l HWIO_PERIPH_SS_BAM_DMA_BAM_P_FIFO_SIZES9_ADDR A:0xf998e820
y.create.l HWIO_PERIPH_SS_BAM_DMA_BAM_P_RETR_CNTXT_0_ADDR A:0xf9985834
y.create.l HWIO_PERIPH_SS_BAM_DMA_BAM_P_RETR_CNTXT_1_ADDR A:0xf9986834
y.create.l HWIO_PERIPH_SS_BAM_DMA_BAM_P_RETR_CNTXT_2_ADDR A:0xf9987834
y.create.l HWIO_PERIPH_SS_BAM_DMA_BAM_P_RETR_CNTXT_3_ADDR A:0xf9988834
y.create.l HWIO_PERIPH_SS_BAM_DMA_BAM_P_RETR_CNTXT_4_ADDR A:0xf9989834
y.create.l HWIO_PERIPH_SS_BAM_DMA_BAM_P_RETR_CNTXT_5_ADDR A:0xf998a834
y.create.l HWIO_PERIPH_SS_BAM_DMA_BAM_P_RETR_CNTXT_6_ADDR A:0xf998b834
y.create.l HWIO_PERIPH_SS_BAM_DMA_BAM_P_RETR_CNTXT_7_ADDR A:0xf998c834
y.create.l HWIO_PERIPH_SS_BAM_DMA_BAM_P_RETR_CNTXT_8_ADDR A:0xf998d834
y.create.l HWIO_PERIPH_SS_BAM_DMA_BAM_P_RETR_CNTXT_9_ADDR A:0xf998e834
y.create.l HWIO_PERIPH_SS_BAM_DMA_BAM_P_SI_CNTXT_0_ADDR A:0xf9985838
y.create.l HWIO_PERIPH_SS_BAM_DMA_BAM_P_SI_CNTXT_1_ADDR A:0xf9986838
y.create.l HWIO_PERIPH_SS_BAM_DMA_BAM_P_SI_CNTXT_2_ADDR A:0xf9987838
y.create.l HWIO_PERIPH_SS_BAM_DMA_BAM_P_SI_CNTXT_3_ADDR A:0xf9988838
y.create.l HWIO_PERIPH_SS_BAM_DMA_BAM_P_SI_CNTXT_4_ADDR A:0xf9989838
y.create.l HWIO_PERIPH_SS_BAM_DMA_BAM_P_SI_CNTXT_5_ADDR A:0xf998a838
y.create.l HWIO_PERIPH_SS_BAM_DMA_BAM_P_SI_CNTXT_6_ADDR A:0xf998b838
y.create.l HWIO_PERIPH_SS_BAM_DMA_BAM_P_SI_CNTXT_7_ADDR A:0xf998c838
y.create.l HWIO_PERIPH_SS_BAM_DMA_BAM_P_SI_CNTXT_8_ADDR A:0xf998d838
y.create.l HWIO_PERIPH_SS_BAM_DMA_BAM_P_SI_CNTXT_9_ADDR A:0xf998e838
y.create.l HWIO_PERIPH_SS_BAM_DMA_BAM_P_DF_CNTXT_0_ADDR A:0xf9985830
y.create.l HWIO_PERIPH_SS_BAM_DMA_BAM_P_DF_CNTXT_1_ADDR A:0xf9986830
y.create.l HWIO_PERIPH_SS_BAM_DMA_BAM_P_DF_CNTXT_2_ADDR A:0xf9987830
y.create.l HWIO_PERIPH_SS_BAM_DMA_BAM_P_DF_CNTXT_3_ADDR A:0xf9988830
y.create.l HWIO_PERIPH_SS_BAM_DMA_BAM_P_DF_CNTXT_4_ADDR A:0xf9989830
y.create.l HWIO_PERIPH_SS_BAM_DMA_BAM_P_DF_CNTXT_5_ADDR A:0xf998a830
y.create.l HWIO_PERIPH_SS_BAM_DMA_BAM_P_DF_CNTXT_6_ADDR A:0xf998b830
y.create.l HWIO_PERIPH_SS_BAM_DMA_BAM_P_DF_CNTXT_7_ADDR A:0xf998c830
y.create.l HWIO_PERIPH_SS_BAM_DMA_BAM_P_DF_CNTXT_8_ADDR A:0xf998d830
y.create.l HWIO_PERIPH_SS_BAM_DMA_BAM_P_DF_CNTXT_9_ADDR A:0xf998e830
y.create.l HWIO_PERIPH_SS_BAM_DMA_BAM_P_AU_PSM_CNTXT_1_0_ADDR A:0xf9985804
y.create.l HWIO_PERIPH_SS_BAM_DMA_BAM_P_AU_PSM_CNTXT_1_1_ADDR A:0xf9986804
y.create.l HWIO_PERIPH_SS_BAM_DMA_BAM_P_AU_PSM_CNTXT_1_2_ADDR A:0xf9987804
y.create.l HWIO_PERIPH_SS_BAM_DMA_BAM_P_AU_PSM_CNTXT_1_3_ADDR A:0xf9988804
y.create.l HWIO_PERIPH_SS_BAM_DMA_BAM_P_AU_PSM_CNTXT_1_4_ADDR A:0xf9989804
y.create.l HWIO_PERIPH_SS_BAM_DMA_BAM_P_AU_PSM_CNTXT_1_5_ADDR A:0xf998a804
y.create.l HWIO_PERIPH_SS_BAM_DMA_BAM_P_AU_PSM_CNTXT_1_6_ADDR A:0xf998b804
y.create.l HWIO_PERIPH_SS_BAM_DMA_BAM_P_AU_PSM_CNTXT_1_7_ADDR A:0xf998c804
y.create.l HWIO_PERIPH_SS_BAM_DMA_BAM_P_AU_PSM_CNTXT_1_8_ADDR A:0xf998d804
y.create.l HWIO_PERIPH_SS_BAM_DMA_BAM_P_AU_PSM_CNTXT_1_9_ADDR A:0xf998e804
y.create.l HWIO_PERIPH_SS_BAM_DMA_BAM_P_PSM_CNTXT_2_0_ADDR A:0xf9985808
y.create.l HWIO_PERIPH_SS_BAM_DMA_BAM_P_PSM_CNTXT_2_1_ADDR A:0xf9986808
y.create.l HWIO_PERIPH_SS_BAM_DMA_BAM_P_PSM_CNTXT_2_2_ADDR A:0xf9987808
y.create.l HWIO_PERIPH_SS_BAM_DMA_BAM_P_PSM_CNTXT_2_3_ADDR A:0xf9988808
y.create.l HWIO_PERIPH_SS_BAM_DMA_BAM_P_PSM_CNTXT_2_4_ADDR A:0xf9989808
y.create.l HWIO_PERIPH_SS_BAM_DMA_BAM_P_PSM_CNTXT_2_5_ADDR A:0xf998a808
y.create.l HWIO_PERIPH_SS_BAM_DMA_BAM_P_PSM_CNTXT_2_6_ADDR A:0xf998b808
y.create.l HWIO_PERIPH_SS_BAM_DMA_BAM_P_PSM_CNTXT_2_7_ADDR A:0xf998c808
y.create.l HWIO_PERIPH_SS_BAM_DMA_BAM_P_PSM_CNTXT_2_8_ADDR A:0xf998d808
y.create.l HWIO_PERIPH_SS_BAM_DMA_BAM_P_PSM_CNTXT_2_9_ADDR A:0xf998e808
y.create.l HWIO_PERIPH_SS_BAM_DMA_BAM_P_PSM_CNTXT_3_0_ADDR A:0xf998580c
y.create.l HWIO_PERIPH_SS_BAM_DMA_BAM_P_PSM_CNTXT_3_1_ADDR A:0xf998680c
y.create.l HWIO_PERIPH_SS_BAM_DMA_BAM_P_PSM_CNTXT_3_2_ADDR A:0xf998780c
y.create.l HWIO_PERIPH_SS_BAM_DMA_BAM_P_PSM_CNTXT_3_3_ADDR A:0xf998880c
y.create.l HWIO_PERIPH_SS_BAM_DMA_BAM_P_PSM_CNTXT_3_4_ADDR A:0xf998980c
y.create.l HWIO_PERIPH_SS_BAM_DMA_BAM_P_PSM_CNTXT_3_5_ADDR A:0xf998a80c
y.create.l HWIO_PERIPH_SS_BAM_DMA_BAM_P_PSM_CNTXT_3_6_ADDR A:0xf998b80c
y.create.l HWIO_PERIPH_SS_BAM_DMA_BAM_P_PSM_CNTXT_3_7_ADDR A:0xf998c80c
y.create.l HWIO_PERIPH_SS_BAM_DMA_BAM_P_PSM_CNTXT_3_8_ADDR A:0xf998d80c
y.create.l HWIO_PERIPH_SS_BAM_DMA_BAM_P_PSM_CNTXT_3_9_ADDR A:0xf998e80c
y.create.l HWIO_PERIPH_SS_BAM_DMA_BAM_P_PSM_CNTXT_4_0_ADDR A:0xf9985810
y.create.l HWIO_PERIPH_SS_BAM_DMA_BAM_P_PSM_CNTXT_4_1_ADDR A:0xf9986810
y.create.l HWIO_PERIPH_SS_BAM_DMA_BAM_P_PSM_CNTXT_4_2_ADDR A:0xf9987810
y.create.l HWIO_PERIPH_SS_BAM_DMA_BAM_P_PSM_CNTXT_4_3_ADDR A:0xf9988810
y.create.l HWIO_PERIPH_SS_BAM_DMA_BAM_P_PSM_CNTXT_4_4_ADDR A:0xf9989810
y.create.l HWIO_PERIPH_SS_BAM_DMA_BAM_P_PSM_CNTXT_4_5_ADDR A:0xf998a810
y.create.l HWIO_PERIPH_SS_BAM_DMA_BAM_P_PSM_CNTXT_4_6_ADDR A:0xf998b810
y.create.l HWIO_PERIPH_SS_BAM_DMA_BAM_P_PSM_CNTXT_4_7_ADDR A:0xf998c810
y.create.l HWIO_PERIPH_SS_BAM_DMA_BAM_P_PSM_CNTXT_4_8_ADDR A:0xf998d810
y.create.l HWIO_PERIPH_SS_BAM_DMA_BAM_P_PSM_CNTXT_4_9_ADDR A:0xf998e810
y.create.l HWIO_PERIPH_SS_BAM_DMA_BAM_P_PSM_CNTXT_5_0_ADDR A:0xf9985814
y.create.l HWIO_PERIPH_SS_BAM_DMA_BAM_P_PSM_CNTXT_5_1_ADDR A:0xf9986814
y.create.l HWIO_PERIPH_SS_BAM_DMA_BAM_P_PSM_CNTXT_5_2_ADDR A:0xf9987814
y.create.l HWIO_PERIPH_SS_BAM_DMA_BAM_P_PSM_CNTXT_5_3_ADDR A:0xf9988814
y.create.l HWIO_PERIPH_SS_BAM_DMA_BAM_P_PSM_CNTXT_5_4_ADDR A:0xf9989814
y.create.l HWIO_PERIPH_SS_BAM_DMA_BAM_P_PSM_CNTXT_5_5_ADDR A:0xf998a814
y.create.l HWIO_PERIPH_SS_BAM_DMA_BAM_P_PSM_CNTXT_5_6_ADDR A:0xf998b814
y.create.l HWIO_PERIPH_SS_BAM_DMA_BAM_P_PSM_CNTXT_5_7_ADDR A:0xf998c814
y.create.l HWIO_PERIPH_SS_BAM_DMA_BAM_P_PSM_CNTXT_5_8_ADDR A:0xf998d814
y.create.l HWIO_PERIPH_SS_BAM_DMA_BAM_P_PSM_CNTXT_5_9_ADDR A:0xf998e814
y.create.l HWIO_PERIPH_SS_BAM_DMA_XPU_SCR_ADDR A:0xf9982000
y.create.l HWIO_PERIPH_SS_BAM_DMA_XPU_SWDR_ADDR A:0xf9982004
y.create.l HWIO_PERIPH_SS_BAM_DMA_XPU_SEAR0_ADDR A:0xf9982040
y.create.l HWIO_PERIPH_SS_BAM_DMA_XPU_SESR_ADDR A:0xf9982048
y.create.l HWIO_PERIPH_SS_BAM_DMA_XPU_SESRRESTORE_ADDR A:0xf998204c
y.create.l HWIO_PERIPH_SS_BAM_DMA_XPU_SESYNR0_ADDR A:0xf9982050
y.create.l HWIO_PERIPH_SS_BAM_DMA_XPU_SESYNR1_ADDR A:0xf9982054
y.create.l HWIO_PERIPH_SS_BAM_DMA_XPU_SESYNR2_ADDR A:0xf9982058
y.create.l HWIO_PERIPH_SS_BAM_DMA_XPU_MCR_ADDR A:0xf9982100
y.create.l HWIO_PERIPH_SS_BAM_DMA_XPU_MEAR0_ADDR A:0xf9982140
y.create.l HWIO_PERIPH_SS_BAM_DMA_XPU_MESR_ADDR A:0xf9982148
y.create.l HWIO_PERIPH_SS_BAM_DMA_XPU_MESRRESTORE_ADDR A:0xf998214c
y.create.l HWIO_PERIPH_SS_BAM_DMA_XPU_MESYNR0_ADDR A:0xf9982150
y.create.l HWIO_PERIPH_SS_BAM_DMA_XPU_MESYNR1_ADDR A:0xf9982154
y.create.l HWIO_PERIPH_SS_BAM_DMA_XPU_MESYNR2_ADDR A:0xf9982158
y.create.l HWIO_PERIPH_SS_BAM_DMA_XPU_CR_ADDR A:0xf9982080
y.create.l HWIO_PERIPH_SS_BAM_DMA_XPU_RPU_ACR0_ADDR A:0xf99820a0
y.create.l HWIO_PERIPH_SS_BAM_DMA_XPU_EAR0_ADDR A:0xf99820c0
y.create.l HWIO_PERIPH_SS_BAM_DMA_XPU_ESR_ADDR A:0xf99820c8
y.create.l HWIO_PERIPH_SS_BAM_DMA_XPU_ESRRESTORE_ADDR A:0xf99820cc
y.create.l HWIO_PERIPH_SS_BAM_DMA_XPU_ESYNR0_ADDR A:0xf99820d0
y.create.l HWIO_PERIPH_SS_BAM_DMA_XPU_ESYNR1_ADDR A:0xf99820d4
y.create.l HWIO_PERIPH_SS_BAM_DMA_XPU_ESYNR2_ADDR A:0xf99820d8
y.create.l HWIO_PERIPH_SS_BAM_DMA_XPU_IDR0_ADDR A:0xf9982074
y.create.l HWIO_PERIPH_SS_BAM_DMA_XPU_IDR1_ADDR A:0xf9982078
y.create.l HWIO_PERIPH_SS_BAM_DMA_XPU_REV_ADDR A:0xf998207c
y.create.l HWIO_PERIPH_SS_BAM_DMA_XPU_RG0_RACR0_ADDR A:0xf9982200
y.create.l HWIO_PERIPH_SS_BAM_DMA_XPU_RG1_RACR0_ADDR A:0xf9982280
y.create.l HWIO_PERIPH_SS_BAM_DMA_XPU_RG2_RACR0_ADDR A:0xf9982300
y.create.l HWIO_PERIPH_SS_BAM_DMA_XPU_RG3_RACR0_ADDR A:0xf9982380
y.create.l HWIO_PERIPH_SS_BAM_DMA_XPU_RG4_RACR0_ADDR A:0xf9982400
y.create.l HWIO_PERIPH_SS_BAM_DMA_XPU_RG5_RACR0_ADDR A:0xf9982480
y.create.l HWIO_PERIPH_SS_BAM_DMA_XPU_RG6_RACR0_ADDR A:0xf9982500
y.create.l HWIO_PERIPH_SS_BAM_DMA_XPU_RG7_RACR0_ADDR A:0xf9982580
y.create.l HWIO_PERIPH_SS_BAM_DMA_XPU_RG8_RACR0_ADDR A:0xf9982600
y.create.l HWIO_PERIPH_SS_BAM_DMA_XPU_RG9_RACR0_ADDR A:0xf9982680
y.create.l HWIO_PERIPH_SS_BAM_DMA_XPU_RG0_SCR_ADDR A:0xf9982250
y.create.l HWIO_PERIPH_SS_BAM_DMA_XPU_RG1_SCR_ADDR A:0xf99822d0
y.create.l HWIO_PERIPH_SS_BAM_DMA_XPU_RG2_SCR_ADDR A:0xf9982350
y.create.l HWIO_PERIPH_SS_BAM_DMA_XPU_RG3_SCR_ADDR A:0xf99823d0
y.create.l HWIO_PERIPH_SS_BAM_DMA_XPU_RG4_SCR_ADDR A:0xf9982450
y.create.l HWIO_PERIPH_SS_BAM_DMA_XPU_RG5_SCR_ADDR A:0xf99824d0
y.create.l HWIO_PERIPH_SS_BAM_DMA_XPU_RG6_SCR_ADDR A:0xf9982550
y.create.l HWIO_PERIPH_SS_BAM_DMA_XPU_RG7_SCR_ADDR A:0xf99825d0
y.create.l HWIO_PERIPH_SS_BAM_DMA_XPU_RG8_SCR_ADDR A:0xf9982650
y.create.l HWIO_PERIPH_SS_BAM_DMA_XPU_RG9_SCR_ADDR A:0xf99826d0
y.create.l HWIO_PERIPH_SS_BAM_DMA_XPU_RG0_MCR_ADDR A:0xf9982254
y.create.l HWIO_PERIPH_SS_BAM_DMA_XPU_RG1_MCR_ADDR A:0xf99822d4
y.create.l HWIO_PERIPH_SS_BAM_DMA_XPU_RG2_MCR_ADDR A:0xf9982354
y.create.l HWIO_PERIPH_SS_BAM_DMA_XPU_RG3_MCR_ADDR A:0xf99823d4
y.create.l HWIO_PERIPH_SS_BAM_DMA_XPU_RG4_MCR_ADDR A:0xf9982454
y.create.l HWIO_PERIPH_SS_BAM_DMA_XPU_RG5_MCR_ADDR A:0xf99824d4
y.create.l HWIO_PERIPH_SS_BAM_DMA_XPU_RG6_MCR_ADDR A:0xf9982554
y.create.l HWIO_PERIPH_SS_BAM_DMA_XPU_RG7_MCR_ADDR A:0xf99825d4
y.create.l HWIO_PERIPH_SS_BAM_DMA_XPU_RG8_MCR_ADDR A:0xf9982654
y.create.l HWIO_PERIPH_SS_BAM_DMA_XPU_RG9_MCR_ADDR A:0xf99826d4
y.create.l HWIO_PERIPH_SS_BAM_DMA_VMIDMT_SCR0_ADDR A:0xf9980000
y.create.l HWIO_PERIPH_SS_BAM_DMA_VMIDMT_SCR1_ADDR A:0xf9980004
y.create.l HWIO_PERIPH_SS_BAM_DMA_VMIDMT_SCR2_ADDR A:0xf9980008
y.create.l HWIO_PERIPH_SS_BAM_DMA_VMIDMT_SACR_ADDR A:0xf9980010
y.create.l HWIO_PERIPH_SS_BAM_DMA_VMIDMT_SIDR0_ADDR A:0xf9980020
y.create.l HWIO_PERIPH_SS_BAM_DMA_VMIDMT_SIDR1_ADDR A:0xf9980024
y.create.l HWIO_PERIPH_SS_BAM_DMA_VMIDMT_SIDR2_ADDR A:0xf9980028
y.create.l HWIO_PERIPH_SS_BAM_DMA_VMIDMT_SIDR4_ADDR A:0xf9980030
y.create.l HWIO_PERIPH_SS_BAM_DMA_VMIDMT_SIDR5_ADDR A:0xf9980034
y.create.l HWIO_PERIPH_SS_BAM_DMA_VMIDMT_SIDR7_ADDR A:0xf998003c
y.create.l HWIO_PERIPH_SS_BAM_DMA_VMIDMT_SGFAR0_ADDR A:0xf9980040
y.create.l HWIO_PERIPH_SS_BAM_DMA_VMIDMT_SGFSR_ADDR A:0xf9980048
y.create.l HWIO_PERIPH_SS_BAM_DMA_VMIDMT_SGFSRRESTORE_ADDR A:0xf998004c
y.create.l HWIO_PERIPH_SS_BAM_DMA_VMIDMT_SGFSYNDR0_ADDR A:0xf9980050
y.create.l HWIO_PERIPH_SS_BAM_DMA_VMIDMT_SGFSYNDR1_ADDR A:0xf9980054
y.create.l HWIO_PERIPH_SS_BAM_DMA_VMIDMT_SGFSYNDR2_ADDR A:0xf9980058
y.create.l HWIO_PERIPH_SS_BAM_DMA_VMIDMT_VMIDMTSCR0_ADDR A:0xf9980090
y.create.l HWIO_PERIPH_SS_BAM_DMA_VMIDMT_CR0_ADDR A:0xf9980000
y.create.l HWIO_PERIPH_SS_BAM_DMA_VMIDMT_CR2_ADDR A:0xf9980008
y.create.l HWIO_PERIPH_SS_BAM_DMA_VMIDMT_ACR_ADDR A:0xf9980010
y.create.l HWIO_PERIPH_SS_BAM_DMA_VMIDMT_IDR0_ADDR A:0xf9980020
y.create.l HWIO_PERIPH_SS_BAM_DMA_VMIDMT_IDR1_ADDR A:0xf9980024
y.create.l HWIO_PERIPH_SS_BAM_DMA_VMIDMT_IDR2_ADDR A:0xf9980028
y.create.l HWIO_PERIPH_SS_BAM_DMA_VMIDMT_IDR4_ADDR A:0xf9980030
y.create.l HWIO_PERIPH_SS_BAM_DMA_VMIDMT_IDR5_ADDR A:0xf9980034
y.create.l HWIO_PERIPH_SS_BAM_DMA_VMIDMT_IDR7_ADDR A:0xf998003c
y.create.l HWIO_PERIPH_SS_BAM_DMA_VMIDMT_GFAR0_ADDR A:0xf9980040
y.create.l HWIO_PERIPH_SS_BAM_DMA_VMIDMT_GFSR_ADDR A:0xf9980048
y.create.l HWIO_PERIPH_SS_BAM_DMA_VMIDMT_GFSRRESTORE_ADDR A:0xf998004c
y.create.l HWIO_PERIPH_SS_BAM_DMA_VMIDMT_GFSYNDR0_ADDR A:0xf9980050
y.create.l HWIO_PERIPH_SS_BAM_DMA_VMIDMT_GFSYNDR1_ADDR A:0xf9980054
y.create.l HWIO_PERIPH_SS_BAM_DMA_VMIDMT_GFSYNDR2_ADDR A:0xf9980058
y.create.l HWIO_PERIPH_SS_BAM_DMA_VMIDMT_VMIDMTCR0_ADDR A:0xf9980090
y.create.l HWIO_PERIPH_SS_BAM_DMA_VMIDMT_VMIDMTACR_ADDR A:0xf998009c
y.create.l HWIO_PERIPH_SS_BAM_DMA_VMIDMT_NSCR0_ADDR A:0xf9980400
y.create.l HWIO_PERIPH_SS_BAM_DMA_VMIDMT_NSCR2_ADDR A:0xf9980408
y.create.l HWIO_PERIPH_SS_BAM_DMA_VMIDMT_NSACR_ADDR A:0xf9980410
y.create.l HWIO_PERIPH_SS_BAM_DMA_VMIDMT_NSGFAR0_ADDR A:0xf9980440
y.create.l HWIO_PERIPH_SS_BAM_DMA_VMIDMT_NSGFSR_ADDR A:0xf9980448
y.create.l HWIO_PERIPH_SS_BAM_DMA_VMIDMT_NSGFSRRESTORE_ADDR A:0xf998044c
y.create.l HWIO_PERIPH_SS_BAM_DMA_VMIDMT_NSGFSYNDR0_ADDR A:0xf9980450
y.create.l HWIO_PERIPH_SS_BAM_DMA_VMIDMT_NSGFSYNDR1_ADDR A:0xf9980454
y.create.l HWIO_PERIPH_SS_BAM_DMA_VMIDMT_NSGFSYNDR2_ADDR A:0xf9980458
y.create.l HWIO_PERIPH_SS_BAM_DMA_VMIDMT_NSVMIDMTCR0_ADDR A:0xf9980490
y.create.l HWIO_PERIPH_SS_BAM_DMA_VMIDMT_SSDR0_ADDR A:0xf9980080
y.create.l HWIO_PERIPH_SS_BAM_DMA_VMIDMT_MSDR0_ADDR A:0xf9980480
y.create.l HWIO_PERIPH_SS_BAM_DMA_VMIDMT_MCR_ADDR A:0xf9980494
y.create.l HWIO_PERIPH_SS_BAM_DMA_VMIDMT_S2VR0_ADDR A:0xf9980c00
y.create.l HWIO_PERIPH_SS_BAM_DMA_VMIDMT_S2VR1_ADDR A:0xf9980c04
y.create.l HWIO_PERIPH_SS_BAM_DMA_VMIDMT_S2VR2_ADDR A:0xf9980c08
y.create.l HWIO_PERIPH_SS_BAM_DMA_VMIDMT_S2VR3_ADDR A:0xf9980c0c
y.create.l HWIO_PERIPH_SS_BAM_DMA_VMIDMT_S2VR4_ADDR A:0xf9980c10
y.create.l HWIO_PERIPH_SS_BAM_DMA_VMIDMT_S2VR5_ADDR A:0xf9980c14
y.create.l HWIO_PERIPH_SS_BAM_DMA_VMIDMT_S2VR6_ADDR A:0xf9980c18
y.create.l HWIO_PERIPH_SS_BAM_DMA_VMIDMT_S2VR7_ADDR A:0xf9980c1c
y.create.l HWIO_PERIPH_SS_BAM_DMA_VMIDMT_S2VR8_ADDR A:0xf9980c20
y.create.l HWIO_PERIPH_SS_BAM_DMA_VMIDMT_S2VR9_ADDR A:0xf9980c24
y.create.l HWIO_PERIPH_SS_BAM_DMA_VMIDMT_AS2VR0_ADDR A:0xf9980e00
y.create.l HWIO_PERIPH_SS_BAM_DMA_VMIDMT_AS2VR1_ADDR A:0xf9980e04
y.create.l HWIO_PERIPH_SS_BAM_DMA_VMIDMT_AS2VR2_ADDR A:0xf9980e08
y.create.l HWIO_PERIPH_SS_BAM_DMA_VMIDMT_AS2VR3_ADDR A:0xf9980e0c
y.create.l HWIO_PERIPH_SS_BAM_DMA_VMIDMT_AS2VR4_ADDR A:0xf9980e10
y.create.l HWIO_PERIPH_SS_BAM_DMA_VMIDMT_AS2VR5_ADDR A:0xf9980e14
y.create.l HWIO_PERIPH_SS_BAM_DMA_VMIDMT_AS2VR6_ADDR A:0xf9980e18
y.create.l HWIO_PERIPH_SS_BAM_DMA_VMIDMT_AS2VR7_ADDR A:0xf9980e1c
y.create.l HWIO_PERIPH_SS_BAM_DMA_VMIDMT_AS2VR8_ADDR A:0xf9980e20
y.create.l HWIO_PERIPH_SS_BAM_DMA_VMIDMT_AS2VR9_ADDR A:0xf9980e24
y.create.l HWIO_PERIPH_SS_BAM_DMA_VMIDMT_SMR0_ADDR A:0xf9980800
y.create.l HWIO_PERIPH_SS_BAM_DMA_VMIDMT_SMR1_ADDR A:0xf9980804
y.create.l HWIO_PERIPH_SS_BAM_DMA_VMIDMT_SMR2_ADDR A:0xf9980808
y.create.l HWIO_PERIPH_SS_BAM_DMA_VMIDMT_SMR3_ADDR A:0xf998080c
y.create.l HWIO_PERIPH_SS_BAM_DMA_VMIDMT_SMR4_ADDR A:0xf9980810
y.create.l HWIO_PERIPH_SS_BAM_DMA_VMIDMT_SMR5_ADDR A:0xf9980814
y.create.l HWIO_PERIPH_SS_BAM_DMA_VMIDMT_SMR6_ADDR A:0xf9980818
y.create.l HWIO_PERIPH_SS_BAM_DMA_VMIDMT_SMR7_ADDR A:0xf998081c
y.create.l HWIO_PERIPH_SS_BAM_DMA_VMIDMT_SMR8_ADDR A:0xf9980820
y.create.l HWIO_PERIPH_SS_BAM_DMA_VMIDMT_SMR9_ADDR A:0xf9980824
y.create.l HWIO_PERIPH_SS_BAM_DMA_DMA_ENBL_ADDR A:0xf9999000
y.create.l HWIO_PERIPH_SS_BAM_DMA_DMA_CHNL_CONFIG0_ADDR A:0xf999a000
y.create.l HWIO_PERIPH_SS_BAM_DMA_DMA_CHNL_CONFIG1_ADDR A:0xf999b000
y.create.l HWIO_PERIPH_SS_BAM_DMA_DMA_CHNL_CONFIG2_ADDR A:0xf999c000
y.create.l HWIO_PERIPH_SS_BAM_DMA_DMA_CHNL_CONFIG3_ADDR A:0xf999d000
y.create.l HWIO_PERIPH_SS_BAM_DMA_DMA_CHNL_CONFIG4_ADDR A:0xf999e000
y.create.l HWIO_PERIPH_SS_BAM_DMA_DMA_CHNL_CONFIG5_ADDR A:0xf999f000
y.create.l HWIO_PERIPH_SS_BAM_DMA_DMA_CHNL_CONFIG6_ADDR A:0xf99a0000
y.create.l HWIO_PERIPH_SS_BAM_DMA_DMA_CHNL_CONFIG7_ADDR A:0xf99a1000
y.create.l HWIO_PERIPH_SS_BAM_DMA_DMA_CHNL_CONFIG8_ADDR A:0xf99a2000
y.create.l HWIO_PERIPH_SS_BAM_DMA_DMA_CHNL_CONFIG9_ADDR A:0xf99a3000
y.create.l HWIO_PERIPH_SS_BAM_DMA_DMA_REVISION_ADDR A:0xf9999004
y.create.l HWIO_PERIPH_SS_BAM_DMA_DMA_CONFIG_ADDR A:0xf9999008
y.create.l HWIO_PERIPH_SS_BAM_DMA_DMA_SW_VERSION_ADDR A:0xf999900c
y.create.l HWIO_PERIPH_SS_USB2_HSIC_USB_OTG_HS_ID_ADDR A:0xf9a15000
y.create.l HWIO_PERIPH_SS_USB2_HSIC_USB_OTG_HS_HWGENERAL_ADDR A:0xf9a15004
y.create.l HWIO_PERIPH_SS_USB2_HSIC_USB_OTG_HS_HWHOST_ADDR A:0xf9a15008
y.create.l HWIO_PERIPH_SS_USB2_HSIC_USB_OTG_HS_HWDEVICE_ADDR A:0xf9a1500c
y.create.l HWIO_PERIPH_SS_USB2_HSIC_USB_OTG_HS_HWTXBUF_ADDR A:0xf9a15010
y.create.l HWIO_PERIPH_SS_USB2_HSIC_USB_OTG_HS_HWRXBUF_ADDR A:0xf9a15014
y.create.l HWIO_PERIPH_SS_USB2_HSIC_USB_OTG_HS_SCRATCH_RAM0_ADDR A:0xf9a15040
y.create.l HWIO_PERIPH_SS_USB2_HSIC_USB_OTG_HS_SCRATCH_RAM1_ADDR A:0xf9a15044
y.create.l HWIO_PERIPH_SS_USB2_HSIC_USB_OTG_HS_SCRATCH_RAM2_ADDR A:0xf9a15048
y.create.l HWIO_PERIPH_SS_USB2_HSIC_USB_OTG_HS_SCRATCH_RAM3_ADDR A:0xf9a1504c
y.create.l HWIO_PERIPH_SS_USB2_HSIC_USB_OTG_HS_SCRATCH_RAM4_ADDR A:0xf9a15050
y.create.l HWIO_PERIPH_SS_USB2_HSIC_USB_OTG_HS_SCRATCH_RAM5_ADDR A:0xf9a15054
y.create.l HWIO_PERIPH_SS_USB2_HSIC_USB_OTG_HS_SCRATCH_RAM6_ADDR A:0xf9a15058
y.create.l HWIO_PERIPH_SS_USB2_HSIC_USB_OTG_HS_SCRATCH_RAM7_ADDR A:0xf9a1505c
y.create.l HWIO_PERIPH_SS_USB2_HSIC_USB_OTG_HS_SCRATCH_RAM8_ADDR A:0xf9a15060
y.create.l HWIO_PERIPH_SS_USB2_HSIC_USB_OTG_HS_SCRATCH_RAM9_ADDR A:0xf9a15064
y.create.l HWIO_PERIPH_SS_USB2_HSIC_USB_OTG_HS_GPTIMER0LD_ADDR A:0xf9a15080
y.create.l HWIO_PERIPH_SS_USB2_HSIC_USB_OTG_HS_GPTIMER0CTRL_ADDR A:0xf9a15084
y.create.l HWIO_PERIPH_SS_USB2_HSIC_USB_OTG_HS_GPTIMER1LD_ADDR A:0xf9a15088
y.create.l HWIO_PERIPH_SS_USB2_HSIC_USB_OTG_HS_GPTIMER1CTRL_ADDR A:0xf9a1508c
y.create.l HWIO_PERIPH_SS_USB2_HSIC_USB_OTG_HS_AHB_BURST_ADDR A:0xf9a15090
y.create.l HWIO_PERIPH_SS_USB2_HSIC_USB_OTG_HS_XTOR_STS_ADDR A:0xf9a15094
y.create.l HWIO_PERIPH_SS_USB2_HSIC_USB_OTG_HS_AHB_MODE_ADDR A:0xf9a15098
y.create.l HWIO_PERIPH_SS_USB2_HSIC_USB_OTG_HS_GEN_CONFIG_ADDR A:0xf9a1509c
y.create.l HWIO_PERIPH_SS_USB2_HSIC_USB_OTG_HS_GEN_CONFIG_2_ADDR A:0xf9a150a0
y.create.l HWIO_PERIPH_SS_USB2_HSIC_USB_OTG_HS_CAPLENGTH_ADDR A:0xf9a15100
y.create.l HWIO_PERIPH_SS_USB2_HSIC_USB_OTG_HS_HCSPARAMS_ADDR A:0xf9a15104
y.create.l HWIO_PERIPH_SS_USB2_HSIC_USB_OTG_HS_HCCPARAMS_ADDR A:0xf9a15108
y.create.l HWIO_PERIPH_SS_USB2_HSIC_USB_OTG_HS_DCIVERSION_ADDR A:0xf9a15120
y.create.l HWIO_PERIPH_SS_USB2_HSIC_USB_OTG_HS_DCCPARAMS_ADDR A:0xf9a15124
y.create.l HWIO_PERIPH_SS_USB2_HSIC_USB_OTG_HS_USBCMD_ADDR A:0xf9a15140
y.create.l HWIO_PERIPH_SS_USB2_HSIC_USB_OTG_HS_USBSTS_ADDR A:0xf9a15144
y.create.l HWIO_PERIPH_SS_USB2_HSIC_USB_OTG_HS_USBINTR_ADDR A:0xf9a15148
y.create.l HWIO_PERIPH_SS_USB2_HSIC_USB_OTG_HS_FRINDEX_ADDR A:0xf9a1514c
y.create.l HWIO_PERIPH_SS_USB2_HSIC_USB_OTG_HS_PERIODICLISTBASE_ADDR A:0xf9a15154
y.create.l HWIO_PERIPH_SS_USB2_HSIC_USB_OTG_HS_DEVICEADDR_ADDR A:0xf9a15154
y.create.l HWIO_PERIPH_SS_USB2_HSIC_USB_OTG_HS_ASYNCLISTADDR_ADDR A:0xf9a15158
y.create.l HWIO_PERIPH_SS_USB2_HSIC_USB_OTG_HS_ENDPOINTLISTADDR_ADDR A:0xf9a15158
y.create.l HWIO_PERIPH_SS_USB2_HSIC_USB_OTG_HS_TTCTRL_ADDR A:0xf9a1515c
y.create.l HWIO_PERIPH_SS_USB2_HSIC_USB_OTG_HS_BURSTSIZE_ADDR A:0xf9a15160
y.create.l HWIO_PERIPH_SS_USB2_HSIC_USB_OTG_HS_TXFILLTUNING_ADDR A:0xf9a15164
y.create.l HWIO_PERIPH_SS_USB2_HSIC_USB_OTG_HS_ULPI_VIEWPORT_ADDR A:0xf9a15170
y.create.l HWIO_PERIPH_SS_USB2_HSIC_USB_OTG_HS_ENDPTNAK_ADDR A:0xf9a15178
y.create.l HWIO_PERIPH_SS_USB2_HSIC_USB_OTG_HS_ENDPTNAKEN_ADDR A:0xf9a1517c
y.create.l HWIO_PERIPH_SS_USB2_HSIC_USB_OTG_HS_PORTSC_ADDR A:0xf9a15184
y.create.l HWIO_PERIPH_SS_USB2_HSIC_USB_OTG_HS_OTGSC_ADDR A:0xf9a151a4
y.create.l HWIO_PERIPH_SS_USB2_HSIC_USB_OTG_HS_USBMODE_ADDR A:0xf9a151a8
y.create.l HWIO_PERIPH_SS_USB2_HSIC_USB_OTG_HS_ENDPTSETUPSTAT_ADDR A:0xf9a151ac
y.create.l HWIO_PERIPH_SS_USB2_HSIC_USB_OTG_HS_ENDPTPRIME_ADDR A:0xf9a151b0
y.create.l HWIO_PERIPH_SS_USB2_HSIC_USB_OTG_HS_ENDPTFLUSH_ADDR A:0xf9a151b4
y.create.l HWIO_PERIPH_SS_USB2_HSIC_USB_OTG_HS_ENDPTSTAT_ADDR A:0xf9a151b8
y.create.l HWIO_PERIPH_SS_USB2_HSIC_USB_OTG_HS_ENDPTCOMPLETE_ADDR A:0xf9a151bc
y.create.l HWIO_PERIPH_SS_USB2_HSIC_USB_OTG_HS_ENDPTCTRL0_ADDR A:0xf9a151c0
y.create.l HWIO_PERIPH_SS_USB2_HSIC_USB_OTG_HS_ENDPTCTRL1_ADDR A:0xf9a151c4
y.create.l HWIO_PERIPH_SS_USB2_HSIC_USB_OTG_HS_ENDPTCTRL2_ADDR A:0xf9a151c8
y.create.l HWIO_PERIPH_SS_USB2_HSIC_USB_OTG_HS_ENDPTCTRL3_ADDR A:0xf9a151cc
y.create.l HWIO_PERIPH_SS_USB2_HSIC_USB_OTG_HS_ENDPTCTRL4_ADDR A:0xf9a151d0
y.create.l HWIO_PERIPH_SS_USB2_HSIC_USB_OTG_HS_ENDPTCTRL5_ADDR A:0xf9a151d4
y.create.l HWIO_PERIPH_SS_USB2_HSIC_USB_OTG_HS_ENDPTCTRL6_ADDR A:0xf9a151d8
y.create.l HWIO_PERIPH_SS_USB2_HSIC_USB_OTG_HS_ENDPTCTRL7_ADDR A:0xf9a151dc
y.create.l HWIO_PERIPH_SS_USB2_HSIC_USB_OTG_HS_ENDPTCTRL8_ADDR A:0xf9a151e0
y.create.l HWIO_PERIPH_SS_USB2_HSIC_USB_OTG_HS_ENDPTCTRL9_ADDR A:0xf9a151e4
y.create.l HWIO_PERIPH_SS_USB2_HSIC_USB_OTG_HS_ENDPTCTRL10_ADDR A:0xf9a151e8
y.create.l HWIO_PERIPH_SS_USB2_HSIC_USB_OTG_HS_ENDPT_PIPE_ID1_ADDR A:0xf9a15200
y.create.l HWIO_PERIPH_SS_USB2_HSIC_USB_OTG_HS_ENDPT_PIPE_ID2_ADDR A:0xf9a15204
y.create.l HWIO_PERIPH_SS_USB2_HSIC_USB_OTG_HS_ENDPT_PIPE_ID3_ADDR A:0xf9a15208
y.create.l HWIO_PERIPH_SS_USB2_HSIC_USB_OTG_HS_ENDPT_PIPE_ID4_ADDR A:0xf9a1520c
y.create.l HWIO_PERIPH_SS_USB2_HSIC_USB_OTG_HS_ENDPT_PIPE_ID5_ADDR A:0xf9a15210
y.create.l HWIO_PERIPH_SS_USB2_HSIC_USB_OTG_HS_ENDPT_PIPE_ID6_ADDR A:0xf9a15214
y.create.l HWIO_PERIPH_SS_USB2_HSIC_USB_OTG_HS_ENDPT_PIPE_ID7_ADDR A:0xf9a15218
y.create.l HWIO_PERIPH_SS_USB2_HSIC_USB_OTG_HS_ENDPT_PIPE_ID8_ADDR A:0xf9a1521c
y.create.l HWIO_PERIPH_SS_USB2_HSIC_USB_OTG_HS_ENDPT_PIPE_ID9_ADDR A:0xf9a15220
y.create.l HWIO_PERIPH_SS_USB2_HSIC_USB_OTG_HS_ENDPT_PIPE_ID10_ADDR A:0xf9a15224
y.create.l HWIO_PERIPH_SS_USB2_HSIC_USB_OTG_HS_GENERIC1_ADDR A:0xf9a15244
y.create.l HWIO_PERIPH_SS_USB2_HSIC_USB_OTG_HS_GENERIC2_ADDR A:0xf9a15248
y.create.l HWIO_PERIPH_SS_USB2_HSIC_USB_OTG_HS_L1_EP_CTRL_ADDR A:0xf9a15250
y.create.l HWIO_PERIPH_SS_USB2_HSIC_USB_OTG_HS_L1_CONFIG_ADDR A:0xf9a15254
y.create.l HWIO_PERIPH_SS_USB2_HSIC_USB_OTG_HS_LPM_DEBUG_1_ADDR A:0xf9a15258
y.create.l HWIO_PERIPH_SS_USB2_HSIC_USB_OTG_HS_LPM_DEBUG_2_ADDR A:0xf9a1525c
y.create.l HWIO_PERIPH_SS_USB2_HSIC_USB_OTG_HS_LPM_ATTRIBUTES_ADDR A:0xf9a15260
y.create.l HWIO_PERIPH_SS_USB2_HSIC_USB_OTG_HS_HW_VER_ADDR A:0xf9a15270
y.create.l HWIO_PERIPH_SS_USB2_HSIC_USB_OTG_HS_TEST_BUS_ADDR A:0xf9a15274
y.create.l HWIO_PERIPH_SS_USB2_HSIC_USB_OTG_HS_HBM_CFG_ADDR A:0xf9a15290
y.create.l HWIO_PERIPH_SS_USB2_HSIC_USB_OTG_HS_HBM_QH_MAP_PIPE0_ADDR A:0xf9a15294
y.create.l HWIO_PERIPH_SS_USB2_HSIC_USB_OTG_HS_HBM_QH_MAP_PIPE1_ADDR A:0xf9a15298
y.create.l HWIO_PERIPH_SS_USB2_HSIC_USB_OTG_HS_HBM_QH_MAP_PIPE2_ADDR A:0xf9a1529c
y.create.l HWIO_PERIPH_SS_USB2_HSIC_USB_OTG_HS_HBM_QH_MAP_PIPE3_ADDR A:0xf9a152a0
y.create.l HWIO_PERIPH_SS_USB2_HSIC_USB_OTG_HS_HBM_QH_MAP_PIPE4_ADDR A:0xf9a152a4
y.create.l HWIO_PERIPH_SS_USB2_HSIC_USB_OTG_HS_HBM_QH_MAP_PIPE5_ADDR A:0xf9a152a8
y.create.l HWIO_PERIPH_SS_USB2_HSIC_USB_OTG_HS_HBM_QH_MAP_PIPE6_ADDR A:0xf9a152ac
y.create.l HWIO_PERIPH_SS_USB2_HSIC_USB_OTG_HS_HBM_QH_MAP_PIPE7_ADDR A:0xf9a152b0
y.create.l HWIO_PERIPH_SS_USB2_HSIC_USB_OTG_HS_HBM_QH_MAP_PIPE8_ADDR A:0xf9a152b4
y.create.l HWIO_PERIPH_SS_USB2_HSIC_USB_OTG_HS_HBM_QH_MAP_PIPE9_ADDR A:0xf9a152b8
y.create.l HWIO_PERIPH_SS_USB2_HSIC_USB_OTG_HS_HBM_PIPE_EN_ADDR A:0xf9a15310
y.create.l HWIO_PERIPH_SS_USB2_HSIC_USB_OTG_HS_HBM_PIPE_PRODUCER_ADDR A:0xf9a15314
y.create.l HWIO_PERIPH_SS_USB2_HSIC_USB_OTG_HS_HBM_PARK_MODE_DISABLE_ADDR A:0xf9a15318
y.create.l HWIO_PERIPH_SS_USB2_HSIC_USB_OTG_HS_HBM_PIPE_ZLT_DISABLE_ADDR A:0xf9a1531c
y.create.l HWIO_PERIPH_SS_USB2_HSIC_USB_OTG_HS_HBM_SB_SW_RST_ADDR A:0xf9a15320
y.create.l HWIO_PERIPH_SS_USB2_HSIC_USB_OTG_HS_HBM_SW_RST_ADDR A:0xf9a15324
y.create.l HWIO_PERIPH_SS_USB2_HSIC_BAM_CTRL_ADDR A:0xf9a04000
y.create.l HWIO_PERIPH_SS_USB2_HSIC_BAM_REVISION_ADDR A:0xf9a04004
y.create.l HWIO_PERIPH_SS_USB2_HSIC_BAM_SW_VERSION_ADDR A:0xf9a04080
y.create.l HWIO_PERIPH_SS_USB2_HSIC_BAM_NUM_PIPES_ADDR A:0xf9a0403c
y.create.l HWIO_PERIPH_SS_USB2_HSIC_BAM_TIMER_ADDR A:0xf9a04040
y.create.l HWIO_PERIPH_SS_USB2_HSIC_BAM_TIMER_CTRL_ADDR A:0xf9a04044
y.create.l HWIO_PERIPH_SS_USB2_HSIC_BAM_DESC_CNT_TRSHLD_ADDR A:0xf9a04008
y.create.l HWIO_PERIPH_SS_USB2_HSIC_BAM_IRQ_SRCS_ADDR A:0xf9a0400c
y.create.l HWIO_PERIPH_SS_USB2_HSIC_BAM_IRQ_SRCS_MSK_ADDR A:0xf9a04010
y.create.l HWIO_PERIPH_SS_USB2_HSIC_BAM_IRQ_SRCS_UNMASKED_ADDR A:0xf9a04030
y.create.l HWIO_PERIPH_SS_USB2_HSIC_BAM_IRQ_STTS_ADDR A:0xf9a04014
y.create.l HWIO_PERIPH_SS_USB2_HSIC_BAM_IRQ_CLR_ADDR A:0xf9a04018
y.create.l HWIO_PERIPH_SS_USB2_HSIC_BAM_IRQ_EN_ADDR A:0xf9a0401c
y.create.l HWIO_PERIPH_SS_USB2_HSIC_BAM_AHB_MASTER_ERR_CTRLS_ADDR A:0xf9a04024
y.create.l HWIO_PERIPH_SS_USB2_HSIC_BAM_AHB_MASTER_ERR_ADDR_ADDR A:0xf9a04028
y.create.l HWIO_PERIPH_SS_USB2_HSIC_BAM_AHB_MASTER_ERR_DATA_ADDR A:0xf9a0402c
y.create.l HWIO_PERIPH_SS_USB2_HSIC_BAM_TRUST_REG_ADDR A:0xf9a04070
y.create.l HWIO_PERIPH_SS_USB2_HSIC_BAM_TEST_BUS_SEL_ADDR A:0xf9a04074
y.create.l HWIO_PERIPH_SS_USB2_HSIC_BAM_TEST_BUS_REG_ADDR A:0xf9a04078
y.create.l HWIO_PERIPH_SS_USB2_HSIC_BAM_CNFG_BITS_ADDR A:0xf9a0407c
y.create.l HWIO_PERIPH_SS_USB2_HSIC_BAM_IRQ_SRCS_EE0_ADDR A:0xf9a04800
y.create.l HWIO_PERIPH_SS_USB2_HSIC_BAM_IRQ_SRCS_EE1_ADDR A:0xf9a04880
y.create.l HWIO_PERIPH_SS_USB2_HSIC_BAM_IRQ_SRCS_EE2_ADDR A:0xf9a04900
y.create.l HWIO_PERIPH_SS_USB2_HSIC_BAM_IRQ_SRCS_EE3_ADDR A:0xf9a04980
y.create.l HWIO_PERIPH_SS_USB2_HSIC_BAM_IRQ_SRCS_EE4_ADDR A:0xf9a04a00
y.create.l HWIO_PERIPH_SS_USB2_HSIC_BAM_IRQ_SRCS_EE5_ADDR A:0xf9a04a80
y.create.l HWIO_PERIPH_SS_USB2_HSIC_BAM_IRQ_SRCS_EE6_ADDR A:0xf9a04b00
y.create.l HWIO_PERIPH_SS_USB2_HSIC_BAM_IRQ_SRCS_EE7_ADDR A:0xf9a04b80
y.create.l HWIO_PERIPH_SS_USB2_HSIC_BAM_IRQ_SRCS_MSK_EE0_ADDR A:0xf9a04804
y.create.l HWIO_PERIPH_SS_USB2_HSIC_BAM_IRQ_SRCS_MSK_EE1_ADDR A:0xf9a04884
y.create.l HWIO_PERIPH_SS_USB2_HSIC_BAM_IRQ_SRCS_MSK_EE2_ADDR A:0xf9a04904
y.create.l HWIO_PERIPH_SS_USB2_HSIC_BAM_IRQ_SRCS_MSK_EE3_ADDR A:0xf9a04984
y.create.l HWIO_PERIPH_SS_USB2_HSIC_BAM_IRQ_SRCS_MSK_EE4_ADDR A:0xf9a04a04
y.create.l HWIO_PERIPH_SS_USB2_HSIC_BAM_IRQ_SRCS_MSK_EE5_ADDR A:0xf9a04a84
y.create.l HWIO_PERIPH_SS_USB2_HSIC_BAM_IRQ_SRCS_MSK_EE6_ADDR A:0xf9a04b04
y.create.l HWIO_PERIPH_SS_USB2_HSIC_BAM_IRQ_SRCS_MSK_EE7_ADDR A:0xf9a04b84
y.create.l HWIO_PERIPH_SS_USB2_HSIC_BAM_IRQ_SRCS_UNMASKED_EE0_ADDR A:0xf9a04808
y.create.l HWIO_PERIPH_SS_USB2_HSIC_BAM_IRQ_SRCS_UNMASKED_EE1_ADDR A:0xf9a04888
y.create.l HWIO_PERIPH_SS_USB2_HSIC_BAM_IRQ_SRCS_UNMASKED_EE2_ADDR A:0xf9a04908
y.create.l HWIO_PERIPH_SS_USB2_HSIC_BAM_IRQ_SRCS_UNMASKED_EE3_ADDR A:0xf9a04988
y.create.l HWIO_PERIPH_SS_USB2_HSIC_BAM_IRQ_SRCS_UNMASKED_EE4_ADDR A:0xf9a04a08
y.create.l HWIO_PERIPH_SS_USB2_HSIC_BAM_IRQ_SRCS_UNMASKED_EE5_ADDR A:0xf9a04a88
y.create.l HWIO_PERIPH_SS_USB2_HSIC_BAM_IRQ_SRCS_UNMASKED_EE6_ADDR A:0xf9a04b08
y.create.l HWIO_PERIPH_SS_USB2_HSIC_BAM_IRQ_SRCS_UNMASKED_EE7_ADDR A:0xf9a04b88
y.create.l HWIO_PERIPH_SS_USB2_HSIC_BAM_P_CTRL0_ADDR A:0xf9a05000
y.create.l HWIO_PERIPH_SS_USB2_HSIC_BAM_P_CTRL1_ADDR A:0xf9a06000
y.create.l HWIO_PERIPH_SS_USB2_HSIC_BAM_P_CTRL2_ADDR A:0xf9a07000
y.create.l HWIO_PERIPH_SS_USB2_HSIC_BAM_P_CTRL3_ADDR A:0xf9a08000
y.create.l HWIO_PERIPH_SS_USB2_HSIC_BAM_P_CTRL4_ADDR A:0xf9a09000
y.create.l HWIO_PERIPH_SS_USB2_HSIC_BAM_P_CTRL5_ADDR A:0xf9a0a000
y.create.l HWIO_PERIPH_SS_USB2_HSIC_BAM_P_CTRL6_ADDR A:0xf9a0b000
y.create.l HWIO_PERIPH_SS_USB2_HSIC_BAM_P_CTRL7_ADDR A:0xf9a0c000
y.create.l HWIO_PERIPH_SS_USB2_HSIC_BAM_P_CTRL8_ADDR A:0xf9a0d000
y.create.l HWIO_PERIPH_SS_USB2_HSIC_BAM_P_CTRL9_ADDR A:0xf9a0e000
y.create.l HWIO_PERIPH_SS_USB2_HSIC_BAM_P_RST0_ADDR A:0xf9a05004
y.create.l HWIO_PERIPH_SS_USB2_HSIC_BAM_P_RST1_ADDR A:0xf9a06004
y.create.l HWIO_PERIPH_SS_USB2_HSIC_BAM_P_RST2_ADDR A:0xf9a07004
y.create.l HWIO_PERIPH_SS_USB2_HSIC_BAM_P_RST3_ADDR A:0xf9a08004
y.create.l HWIO_PERIPH_SS_USB2_HSIC_BAM_P_RST4_ADDR A:0xf9a09004
y.create.l HWIO_PERIPH_SS_USB2_HSIC_BAM_P_RST5_ADDR A:0xf9a0a004
y.create.l HWIO_PERIPH_SS_USB2_HSIC_BAM_P_RST6_ADDR A:0xf9a0b004
y.create.l HWIO_PERIPH_SS_USB2_HSIC_BAM_P_RST7_ADDR A:0xf9a0c004
y.create.l HWIO_PERIPH_SS_USB2_HSIC_BAM_P_RST8_ADDR A:0xf9a0d004
y.create.l HWIO_PERIPH_SS_USB2_HSIC_BAM_P_RST9_ADDR A:0xf9a0e004
y.create.l HWIO_PERIPH_SS_USB2_HSIC_BAM_P_HALT0_ADDR A:0xf9a05008
y.create.l HWIO_PERIPH_SS_USB2_HSIC_BAM_P_HALT1_ADDR A:0xf9a06008
y.create.l HWIO_PERIPH_SS_USB2_HSIC_BAM_P_HALT2_ADDR A:0xf9a07008
y.create.l HWIO_PERIPH_SS_USB2_HSIC_BAM_P_HALT3_ADDR A:0xf9a08008
y.create.l HWIO_PERIPH_SS_USB2_HSIC_BAM_P_HALT4_ADDR A:0xf9a09008
y.create.l HWIO_PERIPH_SS_USB2_HSIC_BAM_P_HALT5_ADDR A:0xf9a0a008
y.create.l HWIO_PERIPH_SS_USB2_HSIC_BAM_P_HALT6_ADDR A:0xf9a0b008
y.create.l HWIO_PERIPH_SS_USB2_HSIC_BAM_P_HALT7_ADDR A:0xf9a0c008
y.create.l HWIO_PERIPH_SS_USB2_HSIC_BAM_P_HALT8_ADDR A:0xf9a0d008
y.create.l HWIO_PERIPH_SS_USB2_HSIC_BAM_P_HALT9_ADDR A:0xf9a0e008
y.create.l HWIO_PERIPH_SS_USB2_HSIC_BAM_P_TRUST_REG0_ADDR A:0xf9a05030
y.create.l HWIO_PERIPH_SS_USB2_HSIC_BAM_P_TRUST_REG1_ADDR A:0xf9a06030
y.create.l HWIO_PERIPH_SS_USB2_HSIC_BAM_P_TRUST_REG2_ADDR A:0xf9a07030
y.create.l HWIO_PERIPH_SS_USB2_HSIC_BAM_P_TRUST_REG3_ADDR A:0xf9a08030
y.create.l HWIO_PERIPH_SS_USB2_HSIC_BAM_P_TRUST_REG4_ADDR A:0xf9a09030
y.create.l HWIO_PERIPH_SS_USB2_HSIC_BAM_P_TRUST_REG5_ADDR A:0xf9a0a030
y.create.l HWIO_PERIPH_SS_USB2_HSIC_BAM_P_TRUST_REG6_ADDR A:0xf9a0b030
y.create.l HWIO_PERIPH_SS_USB2_HSIC_BAM_P_TRUST_REG7_ADDR A:0xf9a0c030
y.create.l HWIO_PERIPH_SS_USB2_HSIC_BAM_P_TRUST_REG8_ADDR A:0xf9a0d030
y.create.l HWIO_PERIPH_SS_USB2_HSIC_BAM_P_TRUST_REG9_ADDR A:0xf9a0e030
y.create.l HWIO_PERIPH_SS_USB2_HSIC_BAM_P_IRQ_STTS0_ADDR A:0xf9a05010
y.create.l HWIO_PERIPH_SS_USB2_HSIC_BAM_P_IRQ_STTS1_ADDR A:0xf9a06010
y.create.l HWIO_PERIPH_SS_USB2_HSIC_BAM_P_IRQ_STTS2_ADDR A:0xf9a07010
y.create.l HWIO_PERIPH_SS_USB2_HSIC_BAM_P_IRQ_STTS3_ADDR A:0xf9a08010
y.create.l HWIO_PERIPH_SS_USB2_HSIC_BAM_P_IRQ_STTS4_ADDR A:0xf9a09010
y.create.l HWIO_PERIPH_SS_USB2_HSIC_BAM_P_IRQ_STTS5_ADDR A:0xf9a0a010
y.create.l HWIO_PERIPH_SS_USB2_HSIC_BAM_P_IRQ_STTS6_ADDR A:0xf9a0b010
y.create.l HWIO_PERIPH_SS_USB2_HSIC_BAM_P_IRQ_STTS7_ADDR A:0xf9a0c010
y.create.l HWIO_PERIPH_SS_USB2_HSIC_BAM_P_IRQ_STTS8_ADDR A:0xf9a0d010
y.create.l HWIO_PERIPH_SS_USB2_HSIC_BAM_P_IRQ_STTS9_ADDR A:0xf9a0e010
y.create.l HWIO_PERIPH_SS_USB2_HSIC_BAM_P_IRQ_CLR0_ADDR A:0xf9a05014
y.create.l HWIO_PERIPH_SS_USB2_HSIC_BAM_P_IRQ_CLR1_ADDR A:0xf9a06014
y.create.l HWIO_PERIPH_SS_USB2_HSIC_BAM_P_IRQ_CLR2_ADDR A:0xf9a07014
y.create.l HWIO_PERIPH_SS_USB2_HSIC_BAM_P_IRQ_CLR3_ADDR A:0xf9a08014
y.create.l HWIO_PERIPH_SS_USB2_HSIC_BAM_P_IRQ_CLR4_ADDR A:0xf9a09014
y.create.l HWIO_PERIPH_SS_USB2_HSIC_BAM_P_IRQ_CLR5_ADDR A:0xf9a0a014
y.create.l HWIO_PERIPH_SS_USB2_HSIC_BAM_P_IRQ_CLR6_ADDR A:0xf9a0b014
y.create.l HWIO_PERIPH_SS_USB2_HSIC_BAM_P_IRQ_CLR7_ADDR A:0xf9a0c014
y.create.l HWIO_PERIPH_SS_USB2_HSIC_BAM_P_IRQ_CLR8_ADDR A:0xf9a0d014
y.create.l HWIO_PERIPH_SS_USB2_HSIC_BAM_P_IRQ_CLR9_ADDR A:0xf9a0e014
y.create.l HWIO_PERIPH_SS_USB2_HSIC_BAM_P_IRQ_EN0_ADDR A:0xf9a05018
y.create.l HWIO_PERIPH_SS_USB2_HSIC_BAM_P_IRQ_EN1_ADDR A:0xf9a06018
y.create.l HWIO_PERIPH_SS_USB2_HSIC_BAM_P_IRQ_EN2_ADDR A:0xf9a07018
y.create.l HWIO_PERIPH_SS_USB2_HSIC_BAM_P_IRQ_EN3_ADDR A:0xf9a08018
y.create.l HWIO_PERIPH_SS_USB2_HSIC_BAM_P_IRQ_EN4_ADDR A:0xf9a09018
y.create.l HWIO_PERIPH_SS_USB2_HSIC_BAM_P_IRQ_EN5_ADDR A:0xf9a0a018
y.create.l HWIO_PERIPH_SS_USB2_HSIC_BAM_P_IRQ_EN6_ADDR A:0xf9a0b018
y.create.l HWIO_PERIPH_SS_USB2_HSIC_BAM_P_IRQ_EN7_ADDR A:0xf9a0c018
y.create.l HWIO_PERIPH_SS_USB2_HSIC_BAM_P_IRQ_EN8_ADDR A:0xf9a0d018
y.create.l HWIO_PERIPH_SS_USB2_HSIC_BAM_P_IRQ_EN9_ADDR A:0xf9a0e018
y.create.l HWIO_PERIPH_SS_USB2_HSIC_BAM_P_TIMER0_ADDR A:0xf9a0501c
y.create.l HWIO_PERIPH_SS_USB2_HSIC_BAM_P_TIMER1_ADDR A:0xf9a0601c
y.create.l HWIO_PERIPH_SS_USB2_HSIC_BAM_P_TIMER2_ADDR A:0xf9a0701c
y.create.l HWIO_PERIPH_SS_USB2_HSIC_BAM_P_TIMER3_ADDR A:0xf9a0801c
y.create.l HWIO_PERIPH_SS_USB2_HSIC_BAM_P_TIMER4_ADDR A:0xf9a0901c
y.create.l HWIO_PERIPH_SS_USB2_HSIC_BAM_P_TIMER5_ADDR A:0xf9a0a01c
y.create.l HWIO_PERIPH_SS_USB2_HSIC_BAM_P_TIMER6_ADDR A:0xf9a0b01c
y.create.l HWIO_PERIPH_SS_USB2_HSIC_BAM_P_TIMER7_ADDR A:0xf9a0c01c
y.create.l HWIO_PERIPH_SS_USB2_HSIC_BAM_P_TIMER8_ADDR A:0xf9a0d01c
y.create.l HWIO_PERIPH_SS_USB2_HSIC_BAM_P_TIMER9_ADDR A:0xf9a0e01c
y.create.l HWIO_PERIPH_SS_USB2_HSIC_BAM_P_TIMER_CTRL0_ADDR A:0xf9a05020
y.create.l HWIO_PERIPH_SS_USB2_HSIC_BAM_P_TIMER_CTRL1_ADDR A:0xf9a06020
y.create.l HWIO_PERIPH_SS_USB2_HSIC_BAM_P_TIMER_CTRL2_ADDR A:0xf9a07020
y.create.l HWIO_PERIPH_SS_USB2_HSIC_BAM_P_TIMER_CTRL3_ADDR A:0xf9a08020
y.create.l HWIO_PERIPH_SS_USB2_HSIC_BAM_P_TIMER_CTRL4_ADDR A:0xf9a09020
y.create.l HWIO_PERIPH_SS_USB2_HSIC_BAM_P_TIMER_CTRL5_ADDR A:0xf9a0a020
y.create.l HWIO_PERIPH_SS_USB2_HSIC_BAM_P_TIMER_CTRL6_ADDR A:0xf9a0b020
y.create.l HWIO_PERIPH_SS_USB2_HSIC_BAM_P_TIMER_CTRL7_ADDR A:0xf9a0c020
y.create.l HWIO_PERIPH_SS_USB2_HSIC_BAM_P_TIMER_CTRL8_ADDR A:0xf9a0d020
y.create.l HWIO_PERIPH_SS_USB2_HSIC_BAM_P_TIMER_CTRL9_ADDR A:0xf9a0e020
y.create.l HWIO_PERIPH_SS_USB2_HSIC_BAM_P_PRDCR_SDBND0_ADDR A:0xf9a05024
y.create.l HWIO_PERIPH_SS_USB2_HSIC_BAM_P_PRDCR_SDBND1_ADDR A:0xf9a06024
y.create.l HWIO_PERIPH_SS_USB2_HSIC_BAM_P_PRDCR_SDBND2_ADDR A:0xf9a07024
y.create.l HWIO_PERIPH_SS_USB2_HSIC_BAM_P_PRDCR_SDBND3_ADDR A:0xf9a08024
y.create.l HWIO_PERIPH_SS_USB2_HSIC_BAM_P_PRDCR_SDBND4_ADDR A:0xf9a09024
y.create.l HWIO_PERIPH_SS_USB2_HSIC_BAM_P_PRDCR_SDBND5_ADDR A:0xf9a0a024
y.create.l HWIO_PERIPH_SS_USB2_HSIC_BAM_P_PRDCR_SDBND6_ADDR A:0xf9a0b024
y.create.l HWIO_PERIPH_SS_USB2_HSIC_BAM_P_PRDCR_SDBND7_ADDR A:0xf9a0c024
y.create.l HWIO_PERIPH_SS_USB2_HSIC_BAM_P_PRDCR_SDBND8_ADDR A:0xf9a0d024
y.create.l HWIO_PERIPH_SS_USB2_HSIC_BAM_P_PRDCR_SDBND9_ADDR A:0xf9a0e024
y.create.l HWIO_PERIPH_SS_USB2_HSIC_BAM_P_CNSMR_SDBND0_ADDR A:0xf9a05028
y.create.l HWIO_PERIPH_SS_USB2_HSIC_BAM_P_CNSMR_SDBND1_ADDR A:0xf9a06028
y.create.l HWIO_PERIPH_SS_USB2_HSIC_BAM_P_CNSMR_SDBND2_ADDR A:0xf9a07028
y.create.l HWIO_PERIPH_SS_USB2_HSIC_BAM_P_CNSMR_SDBND3_ADDR A:0xf9a08028
y.create.l HWIO_PERIPH_SS_USB2_HSIC_BAM_P_CNSMR_SDBND4_ADDR A:0xf9a09028
y.create.l HWIO_PERIPH_SS_USB2_HSIC_BAM_P_CNSMR_SDBND5_ADDR A:0xf9a0a028
y.create.l HWIO_PERIPH_SS_USB2_HSIC_BAM_P_CNSMR_SDBND6_ADDR A:0xf9a0b028
y.create.l HWIO_PERIPH_SS_USB2_HSIC_BAM_P_CNSMR_SDBND7_ADDR A:0xf9a0c028
y.create.l HWIO_PERIPH_SS_USB2_HSIC_BAM_P_CNSMR_SDBND8_ADDR A:0xf9a0d028
y.create.l HWIO_PERIPH_SS_USB2_HSIC_BAM_P_CNSMR_SDBND9_ADDR A:0xf9a0e028
y.create.l HWIO_PERIPH_SS_USB2_HSIC_BAM_P_EVNT_DEST_ADDR0_ADDR A:0xf9a0582c
y.create.l HWIO_PERIPH_SS_USB2_HSIC_BAM_P_EVNT_DEST_ADDR1_ADDR A:0xf9a0682c
y.create.l HWIO_PERIPH_SS_USB2_HSIC_BAM_P_EVNT_DEST_ADDR2_ADDR A:0xf9a0782c
y.create.l HWIO_PERIPH_SS_USB2_HSIC_BAM_P_EVNT_DEST_ADDR3_ADDR A:0xf9a0882c
y.create.l HWIO_PERIPH_SS_USB2_HSIC_BAM_P_EVNT_DEST_ADDR4_ADDR A:0xf9a0982c
y.create.l HWIO_PERIPH_SS_USB2_HSIC_BAM_P_EVNT_DEST_ADDR5_ADDR A:0xf9a0a82c
y.create.l HWIO_PERIPH_SS_USB2_HSIC_BAM_P_EVNT_DEST_ADDR6_ADDR A:0xf9a0b82c
y.create.l HWIO_PERIPH_SS_USB2_HSIC_BAM_P_EVNT_DEST_ADDR7_ADDR A:0xf9a0c82c
y.create.l HWIO_PERIPH_SS_USB2_HSIC_BAM_P_EVNT_DEST_ADDR8_ADDR A:0xf9a0d82c
y.create.l HWIO_PERIPH_SS_USB2_HSIC_BAM_P_EVNT_DEST_ADDR9_ADDR A:0xf9a0e82c
y.create.l HWIO_PERIPH_SS_USB2_HSIC_BAM_P_EVNT_REG0_ADDR A:0xf9a05818
y.create.l HWIO_PERIPH_SS_USB2_HSIC_BAM_P_EVNT_REG1_ADDR A:0xf9a06818
y.create.l HWIO_PERIPH_SS_USB2_HSIC_BAM_P_EVNT_REG2_ADDR A:0xf9a07818
y.create.l HWIO_PERIPH_SS_USB2_HSIC_BAM_P_EVNT_REG3_ADDR A:0xf9a08818
y.create.l HWIO_PERIPH_SS_USB2_HSIC_BAM_P_EVNT_REG4_ADDR A:0xf9a09818
y.create.l HWIO_PERIPH_SS_USB2_HSIC_BAM_P_EVNT_REG5_ADDR A:0xf9a0a818
y.create.l HWIO_PERIPH_SS_USB2_HSIC_BAM_P_EVNT_REG6_ADDR A:0xf9a0b818
y.create.l HWIO_PERIPH_SS_USB2_HSIC_BAM_P_EVNT_REG7_ADDR A:0xf9a0c818
y.create.l HWIO_PERIPH_SS_USB2_HSIC_BAM_P_EVNT_REG8_ADDR A:0xf9a0d818
y.create.l HWIO_PERIPH_SS_USB2_HSIC_BAM_P_EVNT_REG9_ADDR A:0xf9a0e818
y.create.l HWIO_PERIPH_SS_USB2_HSIC_BAM_P_SW_OFSTS0_ADDR A:0xf9a05800
y.create.l HWIO_PERIPH_SS_USB2_HSIC_BAM_P_SW_OFSTS1_ADDR A:0xf9a06800
y.create.l HWIO_PERIPH_SS_USB2_HSIC_BAM_P_SW_OFSTS2_ADDR A:0xf9a07800
y.create.l HWIO_PERIPH_SS_USB2_HSIC_BAM_P_SW_OFSTS3_ADDR A:0xf9a08800
y.create.l HWIO_PERIPH_SS_USB2_HSIC_BAM_P_SW_OFSTS4_ADDR A:0xf9a09800
y.create.l HWIO_PERIPH_SS_USB2_HSIC_BAM_P_SW_OFSTS5_ADDR A:0xf9a0a800
y.create.l HWIO_PERIPH_SS_USB2_HSIC_BAM_P_SW_OFSTS6_ADDR A:0xf9a0b800
y.create.l HWIO_PERIPH_SS_USB2_HSIC_BAM_P_SW_OFSTS7_ADDR A:0xf9a0c800
y.create.l HWIO_PERIPH_SS_USB2_HSIC_BAM_P_SW_OFSTS8_ADDR A:0xf9a0d800
y.create.l HWIO_PERIPH_SS_USB2_HSIC_BAM_P_SW_OFSTS9_ADDR A:0xf9a0e800
y.create.l HWIO_PERIPH_SS_USB2_HSIC_BAM_P_DATA_FIFO_ADDR0_ADDR A:0xf9a05824
y.create.l HWIO_PERIPH_SS_USB2_HSIC_BAM_P_DATA_FIFO_ADDR1_ADDR A:0xf9a06824
y.create.l HWIO_PERIPH_SS_USB2_HSIC_BAM_P_DATA_FIFO_ADDR2_ADDR A:0xf9a07824
y.create.l HWIO_PERIPH_SS_USB2_HSIC_BAM_P_DATA_FIFO_ADDR3_ADDR A:0xf9a08824
y.create.l HWIO_PERIPH_SS_USB2_HSIC_BAM_P_DATA_FIFO_ADDR4_ADDR A:0xf9a09824
y.create.l HWIO_PERIPH_SS_USB2_HSIC_BAM_P_DATA_FIFO_ADDR5_ADDR A:0xf9a0a824
y.create.l HWIO_PERIPH_SS_USB2_HSIC_BAM_P_DATA_FIFO_ADDR6_ADDR A:0xf9a0b824
y.create.l HWIO_PERIPH_SS_USB2_HSIC_BAM_P_DATA_FIFO_ADDR7_ADDR A:0xf9a0c824
y.create.l HWIO_PERIPH_SS_USB2_HSIC_BAM_P_DATA_FIFO_ADDR8_ADDR A:0xf9a0d824
y.create.l HWIO_PERIPH_SS_USB2_HSIC_BAM_P_DATA_FIFO_ADDR9_ADDR A:0xf9a0e824
y.create.l HWIO_PERIPH_SS_USB2_HSIC_BAM_P_DESC_FIFO_ADDR0_ADDR A:0xf9a0581c
y.create.l HWIO_PERIPH_SS_USB2_HSIC_BAM_P_DESC_FIFO_ADDR1_ADDR A:0xf9a0681c
y.create.l HWIO_PERIPH_SS_USB2_HSIC_BAM_P_DESC_FIFO_ADDR2_ADDR A:0xf9a0781c
y.create.l HWIO_PERIPH_SS_USB2_HSIC_BAM_P_DESC_FIFO_ADDR3_ADDR A:0xf9a0881c
y.create.l HWIO_PERIPH_SS_USB2_HSIC_BAM_P_DESC_FIFO_ADDR4_ADDR A:0xf9a0981c
y.create.l HWIO_PERIPH_SS_USB2_HSIC_BAM_P_DESC_FIFO_ADDR5_ADDR A:0xf9a0a81c
y.create.l HWIO_PERIPH_SS_USB2_HSIC_BAM_P_DESC_FIFO_ADDR6_ADDR A:0xf9a0b81c
y.create.l HWIO_PERIPH_SS_USB2_HSIC_BAM_P_DESC_FIFO_ADDR7_ADDR A:0xf9a0c81c
y.create.l HWIO_PERIPH_SS_USB2_HSIC_BAM_P_DESC_FIFO_ADDR8_ADDR A:0xf9a0d81c
y.create.l HWIO_PERIPH_SS_USB2_HSIC_BAM_P_DESC_FIFO_ADDR9_ADDR A:0xf9a0e81c
y.create.l HWIO_PERIPH_SS_USB2_HSIC_BAM_P_EVNT_GEN_TRSHLD0_ADDR A:0xf9a05828
y.create.l HWIO_PERIPH_SS_USB2_HSIC_BAM_P_EVNT_GEN_TRSHLD1_ADDR A:0xf9a06828
y.create.l HWIO_PERIPH_SS_USB2_HSIC_BAM_P_EVNT_GEN_TRSHLD2_ADDR A:0xf9a07828
y.create.l HWIO_PERIPH_SS_USB2_HSIC_BAM_P_EVNT_GEN_TRSHLD3_ADDR A:0xf9a08828
y.create.l HWIO_PERIPH_SS_USB2_HSIC_BAM_P_EVNT_GEN_TRSHLD4_ADDR A:0xf9a09828
y.create.l HWIO_PERIPH_SS_USB2_HSIC_BAM_P_EVNT_GEN_TRSHLD5_ADDR A:0xf9a0a828
y.create.l HWIO_PERIPH_SS_USB2_HSIC_BAM_P_EVNT_GEN_TRSHLD6_ADDR A:0xf9a0b828
y.create.l HWIO_PERIPH_SS_USB2_HSIC_BAM_P_EVNT_GEN_TRSHLD7_ADDR A:0xf9a0c828
y.create.l HWIO_PERIPH_SS_USB2_HSIC_BAM_P_EVNT_GEN_TRSHLD8_ADDR A:0xf9a0d828
y.create.l HWIO_PERIPH_SS_USB2_HSIC_BAM_P_EVNT_GEN_TRSHLD9_ADDR A:0xf9a0e828
y.create.l HWIO_PERIPH_SS_USB2_HSIC_BAM_P_FIFO_SIZES0_ADDR A:0xf9a05820
y.create.l HWIO_PERIPH_SS_USB2_HSIC_BAM_P_FIFO_SIZES1_ADDR A:0xf9a06820
y.create.l HWIO_PERIPH_SS_USB2_HSIC_BAM_P_FIFO_SIZES2_ADDR A:0xf9a07820
y.create.l HWIO_PERIPH_SS_USB2_HSIC_BAM_P_FIFO_SIZES3_ADDR A:0xf9a08820
y.create.l HWIO_PERIPH_SS_USB2_HSIC_BAM_P_FIFO_SIZES4_ADDR A:0xf9a09820
y.create.l HWIO_PERIPH_SS_USB2_HSIC_BAM_P_FIFO_SIZES5_ADDR A:0xf9a0a820
y.create.l HWIO_PERIPH_SS_USB2_HSIC_BAM_P_FIFO_SIZES6_ADDR A:0xf9a0b820
y.create.l HWIO_PERIPH_SS_USB2_HSIC_BAM_P_FIFO_SIZES7_ADDR A:0xf9a0c820
y.create.l HWIO_PERIPH_SS_USB2_HSIC_BAM_P_FIFO_SIZES8_ADDR A:0xf9a0d820
y.create.l HWIO_PERIPH_SS_USB2_HSIC_BAM_P_FIFO_SIZES9_ADDR A:0xf9a0e820
y.create.l HWIO_PERIPH_SS_USB2_HSIC_BAM_P_RETR_CNTXT_0_ADDR A:0xf9a05834
y.create.l HWIO_PERIPH_SS_USB2_HSIC_BAM_P_RETR_CNTXT_1_ADDR A:0xf9a06834
y.create.l HWIO_PERIPH_SS_USB2_HSIC_BAM_P_RETR_CNTXT_2_ADDR A:0xf9a07834
y.create.l HWIO_PERIPH_SS_USB2_HSIC_BAM_P_RETR_CNTXT_3_ADDR A:0xf9a08834
y.create.l HWIO_PERIPH_SS_USB2_HSIC_BAM_P_RETR_CNTXT_4_ADDR A:0xf9a09834
y.create.l HWIO_PERIPH_SS_USB2_HSIC_BAM_P_RETR_CNTXT_5_ADDR A:0xf9a0a834
y.create.l HWIO_PERIPH_SS_USB2_HSIC_BAM_P_RETR_CNTXT_6_ADDR A:0xf9a0b834
y.create.l HWIO_PERIPH_SS_USB2_HSIC_BAM_P_RETR_CNTXT_7_ADDR A:0xf9a0c834
y.create.l HWIO_PERIPH_SS_USB2_HSIC_BAM_P_RETR_CNTXT_8_ADDR A:0xf9a0d834
y.create.l HWIO_PERIPH_SS_USB2_HSIC_BAM_P_RETR_CNTXT_9_ADDR A:0xf9a0e834
y.create.l HWIO_PERIPH_SS_USB2_HSIC_BAM_P_SI_CNTXT_0_ADDR A:0xf9a05838
y.create.l HWIO_PERIPH_SS_USB2_HSIC_BAM_P_SI_CNTXT_1_ADDR A:0xf9a06838
y.create.l HWIO_PERIPH_SS_USB2_HSIC_BAM_P_SI_CNTXT_2_ADDR A:0xf9a07838
y.create.l HWIO_PERIPH_SS_USB2_HSIC_BAM_P_SI_CNTXT_3_ADDR A:0xf9a08838
y.create.l HWIO_PERIPH_SS_USB2_HSIC_BAM_P_SI_CNTXT_4_ADDR A:0xf9a09838
y.create.l HWIO_PERIPH_SS_USB2_HSIC_BAM_P_SI_CNTXT_5_ADDR A:0xf9a0a838
y.create.l HWIO_PERIPH_SS_USB2_HSIC_BAM_P_SI_CNTXT_6_ADDR A:0xf9a0b838
y.create.l HWIO_PERIPH_SS_USB2_HSIC_BAM_P_SI_CNTXT_7_ADDR A:0xf9a0c838
y.create.l HWIO_PERIPH_SS_USB2_HSIC_BAM_P_SI_CNTXT_8_ADDR A:0xf9a0d838
y.create.l HWIO_PERIPH_SS_USB2_HSIC_BAM_P_SI_CNTXT_9_ADDR A:0xf9a0e838
y.create.l HWIO_PERIPH_SS_USB2_HSIC_BAM_P_DF_CNTXT_0_ADDR A:0xf9a05830
y.create.l HWIO_PERIPH_SS_USB2_HSIC_BAM_P_DF_CNTXT_1_ADDR A:0xf9a06830
y.create.l HWIO_PERIPH_SS_USB2_HSIC_BAM_P_DF_CNTXT_2_ADDR A:0xf9a07830
y.create.l HWIO_PERIPH_SS_USB2_HSIC_BAM_P_DF_CNTXT_3_ADDR A:0xf9a08830
y.create.l HWIO_PERIPH_SS_USB2_HSIC_BAM_P_DF_CNTXT_4_ADDR A:0xf9a09830
y.create.l HWIO_PERIPH_SS_USB2_HSIC_BAM_P_DF_CNTXT_5_ADDR A:0xf9a0a830
y.create.l HWIO_PERIPH_SS_USB2_HSIC_BAM_P_DF_CNTXT_6_ADDR A:0xf9a0b830
y.create.l HWIO_PERIPH_SS_USB2_HSIC_BAM_P_DF_CNTXT_7_ADDR A:0xf9a0c830
y.create.l HWIO_PERIPH_SS_USB2_HSIC_BAM_P_DF_CNTXT_8_ADDR A:0xf9a0d830
y.create.l HWIO_PERIPH_SS_USB2_HSIC_BAM_P_DF_CNTXT_9_ADDR A:0xf9a0e830
y.create.l HWIO_PERIPH_SS_USB2_HSIC_BAM_P_AU_PSM_CNTXT_1_0_ADDR A:0xf9a05804
y.create.l HWIO_PERIPH_SS_USB2_HSIC_BAM_P_AU_PSM_CNTXT_1_1_ADDR A:0xf9a06804
y.create.l HWIO_PERIPH_SS_USB2_HSIC_BAM_P_AU_PSM_CNTXT_1_2_ADDR A:0xf9a07804
y.create.l HWIO_PERIPH_SS_USB2_HSIC_BAM_P_AU_PSM_CNTXT_1_3_ADDR A:0xf9a08804
y.create.l HWIO_PERIPH_SS_USB2_HSIC_BAM_P_AU_PSM_CNTXT_1_4_ADDR A:0xf9a09804
y.create.l HWIO_PERIPH_SS_USB2_HSIC_BAM_P_AU_PSM_CNTXT_1_5_ADDR A:0xf9a0a804
y.create.l HWIO_PERIPH_SS_USB2_HSIC_BAM_P_AU_PSM_CNTXT_1_6_ADDR A:0xf9a0b804
y.create.l HWIO_PERIPH_SS_USB2_HSIC_BAM_P_AU_PSM_CNTXT_1_7_ADDR A:0xf9a0c804
y.create.l HWIO_PERIPH_SS_USB2_HSIC_BAM_P_AU_PSM_CNTXT_1_8_ADDR A:0xf9a0d804
y.create.l HWIO_PERIPH_SS_USB2_HSIC_BAM_P_AU_PSM_CNTXT_1_9_ADDR A:0xf9a0e804
y.create.l HWIO_PERIPH_SS_USB2_HSIC_BAM_P_PSM_CNTXT_2_0_ADDR A:0xf9a05808
y.create.l HWIO_PERIPH_SS_USB2_HSIC_BAM_P_PSM_CNTXT_2_1_ADDR A:0xf9a06808
y.create.l HWIO_PERIPH_SS_USB2_HSIC_BAM_P_PSM_CNTXT_2_2_ADDR A:0xf9a07808
y.create.l HWIO_PERIPH_SS_USB2_HSIC_BAM_P_PSM_CNTXT_2_3_ADDR A:0xf9a08808
y.create.l HWIO_PERIPH_SS_USB2_HSIC_BAM_P_PSM_CNTXT_2_4_ADDR A:0xf9a09808
y.create.l HWIO_PERIPH_SS_USB2_HSIC_BAM_P_PSM_CNTXT_2_5_ADDR A:0xf9a0a808
y.create.l HWIO_PERIPH_SS_USB2_HSIC_BAM_P_PSM_CNTXT_2_6_ADDR A:0xf9a0b808
y.create.l HWIO_PERIPH_SS_USB2_HSIC_BAM_P_PSM_CNTXT_2_7_ADDR A:0xf9a0c808
y.create.l HWIO_PERIPH_SS_USB2_HSIC_BAM_P_PSM_CNTXT_2_8_ADDR A:0xf9a0d808
y.create.l HWIO_PERIPH_SS_USB2_HSIC_BAM_P_PSM_CNTXT_2_9_ADDR A:0xf9a0e808
y.create.l HWIO_PERIPH_SS_USB2_HSIC_BAM_P_PSM_CNTXT_3_0_ADDR A:0xf9a0580c
y.create.l HWIO_PERIPH_SS_USB2_HSIC_BAM_P_PSM_CNTXT_3_1_ADDR A:0xf9a0680c
y.create.l HWIO_PERIPH_SS_USB2_HSIC_BAM_P_PSM_CNTXT_3_2_ADDR A:0xf9a0780c
y.create.l HWIO_PERIPH_SS_USB2_HSIC_BAM_P_PSM_CNTXT_3_3_ADDR A:0xf9a0880c
y.create.l HWIO_PERIPH_SS_USB2_HSIC_BAM_P_PSM_CNTXT_3_4_ADDR A:0xf9a0980c
y.create.l HWIO_PERIPH_SS_USB2_HSIC_BAM_P_PSM_CNTXT_3_5_ADDR A:0xf9a0a80c
y.create.l HWIO_PERIPH_SS_USB2_HSIC_BAM_P_PSM_CNTXT_3_6_ADDR A:0xf9a0b80c
y.create.l HWIO_PERIPH_SS_USB2_HSIC_BAM_P_PSM_CNTXT_3_7_ADDR A:0xf9a0c80c
y.create.l HWIO_PERIPH_SS_USB2_HSIC_BAM_P_PSM_CNTXT_3_8_ADDR A:0xf9a0d80c
y.create.l HWIO_PERIPH_SS_USB2_HSIC_BAM_P_PSM_CNTXT_3_9_ADDR A:0xf9a0e80c
y.create.l HWIO_PERIPH_SS_USB2_HSIC_BAM_P_PSM_CNTXT_4_0_ADDR A:0xf9a05810
y.create.l HWIO_PERIPH_SS_USB2_HSIC_BAM_P_PSM_CNTXT_4_1_ADDR A:0xf9a06810
y.create.l HWIO_PERIPH_SS_USB2_HSIC_BAM_P_PSM_CNTXT_4_2_ADDR A:0xf9a07810
y.create.l HWIO_PERIPH_SS_USB2_HSIC_BAM_P_PSM_CNTXT_4_3_ADDR A:0xf9a08810
y.create.l HWIO_PERIPH_SS_USB2_HSIC_BAM_P_PSM_CNTXT_4_4_ADDR A:0xf9a09810
y.create.l HWIO_PERIPH_SS_USB2_HSIC_BAM_P_PSM_CNTXT_4_5_ADDR A:0xf9a0a810
y.create.l HWIO_PERIPH_SS_USB2_HSIC_BAM_P_PSM_CNTXT_4_6_ADDR A:0xf9a0b810
y.create.l HWIO_PERIPH_SS_USB2_HSIC_BAM_P_PSM_CNTXT_4_7_ADDR A:0xf9a0c810
y.create.l HWIO_PERIPH_SS_USB2_HSIC_BAM_P_PSM_CNTXT_4_8_ADDR A:0xf9a0d810
y.create.l HWIO_PERIPH_SS_USB2_HSIC_BAM_P_PSM_CNTXT_4_9_ADDR A:0xf9a0e810
y.create.l HWIO_PERIPH_SS_USB2_HSIC_BAM_P_PSM_CNTXT_5_0_ADDR A:0xf9a05814
y.create.l HWIO_PERIPH_SS_USB2_HSIC_BAM_P_PSM_CNTXT_5_1_ADDR A:0xf9a06814
y.create.l HWIO_PERIPH_SS_USB2_HSIC_BAM_P_PSM_CNTXT_5_2_ADDR A:0xf9a07814
y.create.l HWIO_PERIPH_SS_USB2_HSIC_BAM_P_PSM_CNTXT_5_3_ADDR A:0xf9a08814
y.create.l HWIO_PERIPH_SS_USB2_HSIC_BAM_P_PSM_CNTXT_5_4_ADDR A:0xf9a09814
y.create.l HWIO_PERIPH_SS_USB2_HSIC_BAM_P_PSM_CNTXT_5_5_ADDR A:0xf9a0a814
y.create.l HWIO_PERIPH_SS_USB2_HSIC_BAM_P_PSM_CNTXT_5_6_ADDR A:0xf9a0b814
y.create.l HWIO_PERIPH_SS_USB2_HSIC_BAM_P_PSM_CNTXT_5_7_ADDR A:0xf9a0c814
y.create.l HWIO_PERIPH_SS_USB2_HSIC_BAM_P_PSM_CNTXT_5_8_ADDR A:0xf9a0d814
y.create.l HWIO_PERIPH_SS_USB2_HSIC_BAM_P_PSM_CNTXT_5_9_ADDR A:0xf9a0e814
y.create.l HWIO_PERIPH_SS_USB2_HSIC_XPU_SCR_ADDR A:0xf9a02000
y.create.l HWIO_PERIPH_SS_USB2_HSIC_XPU_SWDR_ADDR A:0xf9a02004
y.create.l HWIO_PERIPH_SS_USB2_HSIC_XPU_SEAR0_ADDR A:0xf9a02040
y.create.l HWIO_PERIPH_SS_USB2_HSIC_XPU_SESR_ADDR A:0xf9a02048
y.create.l HWIO_PERIPH_SS_USB2_HSIC_XPU_SESRRESTORE_ADDR A:0xf9a0204c
y.create.l HWIO_PERIPH_SS_USB2_HSIC_XPU_SESYNR0_ADDR A:0xf9a02050
y.create.l HWIO_PERIPH_SS_USB2_HSIC_XPU_SESYNR1_ADDR A:0xf9a02054
y.create.l HWIO_PERIPH_SS_USB2_HSIC_XPU_SESYNR2_ADDR A:0xf9a02058
y.create.l HWIO_PERIPH_SS_USB2_HSIC_XPU_MCR_ADDR A:0xf9a02100
y.create.l HWIO_PERIPH_SS_USB2_HSIC_XPU_MEAR0_ADDR A:0xf9a02140
y.create.l HWIO_PERIPH_SS_USB2_HSIC_XPU_MESR_ADDR A:0xf9a02148
y.create.l HWIO_PERIPH_SS_USB2_HSIC_XPU_MESRRESTORE_ADDR A:0xf9a0214c
y.create.l HWIO_PERIPH_SS_USB2_HSIC_XPU_MESYNR0_ADDR A:0xf9a02150
y.create.l HWIO_PERIPH_SS_USB2_HSIC_XPU_MESYNR1_ADDR A:0xf9a02154
y.create.l HWIO_PERIPH_SS_USB2_HSIC_XPU_MESYNR2_ADDR A:0xf9a02158
y.create.l HWIO_PERIPH_SS_USB2_HSIC_XPU_CR_ADDR A:0xf9a02080
y.create.l HWIO_PERIPH_SS_USB2_HSIC_XPU_RPU_ACR0_ADDR A:0xf9a020a0
y.create.l HWIO_PERIPH_SS_USB2_HSIC_XPU_EAR0_ADDR A:0xf9a020c0
y.create.l HWIO_PERIPH_SS_USB2_HSIC_XPU_ESR_ADDR A:0xf9a020c8
y.create.l HWIO_PERIPH_SS_USB2_HSIC_XPU_ESRRESTORE_ADDR A:0xf9a020cc
y.create.l HWIO_PERIPH_SS_USB2_HSIC_XPU_ESYNR0_ADDR A:0xf9a020d0
y.create.l HWIO_PERIPH_SS_USB2_HSIC_XPU_ESYNR1_ADDR A:0xf9a020d4
y.create.l HWIO_PERIPH_SS_USB2_HSIC_XPU_ESYNR2_ADDR A:0xf9a020d8
y.create.l HWIO_PERIPH_SS_USB2_HSIC_XPU_IDR0_ADDR A:0xf9a02074
y.create.l HWIO_PERIPH_SS_USB2_HSIC_XPU_IDR1_ADDR A:0xf9a02078
y.create.l HWIO_PERIPH_SS_USB2_HSIC_XPU_REV_ADDR A:0xf9a0207c
y.create.l HWIO_PERIPH_SS_USB2_HSIC_XPU_RG0_RACR0_ADDR A:0xf9a02200
y.create.l HWIO_PERIPH_SS_USB2_HSIC_XPU_RG1_RACR0_ADDR A:0xf9a02280
y.create.l HWIO_PERIPH_SS_USB2_HSIC_XPU_RG2_RACR0_ADDR A:0xf9a02300
y.create.l HWIO_PERIPH_SS_USB2_HSIC_XPU_RG3_RACR0_ADDR A:0xf9a02380
y.create.l HWIO_PERIPH_SS_USB2_HSIC_XPU_RG4_RACR0_ADDR A:0xf9a02400
y.create.l HWIO_PERIPH_SS_USB2_HSIC_XPU_RG5_RACR0_ADDR A:0xf9a02480
y.create.l HWIO_PERIPH_SS_USB2_HSIC_XPU_RG6_RACR0_ADDR A:0xf9a02500
y.create.l HWIO_PERIPH_SS_USB2_HSIC_XPU_RG7_RACR0_ADDR A:0xf9a02580
y.create.l HWIO_PERIPH_SS_USB2_HSIC_XPU_RG8_RACR0_ADDR A:0xf9a02600
y.create.l HWIO_PERIPH_SS_USB2_HSIC_XPU_RG9_RACR0_ADDR A:0xf9a02680
y.create.l HWIO_PERIPH_SS_USB2_HSIC_XPU_RG0_SCR_ADDR A:0xf9a02250
y.create.l HWIO_PERIPH_SS_USB2_HSIC_XPU_RG1_SCR_ADDR A:0xf9a022d0
y.create.l HWIO_PERIPH_SS_USB2_HSIC_XPU_RG2_SCR_ADDR A:0xf9a02350
y.create.l HWIO_PERIPH_SS_USB2_HSIC_XPU_RG3_SCR_ADDR A:0xf9a023d0
y.create.l HWIO_PERIPH_SS_USB2_HSIC_XPU_RG4_SCR_ADDR A:0xf9a02450
y.create.l HWIO_PERIPH_SS_USB2_HSIC_XPU_RG5_SCR_ADDR A:0xf9a024d0
y.create.l HWIO_PERIPH_SS_USB2_HSIC_XPU_RG6_SCR_ADDR A:0xf9a02550
y.create.l HWIO_PERIPH_SS_USB2_HSIC_XPU_RG7_SCR_ADDR A:0xf9a025d0
y.create.l HWIO_PERIPH_SS_USB2_HSIC_XPU_RG8_SCR_ADDR A:0xf9a02650
y.create.l HWIO_PERIPH_SS_USB2_HSIC_XPU_RG9_SCR_ADDR A:0xf9a026d0
y.create.l HWIO_PERIPH_SS_USB2_HSIC_XPU_RG0_MCR_ADDR A:0xf9a02254
y.create.l HWIO_PERIPH_SS_USB2_HSIC_XPU_RG1_MCR_ADDR A:0xf9a022d4
y.create.l HWIO_PERIPH_SS_USB2_HSIC_XPU_RG2_MCR_ADDR A:0xf9a02354
y.create.l HWIO_PERIPH_SS_USB2_HSIC_XPU_RG3_MCR_ADDR A:0xf9a023d4
y.create.l HWIO_PERIPH_SS_USB2_HSIC_XPU_RG4_MCR_ADDR A:0xf9a02454
y.create.l HWIO_PERIPH_SS_USB2_HSIC_XPU_RG5_MCR_ADDR A:0xf9a024d4
y.create.l HWIO_PERIPH_SS_USB2_HSIC_XPU_RG6_MCR_ADDR A:0xf9a02554
y.create.l HWIO_PERIPH_SS_USB2_HSIC_XPU_RG7_MCR_ADDR A:0xf9a025d4
y.create.l HWIO_PERIPH_SS_USB2_HSIC_XPU_RG8_MCR_ADDR A:0xf9a02654
y.create.l HWIO_PERIPH_SS_USB2_HSIC_XPU_RG9_MCR_ADDR A:0xf9a026d4
y.create.l HWIO_PERIPH_SS_USB2_HSIC_VMIDMT_SCR0_ADDR A:0xf9a00000
y.create.l HWIO_PERIPH_SS_USB2_HSIC_VMIDMT_SCR1_ADDR A:0xf9a00004
y.create.l HWIO_PERIPH_SS_USB2_HSIC_VMIDMT_SCR2_ADDR A:0xf9a00008
y.create.l HWIO_PERIPH_SS_USB2_HSIC_VMIDMT_SACR_ADDR A:0xf9a00010
y.create.l HWIO_PERIPH_SS_USB2_HSIC_VMIDMT_SIDR0_ADDR A:0xf9a00020
y.create.l HWIO_PERIPH_SS_USB2_HSIC_VMIDMT_SIDR1_ADDR A:0xf9a00024
y.create.l HWIO_PERIPH_SS_USB2_HSIC_VMIDMT_SIDR2_ADDR A:0xf9a00028
y.create.l HWIO_PERIPH_SS_USB2_HSIC_VMIDMT_SIDR4_ADDR A:0xf9a00030
y.create.l HWIO_PERIPH_SS_USB2_HSIC_VMIDMT_SIDR5_ADDR A:0xf9a00034
y.create.l HWIO_PERIPH_SS_USB2_HSIC_VMIDMT_SIDR7_ADDR A:0xf9a0003c
y.create.l HWIO_PERIPH_SS_USB2_HSIC_VMIDMT_SGFAR0_ADDR A:0xf9a00040
y.create.l HWIO_PERIPH_SS_USB2_HSIC_VMIDMT_SGFSR_ADDR A:0xf9a00048
y.create.l HWIO_PERIPH_SS_USB2_HSIC_VMIDMT_SGFSRRESTORE_ADDR A:0xf9a0004c
y.create.l HWIO_PERIPH_SS_USB2_HSIC_VMIDMT_SGFSYNDR0_ADDR A:0xf9a00050
y.create.l HWIO_PERIPH_SS_USB2_HSIC_VMIDMT_SGFSYNDR1_ADDR A:0xf9a00054
y.create.l HWIO_PERIPH_SS_USB2_HSIC_VMIDMT_SGFSYNDR2_ADDR A:0xf9a00058
y.create.l HWIO_PERIPH_SS_USB2_HSIC_VMIDMT_VMIDMTSCR0_ADDR A:0xf9a00090
y.create.l HWIO_PERIPH_SS_USB2_HSIC_VMIDMT_CR0_ADDR A:0xf9a00000
y.create.l HWIO_PERIPH_SS_USB2_HSIC_VMIDMT_CR2_ADDR A:0xf9a00008
y.create.l HWIO_PERIPH_SS_USB2_HSIC_VMIDMT_ACR_ADDR A:0xf9a00010
y.create.l HWIO_PERIPH_SS_USB2_HSIC_VMIDMT_IDR0_ADDR A:0xf9a00020
y.create.l HWIO_PERIPH_SS_USB2_HSIC_VMIDMT_IDR1_ADDR A:0xf9a00024
y.create.l HWIO_PERIPH_SS_USB2_HSIC_VMIDMT_IDR2_ADDR A:0xf9a00028
y.create.l HWIO_PERIPH_SS_USB2_HSIC_VMIDMT_IDR4_ADDR A:0xf9a00030
y.create.l HWIO_PERIPH_SS_USB2_HSIC_VMIDMT_IDR5_ADDR A:0xf9a00034
y.create.l HWIO_PERIPH_SS_USB2_HSIC_VMIDMT_IDR7_ADDR A:0xf9a0003c
y.create.l HWIO_PERIPH_SS_USB2_HSIC_VMIDMT_GFAR0_ADDR A:0xf9a00040
y.create.l HWIO_PERIPH_SS_USB2_HSIC_VMIDMT_GFSR_ADDR A:0xf9a00048
y.create.l HWIO_PERIPH_SS_USB2_HSIC_VMIDMT_GFSRRESTORE_ADDR A:0xf9a0004c
y.create.l HWIO_PERIPH_SS_USB2_HSIC_VMIDMT_GFSYNDR0_ADDR A:0xf9a00050
y.create.l HWIO_PERIPH_SS_USB2_HSIC_VMIDMT_GFSYNDR1_ADDR A:0xf9a00054
y.create.l HWIO_PERIPH_SS_USB2_HSIC_VMIDMT_GFSYNDR2_ADDR A:0xf9a00058
y.create.l HWIO_PERIPH_SS_USB2_HSIC_VMIDMT_VMIDMTCR0_ADDR A:0xf9a00090
y.create.l HWIO_PERIPH_SS_USB2_HSIC_VMIDMT_VMIDMTACR_ADDR A:0xf9a0009c
y.create.l HWIO_PERIPH_SS_USB2_HSIC_VMIDMT_NSCR0_ADDR A:0xf9a00400
y.create.l HWIO_PERIPH_SS_USB2_HSIC_VMIDMT_NSCR2_ADDR A:0xf9a00408
y.create.l HWIO_PERIPH_SS_USB2_HSIC_VMIDMT_NSACR_ADDR A:0xf9a00410
y.create.l HWIO_PERIPH_SS_USB2_HSIC_VMIDMT_NSGFAR0_ADDR A:0xf9a00440
y.create.l HWIO_PERIPH_SS_USB2_HSIC_VMIDMT_NSGFSR_ADDR A:0xf9a00448
y.create.l HWIO_PERIPH_SS_USB2_HSIC_VMIDMT_NSGFSRRESTORE_ADDR A:0xf9a0044c
y.create.l HWIO_PERIPH_SS_USB2_HSIC_VMIDMT_NSGFSYNDR0_ADDR A:0xf9a00450
y.create.l HWIO_PERIPH_SS_USB2_HSIC_VMIDMT_NSGFSYNDR1_ADDR A:0xf9a00454
y.create.l HWIO_PERIPH_SS_USB2_HSIC_VMIDMT_NSGFSYNDR2_ADDR A:0xf9a00458
y.create.l HWIO_PERIPH_SS_USB2_HSIC_VMIDMT_NSVMIDMTCR0_ADDR A:0xf9a00490
y.create.l HWIO_PERIPH_SS_USB2_HSIC_VMIDMT_SSDR0_ADDR A:0xf9a00080
y.create.l HWIO_PERIPH_SS_USB2_HSIC_VMIDMT_MSDR0_ADDR A:0xf9a00480
y.create.l HWIO_PERIPH_SS_USB2_HSIC_VMIDMT_MCR_ADDR A:0xf9a00494
y.create.l HWIO_PERIPH_SS_USB2_HSIC_VMIDMT_S2VR0_ADDR A:0xf9a00c00
y.create.l HWIO_PERIPH_SS_USB2_HSIC_VMIDMT_S2VR1_ADDR A:0xf9a00c04
y.create.l HWIO_PERIPH_SS_USB2_HSIC_VMIDMT_S2VR2_ADDR A:0xf9a00c08
y.create.l HWIO_PERIPH_SS_USB2_HSIC_VMIDMT_S2VR3_ADDR A:0xf9a00c0c
y.create.l HWIO_PERIPH_SS_USB2_HSIC_VMIDMT_S2VR4_ADDR A:0xf9a00c10
y.create.l HWIO_PERIPH_SS_USB2_HSIC_VMIDMT_S2VR5_ADDR A:0xf9a00c14
y.create.l HWIO_PERIPH_SS_USB2_HSIC_VMIDMT_S2VR6_ADDR A:0xf9a00c18
y.create.l HWIO_PERIPH_SS_USB2_HSIC_VMIDMT_S2VR7_ADDR A:0xf9a00c1c
y.create.l HWIO_PERIPH_SS_USB2_HSIC_VMIDMT_S2VR8_ADDR A:0xf9a00c20
y.create.l HWIO_PERIPH_SS_USB2_HSIC_VMIDMT_S2VR9_ADDR A:0xf9a00c24
y.create.l HWIO_PERIPH_SS_USB2_HSIC_VMIDMT_AS2VR0_ADDR A:0xf9a00e00
y.create.l HWIO_PERIPH_SS_USB2_HSIC_VMIDMT_AS2VR1_ADDR A:0xf9a00e04
y.create.l HWIO_PERIPH_SS_USB2_HSIC_VMIDMT_AS2VR2_ADDR A:0xf9a00e08
y.create.l HWIO_PERIPH_SS_USB2_HSIC_VMIDMT_AS2VR3_ADDR A:0xf9a00e0c
y.create.l HWIO_PERIPH_SS_USB2_HSIC_VMIDMT_AS2VR4_ADDR A:0xf9a00e10
y.create.l HWIO_PERIPH_SS_USB2_HSIC_VMIDMT_AS2VR5_ADDR A:0xf9a00e14
y.create.l HWIO_PERIPH_SS_USB2_HSIC_VMIDMT_AS2VR6_ADDR A:0xf9a00e18
y.create.l HWIO_PERIPH_SS_USB2_HSIC_VMIDMT_AS2VR7_ADDR A:0xf9a00e1c
y.create.l HWIO_PERIPH_SS_USB2_HSIC_VMIDMT_AS2VR8_ADDR A:0xf9a00e20
y.create.l HWIO_PERIPH_SS_USB2_HSIC_VMIDMT_AS2VR9_ADDR A:0xf9a00e24
y.create.l HWIO_PERIPH_SS_USB2_HSIC_VMIDMT_SMR0_ADDR A:0xf9a00800
y.create.l HWIO_PERIPH_SS_USB2_HSIC_VMIDMT_SMR1_ADDR A:0xf9a00804
y.create.l HWIO_PERIPH_SS_USB2_HSIC_VMIDMT_SMR2_ADDR A:0xf9a00808
y.create.l HWIO_PERIPH_SS_USB2_HSIC_VMIDMT_SMR3_ADDR A:0xf9a0080c
y.create.l HWIO_PERIPH_SS_USB2_HSIC_VMIDMT_SMR4_ADDR A:0xf9a00810
y.create.l HWIO_PERIPH_SS_USB2_HSIC_VMIDMT_SMR5_ADDR A:0xf9a00814
y.create.l HWIO_PERIPH_SS_USB2_HSIC_VMIDMT_SMR6_ADDR A:0xf9a00818
y.create.l HWIO_PERIPH_SS_USB2_HSIC_VMIDMT_SMR7_ADDR A:0xf9a0081c
y.create.l HWIO_PERIPH_SS_USB2_HSIC_VMIDMT_SMR8_ADDR A:0xf9a00820
y.create.l HWIO_PERIPH_SS_USB2_HSIC_VMIDMT_SMR9_ADDR A:0xf9a00824
y.create.l HWIO_PERIPH_SS_USB1_HS_USB_OTG_HS_ID_ADDR A:0xf9a55000
y.create.l HWIO_PERIPH_SS_USB1_HS_USB_OTG_HS_HWGENERAL_ADDR A:0xf9a55004
y.create.l HWIO_PERIPH_SS_USB1_HS_USB_OTG_HS_HWHOST_ADDR A:0xf9a55008
y.create.l HWIO_PERIPH_SS_USB1_HS_USB_OTG_HS_HWDEVICE_ADDR A:0xf9a5500c
y.create.l HWIO_PERIPH_SS_USB1_HS_USB_OTG_HS_HWTXBUF_ADDR A:0xf9a55010
y.create.l HWIO_PERIPH_SS_USB1_HS_USB_OTG_HS_HWRXBUF_ADDR A:0xf9a55014
y.create.l HWIO_PERIPH_SS_USB1_HS_USB_OTG_HS_SCRATCH_RAM0_ADDR A:0xf9a55040
y.create.l HWIO_PERIPH_SS_USB1_HS_USB_OTG_HS_SCRATCH_RAM1_ADDR A:0xf9a55044
y.create.l HWIO_PERIPH_SS_USB1_HS_USB_OTG_HS_SCRATCH_RAM2_ADDR A:0xf9a55048
y.create.l HWIO_PERIPH_SS_USB1_HS_USB_OTG_HS_SCRATCH_RAM3_ADDR A:0xf9a5504c
y.create.l HWIO_PERIPH_SS_USB1_HS_USB_OTG_HS_SCRATCH_RAM4_ADDR A:0xf9a55050
y.create.l HWIO_PERIPH_SS_USB1_HS_USB_OTG_HS_SCRATCH_RAM5_ADDR A:0xf9a55054
y.create.l HWIO_PERIPH_SS_USB1_HS_USB_OTG_HS_SCRATCH_RAM6_ADDR A:0xf9a55058
y.create.l HWIO_PERIPH_SS_USB1_HS_USB_OTG_HS_SCRATCH_RAM7_ADDR A:0xf9a5505c
y.create.l HWIO_PERIPH_SS_USB1_HS_USB_OTG_HS_SCRATCH_RAM8_ADDR A:0xf9a55060
y.create.l HWIO_PERIPH_SS_USB1_HS_USB_OTG_HS_SCRATCH_RAM9_ADDR A:0xf9a55064
y.create.l HWIO_PERIPH_SS_USB1_HS_USB_OTG_HS_GPTIMER0LD_ADDR A:0xf9a55080
y.create.l HWIO_PERIPH_SS_USB1_HS_USB_OTG_HS_GPTIMER0CTRL_ADDR A:0xf9a55084
y.create.l HWIO_PERIPH_SS_USB1_HS_USB_OTG_HS_GPTIMER1LD_ADDR A:0xf9a55088
y.create.l HWIO_PERIPH_SS_USB1_HS_USB_OTG_HS_GPTIMER1CTRL_ADDR A:0xf9a5508c
y.create.l HWIO_PERIPH_SS_USB1_HS_USB_OTG_HS_AHB_BURST_ADDR A:0xf9a55090
y.create.l HWIO_PERIPH_SS_USB1_HS_USB_OTG_HS_XTOR_STS_ADDR A:0xf9a55094
y.create.l HWIO_PERIPH_SS_USB1_HS_USB_OTG_HS_AHB_MODE_ADDR A:0xf9a55098
y.create.l HWIO_PERIPH_SS_USB1_HS_USB_OTG_HS_GEN_CONFIG_ADDR A:0xf9a5509c
y.create.l HWIO_PERIPH_SS_USB1_HS_USB_OTG_HS_GEN_CONFIG_2_ADDR A:0xf9a550a0
y.create.l HWIO_PERIPH_SS_USB1_HS_USB_OTG_HS_CAPLENGTH_ADDR A:0xf9a55100
y.create.l HWIO_PERIPH_SS_USB1_HS_USB_OTG_HS_HCSPARAMS_ADDR A:0xf9a55104
y.create.l HWIO_PERIPH_SS_USB1_HS_USB_OTG_HS_HCCPARAMS_ADDR A:0xf9a55108
y.create.l HWIO_PERIPH_SS_USB1_HS_USB_OTG_HS_DCIVERSION_ADDR A:0xf9a55120
y.create.l HWIO_PERIPH_SS_USB1_HS_USB_OTG_HS_DCCPARAMS_ADDR A:0xf9a55124
y.create.l HWIO_PERIPH_SS_USB1_HS_USB_OTG_HS_USBCMD_ADDR A:0xf9a55140
y.create.l HWIO_PERIPH_SS_USB1_HS_USB_OTG_HS_USBSTS_ADDR A:0xf9a55144
y.create.l HWIO_PERIPH_SS_USB1_HS_USB_OTG_HS_USBINTR_ADDR A:0xf9a55148
y.create.l HWIO_PERIPH_SS_USB1_HS_USB_OTG_HS_FRINDEX_ADDR A:0xf9a5514c
y.create.l HWIO_PERIPH_SS_USB1_HS_USB_OTG_HS_PERIODICLISTBASE_ADDR A:0xf9a55154
y.create.l HWIO_PERIPH_SS_USB1_HS_USB_OTG_HS_DEVICEADDR_ADDR A:0xf9a55154
y.create.l HWIO_PERIPH_SS_USB1_HS_USB_OTG_HS_ASYNCLISTADDR_ADDR A:0xf9a55158
y.create.l HWIO_PERIPH_SS_USB1_HS_USB_OTG_HS_ENDPOINTLISTADDR_ADDR A:0xf9a55158
y.create.l HWIO_PERIPH_SS_USB1_HS_USB_OTG_HS_TTCTRL_ADDR A:0xf9a5515c
y.create.l HWIO_PERIPH_SS_USB1_HS_USB_OTG_HS_BURSTSIZE_ADDR A:0xf9a55160
y.create.l HWIO_PERIPH_SS_USB1_HS_USB_OTG_HS_TXFILLTUNING_ADDR A:0xf9a55164
y.create.l HWIO_PERIPH_SS_USB1_HS_USB_OTG_HS_ULPI_VIEWPORT_ADDR A:0xf9a55170
y.create.l HWIO_PERIPH_SS_USB1_HS_USB_OTG_HS_ENDPTNAK_ADDR A:0xf9a55178
y.create.l HWIO_PERIPH_SS_USB1_HS_USB_OTG_HS_ENDPTNAKEN_ADDR A:0xf9a5517c
y.create.l HWIO_PERIPH_SS_USB1_HS_USB_OTG_HS_PORTSC_ADDR A:0xf9a55184
y.create.l HWIO_PERIPH_SS_USB1_HS_USB_OTG_HS_OTGSC_ADDR A:0xf9a551a4
y.create.l HWIO_PERIPH_SS_USB1_HS_USB_OTG_HS_USBMODE_ADDR A:0xf9a551a8
y.create.l HWIO_PERIPH_SS_USB1_HS_USB_OTG_HS_ENDPTSETUPSTAT_ADDR A:0xf9a551ac
y.create.l HWIO_PERIPH_SS_USB1_HS_USB_OTG_HS_ENDPTPRIME_ADDR A:0xf9a551b0
y.create.l HWIO_PERIPH_SS_USB1_HS_USB_OTG_HS_ENDPTFLUSH_ADDR A:0xf9a551b4
y.create.l HWIO_PERIPH_SS_USB1_HS_USB_OTG_HS_ENDPTSTAT_ADDR A:0xf9a551b8
y.create.l HWIO_PERIPH_SS_USB1_HS_USB_OTG_HS_ENDPTCOMPLETE_ADDR A:0xf9a551bc
y.create.l HWIO_PERIPH_SS_USB1_HS_USB_OTG_HS_ENDPTCTRL0_ADDR A:0xf9a551c0
y.create.l HWIO_PERIPH_SS_USB1_HS_USB_OTG_HS_ENDPTCTRL1_ADDR A:0xf9a551c4
y.create.l HWIO_PERIPH_SS_USB1_HS_USB_OTG_HS_ENDPTCTRL2_ADDR A:0xf9a551c8
y.create.l HWIO_PERIPH_SS_USB1_HS_USB_OTG_HS_ENDPTCTRL3_ADDR A:0xf9a551cc
y.create.l HWIO_PERIPH_SS_USB1_HS_USB_OTG_HS_ENDPTCTRL4_ADDR A:0xf9a551d0
y.create.l HWIO_PERIPH_SS_USB1_HS_USB_OTG_HS_ENDPTCTRL5_ADDR A:0xf9a551d4
y.create.l HWIO_PERIPH_SS_USB1_HS_USB_OTG_HS_ENDPTCTRL6_ADDR A:0xf9a551d8
y.create.l HWIO_PERIPH_SS_USB1_HS_USB_OTG_HS_ENDPTCTRL7_ADDR A:0xf9a551dc
y.create.l HWIO_PERIPH_SS_USB1_HS_USB_OTG_HS_ENDPTCTRL8_ADDR A:0xf9a551e0
y.create.l HWIO_PERIPH_SS_USB1_HS_USB_OTG_HS_ENDPTCTRL9_ADDR A:0xf9a551e4
y.create.l HWIO_PERIPH_SS_USB1_HS_USB_OTG_HS_ENDPTCTRL10_ADDR A:0xf9a551e8
y.create.l HWIO_PERIPH_SS_USB1_HS_USB_OTG_HS_ENDPT_PIPE_ID1_ADDR A:0xf9a55200
y.create.l HWIO_PERIPH_SS_USB1_HS_USB_OTG_HS_ENDPT_PIPE_ID2_ADDR A:0xf9a55204
y.create.l HWIO_PERIPH_SS_USB1_HS_USB_OTG_HS_ENDPT_PIPE_ID3_ADDR A:0xf9a55208
y.create.l HWIO_PERIPH_SS_USB1_HS_USB_OTG_HS_ENDPT_PIPE_ID4_ADDR A:0xf9a5520c
y.create.l HWIO_PERIPH_SS_USB1_HS_USB_OTG_HS_ENDPT_PIPE_ID5_ADDR A:0xf9a55210
y.create.l HWIO_PERIPH_SS_USB1_HS_USB_OTG_HS_ENDPT_PIPE_ID6_ADDR A:0xf9a55214
y.create.l HWIO_PERIPH_SS_USB1_HS_USB_OTG_HS_ENDPT_PIPE_ID7_ADDR A:0xf9a55218
y.create.l HWIO_PERIPH_SS_USB1_HS_USB_OTG_HS_ENDPT_PIPE_ID8_ADDR A:0xf9a5521c
y.create.l HWIO_PERIPH_SS_USB1_HS_USB_OTG_HS_ENDPT_PIPE_ID9_ADDR A:0xf9a55220
y.create.l HWIO_PERIPH_SS_USB1_HS_USB_OTG_HS_ENDPT_PIPE_ID10_ADDR A:0xf9a55224
y.create.l HWIO_PERIPH_SS_USB1_HS_USB_OTG_HS_PHY_CTRL_ADDR A:0xf9a55240
y.create.l HWIO_PERIPH_SS_USB1_HS_USB_OTG_HS_GENERIC1_ADDR A:0xf9a55244
y.create.l HWIO_PERIPH_SS_USB1_HS_USB_OTG_HS_GENERIC2_ADDR A:0xf9a55248
y.create.l HWIO_PERIPH_SS_USB1_HS_USB_OTG_HS_HW_VER_ADDR A:0xf9a55270
y.create.l HWIO_PERIPH_SS_USB1_HS_USB_OTG_HS_TEST_BUS_ADDR A:0xf9a55274
y.create.l HWIO_PERIPH_SS_USB1_HS_USB_OTG_HS_PHY_SEC_CTRL_ADDR A:0xf9a55278
y.create.l HWIO_PERIPH_SS_USB1_HS_BAM_CTRL_ADDR A:0xf9a44000
y.create.l HWIO_PERIPH_SS_USB1_HS_BAM_REVISION_ADDR A:0xf9a44004
y.create.l HWIO_PERIPH_SS_USB1_HS_BAM_SW_VERSION_ADDR A:0xf9a44080
y.create.l HWIO_PERIPH_SS_USB1_HS_BAM_NUM_PIPES_ADDR A:0xf9a4403c
y.create.l HWIO_PERIPH_SS_USB1_HS_BAM_TIMER_ADDR A:0xf9a44040
y.create.l HWIO_PERIPH_SS_USB1_HS_BAM_TIMER_CTRL_ADDR A:0xf9a44044
y.create.l HWIO_PERIPH_SS_USB1_HS_BAM_DESC_CNT_TRSHLD_ADDR A:0xf9a44008
y.create.l HWIO_PERIPH_SS_USB1_HS_BAM_IRQ_SRCS_ADDR A:0xf9a4400c
y.create.l HWIO_PERIPH_SS_USB1_HS_BAM_IRQ_SRCS_MSK_ADDR A:0xf9a44010
y.create.l HWIO_PERIPH_SS_USB1_HS_BAM_IRQ_SRCS_UNMASKED_ADDR A:0xf9a44030
y.create.l HWIO_PERIPH_SS_USB1_HS_BAM_IRQ_STTS_ADDR A:0xf9a44014
y.create.l HWIO_PERIPH_SS_USB1_HS_BAM_IRQ_CLR_ADDR A:0xf9a44018
y.create.l HWIO_PERIPH_SS_USB1_HS_BAM_IRQ_EN_ADDR A:0xf9a4401c
y.create.l HWIO_PERIPH_SS_USB1_HS_BAM_AHB_MASTER_ERR_CTRLS_ADDR A:0xf9a44024
y.create.l HWIO_PERIPH_SS_USB1_HS_BAM_AHB_MASTER_ERR_ADDR_ADDR A:0xf9a44028
y.create.l HWIO_PERIPH_SS_USB1_HS_BAM_AHB_MASTER_ERR_DATA_ADDR A:0xf9a4402c
y.create.l HWIO_PERIPH_SS_USB1_HS_BAM_TRUST_REG_ADDR A:0xf9a44070
y.create.l HWIO_PERIPH_SS_USB1_HS_BAM_TEST_BUS_SEL_ADDR A:0xf9a44074
y.create.l HWIO_PERIPH_SS_USB1_HS_BAM_TEST_BUS_REG_ADDR A:0xf9a44078
y.create.l HWIO_PERIPH_SS_USB1_HS_BAM_CNFG_BITS_ADDR A:0xf9a4407c
y.create.l HWIO_PERIPH_SS_USB1_HS_BAM_IRQ_SRCS_EE0_ADDR A:0xf9a44800
y.create.l HWIO_PERIPH_SS_USB1_HS_BAM_IRQ_SRCS_EE1_ADDR A:0xf9a44880
y.create.l HWIO_PERIPH_SS_USB1_HS_BAM_IRQ_SRCS_EE2_ADDR A:0xf9a44900
y.create.l HWIO_PERIPH_SS_USB1_HS_BAM_IRQ_SRCS_EE3_ADDR A:0xf9a44980
y.create.l HWIO_PERIPH_SS_USB1_HS_BAM_IRQ_SRCS_EE4_ADDR A:0xf9a44a00
y.create.l HWIO_PERIPH_SS_USB1_HS_BAM_IRQ_SRCS_EE5_ADDR A:0xf9a44a80
y.create.l HWIO_PERIPH_SS_USB1_HS_BAM_IRQ_SRCS_EE6_ADDR A:0xf9a44b00
y.create.l HWIO_PERIPH_SS_USB1_HS_BAM_IRQ_SRCS_EE7_ADDR A:0xf9a44b80
y.create.l HWIO_PERIPH_SS_USB1_HS_BAM_IRQ_SRCS_MSK_EE0_ADDR A:0xf9a44804
y.create.l HWIO_PERIPH_SS_USB1_HS_BAM_IRQ_SRCS_MSK_EE1_ADDR A:0xf9a44884
y.create.l HWIO_PERIPH_SS_USB1_HS_BAM_IRQ_SRCS_MSK_EE2_ADDR A:0xf9a44904
y.create.l HWIO_PERIPH_SS_USB1_HS_BAM_IRQ_SRCS_MSK_EE3_ADDR A:0xf9a44984
y.create.l HWIO_PERIPH_SS_USB1_HS_BAM_IRQ_SRCS_MSK_EE4_ADDR A:0xf9a44a04
y.create.l HWIO_PERIPH_SS_USB1_HS_BAM_IRQ_SRCS_MSK_EE5_ADDR A:0xf9a44a84
y.create.l HWIO_PERIPH_SS_USB1_HS_BAM_IRQ_SRCS_MSK_EE6_ADDR A:0xf9a44b04
y.create.l HWIO_PERIPH_SS_USB1_HS_BAM_IRQ_SRCS_MSK_EE7_ADDR A:0xf9a44b84
y.create.l HWIO_PERIPH_SS_USB1_HS_BAM_IRQ_SRCS_UNMASKED_EE0_ADDR A:0xf9a44808
y.create.l HWIO_PERIPH_SS_USB1_HS_BAM_IRQ_SRCS_UNMASKED_EE1_ADDR A:0xf9a44888
y.create.l HWIO_PERIPH_SS_USB1_HS_BAM_IRQ_SRCS_UNMASKED_EE2_ADDR A:0xf9a44908
y.create.l HWIO_PERIPH_SS_USB1_HS_BAM_IRQ_SRCS_UNMASKED_EE3_ADDR A:0xf9a44988
y.create.l HWIO_PERIPH_SS_USB1_HS_BAM_IRQ_SRCS_UNMASKED_EE4_ADDR A:0xf9a44a08
y.create.l HWIO_PERIPH_SS_USB1_HS_BAM_IRQ_SRCS_UNMASKED_EE5_ADDR A:0xf9a44a88
y.create.l HWIO_PERIPH_SS_USB1_HS_BAM_IRQ_SRCS_UNMASKED_EE6_ADDR A:0xf9a44b08
y.create.l HWIO_PERIPH_SS_USB1_HS_BAM_IRQ_SRCS_UNMASKED_EE7_ADDR A:0xf9a44b88
y.create.l HWIO_PERIPH_SS_USB1_HS_BAM_P_CTRL0_ADDR A:0xf9a45000
y.create.l HWIO_PERIPH_SS_USB1_HS_BAM_P_CTRL1_ADDR A:0xf9a46000
y.create.l HWIO_PERIPH_SS_USB1_HS_BAM_P_CTRL2_ADDR A:0xf9a47000
y.create.l HWIO_PERIPH_SS_USB1_HS_BAM_P_CTRL3_ADDR A:0xf9a48000
y.create.l HWIO_PERIPH_SS_USB1_HS_BAM_P_CTRL4_ADDR A:0xf9a49000
y.create.l HWIO_PERIPH_SS_USB1_HS_BAM_P_CTRL5_ADDR A:0xf9a4a000
y.create.l HWIO_PERIPH_SS_USB1_HS_BAM_P_CTRL6_ADDR A:0xf9a4b000
y.create.l HWIO_PERIPH_SS_USB1_HS_BAM_P_CTRL7_ADDR A:0xf9a4c000
y.create.l HWIO_PERIPH_SS_USB1_HS_BAM_P_CTRL8_ADDR A:0xf9a4d000
y.create.l HWIO_PERIPH_SS_USB1_HS_BAM_P_CTRL9_ADDR A:0xf9a4e000
y.create.l HWIO_PERIPH_SS_USB1_HS_BAM_P_RST0_ADDR A:0xf9a45004
y.create.l HWIO_PERIPH_SS_USB1_HS_BAM_P_RST1_ADDR A:0xf9a46004
y.create.l HWIO_PERIPH_SS_USB1_HS_BAM_P_RST2_ADDR A:0xf9a47004
y.create.l HWIO_PERIPH_SS_USB1_HS_BAM_P_RST3_ADDR A:0xf9a48004
y.create.l HWIO_PERIPH_SS_USB1_HS_BAM_P_RST4_ADDR A:0xf9a49004
y.create.l HWIO_PERIPH_SS_USB1_HS_BAM_P_RST5_ADDR A:0xf9a4a004
y.create.l HWIO_PERIPH_SS_USB1_HS_BAM_P_RST6_ADDR A:0xf9a4b004
y.create.l HWIO_PERIPH_SS_USB1_HS_BAM_P_RST7_ADDR A:0xf9a4c004
y.create.l HWIO_PERIPH_SS_USB1_HS_BAM_P_RST8_ADDR A:0xf9a4d004
y.create.l HWIO_PERIPH_SS_USB1_HS_BAM_P_RST9_ADDR A:0xf9a4e004
y.create.l HWIO_PERIPH_SS_USB1_HS_BAM_P_HALT0_ADDR A:0xf9a45008
y.create.l HWIO_PERIPH_SS_USB1_HS_BAM_P_HALT1_ADDR A:0xf9a46008
y.create.l HWIO_PERIPH_SS_USB1_HS_BAM_P_HALT2_ADDR A:0xf9a47008
y.create.l HWIO_PERIPH_SS_USB1_HS_BAM_P_HALT3_ADDR A:0xf9a48008
y.create.l HWIO_PERIPH_SS_USB1_HS_BAM_P_HALT4_ADDR A:0xf9a49008
y.create.l HWIO_PERIPH_SS_USB1_HS_BAM_P_HALT5_ADDR A:0xf9a4a008
y.create.l HWIO_PERIPH_SS_USB1_HS_BAM_P_HALT6_ADDR A:0xf9a4b008
y.create.l HWIO_PERIPH_SS_USB1_HS_BAM_P_HALT7_ADDR A:0xf9a4c008
y.create.l HWIO_PERIPH_SS_USB1_HS_BAM_P_HALT8_ADDR A:0xf9a4d008
y.create.l HWIO_PERIPH_SS_USB1_HS_BAM_P_HALT9_ADDR A:0xf9a4e008
y.create.l HWIO_PERIPH_SS_USB1_HS_BAM_P_TRUST_REG0_ADDR A:0xf9a45030
y.create.l HWIO_PERIPH_SS_USB1_HS_BAM_P_TRUST_REG1_ADDR A:0xf9a46030
y.create.l HWIO_PERIPH_SS_USB1_HS_BAM_P_TRUST_REG2_ADDR A:0xf9a47030
y.create.l HWIO_PERIPH_SS_USB1_HS_BAM_P_TRUST_REG3_ADDR A:0xf9a48030
y.create.l HWIO_PERIPH_SS_USB1_HS_BAM_P_TRUST_REG4_ADDR A:0xf9a49030
y.create.l HWIO_PERIPH_SS_USB1_HS_BAM_P_TRUST_REG5_ADDR A:0xf9a4a030
y.create.l HWIO_PERIPH_SS_USB1_HS_BAM_P_TRUST_REG6_ADDR A:0xf9a4b030
y.create.l HWIO_PERIPH_SS_USB1_HS_BAM_P_TRUST_REG7_ADDR A:0xf9a4c030
y.create.l HWIO_PERIPH_SS_USB1_HS_BAM_P_TRUST_REG8_ADDR A:0xf9a4d030
y.create.l HWIO_PERIPH_SS_USB1_HS_BAM_P_TRUST_REG9_ADDR A:0xf9a4e030
y.create.l HWIO_PERIPH_SS_USB1_HS_BAM_P_IRQ_STTS0_ADDR A:0xf9a45010
y.create.l HWIO_PERIPH_SS_USB1_HS_BAM_P_IRQ_STTS1_ADDR A:0xf9a46010
y.create.l HWIO_PERIPH_SS_USB1_HS_BAM_P_IRQ_STTS2_ADDR A:0xf9a47010
y.create.l HWIO_PERIPH_SS_USB1_HS_BAM_P_IRQ_STTS3_ADDR A:0xf9a48010
y.create.l HWIO_PERIPH_SS_USB1_HS_BAM_P_IRQ_STTS4_ADDR A:0xf9a49010
y.create.l HWIO_PERIPH_SS_USB1_HS_BAM_P_IRQ_STTS5_ADDR A:0xf9a4a010
y.create.l HWIO_PERIPH_SS_USB1_HS_BAM_P_IRQ_STTS6_ADDR A:0xf9a4b010
y.create.l HWIO_PERIPH_SS_USB1_HS_BAM_P_IRQ_STTS7_ADDR A:0xf9a4c010
y.create.l HWIO_PERIPH_SS_USB1_HS_BAM_P_IRQ_STTS8_ADDR A:0xf9a4d010
y.create.l HWIO_PERIPH_SS_USB1_HS_BAM_P_IRQ_STTS9_ADDR A:0xf9a4e010
y.create.l HWIO_PERIPH_SS_USB1_HS_BAM_P_IRQ_CLR0_ADDR A:0xf9a45014
y.create.l HWIO_PERIPH_SS_USB1_HS_BAM_P_IRQ_CLR1_ADDR A:0xf9a46014
y.create.l HWIO_PERIPH_SS_USB1_HS_BAM_P_IRQ_CLR2_ADDR A:0xf9a47014
y.create.l HWIO_PERIPH_SS_USB1_HS_BAM_P_IRQ_CLR3_ADDR A:0xf9a48014
y.create.l HWIO_PERIPH_SS_USB1_HS_BAM_P_IRQ_CLR4_ADDR A:0xf9a49014
y.create.l HWIO_PERIPH_SS_USB1_HS_BAM_P_IRQ_CLR5_ADDR A:0xf9a4a014
y.create.l HWIO_PERIPH_SS_USB1_HS_BAM_P_IRQ_CLR6_ADDR A:0xf9a4b014
y.create.l HWIO_PERIPH_SS_USB1_HS_BAM_P_IRQ_CLR7_ADDR A:0xf9a4c014
y.create.l HWIO_PERIPH_SS_USB1_HS_BAM_P_IRQ_CLR8_ADDR A:0xf9a4d014
y.create.l HWIO_PERIPH_SS_USB1_HS_BAM_P_IRQ_CLR9_ADDR A:0xf9a4e014
y.create.l HWIO_PERIPH_SS_USB1_HS_BAM_P_IRQ_EN0_ADDR A:0xf9a45018
y.create.l HWIO_PERIPH_SS_USB1_HS_BAM_P_IRQ_EN1_ADDR A:0xf9a46018
y.create.l HWIO_PERIPH_SS_USB1_HS_BAM_P_IRQ_EN2_ADDR A:0xf9a47018
y.create.l HWIO_PERIPH_SS_USB1_HS_BAM_P_IRQ_EN3_ADDR A:0xf9a48018
y.create.l HWIO_PERIPH_SS_USB1_HS_BAM_P_IRQ_EN4_ADDR A:0xf9a49018
y.create.l HWIO_PERIPH_SS_USB1_HS_BAM_P_IRQ_EN5_ADDR A:0xf9a4a018
y.create.l HWIO_PERIPH_SS_USB1_HS_BAM_P_IRQ_EN6_ADDR A:0xf9a4b018
y.create.l HWIO_PERIPH_SS_USB1_HS_BAM_P_IRQ_EN7_ADDR A:0xf9a4c018
y.create.l HWIO_PERIPH_SS_USB1_HS_BAM_P_IRQ_EN8_ADDR A:0xf9a4d018
y.create.l HWIO_PERIPH_SS_USB1_HS_BAM_P_IRQ_EN9_ADDR A:0xf9a4e018
y.create.l HWIO_PERIPH_SS_USB1_HS_BAM_P_TIMER0_ADDR A:0xf9a4501c
y.create.l HWIO_PERIPH_SS_USB1_HS_BAM_P_TIMER1_ADDR A:0xf9a4601c
y.create.l HWIO_PERIPH_SS_USB1_HS_BAM_P_TIMER2_ADDR A:0xf9a4701c
y.create.l HWIO_PERIPH_SS_USB1_HS_BAM_P_TIMER3_ADDR A:0xf9a4801c
y.create.l HWIO_PERIPH_SS_USB1_HS_BAM_P_TIMER4_ADDR A:0xf9a4901c
y.create.l HWIO_PERIPH_SS_USB1_HS_BAM_P_TIMER5_ADDR A:0xf9a4a01c
y.create.l HWIO_PERIPH_SS_USB1_HS_BAM_P_TIMER6_ADDR A:0xf9a4b01c
y.create.l HWIO_PERIPH_SS_USB1_HS_BAM_P_TIMER7_ADDR A:0xf9a4c01c
y.create.l HWIO_PERIPH_SS_USB1_HS_BAM_P_TIMER8_ADDR A:0xf9a4d01c
y.create.l HWIO_PERIPH_SS_USB1_HS_BAM_P_TIMER9_ADDR A:0xf9a4e01c
y.create.l HWIO_PERIPH_SS_USB1_HS_BAM_P_TIMER_CTRL0_ADDR A:0xf9a45020
y.create.l HWIO_PERIPH_SS_USB1_HS_BAM_P_TIMER_CTRL1_ADDR A:0xf9a46020
y.create.l HWIO_PERIPH_SS_USB1_HS_BAM_P_TIMER_CTRL2_ADDR A:0xf9a47020
y.create.l HWIO_PERIPH_SS_USB1_HS_BAM_P_TIMER_CTRL3_ADDR A:0xf9a48020
y.create.l HWIO_PERIPH_SS_USB1_HS_BAM_P_TIMER_CTRL4_ADDR A:0xf9a49020
y.create.l HWIO_PERIPH_SS_USB1_HS_BAM_P_TIMER_CTRL5_ADDR A:0xf9a4a020
y.create.l HWIO_PERIPH_SS_USB1_HS_BAM_P_TIMER_CTRL6_ADDR A:0xf9a4b020
y.create.l HWIO_PERIPH_SS_USB1_HS_BAM_P_TIMER_CTRL7_ADDR A:0xf9a4c020
y.create.l HWIO_PERIPH_SS_USB1_HS_BAM_P_TIMER_CTRL8_ADDR A:0xf9a4d020
y.create.l HWIO_PERIPH_SS_USB1_HS_BAM_P_TIMER_CTRL9_ADDR A:0xf9a4e020
y.create.l HWIO_PERIPH_SS_USB1_HS_BAM_P_PRDCR_SDBND0_ADDR A:0xf9a45024
y.create.l HWIO_PERIPH_SS_USB1_HS_BAM_P_PRDCR_SDBND1_ADDR A:0xf9a46024
y.create.l HWIO_PERIPH_SS_USB1_HS_BAM_P_PRDCR_SDBND2_ADDR A:0xf9a47024
y.create.l HWIO_PERIPH_SS_USB1_HS_BAM_P_PRDCR_SDBND3_ADDR A:0xf9a48024
y.create.l HWIO_PERIPH_SS_USB1_HS_BAM_P_PRDCR_SDBND4_ADDR A:0xf9a49024
y.create.l HWIO_PERIPH_SS_USB1_HS_BAM_P_PRDCR_SDBND5_ADDR A:0xf9a4a024
y.create.l HWIO_PERIPH_SS_USB1_HS_BAM_P_PRDCR_SDBND6_ADDR A:0xf9a4b024
y.create.l HWIO_PERIPH_SS_USB1_HS_BAM_P_PRDCR_SDBND7_ADDR A:0xf9a4c024
y.create.l HWIO_PERIPH_SS_USB1_HS_BAM_P_PRDCR_SDBND8_ADDR A:0xf9a4d024
y.create.l HWIO_PERIPH_SS_USB1_HS_BAM_P_PRDCR_SDBND9_ADDR A:0xf9a4e024
y.create.l HWIO_PERIPH_SS_USB1_HS_BAM_P_CNSMR_SDBND0_ADDR A:0xf9a45028
y.create.l HWIO_PERIPH_SS_USB1_HS_BAM_P_CNSMR_SDBND1_ADDR A:0xf9a46028
y.create.l HWIO_PERIPH_SS_USB1_HS_BAM_P_CNSMR_SDBND2_ADDR A:0xf9a47028
y.create.l HWIO_PERIPH_SS_USB1_HS_BAM_P_CNSMR_SDBND3_ADDR A:0xf9a48028
y.create.l HWIO_PERIPH_SS_USB1_HS_BAM_P_CNSMR_SDBND4_ADDR A:0xf9a49028
y.create.l HWIO_PERIPH_SS_USB1_HS_BAM_P_CNSMR_SDBND5_ADDR A:0xf9a4a028
y.create.l HWIO_PERIPH_SS_USB1_HS_BAM_P_CNSMR_SDBND6_ADDR A:0xf9a4b028
y.create.l HWIO_PERIPH_SS_USB1_HS_BAM_P_CNSMR_SDBND7_ADDR A:0xf9a4c028
y.create.l HWIO_PERIPH_SS_USB1_HS_BAM_P_CNSMR_SDBND8_ADDR A:0xf9a4d028
y.create.l HWIO_PERIPH_SS_USB1_HS_BAM_P_CNSMR_SDBND9_ADDR A:0xf9a4e028
y.create.l HWIO_PERIPH_SS_USB1_HS_BAM_P_EVNT_DEST_ADDR0_ADDR A:0xf9a4582c
y.create.l HWIO_PERIPH_SS_USB1_HS_BAM_P_EVNT_DEST_ADDR1_ADDR A:0xf9a4682c
y.create.l HWIO_PERIPH_SS_USB1_HS_BAM_P_EVNT_DEST_ADDR2_ADDR A:0xf9a4782c
y.create.l HWIO_PERIPH_SS_USB1_HS_BAM_P_EVNT_DEST_ADDR3_ADDR A:0xf9a4882c
y.create.l HWIO_PERIPH_SS_USB1_HS_BAM_P_EVNT_DEST_ADDR4_ADDR A:0xf9a4982c
y.create.l HWIO_PERIPH_SS_USB1_HS_BAM_P_EVNT_DEST_ADDR5_ADDR A:0xf9a4a82c
y.create.l HWIO_PERIPH_SS_USB1_HS_BAM_P_EVNT_DEST_ADDR6_ADDR A:0xf9a4b82c
y.create.l HWIO_PERIPH_SS_USB1_HS_BAM_P_EVNT_DEST_ADDR7_ADDR A:0xf9a4c82c
y.create.l HWIO_PERIPH_SS_USB1_HS_BAM_P_EVNT_DEST_ADDR8_ADDR A:0xf9a4d82c
y.create.l HWIO_PERIPH_SS_USB1_HS_BAM_P_EVNT_DEST_ADDR9_ADDR A:0xf9a4e82c
y.create.l HWIO_PERIPH_SS_USB1_HS_BAM_P_EVNT_REG0_ADDR A:0xf9a45818
y.create.l HWIO_PERIPH_SS_USB1_HS_BAM_P_EVNT_REG1_ADDR A:0xf9a46818
y.create.l HWIO_PERIPH_SS_USB1_HS_BAM_P_EVNT_REG2_ADDR A:0xf9a47818
y.create.l HWIO_PERIPH_SS_USB1_HS_BAM_P_EVNT_REG3_ADDR A:0xf9a48818
y.create.l HWIO_PERIPH_SS_USB1_HS_BAM_P_EVNT_REG4_ADDR A:0xf9a49818
y.create.l HWIO_PERIPH_SS_USB1_HS_BAM_P_EVNT_REG5_ADDR A:0xf9a4a818
y.create.l HWIO_PERIPH_SS_USB1_HS_BAM_P_EVNT_REG6_ADDR A:0xf9a4b818
y.create.l HWIO_PERIPH_SS_USB1_HS_BAM_P_EVNT_REG7_ADDR A:0xf9a4c818
y.create.l HWIO_PERIPH_SS_USB1_HS_BAM_P_EVNT_REG8_ADDR A:0xf9a4d818
y.create.l HWIO_PERIPH_SS_USB1_HS_BAM_P_EVNT_REG9_ADDR A:0xf9a4e818
y.create.l HWIO_PERIPH_SS_USB1_HS_BAM_P_SW_OFSTS0_ADDR A:0xf9a45800
y.create.l HWIO_PERIPH_SS_USB1_HS_BAM_P_SW_OFSTS1_ADDR A:0xf9a46800
y.create.l HWIO_PERIPH_SS_USB1_HS_BAM_P_SW_OFSTS2_ADDR A:0xf9a47800
y.create.l HWIO_PERIPH_SS_USB1_HS_BAM_P_SW_OFSTS3_ADDR A:0xf9a48800
y.create.l HWIO_PERIPH_SS_USB1_HS_BAM_P_SW_OFSTS4_ADDR A:0xf9a49800
y.create.l HWIO_PERIPH_SS_USB1_HS_BAM_P_SW_OFSTS5_ADDR A:0xf9a4a800
y.create.l HWIO_PERIPH_SS_USB1_HS_BAM_P_SW_OFSTS6_ADDR A:0xf9a4b800
y.create.l HWIO_PERIPH_SS_USB1_HS_BAM_P_SW_OFSTS7_ADDR A:0xf9a4c800
y.create.l HWIO_PERIPH_SS_USB1_HS_BAM_P_SW_OFSTS8_ADDR A:0xf9a4d800
y.create.l HWIO_PERIPH_SS_USB1_HS_BAM_P_SW_OFSTS9_ADDR A:0xf9a4e800
y.create.l HWIO_PERIPH_SS_USB1_HS_BAM_P_DATA_FIFO_ADDR0_ADDR A:0xf9a45824
y.create.l HWIO_PERIPH_SS_USB1_HS_BAM_P_DATA_FIFO_ADDR1_ADDR A:0xf9a46824
y.create.l HWIO_PERIPH_SS_USB1_HS_BAM_P_DATA_FIFO_ADDR2_ADDR A:0xf9a47824
y.create.l HWIO_PERIPH_SS_USB1_HS_BAM_P_DATA_FIFO_ADDR3_ADDR A:0xf9a48824
y.create.l HWIO_PERIPH_SS_USB1_HS_BAM_P_DATA_FIFO_ADDR4_ADDR A:0xf9a49824
y.create.l HWIO_PERIPH_SS_USB1_HS_BAM_P_DATA_FIFO_ADDR5_ADDR A:0xf9a4a824
y.create.l HWIO_PERIPH_SS_USB1_HS_BAM_P_DATA_FIFO_ADDR6_ADDR A:0xf9a4b824
y.create.l HWIO_PERIPH_SS_USB1_HS_BAM_P_DATA_FIFO_ADDR7_ADDR A:0xf9a4c824
y.create.l HWIO_PERIPH_SS_USB1_HS_BAM_P_DATA_FIFO_ADDR8_ADDR A:0xf9a4d824
y.create.l HWIO_PERIPH_SS_USB1_HS_BAM_P_DATA_FIFO_ADDR9_ADDR A:0xf9a4e824
y.create.l HWIO_PERIPH_SS_USB1_HS_BAM_P_DESC_FIFO_ADDR0_ADDR A:0xf9a4581c
y.create.l HWIO_PERIPH_SS_USB1_HS_BAM_P_DESC_FIFO_ADDR1_ADDR A:0xf9a4681c
y.create.l HWIO_PERIPH_SS_USB1_HS_BAM_P_DESC_FIFO_ADDR2_ADDR A:0xf9a4781c
y.create.l HWIO_PERIPH_SS_USB1_HS_BAM_P_DESC_FIFO_ADDR3_ADDR A:0xf9a4881c
y.create.l HWIO_PERIPH_SS_USB1_HS_BAM_P_DESC_FIFO_ADDR4_ADDR A:0xf9a4981c
y.create.l HWIO_PERIPH_SS_USB1_HS_BAM_P_DESC_FIFO_ADDR5_ADDR A:0xf9a4a81c
y.create.l HWIO_PERIPH_SS_USB1_HS_BAM_P_DESC_FIFO_ADDR6_ADDR A:0xf9a4b81c
y.create.l HWIO_PERIPH_SS_USB1_HS_BAM_P_DESC_FIFO_ADDR7_ADDR A:0xf9a4c81c
y.create.l HWIO_PERIPH_SS_USB1_HS_BAM_P_DESC_FIFO_ADDR8_ADDR A:0xf9a4d81c
y.create.l HWIO_PERIPH_SS_USB1_HS_BAM_P_DESC_FIFO_ADDR9_ADDR A:0xf9a4e81c
y.create.l HWIO_PERIPH_SS_USB1_HS_BAM_P_EVNT_GEN_TRSHLD0_ADDR A:0xf9a45828
y.create.l HWIO_PERIPH_SS_USB1_HS_BAM_P_EVNT_GEN_TRSHLD1_ADDR A:0xf9a46828
y.create.l HWIO_PERIPH_SS_USB1_HS_BAM_P_EVNT_GEN_TRSHLD2_ADDR A:0xf9a47828
y.create.l HWIO_PERIPH_SS_USB1_HS_BAM_P_EVNT_GEN_TRSHLD3_ADDR A:0xf9a48828
y.create.l HWIO_PERIPH_SS_USB1_HS_BAM_P_EVNT_GEN_TRSHLD4_ADDR A:0xf9a49828
y.create.l HWIO_PERIPH_SS_USB1_HS_BAM_P_EVNT_GEN_TRSHLD5_ADDR A:0xf9a4a828
y.create.l HWIO_PERIPH_SS_USB1_HS_BAM_P_EVNT_GEN_TRSHLD6_ADDR A:0xf9a4b828
y.create.l HWIO_PERIPH_SS_USB1_HS_BAM_P_EVNT_GEN_TRSHLD7_ADDR A:0xf9a4c828
y.create.l HWIO_PERIPH_SS_USB1_HS_BAM_P_EVNT_GEN_TRSHLD8_ADDR A:0xf9a4d828
y.create.l HWIO_PERIPH_SS_USB1_HS_BAM_P_EVNT_GEN_TRSHLD9_ADDR A:0xf9a4e828
y.create.l HWIO_PERIPH_SS_USB1_HS_BAM_P_FIFO_SIZES0_ADDR A:0xf9a45820
y.create.l HWIO_PERIPH_SS_USB1_HS_BAM_P_FIFO_SIZES1_ADDR A:0xf9a46820
y.create.l HWIO_PERIPH_SS_USB1_HS_BAM_P_FIFO_SIZES2_ADDR A:0xf9a47820
y.create.l HWIO_PERIPH_SS_USB1_HS_BAM_P_FIFO_SIZES3_ADDR A:0xf9a48820
y.create.l HWIO_PERIPH_SS_USB1_HS_BAM_P_FIFO_SIZES4_ADDR A:0xf9a49820
y.create.l HWIO_PERIPH_SS_USB1_HS_BAM_P_FIFO_SIZES5_ADDR A:0xf9a4a820
y.create.l HWIO_PERIPH_SS_USB1_HS_BAM_P_FIFO_SIZES6_ADDR A:0xf9a4b820
y.create.l HWIO_PERIPH_SS_USB1_HS_BAM_P_FIFO_SIZES7_ADDR A:0xf9a4c820
y.create.l HWIO_PERIPH_SS_USB1_HS_BAM_P_FIFO_SIZES8_ADDR A:0xf9a4d820
y.create.l HWIO_PERIPH_SS_USB1_HS_BAM_P_FIFO_SIZES9_ADDR A:0xf9a4e820
y.create.l HWIO_PERIPH_SS_USB1_HS_BAM_P_RETR_CNTXT_0_ADDR A:0xf9a45834
y.create.l HWIO_PERIPH_SS_USB1_HS_BAM_P_RETR_CNTXT_1_ADDR A:0xf9a46834
y.create.l HWIO_PERIPH_SS_USB1_HS_BAM_P_RETR_CNTXT_2_ADDR A:0xf9a47834
y.create.l HWIO_PERIPH_SS_USB1_HS_BAM_P_RETR_CNTXT_3_ADDR A:0xf9a48834
y.create.l HWIO_PERIPH_SS_USB1_HS_BAM_P_RETR_CNTXT_4_ADDR A:0xf9a49834
y.create.l HWIO_PERIPH_SS_USB1_HS_BAM_P_RETR_CNTXT_5_ADDR A:0xf9a4a834
y.create.l HWIO_PERIPH_SS_USB1_HS_BAM_P_RETR_CNTXT_6_ADDR A:0xf9a4b834
y.create.l HWIO_PERIPH_SS_USB1_HS_BAM_P_RETR_CNTXT_7_ADDR A:0xf9a4c834
y.create.l HWIO_PERIPH_SS_USB1_HS_BAM_P_RETR_CNTXT_8_ADDR A:0xf9a4d834
y.create.l HWIO_PERIPH_SS_USB1_HS_BAM_P_RETR_CNTXT_9_ADDR A:0xf9a4e834
y.create.l HWIO_PERIPH_SS_USB1_HS_BAM_P_SI_CNTXT_0_ADDR A:0xf9a45838
y.create.l HWIO_PERIPH_SS_USB1_HS_BAM_P_SI_CNTXT_1_ADDR A:0xf9a46838
y.create.l HWIO_PERIPH_SS_USB1_HS_BAM_P_SI_CNTXT_2_ADDR A:0xf9a47838
y.create.l HWIO_PERIPH_SS_USB1_HS_BAM_P_SI_CNTXT_3_ADDR A:0xf9a48838
y.create.l HWIO_PERIPH_SS_USB1_HS_BAM_P_SI_CNTXT_4_ADDR A:0xf9a49838
y.create.l HWIO_PERIPH_SS_USB1_HS_BAM_P_SI_CNTXT_5_ADDR A:0xf9a4a838
y.create.l HWIO_PERIPH_SS_USB1_HS_BAM_P_SI_CNTXT_6_ADDR A:0xf9a4b838
y.create.l HWIO_PERIPH_SS_USB1_HS_BAM_P_SI_CNTXT_7_ADDR A:0xf9a4c838
y.create.l HWIO_PERIPH_SS_USB1_HS_BAM_P_SI_CNTXT_8_ADDR A:0xf9a4d838
y.create.l HWIO_PERIPH_SS_USB1_HS_BAM_P_SI_CNTXT_9_ADDR A:0xf9a4e838
y.create.l HWIO_PERIPH_SS_USB1_HS_BAM_P_DF_CNTXT_0_ADDR A:0xf9a45830
y.create.l HWIO_PERIPH_SS_USB1_HS_BAM_P_DF_CNTXT_1_ADDR A:0xf9a46830
y.create.l HWIO_PERIPH_SS_USB1_HS_BAM_P_DF_CNTXT_2_ADDR A:0xf9a47830
y.create.l HWIO_PERIPH_SS_USB1_HS_BAM_P_DF_CNTXT_3_ADDR A:0xf9a48830
y.create.l HWIO_PERIPH_SS_USB1_HS_BAM_P_DF_CNTXT_4_ADDR A:0xf9a49830
y.create.l HWIO_PERIPH_SS_USB1_HS_BAM_P_DF_CNTXT_5_ADDR A:0xf9a4a830
y.create.l HWIO_PERIPH_SS_USB1_HS_BAM_P_DF_CNTXT_6_ADDR A:0xf9a4b830
y.create.l HWIO_PERIPH_SS_USB1_HS_BAM_P_DF_CNTXT_7_ADDR A:0xf9a4c830
y.create.l HWIO_PERIPH_SS_USB1_HS_BAM_P_DF_CNTXT_8_ADDR A:0xf9a4d830
y.create.l HWIO_PERIPH_SS_USB1_HS_BAM_P_DF_CNTXT_9_ADDR A:0xf9a4e830
y.create.l HWIO_PERIPH_SS_USB1_HS_BAM_P_AU_PSM_CNTXT_1_0_ADDR A:0xf9a45804
y.create.l HWIO_PERIPH_SS_USB1_HS_BAM_P_AU_PSM_CNTXT_1_1_ADDR A:0xf9a46804
y.create.l HWIO_PERIPH_SS_USB1_HS_BAM_P_AU_PSM_CNTXT_1_2_ADDR A:0xf9a47804
y.create.l HWIO_PERIPH_SS_USB1_HS_BAM_P_AU_PSM_CNTXT_1_3_ADDR A:0xf9a48804
y.create.l HWIO_PERIPH_SS_USB1_HS_BAM_P_AU_PSM_CNTXT_1_4_ADDR A:0xf9a49804
y.create.l HWIO_PERIPH_SS_USB1_HS_BAM_P_AU_PSM_CNTXT_1_5_ADDR A:0xf9a4a804
y.create.l HWIO_PERIPH_SS_USB1_HS_BAM_P_AU_PSM_CNTXT_1_6_ADDR A:0xf9a4b804
y.create.l HWIO_PERIPH_SS_USB1_HS_BAM_P_AU_PSM_CNTXT_1_7_ADDR A:0xf9a4c804
y.create.l HWIO_PERIPH_SS_USB1_HS_BAM_P_AU_PSM_CNTXT_1_8_ADDR A:0xf9a4d804
y.create.l HWIO_PERIPH_SS_USB1_HS_BAM_P_AU_PSM_CNTXT_1_9_ADDR A:0xf9a4e804
y.create.l HWIO_PERIPH_SS_USB1_HS_BAM_P_PSM_CNTXT_2_0_ADDR A:0xf9a45808
y.create.l HWIO_PERIPH_SS_USB1_HS_BAM_P_PSM_CNTXT_2_1_ADDR A:0xf9a46808
y.create.l HWIO_PERIPH_SS_USB1_HS_BAM_P_PSM_CNTXT_2_2_ADDR A:0xf9a47808
y.create.l HWIO_PERIPH_SS_USB1_HS_BAM_P_PSM_CNTXT_2_3_ADDR A:0xf9a48808
y.create.l HWIO_PERIPH_SS_USB1_HS_BAM_P_PSM_CNTXT_2_4_ADDR A:0xf9a49808
y.create.l HWIO_PERIPH_SS_USB1_HS_BAM_P_PSM_CNTXT_2_5_ADDR A:0xf9a4a808
y.create.l HWIO_PERIPH_SS_USB1_HS_BAM_P_PSM_CNTXT_2_6_ADDR A:0xf9a4b808
y.create.l HWIO_PERIPH_SS_USB1_HS_BAM_P_PSM_CNTXT_2_7_ADDR A:0xf9a4c808
y.create.l HWIO_PERIPH_SS_USB1_HS_BAM_P_PSM_CNTXT_2_8_ADDR A:0xf9a4d808
y.create.l HWIO_PERIPH_SS_USB1_HS_BAM_P_PSM_CNTXT_2_9_ADDR A:0xf9a4e808
y.create.l HWIO_PERIPH_SS_USB1_HS_BAM_P_PSM_CNTXT_3_0_ADDR A:0xf9a4580c
y.create.l HWIO_PERIPH_SS_USB1_HS_BAM_P_PSM_CNTXT_3_1_ADDR A:0xf9a4680c
y.create.l HWIO_PERIPH_SS_USB1_HS_BAM_P_PSM_CNTXT_3_2_ADDR A:0xf9a4780c
y.create.l HWIO_PERIPH_SS_USB1_HS_BAM_P_PSM_CNTXT_3_3_ADDR A:0xf9a4880c
y.create.l HWIO_PERIPH_SS_USB1_HS_BAM_P_PSM_CNTXT_3_4_ADDR A:0xf9a4980c
y.create.l HWIO_PERIPH_SS_USB1_HS_BAM_P_PSM_CNTXT_3_5_ADDR A:0xf9a4a80c
y.create.l HWIO_PERIPH_SS_USB1_HS_BAM_P_PSM_CNTXT_3_6_ADDR A:0xf9a4b80c
y.create.l HWIO_PERIPH_SS_USB1_HS_BAM_P_PSM_CNTXT_3_7_ADDR A:0xf9a4c80c
y.create.l HWIO_PERIPH_SS_USB1_HS_BAM_P_PSM_CNTXT_3_8_ADDR A:0xf9a4d80c
y.create.l HWIO_PERIPH_SS_USB1_HS_BAM_P_PSM_CNTXT_3_9_ADDR A:0xf9a4e80c
y.create.l HWIO_PERIPH_SS_USB1_HS_BAM_P_PSM_CNTXT_4_0_ADDR A:0xf9a45810
y.create.l HWIO_PERIPH_SS_USB1_HS_BAM_P_PSM_CNTXT_4_1_ADDR A:0xf9a46810
y.create.l HWIO_PERIPH_SS_USB1_HS_BAM_P_PSM_CNTXT_4_2_ADDR A:0xf9a47810
y.create.l HWIO_PERIPH_SS_USB1_HS_BAM_P_PSM_CNTXT_4_3_ADDR A:0xf9a48810
y.create.l HWIO_PERIPH_SS_USB1_HS_BAM_P_PSM_CNTXT_4_4_ADDR A:0xf9a49810
y.create.l HWIO_PERIPH_SS_USB1_HS_BAM_P_PSM_CNTXT_4_5_ADDR A:0xf9a4a810
y.create.l HWIO_PERIPH_SS_USB1_HS_BAM_P_PSM_CNTXT_4_6_ADDR A:0xf9a4b810
y.create.l HWIO_PERIPH_SS_USB1_HS_BAM_P_PSM_CNTXT_4_7_ADDR A:0xf9a4c810
y.create.l HWIO_PERIPH_SS_USB1_HS_BAM_P_PSM_CNTXT_4_8_ADDR A:0xf9a4d810
y.create.l HWIO_PERIPH_SS_USB1_HS_BAM_P_PSM_CNTXT_4_9_ADDR A:0xf9a4e810
y.create.l HWIO_PERIPH_SS_USB1_HS_BAM_P_PSM_CNTXT_5_0_ADDR A:0xf9a45814
y.create.l HWIO_PERIPH_SS_USB1_HS_BAM_P_PSM_CNTXT_5_1_ADDR A:0xf9a46814
y.create.l HWIO_PERIPH_SS_USB1_HS_BAM_P_PSM_CNTXT_5_2_ADDR A:0xf9a47814
y.create.l HWIO_PERIPH_SS_USB1_HS_BAM_P_PSM_CNTXT_5_3_ADDR A:0xf9a48814
y.create.l HWIO_PERIPH_SS_USB1_HS_BAM_P_PSM_CNTXT_5_4_ADDR A:0xf9a49814
y.create.l HWIO_PERIPH_SS_USB1_HS_BAM_P_PSM_CNTXT_5_5_ADDR A:0xf9a4a814
y.create.l HWIO_PERIPH_SS_USB1_HS_BAM_P_PSM_CNTXT_5_6_ADDR A:0xf9a4b814
y.create.l HWIO_PERIPH_SS_USB1_HS_BAM_P_PSM_CNTXT_5_7_ADDR A:0xf9a4c814
y.create.l HWIO_PERIPH_SS_USB1_HS_BAM_P_PSM_CNTXT_5_8_ADDR A:0xf9a4d814
y.create.l HWIO_PERIPH_SS_USB1_HS_BAM_P_PSM_CNTXT_5_9_ADDR A:0xf9a4e814
y.create.l HWIO_PERIPH_SS_USB1_HS_XPU_SCR_ADDR A:0xf9a42000
y.create.l HWIO_PERIPH_SS_USB1_HS_XPU_SWDR_ADDR A:0xf9a42004
y.create.l HWIO_PERIPH_SS_USB1_HS_XPU_SEAR0_ADDR A:0xf9a42040
y.create.l HWIO_PERIPH_SS_USB1_HS_XPU_SESR_ADDR A:0xf9a42048
y.create.l HWIO_PERIPH_SS_USB1_HS_XPU_SESRRESTORE_ADDR A:0xf9a4204c
y.create.l HWIO_PERIPH_SS_USB1_HS_XPU_SESYNR0_ADDR A:0xf9a42050
y.create.l HWIO_PERIPH_SS_USB1_HS_XPU_SESYNR1_ADDR A:0xf9a42054
y.create.l HWIO_PERIPH_SS_USB1_HS_XPU_SESYNR2_ADDR A:0xf9a42058
y.create.l HWIO_PERIPH_SS_USB1_HS_XPU_MCR_ADDR A:0xf9a42100
y.create.l HWIO_PERIPH_SS_USB1_HS_XPU_MEAR0_ADDR A:0xf9a42140
y.create.l HWIO_PERIPH_SS_USB1_HS_XPU_MESR_ADDR A:0xf9a42148
y.create.l HWIO_PERIPH_SS_USB1_HS_XPU_MESRRESTORE_ADDR A:0xf9a4214c
y.create.l HWIO_PERIPH_SS_USB1_HS_XPU_MESYNR0_ADDR A:0xf9a42150
y.create.l HWIO_PERIPH_SS_USB1_HS_XPU_MESYNR1_ADDR A:0xf9a42154
y.create.l HWIO_PERIPH_SS_USB1_HS_XPU_MESYNR2_ADDR A:0xf9a42158
y.create.l HWIO_PERIPH_SS_USB1_HS_XPU_CR_ADDR A:0xf9a42080
y.create.l HWIO_PERIPH_SS_USB1_HS_XPU_RPU_ACR0_ADDR A:0xf9a420a0
y.create.l HWIO_PERIPH_SS_USB1_HS_XPU_EAR0_ADDR A:0xf9a420c0
y.create.l HWIO_PERIPH_SS_USB1_HS_XPU_ESR_ADDR A:0xf9a420c8
y.create.l HWIO_PERIPH_SS_USB1_HS_XPU_ESRRESTORE_ADDR A:0xf9a420cc
y.create.l HWIO_PERIPH_SS_USB1_HS_XPU_ESYNR0_ADDR A:0xf9a420d0
y.create.l HWIO_PERIPH_SS_USB1_HS_XPU_ESYNR1_ADDR A:0xf9a420d4
y.create.l HWIO_PERIPH_SS_USB1_HS_XPU_ESYNR2_ADDR A:0xf9a420d8
y.create.l HWIO_PERIPH_SS_USB1_HS_XPU_IDR0_ADDR A:0xf9a42074
y.create.l HWIO_PERIPH_SS_USB1_HS_XPU_IDR1_ADDR A:0xf9a42078
y.create.l HWIO_PERIPH_SS_USB1_HS_XPU_REV_ADDR A:0xf9a4207c
y.create.l HWIO_PERIPH_SS_USB1_HS_XPU_RG0_RACR0_ADDR A:0xf9a42200
y.create.l HWIO_PERIPH_SS_USB1_HS_XPU_RG1_RACR0_ADDR A:0xf9a42280
y.create.l HWIO_PERIPH_SS_USB1_HS_XPU_RG2_RACR0_ADDR A:0xf9a42300
y.create.l HWIO_PERIPH_SS_USB1_HS_XPU_RG3_RACR0_ADDR A:0xf9a42380
y.create.l HWIO_PERIPH_SS_USB1_HS_XPU_RG4_RACR0_ADDR A:0xf9a42400
y.create.l HWIO_PERIPH_SS_USB1_HS_XPU_RG5_RACR0_ADDR A:0xf9a42480
y.create.l HWIO_PERIPH_SS_USB1_HS_XPU_RG6_RACR0_ADDR A:0xf9a42500
y.create.l HWIO_PERIPH_SS_USB1_HS_XPU_RG7_RACR0_ADDR A:0xf9a42580
y.create.l HWIO_PERIPH_SS_USB1_HS_XPU_RG8_RACR0_ADDR A:0xf9a42600
y.create.l HWIO_PERIPH_SS_USB1_HS_XPU_RG9_RACR0_ADDR A:0xf9a42680
y.create.l HWIO_PERIPH_SS_USB1_HS_XPU_RG0_SCR_ADDR A:0xf9a42250
y.create.l HWIO_PERIPH_SS_USB1_HS_XPU_RG1_SCR_ADDR A:0xf9a422d0
y.create.l HWIO_PERIPH_SS_USB1_HS_XPU_RG2_SCR_ADDR A:0xf9a42350
y.create.l HWIO_PERIPH_SS_USB1_HS_XPU_RG3_SCR_ADDR A:0xf9a423d0
y.create.l HWIO_PERIPH_SS_USB1_HS_XPU_RG4_SCR_ADDR A:0xf9a42450
y.create.l HWIO_PERIPH_SS_USB1_HS_XPU_RG5_SCR_ADDR A:0xf9a424d0
y.create.l HWIO_PERIPH_SS_USB1_HS_XPU_RG6_SCR_ADDR A:0xf9a42550
y.create.l HWIO_PERIPH_SS_USB1_HS_XPU_RG7_SCR_ADDR A:0xf9a425d0
y.create.l HWIO_PERIPH_SS_USB1_HS_XPU_RG8_SCR_ADDR A:0xf9a42650
y.create.l HWIO_PERIPH_SS_USB1_HS_XPU_RG9_SCR_ADDR A:0xf9a426d0
y.create.l HWIO_PERIPH_SS_USB1_HS_XPU_RG0_MCR_ADDR A:0xf9a42254
y.create.l HWIO_PERIPH_SS_USB1_HS_XPU_RG1_MCR_ADDR A:0xf9a422d4
y.create.l HWIO_PERIPH_SS_USB1_HS_XPU_RG2_MCR_ADDR A:0xf9a42354
y.create.l HWIO_PERIPH_SS_USB1_HS_XPU_RG3_MCR_ADDR A:0xf9a423d4
y.create.l HWIO_PERIPH_SS_USB1_HS_XPU_RG4_MCR_ADDR A:0xf9a42454
y.create.l HWIO_PERIPH_SS_USB1_HS_XPU_RG5_MCR_ADDR A:0xf9a424d4
y.create.l HWIO_PERIPH_SS_USB1_HS_XPU_RG6_MCR_ADDR A:0xf9a42554
y.create.l HWIO_PERIPH_SS_USB1_HS_XPU_RG7_MCR_ADDR A:0xf9a425d4
y.create.l HWIO_PERIPH_SS_USB1_HS_XPU_RG8_MCR_ADDR A:0xf9a42654
y.create.l HWIO_PERIPH_SS_USB1_HS_XPU_RG9_MCR_ADDR A:0xf9a426d4
y.create.l HWIO_PERIPH_SS_USB1_HS_VMIDMT_SCR0_ADDR A:0xf9a40000
y.create.l HWIO_PERIPH_SS_USB1_HS_VMIDMT_SCR1_ADDR A:0xf9a40004
y.create.l HWIO_PERIPH_SS_USB1_HS_VMIDMT_SCR2_ADDR A:0xf9a40008
y.create.l HWIO_PERIPH_SS_USB1_HS_VMIDMT_SACR_ADDR A:0xf9a40010
y.create.l HWIO_PERIPH_SS_USB1_HS_VMIDMT_SIDR0_ADDR A:0xf9a40020
y.create.l HWIO_PERIPH_SS_USB1_HS_VMIDMT_SIDR1_ADDR A:0xf9a40024
y.create.l HWIO_PERIPH_SS_USB1_HS_VMIDMT_SIDR2_ADDR A:0xf9a40028
y.create.l HWIO_PERIPH_SS_USB1_HS_VMIDMT_SIDR4_ADDR A:0xf9a40030
y.create.l HWIO_PERIPH_SS_USB1_HS_VMIDMT_SIDR5_ADDR A:0xf9a40034
y.create.l HWIO_PERIPH_SS_USB1_HS_VMIDMT_SIDR7_ADDR A:0xf9a4003c
y.create.l HWIO_PERIPH_SS_USB1_HS_VMIDMT_SGFAR0_ADDR A:0xf9a40040
y.create.l HWIO_PERIPH_SS_USB1_HS_VMIDMT_SGFSR_ADDR A:0xf9a40048
y.create.l HWIO_PERIPH_SS_USB1_HS_VMIDMT_SGFSRRESTORE_ADDR A:0xf9a4004c
y.create.l HWIO_PERIPH_SS_USB1_HS_VMIDMT_SGFSYNDR0_ADDR A:0xf9a40050
y.create.l HWIO_PERIPH_SS_USB1_HS_VMIDMT_SGFSYNDR1_ADDR A:0xf9a40054
y.create.l HWIO_PERIPH_SS_USB1_HS_VMIDMT_SGFSYNDR2_ADDR A:0xf9a40058
y.create.l HWIO_PERIPH_SS_USB1_HS_VMIDMT_VMIDMTSCR0_ADDR A:0xf9a40090
y.create.l HWIO_PERIPH_SS_USB1_HS_VMIDMT_CR0_ADDR A:0xf9a40000
y.create.l HWIO_PERIPH_SS_USB1_HS_VMIDMT_CR2_ADDR A:0xf9a40008
y.create.l HWIO_PERIPH_SS_USB1_HS_VMIDMT_ACR_ADDR A:0xf9a40010
y.create.l HWIO_PERIPH_SS_USB1_HS_VMIDMT_IDR0_ADDR A:0xf9a40020
y.create.l HWIO_PERIPH_SS_USB1_HS_VMIDMT_IDR1_ADDR A:0xf9a40024
y.create.l HWIO_PERIPH_SS_USB1_HS_VMIDMT_IDR2_ADDR A:0xf9a40028
y.create.l HWIO_PERIPH_SS_USB1_HS_VMIDMT_IDR4_ADDR A:0xf9a40030
y.create.l HWIO_PERIPH_SS_USB1_HS_VMIDMT_IDR5_ADDR A:0xf9a40034
y.create.l HWIO_PERIPH_SS_USB1_HS_VMIDMT_IDR7_ADDR A:0xf9a4003c
y.create.l HWIO_PERIPH_SS_USB1_HS_VMIDMT_GFAR0_ADDR A:0xf9a40040
y.create.l HWIO_PERIPH_SS_USB1_HS_VMIDMT_GFSR_ADDR A:0xf9a40048
y.create.l HWIO_PERIPH_SS_USB1_HS_VMIDMT_GFSRRESTORE_ADDR A:0xf9a4004c
y.create.l HWIO_PERIPH_SS_USB1_HS_VMIDMT_GFSYNDR0_ADDR A:0xf9a40050
y.create.l HWIO_PERIPH_SS_USB1_HS_VMIDMT_GFSYNDR1_ADDR A:0xf9a40054
y.create.l HWIO_PERIPH_SS_USB1_HS_VMIDMT_GFSYNDR2_ADDR A:0xf9a40058
y.create.l HWIO_PERIPH_SS_USB1_HS_VMIDMT_VMIDMTCR0_ADDR A:0xf9a40090
y.create.l HWIO_PERIPH_SS_USB1_HS_VMIDMT_VMIDMTACR_ADDR A:0xf9a4009c
y.create.l HWIO_PERIPH_SS_USB1_HS_VMIDMT_NSCR0_ADDR A:0xf9a40400
y.create.l HWIO_PERIPH_SS_USB1_HS_VMIDMT_NSCR2_ADDR A:0xf9a40408
y.create.l HWIO_PERIPH_SS_USB1_HS_VMIDMT_NSACR_ADDR A:0xf9a40410
y.create.l HWIO_PERIPH_SS_USB1_HS_VMIDMT_NSGFAR0_ADDR A:0xf9a40440
y.create.l HWIO_PERIPH_SS_USB1_HS_VMIDMT_NSGFSR_ADDR A:0xf9a40448
y.create.l HWIO_PERIPH_SS_USB1_HS_VMIDMT_NSGFSRRESTORE_ADDR A:0xf9a4044c
y.create.l HWIO_PERIPH_SS_USB1_HS_VMIDMT_NSGFSYNDR0_ADDR A:0xf9a40450
y.create.l HWIO_PERIPH_SS_USB1_HS_VMIDMT_NSGFSYNDR1_ADDR A:0xf9a40454
y.create.l HWIO_PERIPH_SS_USB1_HS_VMIDMT_NSGFSYNDR2_ADDR A:0xf9a40458
y.create.l HWIO_PERIPH_SS_USB1_HS_VMIDMT_NSVMIDMTCR0_ADDR A:0xf9a40490
y.create.l HWIO_PERIPH_SS_USB1_HS_VMIDMT_SSDR0_ADDR A:0xf9a40080
y.create.l HWIO_PERIPH_SS_USB1_HS_VMIDMT_MSDR0_ADDR A:0xf9a40480
y.create.l HWIO_PERIPH_SS_USB1_HS_VMIDMT_MCR_ADDR A:0xf9a40494
y.create.l HWIO_PERIPH_SS_USB1_HS_VMIDMT_S2VR0_ADDR A:0xf9a40c00
y.create.l HWIO_PERIPH_SS_USB1_HS_VMIDMT_S2VR1_ADDR A:0xf9a40c04
y.create.l HWIO_PERIPH_SS_USB1_HS_VMIDMT_S2VR2_ADDR A:0xf9a40c08
y.create.l HWIO_PERIPH_SS_USB1_HS_VMIDMT_S2VR3_ADDR A:0xf9a40c0c
y.create.l HWIO_PERIPH_SS_USB1_HS_VMIDMT_S2VR4_ADDR A:0xf9a40c10
y.create.l HWIO_PERIPH_SS_USB1_HS_VMIDMT_S2VR5_ADDR A:0xf9a40c14
y.create.l HWIO_PERIPH_SS_USB1_HS_VMIDMT_S2VR6_ADDR A:0xf9a40c18
y.create.l HWIO_PERIPH_SS_USB1_HS_VMIDMT_S2VR7_ADDR A:0xf9a40c1c
y.create.l HWIO_PERIPH_SS_USB1_HS_VMIDMT_S2VR8_ADDR A:0xf9a40c20
y.create.l HWIO_PERIPH_SS_USB1_HS_VMIDMT_S2VR9_ADDR A:0xf9a40c24
y.create.l HWIO_PERIPH_SS_USB1_HS_VMIDMT_AS2VR0_ADDR A:0xf9a40e00
y.create.l HWIO_PERIPH_SS_USB1_HS_VMIDMT_AS2VR1_ADDR A:0xf9a40e04
y.create.l HWIO_PERIPH_SS_USB1_HS_VMIDMT_AS2VR2_ADDR A:0xf9a40e08
y.create.l HWIO_PERIPH_SS_USB1_HS_VMIDMT_AS2VR3_ADDR A:0xf9a40e0c
y.create.l HWIO_PERIPH_SS_USB1_HS_VMIDMT_AS2VR4_ADDR A:0xf9a40e10
y.create.l HWIO_PERIPH_SS_USB1_HS_VMIDMT_AS2VR5_ADDR A:0xf9a40e14
y.create.l HWIO_PERIPH_SS_USB1_HS_VMIDMT_AS2VR6_ADDR A:0xf9a40e18
y.create.l HWIO_PERIPH_SS_USB1_HS_VMIDMT_AS2VR7_ADDR A:0xf9a40e1c
y.create.l HWIO_PERIPH_SS_USB1_HS_VMIDMT_AS2VR8_ADDR A:0xf9a40e20
y.create.l HWIO_PERIPH_SS_USB1_HS_VMIDMT_AS2VR9_ADDR A:0xf9a40e24
y.create.l HWIO_PERIPH_SS_USB1_HS_VMIDMT_SMR0_ADDR A:0xf9a40800
y.create.l HWIO_PERIPH_SS_USB1_HS_VMIDMT_SMR1_ADDR A:0xf9a40804
y.create.l HWIO_PERIPH_SS_USB1_HS_VMIDMT_SMR2_ADDR A:0xf9a40808
y.create.l HWIO_PERIPH_SS_USB1_HS_VMIDMT_SMR3_ADDR A:0xf9a4080c
y.create.l HWIO_PERIPH_SS_USB1_HS_VMIDMT_SMR4_ADDR A:0xf9a40810
y.create.l HWIO_PERIPH_SS_USB1_HS_VMIDMT_SMR5_ADDR A:0xf9a40814
y.create.l HWIO_PERIPH_SS_USB1_HS_VMIDMT_SMR6_ADDR A:0xf9a40818
y.create.l HWIO_PERIPH_SS_USB1_HS_VMIDMT_SMR7_ADDR A:0xf9a4081c
y.create.l HWIO_PERIPH_SS_USB1_HS_VMIDMT_SMR8_ADDR A:0xf9a40820
y.create.l HWIO_PERIPH_SS_USB1_HS_VMIDMT_SMR9_ADDR A:0xf9a40824
y.create.l HWIO_PERIPH_SS_QPIC_QPIC_BAM_CTRL_ADDR A:0xf9ac4000
y.create.l HWIO_PERIPH_SS_QPIC_QPIC_BAM_REVISION_ADDR A:0xf9ac4004
y.create.l HWIO_PERIPH_SS_QPIC_QPIC_BAM_SW_VERSION_ADDR A:0xf9ac4080
y.create.l HWIO_PERIPH_SS_QPIC_QPIC_BAM_NUM_PIPES_ADDR A:0xf9ac403c
y.create.l HWIO_PERIPH_SS_QPIC_QPIC_BAM_TIMER_ADDR A:0xf9ac4040
y.create.l HWIO_PERIPH_SS_QPIC_QPIC_BAM_TIMER_CTRL_ADDR A:0xf9ac4044
y.create.l HWIO_PERIPH_SS_QPIC_QPIC_BAM_DESC_CNT_TRSHLD_ADDR A:0xf9ac4008
y.create.l HWIO_PERIPH_SS_QPIC_QPIC_BAM_IRQ_SRCS_ADDR A:0xf9ac400c
y.create.l HWIO_PERIPH_SS_QPIC_QPIC_BAM_IRQ_SRCS_MSK_ADDR A:0xf9ac4010
y.create.l HWIO_PERIPH_SS_QPIC_QPIC_BAM_IRQ_SRCS_UNMASKED_ADDR A:0xf9ac4030
y.create.l HWIO_PERIPH_SS_QPIC_QPIC_BAM_IRQ_STTS_ADDR A:0xf9ac4014
y.create.l HWIO_PERIPH_SS_QPIC_QPIC_BAM_IRQ_CLR_ADDR A:0xf9ac4018
y.create.l HWIO_PERIPH_SS_QPIC_QPIC_BAM_IRQ_EN_ADDR A:0xf9ac401c
y.create.l HWIO_PERIPH_SS_QPIC_QPIC_BAM_AHB_MASTER_ERR_CTRLS_ADDR A:0xf9ac4024
y.create.l HWIO_PERIPH_SS_QPIC_QPIC_BAM_AHB_MASTER_ERR_ADDR_ADDR A:0xf9ac4028
y.create.l HWIO_PERIPH_SS_QPIC_QPIC_BAM_AHB_MASTER_ERR_DATA_ADDR A:0xf9ac402c
y.create.l HWIO_PERIPH_SS_QPIC_QPIC_BAM_TRUST_REG_ADDR A:0xf9ac4070
y.create.l HWIO_PERIPH_SS_QPIC_QPIC_BAM_TEST_BUS_SEL_ADDR A:0xf9ac4074
y.create.l HWIO_PERIPH_SS_QPIC_QPIC_BAM_TEST_BUS_REG_ADDR A:0xf9ac4078
y.create.l HWIO_PERIPH_SS_QPIC_QPIC_BAM_CNFG_BITS_ADDR A:0xf9ac407c
y.create.l HWIO_PERIPH_SS_QPIC_QPIC_BAM_IRQ_SRCS_EE0_ADDR A:0xf9ac4800
y.create.l HWIO_PERIPH_SS_QPIC_QPIC_BAM_IRQ_SRCS_EE1_ADDR A:0xf9ac4880
y.create.l HWIO_PERIPH_SS_QPIC_QPIC_BAM_IRQ_SRCS_EE2_ADDR A:0xf9ac4900
y.create.l HWIO_PERIPH_SS_QPIC_QPIC_BAM_IRQ_SRCS_EE3_ADDR A:0xf9ac4980
y.create.l HWIO_PERIPH_SS_QPIC_QPIC_BAM_IRQ_SRCS_EE4_ADDR A:0xf9ac4a00
y.create.l HWIO_PERIPH_SS_QPIC_QPIC_BAM_IRQ_SRCS_EE5_ADDR A:0xf9ac4a80
y.create.l HWIO_PERIPH_SS_QPIC_QPIC_BAM_IRQ_SRCS_EE6_ADDR A:0xf9ac4b00
y.create.l HWIO_PERIPH_SS_QPIC_QPIC_BAM_IRQ_SRCS_EE7_ADDR A:0xf9ac4b80
y.create.l HWIO_PERIPH_SS_QPIC_QPIC_BAM_IRQ_SRCS_MSK_EE0_ADDR A:0xf9ac4804
y.create.l HWIO_PERIPH_SS_QPIC_QPIC_BAM_IRQ_SRCS_MSK_EE1_ADDR A:0xf9ac4884
y.create.l HWIO_PERIPH_SS_QPIC_QPIC_BAM_IRQ_SRCS_MSK_EE2_ADDR A:0xf9ac4904
y.create.l HWIO_PERIPH_SS_QPIC_QPIC_BAM_IRQ_SRCS_MSK_EE3_ADDR A:0xf9ac4984
y.create.l HWIO_PERIPH_SS_QPIC_QPIC_BAM_IRQ_SRCS_MSK_EE4_ADDR A:0xf9ac4a04
y.create.l HWIO_PERIPH_SS_QPIC_QPIC_BAM_IRQ_SRCS_MSK_EE5_ADDR A:0xf9ac4a84
y.create.l HWIO_PERIPH_SS_QPIC_QPIC_BAM_IRQ_SRCS_MSK_EE6_ADDR A:0xf9ac4b04
y.create.l HWIO_PERIPH_SS_QPIC_QPIC_BAM_IRQ_SRCS_MSK_EE7_ADDR A:0xf9ac4b84
y.create.l HWIO_PERIPH_SS_QPIC_QPIC_BAM_IRQ_SRCS_UNMASKED_EE0_ADDR A:0xf9ac4808
y.create.l HWIO_PERIPH_SS_QPIC_QPIC_BAM_IRQ_SRCS_UNMASKED_EE1_ADDR A:0xf9ac4888
y.create.l HWIO_PERIPH_SS_QPIC_QPIC_BAM_IRQ_SRCS_UNMASKED_EE2_ADDR A:0xf9ac4908
y.create.l HWIO_PERIPH_SS_QPIC_QPIC_BAM_IRQ_SRCS_UNMASKED_EE3_ADDR A:0xf9ac4988
y.create.l HWIO_PERIPH_SS_QPIC_QPIC_BAM_IRQ_SRCS_UNMASKED_EE4_ADDR A:0xf9ac4a08
y.create.l HWIO_PERIPH_SS_QPIC_QPIC_BAM_IRQ_SRCS_UNMASKED_EE5_ADDR A:0xf9ac4a88
y.create.l HWIO_PERIPH_SS_QPIC_QPIC_BAM_IRQ_SRCS_UNMASKED_EE6_ADDR A:0xf9ac4b08
y.create.l HWIO_PERIPH_SS_QPIC_QPIC_BAM_IRQ_SRCS_UNMASKED_EE7_ADDR A:0xf9ac4b88
y.create.l HWIO_PERIPH_SS_QPIC_QPIC_BAM_P_CTRL0_ADDR A:0xf9ac5000
y.create.l HWIO_PERIPH_SS_QPIC_QPIC_BAM_P_CTRL1_ADDR A:0xf9ac6000
y.create.l HWIO_PERIPH_SS_QPIC_QPIC_BAM_P_CTRL2_ADDR A:0xf9ac7000
y.create.l HWIO_PERIPH_SS_QPIC_QPIC_BAM_P_CTRL3_ADDR A:0xf9ac8000
y.create.l HWIO_PERIPH_SS_QPIC_QPIC_BAM_P_CTRL4_ADDR A:0xf9ac9000
y.create.l HWIO_PERIPH_SS_QPIC_QPIC_BAM_P_CTRL5_ADDR A:0xf9aca000
y.create.l HWIO_PERIPH_SS_QPIC_QPIC_BAM_P_CTRL6_ADDR A:0xf9acb000
y.create.l HWIO_PERIPH_SS_QPIC_QPIC_BAM_P_RST0_ADDR A:0xf9ac5004
y.create.l HWIO_PERIPH_SS_QPIC_QPIC_BAM_P_RST1_ADDR A:0xf9ac6004
y.create.l HWIO_PERIPH_SS_QPIC_QPIC_BAM_P_RST2_ADDR A:0xf9ac7004
y.create.l HWIO_PERIPH_SS_QPIC_QPIC_BAM_P_RST3_ADDR A:0xf9ac8004
y.create.l HWIO_PERIPH_SS_QPIC_QPIC_BAM_P_RST4_ADDR A:0xf9ac9004
y.create.l HWIO_PERIPH_SS_QPIC_QPIC_BAM_P_RST5_ADDR A:0xf9aca004
y.create.l HWIO_PERIPH_SS_QPIC_QPIC_BAM_P_RST6_ADDR A:0xf9acb004
y.create.l HWIO_PERIPH_SS_QPIC_QPIC_BAM_P_HALT0_ADDR A:0xf9ac5008
y.create.l HWIO_PERIPH_SS_QPIC_QPIC_BAM_P_HALT1_ADDR A:0xf9ac6008
y.create.l HWIO_PERIPH_SS_QPIC_QPIC_BAM_P_HALT2_ADDR A:0xf9ac7008
y.create.l HWIO_PERIPH_SS_QPIC_QPIC_BAM_P_HALT3_ADDR A:0xf9ac8008
y.create.l HWIO_PERIPH_SS_QPIC_QPIC_BAM_P_HALT4_ADDR A:0xf9ac9008
y.create.l HWIO_PERIPH_SS_QPIC_QPIC_BAM_P_HALT5_ADDR A:0xf9aca008
y.create.l HWIO_PERIPH_SS_QPIC_QPIC_BAM_P_HALT6_ADDR A:0xf9acb008
y.create.l HWIO_PERIPH_SS_QPIC_QPIC_BAM_P_TRUST_REG0_ADDR A:0xf9ac5030
y.create.l HWIO_PERIPH_SS_QPIC_QPIC_BAM_P_TRUST_REG1_ADDR A:0xf9ac6030
y.create.l HWIO_PERIPH_SS_QPIC_QPIC_BAM_P_TRUST_REG2_ADDR A:0xf9ac7030
y.create.l HWIO_PERIPH_SS_QPIC_QPIC_BAM_P_TRUST_REG3_ADDR A:0xf9ac8030
y.create.l HWIO_PERIPH_SS_QPIC_QPIC_BAM_P_TRUST_REG4_ADDR A:0xf9ac9030
y.create.l HWIO_PERIPH_SS_QPIC_QPIC_BAM_P_TRUST_REG5_ADDR A:0xf9aca030
y.create.l HWIO_PERIPH_SS_QPIC_QPIC_BAM_P_TRUST_REG6_ADDR A:0xf9acb030
y.create.l HWIO_PERIPH_SS_QPIC_QPIC_BAM_P_IRQ_STTS0_ADDR A:0xf9ac5010
y.create.l HWIO_PERIPH_SS_QPIC_QPIC_BAM_P_IRQ_STTS1_ADDR A:0xf9ac6010
y.create.l HWIO_PERIPH_SS_QPIC_QPIC_BAM_P_IRQ_STTS2_ADDR A:0xf9ac7010
y.create.l HWIO_PERIPH_SS_QPIC_QPIC_BAM_P_IRQ_STTS3_ADDR A:0xf9ac8010
y.create.l HWIO_PERIPH_SS_QPIC_QPIC_BAM_P_IRQ_STTS4_ADDR A:0xf9ac9010
y.create.l HWIO_PERIPH_SS_QPIC_QPIC_BAM_P_IRQ_STTS5_ADDR A:0xf9aca010
y.create.l HWIO_PERIPH_SS_QPIC_QPIC_BAM_P_IRQ_STTS6_ADDR A:0xf9acb010
y.create.l HWIO_PERIPH_SS_QPIC_QPIC_BAM_P_IRQ_CLR0_ADDR A:0xf9ac5014
y.create.l HWIO_PERIPH_SS_QPIC_QPIC_BAM_P_IRQ_CLR1_ADDR A:0xf9ac6014
y.create.l HWIO_PERIPH_SS_QPIC_QPIC_BAM_P_IRQ_CLR2_ADDR A:0xf9ac7014
y.create.l HWIO_PERIPH_SS_QPIC_QPIC_BAM_P_IRQ_CLR3_ADDR A:0xf9ac8014
y.create.l HWIO_PERIPH_SS_QPIC_QPIC_BAM_P_IRQ_CLR4_ADDR A:0xf9ac9014
y.create.l HWIO_PERIPH_SS_QPIC_QPIC_BAM_P_IRQ_CLR5_ADDR A:0xf9aca014
y.create.l HWIO_PERIPH_SS_QPIC_QPIC_BAM_P_IRQ_CLR6_ADDR A:0xf9acb014
y.create.l HWIO_PERIPH_SS_QPIC_QPIC_BAM_P_IRQ_EN0_ADDR A:0xf9ac5018
y.create.l HWIO_PERIPH_SS_QPIC_QPIC_BAM_P_IRQ_EN1_ADDR A:0xf9ac6018
y.create.l HWIO_PERIPH_SS_QPIC_QPIC_BAM_P_IRQ_EN2_ADDR A:0xf9ac7018
y.create.l HWIO_PERIPH_SS_QPIC_QPIC_BAM_P_IRQ_EN3_ADDR A:0xf9ac8018
y.create.l HWIO_PERIPH_SS_QPIC_QPIC_BAM_P_IRQ_EN4_ADDR A:0xf9ac9018
y.create.l HWIO_PERIPH_SS_QPIC_QPIC_BAM_P_IRQ_EN5_ADDR A:0xf9aca018
y.create.l HWIO_PERIPH_SS_QPIC_QPIC_BAM_P_IRQ_EN6_ADDR A:0xf9acb018
y.create.l HWIO_PERIPH_SS_QPIC_QPIC_BAM_P_TIMER0_ADDR A:0xf9ac501c
y.create.l HWIO_PERIPH_SS_QPIC_QPIC_BAM_P_TIMER1_ADDR A:0xf9ac601c
y.create.l HWIO_PERIPH_SS_QPIC_QPIC_BAM_P_TIMER2_ADDR A:0xf9ac701c
y.create.l HWIO_PERIPH_SS_QPIC_QPIC_BAM_P_TIMER3_ADDR A:0xf9ac801c
y.create.l HWIO_PERIPH_SS_QPIC_QPIC_BAM_P_TIMER4_ADDR A:0xf9ac901c
y.create.l HWIO_PERIPH_SS_QPIC_QPIC_BAM_P_TIMER5_ADDR A:0xf9aca01c
y.create.l HWIO_PERIPH_SS_QPIC_QPIC_BAM_P_TIMER6_ADDR A:0xf9acb01c
y.create.l HWIO_PERIPH_SS_QPIC_QPIC_BAM_P_TIMER_CTRL0_ADDR A:0xf9ac5020
y.create.l HWIO_PERIPH_SS_QPIC_QPIC_BAM_P_TIMER_CTRL1_ADDR A:0xf9ac6020
y.create.l HWIO_PERIPH_SS_QPIC_QPIC_BAM_P_TIMER_CTRL2_ADDR A:0xf9ac7020
y.create.l HWIO_PERIPH_SS_QPIC_QPIC_BAM_P_TIMER_CTRL3_ADDR A:0xf9ac8020
y.create.l HWIO_PERIPH_SS_QPIC_QPIC_BAM_P_TIMER_CTRL4_ADDR A:0xf9ac9020
y.create.l HWIO_PERIPH_SS_QPIC_QPIC_BAM_P_TIMER_CTRL5_ADDR A:0xf9aca020
y.create.l HWIO_PERIPH_SS_QPIC_QPIC_BAM_P_TIMER_CTRL6_ADDR A:0xf9acb020
y.create.l HWIO_PERIPH_SS_QPIC_QPIC_BAM_P_PRDCR_SDBND0_ADDR A:0xf9ac5024
y.create.l HWIO_PERIPH_SS_QPIC_QPIC_BAM_P_PRDCR_SDBND1_ADDR A:0xf9ac6024
y.create.l HWIO_PERIPH_SS_QPIC_QPIC_BAM_P_PRDCR_SDBND2_ADDR A:0xf9ac7024
y.create.l HWIO_PERIPH_SS_QPIC_QPIC_BAM_P_PRDCR_SDBND3_ADDR A:0xf9ac8024
y.create.l HWIO_PERIPH_SS_QPIC_QPIC_BAM_P_PRDCR_SDBND4_ADDR A:0xf9ac9024
y.create.l HWIO_PERIPH_SS_QPIC_QPIC_BAM_P_PRDCR_SDBND5_ADDR A:0xf9aca024
y.create.l HWIO_PERIPH_SS_QPIC_QPIC_BAM_P_PRDCR_SDBND6_ADDR A:0xf9acb024
y.create.l HWIO_PERIPH_SS_QPIC_QPIC_BAM_P_CNSMR_SDBND0_ADDR A:0xf9ac5028
y.create.l HWIO_PERIPH_SS_QPIC_QPIC_BAM_P_CNSMR_SDBND1_ADDR A:0xf9ac6028
y.create.l HWIO_PERIPH_SS_QPIC_QPIC_BAM_P_CNSMR_SDBND2_ADDR A:0xf9ac7028
y.create.l HWIO_PERIPH_SS_QPIC_QPIC_BAM_P_CNSMR_SDBND3_ADDR A:0xf9ac8028
y.create.l HWIO_PERIPH_SS_QPIC_QPIC_BAM_P_CNSMR_SDBND4_ADDR A:0xf9ac9028
y.create.l HWIO_PERIPH_SS_QPIC_QPIC_BAM_P_CNSMR_SDBND5_ADDR A:0xf9aca028
y.create.l HWIO_PERIPH_SS_QPIC_QPIC_BAM_P_CNSMR_SDBND6_ADDR A:0xf9acb028
y.create.l HWIO_PERIPH_SS_QPIC_QPIC_BAM_P_EVNT_DEST_ADDR0_ADDR A:0xf9ac582c
y.create.l HWIO_PERIPH_SS_QPIC_QPIC_BAM_P_EVNT_DEST_ADDR1_ADDR A:0xf9ac682c
y.create.l HWIO_PERIPH_SS_QPIC_QPIC_BAM_P_EVNT_DEST_ADDR2_ADDR A:0xf9ac782c
y.create.l HWIO_PERIPH_SS_QPIC_QPIC_BAM_P_EVNT_DEST_ADDR3_ADDR A:0xf9ac882c
y.create.l HWIO_PERIPH_SS_QPIC_QPIC_BAM_P_EVNT_DEST_ADDR4_ADDR A:0xf9ac982c
y.create.l HWIO_PERIPH_SS_QPIC_QPIC_BAM_P_EVNT_DEST_ADDR5_ADDR A:0xf9aca82c
y.create.l HWIO_PERIPH_SS_QPIC_QPIC_BAM_P_EVNT_DEST_ADDR6_ADDR A:0xf9acb82c
y.create.l HWIO_PERIPH_SS_QPIC_QPIC_BAM_P_EVNT_REG0_ADDR A:0xf9ac5818
y.create.l HWIO_PERIPH_SS_QPIC_QPIC_BAM_P_EVNT_REG1_ADDR A:0xf9ac6818
y.create.l HWIO_PERIPH_SS_QPIC_QPIC_BAM_P_EVNT_REG2_ADDR A:0xf9ac7818
y.create.l HWIO_PERIPH_SS_QPIC_QPIC_BAM_P_EVNT_REG3_ADDR A:0xf9ac8818
y.create.l HWIO_PERIPH_SS_QPIC_QPIC_BAM_P_EVNT_REG4_ADDR A:0xf9ac9818
y.create.l HWIO_PERIPH_SS_QPIC_QPIC_BAM_P_EVNT_REG5_ADDR A:0xf9aca818
y.create.l HWIO_PERIPH_SS_QPIC_QPIC_BAM_P_EVNT_REG6_ADDR A:0xf9acb818
y.create.l HWIO_PERIPH_SS_QPIC_QPIC_BAM_P_SW_OFSTS0_ADDR A:0xf9ac5800
y.create.l HWIO_PERIPH_SS_QPIC_QPIC_BAM_P_SW_OFSTS1_ADDR A:0xf9ac6800
y.create.l HWIO_PERIPH_SS_QPIC_QPIC_BAM_P_SW_OFSTS2_ADDR A:0xf9ac7800
y.create.l HWIO_PERIPH_SS_QPIC_QPIC_BAM_P_SW_OFSTS3_ADDR A:0xf9ac8800
y.create.l HWIO_PERIPH_SS_QPIC_QPIC_BAM_P_SW_OFSTS4_ADDR A:0xf9ac9800
y.create.l HWIO_PERIPH_SS_QPIC_QPIC_BAM_P_SW_OFSTS5_ADDR A:0xf9aca800
y.create.l HWIO_PERIPH_SS_QPIC_QPIC_BAM_P_SW_OFSTS6_ADDR A:0xf9acb800
y.create.l HWIO_PERIPH_SS_QPIC_QPIC_BAM_P_DATA_FIFO_ADDR0_ADDR A:0xf9ac5824
y.create.l HWIO_PERIPH_SS_QPIC_QPIC_BAM_P_DATA_FIFO_ADDR1_ADDR A:0xf9ac6824
y.create.l HWIO_PERIPH_SS_QPIC_QPIC_BAM_P_DATA_FIFO_ADDR2_ADDR A:0xf9ac7824
y.create.l HWIO_PERIPH_SS_QPIC_QPIC_BAM_P_DATA_FIFO_ADDR3_ADDR A:0xf9ac8824
y.create.l HWIO_PERIPH_SS_QPIC_QPIC_BAM_P_DATA_FIFO_ADDR4_ADDR A:0xf9ac9824
y.create.l HWIO_PERIPH_SS_QPIC_QPIC_BAM_P_DATA_FIFO_ADDR5_ADDR A:0xf9aca824
y.create.l HWIO_PERIPH_SS_QPIC_QPIC_BAM_P_DATA_FIFO_ADDR6_ADDR A:0xf9acb824
y.create.l HWIO_PERIPH_SS_QPIC_QPIC_BAM_P_DESC_FIFO_ADDR0_ADDR A:0xf9ac581c
y.create.l HWIO_PERIPH_SS_QPIC_QPIC_BAM_P_DESC_FIFO_ADDR1_ADDR A:0xf9ac681c
y.create.l HWIO_PERIPH_SS_QPIC_QPIC_BAM_P_DESC_FIFO_ADDR2_ADDR A:0xf9ac781c
y.create.l HWIO_PERIPH_SS_QPIC_QPIC_BAM_P_DESC_FIFO_ADDR3_ADDR A:0xf9ac881c
y.create.l HWIO_PERIPH_SS_QPIC_QPIC_BAM_P_DESC_FIFO_ADDR4_ADDR A:0xf9ac981c
y.create.l HWIO_PERIPH_SS_QPIC_QPIC_BAM_P_DESC_FIFO_ADDR5_ADDR A:0xf9aca81c
y.create.l HWIO_PERIPH_SS_QPIC_QPIC_BAM_P_DESC_FIFO_ADDR6_ADDR A:0xf9acb81c
y.create.l HWIO_PERIPH_SS_QPIC_QPIC_BAM_P_EVNT_GEN_TRSHLD0_ADDR A:0xf9ac5828
y.create.l HWIO_PERIPH_SS_QPIC_QPIC_BAM_P_EVNT_GEN_TRSHLD1_ADDR A:0xf9ac6828
y.create.l HWIO_PERIPH_SS_QPIC_QPIC_BAM_P_EVNT_GEN_TRSHLD2_ADDR A:0xf9ac7828
y.create.l HWIO_PERIPH_SS_QPIC_QPIC_BAM_P_EVNT_GEN_TRSHLD3_ADDR A:0xf9ac8828
y.create.l HWIO_PERIPH_SS_QPIC_QPIC_BAM_P_EVNT_GEN_TRSHLD4_ADDR A:0xf9ac9828
y.create.l HWIO_PERIPH_SS_QPIC_QPIC_BAM_P_EVNT_GEN_TRSHLD5_ADDR A:0xf9aca828
y.create.l HWIO_PERIPH_SS_QPIC_QPIC_BAM_P_EVNT_GEN_TRSHLD6_ADDR A:0xf9acb828
y.create.l HWIO_PERIPH_SS_QPIC_QPIC_BAM_P_FIFO_SIZES0_ADDR A:0xf9ac5820
y.create.l HWIO_PERIPH_SS_QPIC_QPIC_BAM_P_FIFO_SIZES1_ADDR A:0xf9ac6820
y.create.l HWIO_PERIPH_SS_QPIC_QPIC_BAM_P_FIFO_SIZES2_ADDR A:0xf9ac7820
y.create.l HWIO_PERIPH_SS_QPIC_QPIC_BAM_P_FIFO_SIZES3_ADDR A:0xf9ac8820
y.create.l HWIO_PERIPH_SS_QPIC_QPIC_BAM_P_FIFO_SIZES4_ADDR A:0xf9ac9820
y.create.l HWIO_PERIPH_SS_QPIC_QPIC_BAM_P_FIFO_SIZES5_ADDR A:0xf9aca820
y.create.l HWIO_PERIPH_SS_QPIC_QPIC_BAM_P_FIFO_SIZES6_ADDR A:0xf9acb820
y.create.l HWIO_PERIPH_SS_QPIC_QPIC_BAM_P_RETR_CNTXT_0_ADDR A:0xf9ac5834
y.create.l HWIO_PERIPH_SS_QPIC_QPIC_BAM_P_RETR_CNTXT_1_ADDR A:0xf9ac6834
y.create.l HWIO_PERIPH_SS_QPIC_QPIC_BAM_P_RETR_CNTXT_2_ADDR A:0xf9ac7834
y.create.l HWIO_PERIPH_SS_QPIC_QPIC_BAM_P_RETR_CNTXT_3_ADDR A:0xf9ac8834
y.create.l HWIO_PERIPH_SS_QPIC_QPIC_BAM_P_RETR_CNTXT_4_ADDR A:0xf9ac9834
y.create.l HWIO_PERIPH_SS_QPIC_QPIC_BAM_P_RETR_CNTXT_5_ADDR A:0xf9aca834
y.create.l HWIO_PERIPH_SS_QPIC_QPIC_BAM_P_RETR_CNTXT_6_ADDR A:0xf9acb834
y.create.l HWIO_PERIPH_SS_QPIC_QPIC_BAM_P_SI_CNTXT_0_ADDR A:0xf9ac5838
y.create.l HWIO_PERIPH_SS_QPIC_QPIC_BAM_P_SI_CNTXT_1_ADDR A:0xf9ac6838
y.create.l HWIO_PERIPH_SS_QPIC_QPIC_BAM_P_SI_CNTXT_2_ADDR A:0xf9ac7838
y.create.l HWIO_PERIPH_SS_QPIC_QPIC_BAM_P_SI_CNTXT_3_ADDR A:0xf9ac8838
y.create.l HWIO_PERIPH_SS_QPIC_QPIC_BAM_P_SI_CNTXT_4_ADDR A:0xf9ac9838
y.create.l HWIO_PERIPH_SS_QPIC_QPIC_BAM_P_SI_CNTXT_5_ADDR A:0xf9aca838
y.create.l HWIO_PERIPH_SS_QPIC_QPIC_BAM_P_SI_CNTXT_6_ADDR A:0xf9acb838
y.create.l HWIO_PERIPH_SS_QPIC_QPIC_BAM_P_DF_CNTXT_0_ADDR A:0xf9ac5830
y.create.l HWIO_PERIPH_SS_QPIC_QPIC_BAM_P_DF_CNTXT_1_ADDR A:0xf9ac6830
y.create.l HWIO_PERIPH_SS_QPIC_QPIC_BAM_P_DF_CNTXT_2_ADDR A:0xf9ac7830
y.create.l HWIO_PERIPH_SS_QPIC_QPIC_BAM_P_DF_CNTXT_3_ADDR A:0xf9ac8830
y.create.l HWIO_PERIPH_SS_QPIC_QPIC_BAM_P_DF_CNTXT_4_ADDR A:0xf9ac9830
y.create.l HWIO_PERIPH_SS_QPIC_QPIC_BAM_P_DF_CNTXT_5_ADDR A:0xf9aca830
y.create.l HWIO_PERIPH_SS_QPIC_QPIC_BAM_P_DF_CNTXT_6_ADDR A:0xf9acb830
y.create.l HWIO_PERIPH_SS_QPIC_QPIC_BAM_P_AU_PSM_CNTXT_1_0_ADDR A:0xf9ac5804
y.create.l HWIO_PERIPH_SS_QPIC_QPIC_BAM_P_AU_PSM_CNTXT_1_1_ADDR A:0xf9ac6804
y.create.l HWIO_PERIPH_SS_QPIC_QPIC_BAM_P_AU_PSM_CNTXT_1_2_ADDR A:0xf9ac7804
y.create.l HWIO_PERIPH_SS_QPIC_QPIC_BAM_P_AU_PSM_CNTXT_1_3_ADDR A:0xf9ac8804
y.create.l HWIO_PERIPH_SS_QPIC_QPIC_BAM_P_AU_PSM_CNTXT_1_4_ADDR A:0xf9ac9804
y.create.l HWIO_PERIPH_SS_QPIC_QPIC_BAM_P_AU_PSM_CNTXT_1_5_ADDR A:0xf9aca804
y.create.l HWIO_PERIPH_SS_QPIC_QPIC_BAM_P_AU_PSM_CNTXT_1_6_ADDR A:0xf9acb804
y.create.l HWIO_PERIPH_SS_QPIC_QPIC_BAM_P_PSM_CNTXT_2_0_ADDR A:0xf9ac5808
y.create.l HWIO_PERIPH_SS_QPIC_QPIC_BAM_P_PSM_CNTXT_2_1_ADDR A:0xf9ac6808
y.create.l HWIO_PERIPH_SS_QPIC_QPIC_BAM_P_PSM_CNTXT_2_2_ADDR A:0xf9ac7808
y.create.l HWIO_PERIPH_SS_QPIC_QPIC_BAM_P_PSM_CNTXT_2_3_ADDR A:0xf9ac8808
y.create.l HWIO_PERIPH_SS_QPIC_QPIC_BAM_P_PSM_CNTXT_2_4_ADDR A:0xf9ac9808
y.create.l HWIO_PERIPH_SS_QPIC_QPIC_BAM_P_PSM_CNTXT_2_5_ADDR A:0xf9aca808
y.create.l HWIO_PERIPH_SS_QPIC_QPIC_BAM_P_PSM_CNTXT_2_6_ADDR A:0xf9acb808
y.create.l HWIO_PERIPH_SS_QPIC_QPIC_BAM_P_PSM_CNTXT_3_0_ADDR A:0xf9ac580c
y.create.l HWIO_PERIPH_SS_QPIC_QPIC_BAM_P_PSM_CNTXT_3_1_ADDR A:0xf9ac680c
y.create.l HWIO_PERIPH_SS_QPIC_QPIC_BAM_P_PSM_CNTXT_3_2_ADDR A:0xf9ac780c
y.create.l HWIO_PERIPH_SS_QPIC_QPIC_BAM_P_PSM_CNTXT_3_3_ADDR A:0xf9ac880c
y.create.l HWIO_PERIPH_SS_QPIC_QPIC_BAM_P_PSM_CNTXT_3_4_ADDR A:0xf9ac980c
y.create.l HWIO_PERIPH_SS_QPIC_QPIC_BAM_P_PSM_CNTXT_3_5_ADDR A:0xf9aca80c
y.create.l HWIO_PERIPH_SS_QPIC_QPIC_BAM_P_PSM_CNTXT_3_6_ADDR A:0xf9acb80c
y.create.l HWIO_PERIPH_SS_QPIC_QPIC_BAM_P_PSM_CNTXT_4_0_ADDR A:0xf9ac5810
y.create.l HWIO_PERIPH_SS_QPIC_QPIC_BAM_P_PSM_CNTXT_4_1_ADDR A:0xf9ac6810
y.create.l HWIO_PERIPH_SS_QPIC_QPIC_BAM_P_PSM_CNTXT_4_2_ADDR A:0xf9ac7810
y.create.l HWIO_PERIPH_SS_QPIC_QPIC_BAM_P_PSM_CNTXT_4_3_ADDR A:0xf9ac8810
y.create.l HWIO_PERIPH_SS_QPIC_QPIC_BAM_P_PSM_CNTXT_4_4_ADDR A:0xf9ac9810
y.create.l HWIO_PERIPH_SS_QPIC_QPIC_BAM_P_PSM_CNTXT_4_5_ADDR A:0xf9aca810
y.create.l HWIO_PERIPH_SS_QPIC_QPIC_BAM_P_PSM_CNTXT_4_6_ADDR A:0xf9acb810
y.create.l HWIO_PERIPH_SS_QPIC_QPIC_BAM_P_PSM_CNTXT_5_0_ADDR A:0xf9ac5814
y.create.l HWIO_PERIPH_SS_QPIC_QPIC_BAM_P_PSM_CNTXT_5_1_ADDR A:0xf9ac6814
y.create.l HWIO_PERIPH_SS_QPIC_QPIC_BAM_P_PSM_CNTXT_5_2_ADDR A:0xf9ac7814
y.create.l HWIO_PERIPH_SS_QPIC_QPIC_BAM_P_PSM_CNTXT_5_3_ADDR A:0xf9ac8814
y.create.l HWIO_PERIPH_SS_QPIC_QPIC_BAM_P_PSM_CNTXT_5_4_ADDR A:0xf9ac9814
y.create.l HWIO_PERIPH_SS_QPIC_QPIC_BAM_P_PSM_CNTXT_5_5_ADDR A:0xf9aca814
y.create.l HWIO_PERIPH_SS_QPIC_QPIC_BAM_P_PSM_CNTXT_5_6_ADDR A:0xf9acb814
y.create.l HWIO_PERIPH_SS_QPIC_QPIC_XPU_SCR_ADDR A:0xf9ac2000
y.create.l HWIO_PERIPH_SS_QPIC_QPIC_XPU_SWDR_ADDR A:0xf9ac2004
y.create.l HWIO_PERIPH_SS_QPIC_QPIC_XPU_SEAR0_ADDR A:0xf9ac2040
y.create.l HWIO_PERIPH_SS_QPIC_QPIC_XPU_SESR_ADDR A:0xf9ac2048
y.create.l HWIO_PERIPH_SS_QPIC_QPIC_XPU_SESRRESTORE_ADDR A:0xf9ac204c
y.create.l HWIO_PERIPH_SS_QPIC_QPIC_XPU_SESYNR0_ADDR A:0xf9ac2050
y.create.l HWIO_PERIPH_SS_QPIC_QPIC_XPU_SESYNR1_ADDR A:0xf9ac2054
y.create.l HWIO_PERIPH_SS_QPIC_QPIC_XPU_SESYNR2_ADDR A:0xf9ac2058
y.create.l HWIO_PERIPH_SS_QPIC_QPIC_XPU_MCR_ADDR A:0xf9ac2100
y.create.l HWIO_PERIPH_SS_QPIC_QPIC_XPU_MEAR0_ADDR A:0xf9ac2140
y.create.l HWIO_PERIPH_SS_QPIC_QPIC_XPU_MESR_ADDR A:0xf9ac2148
y.create.l HWIO_PERIPH_SS_QPIC_QPIC_XPU_MESRRESTORE_ADDR A:0xf9ac214c
y.create.l HWIO_PERIPH_SS_QPIC_QPIC_XPU_MESYNR0_ADDR A:0xf9ac2150
y.create.l HWIO_PERIPH_SS_QPIC_QPIC_XPU_MESYNR1_ADDR A:0xf9ac2154
y.create.l HWIO_PERIPH_SS_QPIC_QPIC_XPU_MESYNR2_ADDR A:0xf9ac2158
y.create.l HWIO_PERIPH_SS_QPIC_QPIC_XPU_CR_ADDR A:0xf9ac2080
y.create.l HWIO_PERIPH_SS_QPIC_QPIC_XPU_RPU_ACR0_ADDR A:0xf9ac20a0
y.create.l HWIO_PERIPH_SS_QPIC_QPIC_XPU_EAR0_ADDR A:0xf9ac20c0
y.create.l HWIO_PERIPH_SS_QPIC_QPIC_XPU_ESR_ADDR A:0xf9ac20c8
y.create.l HWIO_PERIPH_SS_QPIC_QPIC_XPU_ESRRESTORE_ADDR A:0xf9ac20cc
y.create.l HWIO_PERIPH_SS_QPIC_QPIC_XPU_ESYNR0_ADDR A:0xf9ac20d0
y.create.l HWIO_PERIPH_SS_QPIC_QPIC_XPU_ESYNR1_ADDR A:0xf9ac20d4
y.create.l HWIO_PERIPH_SS_QPIC_QPIC_XPU_ESYNR2_ADDR A:0xf9ac20d8
y.create.l HWIO_PERIPH_SS_QPIC_QPIC_XPU_IDR0_ADDR A:0xf9ac2074
y.create.l HWIO_PERIPH_SS_QPIC_QPIC_XPU_IDR1_ADDR A:0xf9ac2078
y.create.l HWIO_PERIPH_SS_QPIC_QPIC_XPU_REV_ADDR A:0xf9ac207c
y.create.l HWIO_PERIPH_SS_QPIC_QPIC_XPU_RG0_RACR0_ADDR A:0xf9ac2200
y.create.l HWIO_PERIPH_SS_QPIC_QPIC_XPU_RG1_RACR0_ADDR A:0xf9ac2280
y.create.l HWIO_PERIPH_SS_QPIC_QPIC_XPU_RG2_RACR0_ADDR A:0xf9ac2300
y.create.l HWIO_PERIPH_SS_QPIC_QPIC_XPU_RG3_RACR0_ADDR A:0xf9ac2380
y.create.l HWIO_PERIPH_SS_QPIC_QPIC_XPU_RG4_RACR0_ADDR A:0xf9ac2400
y.create.l HWIO_PERIPH_SS_QPIC_QPIC_XPU_RG5_RACR0_ADDR A:0xf9ac2480
y.create.l HWIO_PERIPH_SS_QPIC_QPIC_XPU_RG6_RACR0_ADDR A:0xf9ac2500
y.create.l HWIO_PERIPH_SS_QPIC_QPIC_XPU_RG7_RACR0_ADDR A:0xf9ac2580
y.create.l HWIO_PERIPH_SS_QPIC_QPIC_XPU_RG8_RACR0_ADDR A:0xf9ac2600
y.create.l HWIO_PERIPH_SS_QPIC_QPIC_XPU_RG9_RACR0_ADDR A:0xf9ac2680
y.create.l HWIO_PERIPH_SS_QPIC_QPIC_XPU_RG0_SCR_ADDR A:0xf9ac2250
y.create.l HWIO_PERIPH_SS_QPIC_QPIC_XPU_RG1_SCR_ADDR A:0xf9ac22d0
y.create.l HWIO_PERIPH_SS_QPIC_QPIC_XPU_RG2_SCR_ADDR A:0xf9ac2350
y.create.l HWIO_PERIPH_SS_QPIC_QPIC_XPU_RG3_SCR_ADDR A:0xf9ac23d0
y.create.l HWIO_PERIPH_SS_QPIC_QPIC_XPU_RG4_SCR_ADDR A:0xf9ac2450
y.create.l HWIO_PERIPH_SS_QPIC_QPIC_XPU_RG5_SCR_ADDR A:0xf9ac24d0
y.create.l HWIO_PERIPH_SS_QPIC_QPIC_XPU_RG6_SCR_ADDR A:0xf9ac2550
y.create.l HWIO_PERIPH_SS_QPIC_QPIC_XPU_RG7_SCR_ADDR A:0xf9ac25d0
y.create.l HWIO_PERIPH_SS_QPIC_QPIC_XPU_RG8_SCR_ADDR A:0xf9ac2650
y.create.l HWIO_PERIPH_SS_QPIC_QPIC_XPU_RG9_SCR_ADDR A:0xf9ac26d0
y.create.l HWIO_PERIPH_SS_QPIC_QPIC_XPU_RG0_MCR_ADDR A:0xf9ac2254
y.create.l HWIO_PERIPH_SS_QPIC_QPIC_XPU_RG1_MCR_ADDR A:0xf9ac22d4
y.create.l HWIO_PERIPH_SS_QPIC_QPIC_XPU_RG2_MCR_ADDR A:0xf9ac2354
y.create.l HWIO_PERIPH_SS_QPIC_QPIC_XPU_RG3_MCR_ADDR A:0xf9ac23d4
y.create.l HWIO_PERIPH_SS_QPIC_QPIC_XPU_RG4_MCR_ADDR A:0xf9ac2454
y.create.l HWIO_PERIPH_SS_QPIC_QPIC_XPU_RG5_MCR_ADDR A:0xf9ac24d4
y.create.l HWIO_PERIPH_SS_QPIC_QPIC_XPU_RG6_MCR_ADDR A:0xf9ac2554
y.create.l HWIO_PERIPH_SS_QPIC_QPIC_XPU_RG7_MCR_ADDR A:0xf9ac25d4
y.create.l HWIO_PERIPH_SS_QPIC_QPIC_XPU_RG8_MCR_ADDR A:0xf9ac2654
y.create.l HWIO_PERIPH_SS_QPIC_QPIC_XPU_RG9_MCR_ADDR A:0xf9ac26d4
y.create.l HWIO_PERIPH_SS_QPIC_QPIC_VMIDMT_SCR0_ADDR A:0xf9ac0000
y.create.l HWIO_PERIPH_SS_QPIC_QPIC_VMIDMT_SCR1_ADDR A:0xf9ac0004
y.create.l HWIO_PERIPH_SS_QPIC_QPIC_VMIDMT_SCR2_ADDR A:0xf9ac0008
y.create.l HWIO_PERIPH_SS_QPIC_QPIC_VMIDMT_SACR_ADDR A:0xf9ac0010
y.create.l HWIO_PERIPH_SS_QPIC_QPIC_VMIDMT_SIDR0_ADDR A:0xf9ac0020
y.create.l HWIO_PERIPH_SS_QPIC_QPIC_VMIDMT_SIDR1_ADDR A:0xf9ac0024
y.create.l HWIO_PERIPH_SS_QPIC_QPIC_VMIDMT_SIDR2_ADDR A:0xf9ac0028
y.create.l HWIO_PERIPH_SS_QPIC_QPIC_VMIDMT_SIDR4_ADDR A:0xf9ac0030
y.create.l HWIO_PERIPH_SS_QPIC_QPIC_VMIDMT_SIDR5_ADDR A:0xf9ac0034
y.create.l HWIO_PERIPH_SS_QPIC_QPIC_VMIDMT_SIDR7_ADDR A:0xf9ac003c
y.create.l HWIO_PERIPH_SS_QPIC_QPIC_VMIDMT_SGFAR0_ADDR A:0xf9ac0040
y.create.l HWIO_PERIPH_SS_QPIC_QPIC_VMIDMT_SGFSR_ADDR A:0xf9ac0048
y.create.l HWIO_PERIPH_SS_QPIC_QPIC_VMIDMT_SGFSRRESTORE_ADDR A:0xf9ac004c
y.create.l HWIO_PERIPH_SS_QPIC_QPIC_VMIDMT_SGFSYNDR0_ADDR A:0xf9ac0050
y.create.l HWIO_PERIPH_SS_QPIC_QPIC_VMIDMT_SGFSYNDR1_ADDR A:0xf9ac0054
y.create.l HWIO_PERIPH_SS_QPIC_QPIC_VMIDMT_SGFSYNDR2_ADDR A:0xf9ac0058
y.create.l HWIO_PERIPH_SS_QPIC_QPIC_VMIDMT_VMIDMTSCR0_ADDR A:0xf9ac0090
y.create.l HWIO_PERIPH_SS_QPIC_QPIC_VMIDMT_CR0_ADDR A:0xf9ac0000
y.create.l HWIO_PERIPH_SS_QPIC_QPIC_VMIDMT_CR2_ADDR A:0xf9ac0008
y.create.l HWIO_PERIPH_SS_QPIC_QPIC_VMIDMT_ACR_ADDR A:0xf9ac0010
y.create.l HWIO_PERIPH_SS_QPIC_QPIC_VMIDMT_IDR0_ADDR A:0xf9ac0020
y.create.l HWIO_PERIPH_SS_QPIC_QPIC_VMIDMT_IDR1_ADDR A:0xf9ac0024
y.create.l HWIO_PERIPH_SS_QPIC_QPIC_VMIDMT_IDR2_ADDR A:0xf9ac0028
y.create.l HWIO_PERIPH_SS_QPIC_QPIC_VMIDMT_IDR4_ADDR A:0xf9ac0030
y.create.l HWIO_PERIPH_SS_QPIC_QPIC_VMIDMT_IDR5_ADDR A:0xf9ac0034
y.create.l HWIO_PERIPH_SS_QPIC_QPIC_VMIDMT_IDR7_ADDR A:0xf9ac003c
y.create.l HWIO_PERIPH_SS_QPIC_QPIC_VMIDMT_GFAR0_ADDR A:0xf9ac0040
y.create.l HWIO_PERIPH_SS_QPIC_QPIC_VMIDMT_GFSR_ADDR A:0xf9ac0048
y.create.l HWIO_PERIPH_SS_QPIC_QPIC_VMIDMT_GFSRRESTORE_ADDR A:0xf9ac004c
y.create.l HWIO_PERIPH_SS_QPIC_QPIC_VMIDMT_GFSYNDR0_ADDR A:0xf9ac0050
y.create.l HWIO_PERIPH_SS_QPIC_QPIC_VMIDMT_GFSYNDR1_ADDR A:0xf9ac0054
y.create.l HWIO_PERIPH_SS_QPIC_QPIC_VMIDMT_GFSYNDR2_ADDR A:0xf9ac0058
y.create.l HWIO_PERIPH_SS_QPIC_QPIC_VMIDMT_VMIDMTCR0_ADDR A:0xf9ac0090
y.create.l HWIO_PERIPH_SS_QPIC_QPIC_VMIDMT_VMIDMTACR_ADDR A:0xf9ac009c
y.create.l HWIO_PERIPH_SS_QPIC_QPIC_VMIDMT_NSCR0_ADDR A:0xf9ac0400
y.create.l HWIO_PERIPH_SS_QPIC_QPIC_VMIDMT_NSCR2_ADDR A:0xf9ac0408
y.create.l HWIO_PERIPH_SS_QPIC_QPIC_VMIDMT_NSACR_ADDR A:0xf9ac0410
y.create.l HWIO_PERIPH_SS_QPIC_QPIC_VMIDMT_NSGFAR0_ADDR A:0xf9ac0440
y.create.l HWIO_PERIPH_SS_QPIC_QPIC_VMIDMT_NSGFSR_ADDR A:0xf9ac0448
y.create.l HWIO_PERIPH_SS_QPIC_QPIC_VMIDMT_NSGFSRRESTORE_ADDR A:0xf9ac044c
y.create.l HWIO_PERIPH_SS_QPIC_QPIC_VMIDMT_NSGFSYNDR0_ADDR A:0xf9ac0450
y.create.l HWIO_PERIPH_SS_QPIC_QPIC_VMIDMT_NSGFSYNDR1_ADDR A:0xf9ac0454
y.create.l HWIO_PERIPH_SS_QPIC_QPIC_VMIDMT_NSGFSYNDR2_ADDR A:0xf9ac0458
y.create.l HWIO_PERIPH_SS_QPIC_QPIC_VMIDMT_NSVMIDMTCR0_ADDR A:0xf9ac0490
y.create.l HWIO_PERIPH_SS_QPIC_QPIC_VMIDMT_SSDR0_ADDR A:0xf9ac0080
y.create.l HWIO_PERIPH_SS_QPIC_QPIC_VMIDMT_MSDR0_ADDR A:0xf9ac0480
y.create.l HWIO_PERIPH_SS_QPIC_QPIC_VMIDMT_MCR_ADDR A:0xf9ac0494
y.create.l HWIO_PERIPH_SS_QPIC_QPIC_VMIDMT_S2VR0_ADDR A:0xf9ac0c00
y.create.l HWIO_PERIPH_SS_QPIC_QPIC_VMIDMT_S2VR1_ADDR A:0xf9ac0c04
y.create.l HWIO_PERIPH_SS_QPIC_QPIC_VMIDMT_S2VR2_ADDR A:0xf9ac0c08
y.create.l HWIO_PERIPH_SS_QPIC_QPIC_VMIDMT_S2VR3_ADDR A:0xf9ac0c0c
y.create.l HWIO_PERIPH_SS_QPIC_QPIC_VMIDMT_S2VR4_ADDR A:0xf9ac0c10
y.create.l HWIO_PERIPH_SS_QPIC_QPIC_VMIDMT_S2VR5_ADDR A:0xf9ac0c14
y.create.l HWIO_PERIPH_SS_QPIC_QPIC_VMIDMT_S2VR6_ADDR A:0xf9ac0c18
y.create.l HWIO_PERIPH_SS_QPIC_QPIC_VMIDMT_S2VR7_ADDR A:0xf9ac0c1c
y.create.l HWIO_PERIPH_SS_QPIC_QPIC_VMIDMT_AS2VR0_ADDR A:0xf9ac0e00
y.create.l HWIO_PERIPH_SS_QPIC_QPIC_VMIDMT_AS2VR1_ADDR A:0xf9ac0e04
y.create.l HWIO_PERIPH_SS_QPIC_QPIC_VMIDMT_AS2VR2_ADDR A:0xf9ac0e08
y.create.l HWIO_PERIPH_SS_QPIC_QPIC_VMIDMT_AS2VR3_ADDR A:0xf9ac0e0c
y.create.l HWIO_PERIPH_SS_QPIC_QPIC_VMIDMT_AS2VR4_ADDR A:0xf9ac0e10
y.create.l HWIO_PERIPH_SS_QPIC_QPIC_VMIDMT_AS2VR5_ADDR A:0xf9ac0e14
y.create.l HWIO_PERIPH_SS_QPIC_QPIC_VMIDMT_AS2VR6_ADDR A:0xf9ac0e18
y.create.l HWIO_PERIPH_SS_QPIC_QPIC_VMIDMT_AS2VR7_ADDR A:0xf9ac0e1c
y.create.l HWIO_PERIPH_SS_QPIC_QPIC_VMIDMT_SMR0_ADDR A:0xf9ac0800
y.create.l HWIO_PERIPH_SS_QPIC_QPIC_VMIDMT_SMR1_ADDR A:0xf9ac0804
y.create.l HWIO_PERIPH_SS_QPIC_QPIC_VMIDMT_SMR2_ADDR A:0xf9ac0808
y.create.l HWIO_PERIPH_SS_QPIC_QPIC_VMIDMT_SMR3_ADDR A:0xf9ac080c
y.create.l HWIO_PERIPH_SS_QPIC_QPIC_VMIDMT_SMR4_ADDR A:0xf9ac0810
y.create.l HWIO_PERIPH_SS_QPIC_QPIC_VMIDMT_SMR5_ADDR A:0xf9ac0814
y.create.l HWIO_PERIPH_SS_QPIC_QPIC_VMIDMT_SMR6_ADDR A:0xf9ac0818
y.create.l HWIO_PERIPH_SS_QPIC_QPIC_VMIDMT_SMR7_ADDR A:0xf9ac081c
y.create.l HWIO_PERIPH_SS_QPIC_EBI2_CHIP_SELECT_CFG0_ADDR A:0xf9ae0000
y.create.l HWIO_PERIPH_SS_QPIC_EBI2_CFG_ADDR A:0xf9ae0004
y.create.l HWIO_PERIPH_SS_QPIC_EBI2_ARBITER_CFG_ADDR A:0xf9ae0030
y.create.l HWIO_PERIPH_SS_QPIC_EBI2_DEBUG_REG_LSB_ADDR A:0xf9ae0048
y.create.l HWIO_PERIPH_SS_QPIC_EBI2_DEBUG_REG_MSB_ADDR A:0xf9ae004c
y.create.l HWIO_PERIPH_SS_QPIC_EBI2_DEBUG_SEL_ADDR A:0xf9ae0050
y.create.l HWIO_PERIPH_SS_QPIC_EBI2_CRC_CFG_ADDR A:0xf9ae0054
y.create.l HWIO_PERIPH_SS_QPIC_EBI2_CRC_REMINDER_CFG_ADDR A:0xf9ae0058
y.create.l HWIO_PERIPH_SS_QPIC_EBI2_NAND_ADM_MUX_ADDR A:0xf9ae005c
y.create.l HWIO_PERIPH_SS_QPIC_EBI2_CLKON_CFG_ADDR A:0xf9ae0068
y.create.l HWIO_PERIPH_SS_QPIC_EBI2_CORE_CLKON_CFG_ADDR A:0xf9ae006c
y.create.l HWIO_PERIPH_SS_QPIC_QPIC_LCDC_CTRL_ADDR A:0xf9ae2000
y.create.l HWIO_PERIPH_SS_QPIC_LCDC_VERSION_ADDR A:0xf9ae2004
y.create.l HWIO_PERIPH_SS_QPIC_QPIC_LCDC_IRQ_EN_ADDR A:0xf9ae2008
y.create.l HWIO_PERIPH_SS_QPIC_QPIC_LCDC_IRQ_STTS_ADDR A:0xf9ae200c
y.create.l HWIO_PERIPH_SS_QPIC_QPIC_LCDC_IRQ_CLR_ADDR A:0xf9ae2010
y.create.l HWIO_PERIPH_SS_QPIC_QPIC_LCDC_STTS_ADDR A:0xf9ae2014
y.create.l HWIO_PERIPH_SS_QPIC_QPIC_LCDC_CMD_DATA_CYCLE_CNT_ADDR A:0xf9ae2018
y.create.l HWIO_PERIPH_SS_QPIC_QPIC_LCDC_CFG0_ADDR A:0xf9ae2020
y.create.l HWIO_PERIPH_SS_QPIC_QPIC_LCDC_CFG1_ADDR A:0xf9ae2024
y.create.l HWIO_PERIPH_SS_QPIC_QPIC_LCDC_CFG2_ADDR A:0xf9ae2028
y.create.l HWIO_PERIPH_SS_QPIC_QPIC_LCDC_RESET_ADDR A:0xf9ae202c
y.create.l HWIO_PERIPH_SS_QPIC_QPIC_LCD_DEVICE_RESET_ADDR A:0xf9ae2030
y.create.l HWIO_PERIPH_SS_QPIC_QPIC_LCDC_FIFO_SOF_ADDR A:0xf9ae2100
y.create.l HWIO_PERIPH_SS_QPIC_QPIC_LCDC_FIFO_DATA_PORT_ADDR A:0xf9ae2140
y.create.l HWIO_PERIPH_SS_QPIC_QPIC_LCDC_FIFO_EOF_ADDR A:0xf9ae2180
y.create.l HWIO_PERIPH_SS_QPIC_LCD_DEVICE_CMD0_ADDR A:0xf9ae3000
y.create.l HWIO_PERIPH_SS_QPIC_LCD_DEVICE_CMD1_ADDR A:0xf9ae3004
y.create.l HWIO_PERIPH_SS_QPIC_LCD_DEVICE_CMD2_ADDR A:0xf9ae3008
y.create.l HWIO_PERIPH_SS_QPIC_LCD_DEVICE_CMD3_ADDR A:0xf9ae300c
y.create.l HWIO_PERIPH_SS_QPIC_LCD_DEVICE_CMD4_ADDR A:0xf9ae3010
y.create.l HWIO_PERIPH_SS_QPIC_LCD_DEVICE_CMD5_ADDR A:0xf9ae3014
y.create.l HWIO_PERIPH_SS_QPIC_LCD_DEVICE_CMD6_ADDR A:0xf9ae3018
y.create.l HWIO_PERIPH_SS_QPIC_LCD_DEVICE_CMD7_ADDR A:0xf9ae301c
y.create.l HWIO_PERIPH_SS_QPIC_LCD_DEVICE_CMD8_ADDR A:0xf9ae3020
y.create.l HWIO_PERIPH_SS_QPIC_LCD_DEVICE_CMD9_ADDR A:0xf9ae3024
y.create.l HWIO_PERIPH_SS_QPIC_QPIC_VERSION_ADDR A:0xf9ae0100
y.create.l HWIO_PERIPH_SS_QPIC_QPIC_CTRL_ADDR A:0xf9ae0104
y.create.l HWIO_PERIPH_SS_QPIC_QPIC_HW_INFO_ADDR A:0xf9ae0108
y.create.l HWIO_PERIPH_SS_QPIC_QPIC_REG_PERMISSION_ADDR A:0xf9ae010c
y.create.l HWIO_PERIPH_SS_QPIC_QPIC_DEBUG_ADDR A:0xf9ae0110
y.create.l HWIO_PERIPH_SS_QPIC_NAND_FLASH_CMD_ADDR A:0xf9af0000
y.create.l HWIO_PERIPH_SS_QPIC_NAND_ADDR0_ADDR A:0xf9af0004
y.create.l HWIO_PERIPH_SS_QPIC_NAND_ADDR1_ADDR A:0xf9af0008
y.create.l HWIO_PERIPH_SS_QPIC_NAND_FLASH_CHIP_SELECT_ADDR A:0xf9af000c
y.create.l HWIO_PERIPH_SS_QPIC_NANDC_EXEC_CMD_ADDR A:0xf9af0010
y.create.l HWIO_PERIPH_SS_QPIC_NAND_FLASH_STATUS_ADDR A:0xf9af0014
y.create.l HWIO_PERIPH_SS_QPIC_NANDC_BUFFER_STATUS_ADDR A:0xf9af0018
y.create.l HWIO_PERIPH_SS_QPIC_NAND_DEV0_CFG0_ADDR A:0xf9af0020
y.create.l HWIO_PERIPH_SS_QPIC_NAND_DEV1_CFG0_ADDR A:0xf9af0030
y.create.l HWIO_PERIPH_SS_QPIC_NAND_DEV0_CFG1_ADDR A:0xf9af0024
y.create.l HWIO_PERIPH_SS_QPIC_NAND_DEV1_CFG1_ADDR A:0xf9af0034
y.create.l HWIO_PERIPH_SS_QPIC_NAND_DEV0_ECC_CFG_ADDR A:0xf9af0028
y.create.l HWIO_PERIPH_SS_QPIC_NAND_DEV1_ECC_CFG_ADDR A:0xf9af002c
y.create.l HWIO_PERIPH_SS_QPIC_NAND_FLASH_READ_ID_ADDR A:0xf9af0040
y.create.l HWIO_PERIPH_SS_QPIC_NAND_FLASH_READ_ID2_ADDR A:0xf9af0048
y.create.l HWIO_PERIPH_SS_QPIC_NAND_FLASH_READ_STATUS_ADDR A:0xf9af0044
y.create.l HWIO_PERIPH_SS_QPIC_NAND_FLASH_CONFIG_DATA_ADDR A:0xf9af0050
y.create.l HWIO_PERIPH_SS_QPIC_NAND_FLASH_CONFIG_ADDR A:0xf9af0054
y.create.l HWIO_PERIPH_SS_QPIC_NAND_FLASH_CONFIG_MODE_ADDR A:0xf9af0058
y.create.l HWIO_PERIPH_SS_QPIC_NAND_FLASH_CONFIG_STATUS_ADDR A:0xf9af0060
y.create.l HWIO_PERIPH_SS_QPIC_FLASH_MACRO1_REG_ADDR A:0xf9af0064
y.create.l HWIO_PERIPH_SS_QPIC_HSDDR_NAND_CFG_ADDR A:0xf9af0068
y.create.l HWIO_PERIPH_SS_QPIC_FLASH_XFR_STEP1_ADDR A:0xf9af0070
y.create.l HWIO_PERIPH_SS_QPIC_FLASH_XFR_STEP2_ADDR A:0xf9af0074
y.create.l HWIO_PERIPH_SS_QPIC_FLASH_XFR_STEP3_ADDR A:0xf9af0078
y.create.l HWIO_PERIPH_SS_QPIC_FLASH_XFR_STEP4_ADDR A:0xf9af007c
y.create.l HWIO_PERIPH_SS_QPIC_FLASH_XFR_STEP5_ADDR A:0xf9af0080
y.create.l HWIO_PERIPH_SS_QPIC_FLASH_XFR_STEP6_ADDR A:0xf9af0084
y.create.l HWIO_PERIPH_SS_QPIC_FLASH_XFR_STEP7_ADDR A:0xf9af0088
y.create.l HWIO_PERIPH_SS_QPIC_NAND_GENP_REG0_ADDR A:0xf9af0090
y.create.l HWIO_PERIPH_SS_QPIC_NAND_GENP_REG1_ADDR A:0xf9af0094
y.create.l HWIO_PERIPH_SS_QPIC_NAND_GENP_REG2_ADDR A:0xf9af0098
y.create.l HWIO_PERIPH_SS_QPIC_NAND_GENP_REG3_ADDR A:0xf9af009c
y.create.l HWIO_PERIPH_SS_QPIC_FLASH_DEV_CMD0_ADDR A:0xf9af00a0
y.create.l HWIO_PERIPH_SS_QPIC_FLASH_DEV_CMD1_ADDR A:0xf9af00a4
y.create.l HWIO_PERIPH_SS_QPIC_FLASH_DEV_CMD2_ADDR A:0xf9af00a8
y.create.l HWIO_PERIPH_SS_QPIC_FLASH_DEV_CMD_VLD_ADDR A:0xf9af00ac
y.create.l HWIO_PERIPH_SS_QPIC_NAND_ADDR2_ADDR A:0xf9af00c0
y.create.l HWIO_PERIPH_SS_QPIC_NAND_ADDR3_ADDR A:0xf9af00c4
y.create.l HWIO_PERIPH_SS_QPIC_NAND_ADDR4_ADDR A:0xf9af00c8
y.create.l HWIO_PERIPH_SS_QPIC_NAND_ADDR5_ADDR A:0xf9af00cc
y.create.l HWIO_PERIPH_SS_QPIC_FLASH_DEV_CMD3_ADDR A:0xf9af00d0
y.create.l HWIO_PERIPH_SS_QPIC_FLASH_DEV_CMD4_ADDR A:0xf9af00d4
y.create.l HWIO_PERIPH_SS_QPIC_FLASH_DEV_CMD5_ADDR A:0xf9af00d8
y.create.l HWIO_PERIPH_SS_QPIC_FLASH_DEV_CMD6_ADDR A:0xf9af00dc
y.create.l HWIO_PERIPH_SS_QPIC_NAND_ADDR6_ADDR A:0xf9af00e4
y.create.l HWIO_PERIPH_SS_QPIC_NAND_ERASED_CW_DETECT_CFG_ADDR A:0xf9af00e8
y.create.l HWIO_PERIPH_SS_QPIC_NAND_ERASED_CW_DETECT_STATUS_ADDR A:0xf9af00ec
y.create.l HWIO_PERIPH_SS_QPIC_EBI2_ECC_BUF_CFG_ADDR A:0xf9af00f0
y.create.l HWIO_PERIPH_SS_QPIC_NANDC_DBG_CFG_ADDR A:0xf9af00f4
y.create.l HWIO_PERIPH_SS_QPIC_NANDC_HW_PROFILE_CFG_ADDR A:0xf9af00f8
y.create.l HWIO_PERIPH_SS_QPIC_FLASH_BUFF0_ACC_ADDR A:0xf9af0100
y.create.l HWIO_PERIPH_SS_QPIC_FLASH_BUFF1_ACC_ADDR A:0xf9af0104
y.create.l HWIO_PERIPH_SS_QPIC_FLASH_BUFF2_ACC_ADDR A:0xf9af0108
y.create.l HWIO_PERIPH_SS_QPIC_FLASH_BUFF3_ACC_ADDR A:0xf9af010c
y.create.l HWIO_PERIPH_SS_QPIC_FLASH_BUFF4_ACC_ADDR A:0xf9af0110
y.create.l HWIO_PERIPH_SS_QPIC_FLASH_BUFF5_ACC_ADDR A:0xf9af0114
y.create.l HWIO_PERIPH_SS_QPIC_FLASH_BUFF6_ACC_ADDR A:0xf9af0118
y.create.l HWIO_PERIPH_SS_QPIC_FLASH_BUFF7_ACC_ADDR A:0xf9af011c
y.create.l HWIO_PERIPH_SS_QPIC_FLASH_BUFF8_ACC_ADDR A:0xf9af0120
y.create.l HWIO_PERIPH_SS_QPIC_FLASH_BUFF9_ACC_ADDR A:0xf9af0124
y.create.l HWIO_PERIPH_SS_QPIC_NAND_CTRL_ADDR A:0xf9af0f00
y.create.l HWIO_PERIPH_SS_QPIC_NAND_STATUS_ADDR A:0xf9af0f04
y.create.l HWIO_PERIPH_SS_QPIC_NAND_VERSION_ADDR A:0xf9af0f08
y.create.l HWIO_PERIPH_SS_QPIC_NAND_MPU_BYPASS_ADDR A:0xf9af0f44
y.create.l HWIO_PERIPH_SS_QPIC_NAND_DEBUG_ADDR A:0xf9af0f0c
y.create.l HWIO_PERIPH_SS_QPIC_NAND_IRQ_STTS_ADDR A:0xf9af0f10
y.create.l HWIO_PERIPH_SS_QPIC_NAND_IRQ_CLR_ADDR A:0xf9af0f14
y.create.l HWIO_PERIPH_SS_QPIC_NAND_IRQ_EN_ADDR A:0xf9af0f18
y.create.l HWIO_PERIPH_SS_QPIC_NAND_MUTEX_ADDR A:0xf9af0f1c
y.create.l HWIO_PERIPH_SS_QPIC_NAND_CONFIG_BITS_ADDR A:0xf9af0f40
y.create.l HWIO_PERIPH_SS_QPIC_NAND_READ_LOCATION_0_ADDR A:0xf9af0f20
y.create.l HWIO_PERIPH_SS_QPIC_NAND_READ_LOCATION_1_ADDR A:0xf9af0f24
y.create.l HWIO_PERIPH_SS_QPIC_NAND_READ_LOCATION_2_ADDR A:0xf9af0f28
y.create.l HWIO_PERIPH_SS_QPIC_NAND_READ_LOCATION_3_ADDR A:0xf9af0f2c
y.create.l HWIO_PERIPH_SS_QPIC_NAND_READ_LOCATION_4_ADDR A:0xf9af0f30
y.create.l HWIO_PERIPH_SS_QPIC_NAND_TEST_BUS_LSB_ADDR A:0xf9af0f48
y.create.l HWIO_PERIPH_SS_QPIC_NAND_TEST_BUS_MSB_ADDR A:0xf9af0f4c
y.create.l HWIO_PERIPH_SS_QPIC_NAND_OP_DONE_CNT_ADDR A:0xf9af0f50
y.create.l HWIO_PERIPH_SS_QPIC_QPIC_MPU_XPU_SCR_ADDR A:0xf9af1000
y.create.l HWIO_PERIPH_SS_QPIC_QPIC_MPU_XPU_SWDR_ADDR A:0xf9af1004
y.create.l HWIO_PERIPH_SS_QPIC_QPIC_MPU_XPU_PRTN_RACR_SSHADOW_ADDR A:0xf9af1008
y.create.l HWIO_PERIPH_SS_QPIC_QPIC_MPU_XPU_PRTN_START_SSHADOW0_ADDR A:0xf9af1010
y.create.l HWIO_PERIPH_SS_QPIC_QPIC_MPU_XPU_PRTN_START_SSHADOW1_ADDR A:0xf9af1014
y.create.l HWIO_PERIPH_SS_QPIC_QPIC_MPU_XPU_PRTN_END_SSHADOW0_ADDR A:0xf9af1018
y.create.l HWIO_PERIPH_SS_QPIC_QPIC_MPU_XPU_PRTN_END_SSHADOW1_ADDR A:0xf9af101c
y.create.l HWIO_PERIPH_SS_QPIC_QPIC_MPU_XPU_SEAR0_ADDR A:0xf9af1040
y.create.l HWIO_PERIPH_SS_QPIC_QPIC_MPU_XPU_SEAR1_ADDR A:0xf9af1044
y.create.l HWIO_PERIPH_SS_QPIC_QPIC_MPU_XPU_SESR_ADDR A:0xf9af1048
y.create.l HWIO_PERIPH_SS_QPIC_QPIC_MPU_XPU_SESRRESTORE_ADDR A:0xf9af104c
y.create.l HWIO_PERIPH_SS_QPIC_QPIC_MPU_XPU_SESYNR0_ADDR A:0xf9af1050
y.create.l HWIO_PERIPH_SS_QPIC_QPIC_MPU_XPU_SESYNR1_ADDR A:0xf9af1054
y.create.l HWIO_PERIPH_SS_QPIC_QPIC_MPU_XPU_SESYNR2_ADDR A:0xf9af1058
y.create.l HWIO_PERIPH_SS_QPIC_QPIC_MPU_XPU_MCR_ADDR A:0xf9af1100
y.create.l HWIO_PERIPH_SS_QPIC_QPIC_MPU_XPU_MEAR0_ADDR A:0xf9af1140
y.create.l HWIO_PERIPH_SS_QPIC_QPIC_MPU_XPU_MEAR1_ADDR A:0xf9af1144
y.create.l HWIO_PERIPH_SS_QPIC_QPIC_MPU_XPU_MESR_ADDR A:0xf9af1148
y.create.l HWIO_PERIPH_SS_QPIC_QPIC_MPU_XPU_MESRRESTORE_ADDR A:0xf9af114c
y.create.l HWIO_PERIPH_SS_QPIC_QPIC_MPU_XPU_MESYNR0_ADDR A:0xf9af1150
y.create.l HWIO_PERIPH_SS_QPIC_QPIC_MPU_XPU_MESYNR1_ADDR A:0xf9af1154
y.create.l HWIO_PERIPH_SS_QPIC_QPIC_MPU_XPU_MESYNR2_ADDR A:0xf9af1158
y.create.l HWIO_PERIPH_SS_QPIC_QPIC_MPU_XPU_CR_ADDR A:0xf9af1080
y.create.l HWIO_PERIPH_SS_QPIC_QPIC_MPU_XPU_PRTN_RACR_SHADOW_ADDR A:0xf9af1088
y.create.l HWIO_PERIPH_SS_QPIC_QPIC_MPU_XPU_PRTN_START_SHADOW0_ADDR A:0xf9af1090
y.create.l HWIO_PERIPH_SS_QPIC_QPIC_MPU_XPU_PRTN_START_SHADOW1_ADDR A:0xf9af1094
y.create.l HWIO_PERIPH_SS_QPIC_QPIC_MPU_XPU_PRTN_END_SHADOW0_ADDR A:0xf9af1098
y.create.l HWIO_PERIPH_SS_QPIC_QPIC_MPU_XPU_PRTN_END_SHADOW1_ADDR A:0xf9af109c
y.create.l HWIO_PERIPH_SS_QPIC_QPIC_MPU_XPU_RPU_ACR0_ADDR A:0xf9af10a0
y.create.l HWIO_PERIPH_SS_QPIC_QPIC_MPU_XPU_EAR0_ADDR A:0xf9af10c0
y.create.l HWIO_PERIPH_SS_QPIC_QPIC_MPU_XPU_EAR1_ADDR A:0xf9af10c4
y.create.l HWIO_PERIPH_SS_QPIC_QPIC_MPU_XPU_ESR_ADDR A:0xf9af10c8
y.create.l HWIO_PERIPH_SS_QPIC_QPIC_MPU_XPU_ESRRESTORE_ADDR A:0xf9af10cc
y.create.l HWIO_PERIPH_SS_QPIC_QPIC_MPU_XPU_ESYNR0_ADDR A:0xf9af10d0
y.create.l HWIO_PERIPH_SS_QPIC_QPIC_MPU_XPU_ESYNR1_ADDR A:0xf9af10d4
y.create.l HWIO_PERIPH_SS_QPIC_QPIC_MPU_XPU_ESYNR2_ADDR A:0xf9af10d8
y.create.l HWIO_PERIPH_SS_QPIC_QPIC_MPU_XPU_UMR_RACR_ADDR A:0xf9af10e0
y.create.l HWIO_PERIPH_SS_QPIC_QPIC_MPU_XPU_UMR_WACR_ADDR A:0xf9af10e4
y.create.l HWIO_PERIPH_SS_QPIC_QPIC_MPU_XPU_IDR0_ADDR A:0xf9af1074
y.create.l HWIO_PERIPH_SS_QPIC_QPIC_MPU_XPU_IDR1_ADDR A:0xf9af1078
y.create.l HWIO_PERIPH_SS_QPIC_QPIC_MPU_XPU_REV_ADDR A:0xf9af107c
y.create.l HWIO_PERIPH_SS_QPIC_QPIC_MPU_XPU_PRT0_RACR0_ADDR A:0xf9af1200
y.create.l HWIO_PERIPH_SS_QPIC_QPIC_MPU_XPU_PRT1_RACR0_ADDR A:0xf9af1280
y.create.l HWIO_PERIPH_SS_QPIC_QPIC_MPU_XPU_PRT2_RACR0_ADDR A:0xf9af1300
y.create.l HWIO_PERIPH_SS_QPIC_QPIC_MPU_XPU_PRT3_RACR0_ADDR A:0xf9af1380
y.create.l HWIO_PERIPH_SS_QPIC_QPIC_MPU_XPU_PRT4_RACR0_ADDR A:0xf9af1400
y.create.l HWIO_PERIPH_SS_QPIC_QPIC_MPU_XPU_PRT5_RACR0_ADDR A:0xf9af1480
y.create.l HWIO_PERIPH_SS_QPIC_QPIC_MPU_XPU_PRT6_RACR0_ADDR A:0xf9af1500
y.create.l HWIO_PERIPH_SS_QPIC_QPIC_MPU_XPU_PRT7_RACR0_ADDR A:0xf9af1580
y.create.l HWIO_PERIPH_SS_QPIC_QPIC_MPU_XPU_PRT0_START0_ADDR A:0xf9af1240
y.create.l HWIO_PERIPH_SS_QPIC_QPIC_MPU_XPU_PRT1_START0_ADDR A:0xf9af12c0
y.create.l HWIO_PERIPH_SS_QPIC_QPIC_MPU_XPU_PRT2_START0_ADDR A:0xf9af1340
y.create.l HWIO_PERIPH_SS_QPIC_QPIC_MPU_XPU_PRT3_START0_ADDR A:0xf9af13c0
y.create.l HWIO_PERIPH_SS_QPIC_QPIC_MPU_XPU_PRT4_START0_ADDR A:0xf9af1440
y.create.l HWIO_PERIPH_SS_QPIC_QPIC_MPU_XPU_PRT5_START0_ADDR A:0xf9af14c0
y.create.l HWIO_PERIPH_SS_QPIC_QPIC_MPU_XPU_PRT6_START0_ADDR A:0xf9af1540
y.create.l HWIO_PERIPH_SS_QPIC_QPIC_MPU_XPU_PRT7_START0_ADDR A:0xf9af15c0
y.create.l HWIO_PERIPH_SS_QPIC_QPIC_MPU_XPU_PRT0_START1_ADDR A:0xf9af1244
y.create.l HWIO_PERIPH_SS_QPIC_QPIC_MPU_XPU_PRT1_START1_ADDR A:0xf9af12c4
y.create.l HWIO_PERIPH_SS_QPIC_QPIC_MPU_XPU_PRT2_START1_ADDR A:0xf9af1344
y.create.l HWIO_PERIPH_SS_QPIC_QPIC_MPU_XPU_PRT3_START1_ADDR A:0xf9af13c4
y.create.l HWIO_PERIPH_SS_QPIC_QPIC_MPU_XPU_PRT4_START1_ADDR A:0xf9af1444
y.create.l HWIO_PERIPH_SS_QPIC_QPIC_MPU_XPU_PRT5_START1_ADDR A:0xf9af14c4
y.create.l HWIO_PERIPH_SS_QPIC_QPIC_MPU_XPU_PRT6_START1_ADDR A:0xf9af1544
y.create.l HWIO_PERIPH_SS_QPIC_QPIC_MPU_XPU_PRT7_START1_ADDR A:0xf9af15c4
y.create.l HWIO_PERIPH_SS_QPIC_QPIC_MPU_XPU_PRT0_END0_ADDR A:0xf9af1248
y.create.l HWIO_PERIPH_SS_QPIC_QPIC_MPU_XPU_PRT1_END0_ADDR A:0xf9af12c8
y.create.l HWIO_PERIPH_SS_QPIC_QPIC_MPU_XPU_PRT2_END0_ADDR A:0xf9af1348
y.create.l HWIO_PERIPH_SS_QPIC_QPIC_MPU_XPU_PRT3_END0_ADDR A:0xf9af13c8
y.create.l HWIO_PERIPH_SS_QPIC_QPIC_MPU_XPU_PRT4_END0_ADDR A:0xf9af1448
y.create.l HWIO_PERIPH_SS_QPIC_QPIC_MPU_XPU_PRT5_END0_ADDR A:0xf9af14c8
y.create.l HWIO_PERIPH_SS_QPIC_QPIC_MPU_XPU_PRT6_END0_ADDR A:0xf9af1548
y.create.l HWIO_PERIPH_SS_QPIC_QPIC_MPU_XPU_PRT7_END0_ADDR A:0xf9af15c8
y.create.l HWIO_PERIPH_SS_QPIC_QPIC_MPU_XPU_PRT0_END1_ADDR A:0xf9af124c
y.create.l HWIO_PERIPH_SS_QPIC_QPIC_MPU_XPU_PRT1_END1_ADDR A:0xf9af12cc
y.create.l HWIO_PERIPH_SS_QPIC_QPIC_MPU_XPU_PRT2_END1_ADDR A:0xf9af134c
y.create.l HWIO_PERIPH_SS_QPIC_QPIC_MPU_XPU_PRT3_END1_ADDR A:0xf9af13cc
y.create.l HWIO_PERIPH_SS_QPIC_QPIC_MPU_XPU_PRT4_END1_ADDR A:0xf9af144c
y.create.l HWIO_PERIPH_SS_QPIC_QPIC_MPU_XPU_PRT5_END1_ADDR A:0xf9af14cc
y.create.l HWIO_PERIPH_SS_QPIC_QPIC_MPU_XPU_PRT6_END1_ADDR A:0xf9af154c
y.create.l HWIO_PERIPH_SS_QPIC_QPIC_MPU_XPU_PRT7_END1_ADDR A:0xf9af15cc
y.create.l HWIO_PERIPH_SS_QPIC_QPIC_MPU_XPU_PRT0_SCR_ADDR A:0xf9af1250
y.create.l HWIO_PERIPH_SS_QPIC_QPIC_MPU_XPU_PRT1_SCR_ADDR A:0xf9af12d0
y.create.l HWIO_PERIPH_SS_QPIC_QPIC_MPU_XPU_PRT2_SCR_ADDR A:0xf9af1350
y.create.l HWIO_PERIPH_SS_QPIC_QPIC_MPU_XPU_PRT3_SCR_ADDR A:0xf9af13d0
y.create.l HWIO_PERIPH_SS_QPIC_QPIC_MPU_XPU_PRT4_SCR_ADDR A:0xf9af1450
y.create.l HWIO_PERIPH_SS_QPIC_QPIC_MPU_XPU_PRT5_SCR_ADDR A:0xf9af14d0
y.create.l HWIO_PERIPH_SS_QPIC_QPIC_MPU_XPU_PRT6_SCR_ADDR A:0xf9af1550
y.create.l HWIO_PERIPH_SS_QPIC_QPIC_MPU_XPU_PRT7_SCR_ADDR A:0xf9af15d0
y.create.l HWIO_PERIPH_SS_QPIC_QPIC_MPU_XPU_PRT0_MCR_ADDR A:0xf9af1254
y.create.l HWIO_PERIPH_SS_QPIC_QPIC_MPU_XPU_PRT1_MCR_ADDR A:0xf9af12d4
y.create.l HWIO_PERIPH_SS_QPIC_QPIC_MPU_XPU_PRT2_MCR_ADDR A:0xf9af1354
y.create.l HWIO_PERIPH_SS_QPIC_QPIC_MPU_XPU_PRT3_MCR_ADDR A:0xf9af13d4
y.create.l HWIO_PERIPH_SS_QPIC_QPIC_MPU_XPU_PRT4_MCR_ADDR A:0xf9af1454
y.create.l HWIO_PERIPH_SS_QPIC_QPIC_MPU_XPU_PRT5_MCR_ADDR A:0xf9af14d4
y.create.l HWIO_PERIPH_SS_QPIC_QPIC_MPU_XPU_PRT6_MCR_ADDR A:0xf9af1554
y.create.l HWIO_PERIPH_SS_QPIC_QPIC_MPU_XPU_PRT7_MCR_ADDR A:0xf9af15d4
y.create.l HWIO_PERIPH_SS_QPIC_QPIC_MPU_XPU_PRT0_CNTL0_ADDR A:0xf9af1258
y.create.l HWIO_PERIPH_SS_QPIC_QPIC_MPU_XPU_PRT1_CNTL0_ADDR A:0xf9af12d8
y.create.l HWIO_PERIPH_SS_QPIC_QPIC_MPU_XPU_PRT2_CNTL0_ADDR A:0xf9af1358
y.create.l HWIO_PERIPH_SS_QPIC_QPIC_MPU_XPU_PRT3_CNTL0_ADDR A:0xf9af13d8
y.create.l HWIO_PERIPH_SS_QPIC_QPIC_MPU_XPU_PRT4_CNTL0_ADDR A:0xf9af1458
y.create.l HWIO_PERIPH_SS_QPIC_QPIC_MPU_XPU_PRT5_CNTL0_ADDR A:0xf9af14d8
y.create.l HWIO_PERIPH_SS_QPIC_QPIC_MPU_XPU_PRT6_CNTL0_ADDR A:0xf9af1558
y.create.l HWIO_PERIPH_SS_QPIC_QPIC_MPU_XPU_PRT7_CNTL0_ADDR A:0xf9af15d8
y.create.l HWIO_PERIPH_SS_QPIC_QPIC_MPU_XPU_PRT0_CNTL1_ADDR A:0xf9af125c
y.create.l HWIO_PERIPH_SS_QPIC_QPIC_MPU_XPU_PRT1_CNTL1_ADDR A:0xf9af12dc
y.create.l HWIO_PERIPH_SS_QPIC_QPIC_MPU_XPU_PRT2_CNTL1_ADDR A:0xf9af135c
y.create.l HWIO_PERIPH_SS_QPIC_QPIC_MPU_XPU_PRT3_CNTL1_ADDR A:0xf9af13dc
y.create.l HWIO_PERIPH_SS_QPIC_QPIC_MPU_XPU_PRT4_CNTL1_ADDR A:0xf9af145c
y.create.l HWIO_PERIPH_SS_QPIC_QPIC_MPU_XPU_PRT5_CNTL1_ADDR A:0xf9af14dc
y.create.l HWIO_PERIPH_SS_QPIC_QPIC_MPU_XPU_PRT6_CNTL1_ADDR A:0xf9af155c
y.create.l HWIO_PERIPH_SS_QPIC_QPIC_MPU_XPU_PRT7_CNTL1_ADDR A:0xf9af15dc
y.create.l HWIO_PERIPH_SS_BUS_TIMEOUT_0_ABT_HW_VERSION_ADDR A:0xf9bf7000
y.create.l HWIO_PERIPH_SS_BUS_TIMEOUT_0_ABT_INST_ID_ADDR A:0xf9bf7004
y.create.l HWIO_PERIPH_SS_BUS_TIMEOUT_0_ABT_NUM_SLAVES_ADDR A:0xf9bf7008
y.create.l HWIO_PERIPH_SS_BUS_TIMEOUT_0_ABT_TIMER_LOADVAL_ADDR A:0xf9bf700c
y.create.l HWIO_PERIPH_SS_BUS_TIMEOUT_0_ABT_TIMER_MODE_ADDR A:0xf9bf7010
y.create.l HWIO_PERIPH_SS_BUS_TIMEOUT_0_ABT_INTR_STATUS_ADDR A:0xf9bf7014
y.create.l HWIO_PERIPH_SS_BUS_TIMEOUT_0_ABT_INTR_CLEAR_ADDR A:0xf9bf7018
y.create.l HWIO_PERIPH_SS_BUS_TIMEOUT_0_ABT_INTR_ENABLE_ADDR A:0xf9bf701c
y.create.l HWIO_PERIPH_SS_BUS_TIMEOUT_0_ABT_SYND_VALID_ADDR A:0xf9bf7020
y.create.l HWIO_PERIPH_SS_BUS_TIMEOUT_0_ABT_SYND_CLEAR_ADDR A:0xf9bf7024
y.create.l HWIO_PERIPH_SS_BUS_TIMEOUT_0_ABT_SYND_ID_ADDR A:0xf9bf7028
y.create.l HWIO_PERIPH_SS_BUS_TIMEOUT_0_ABT_SYND_ADDR0_ADDR A:0xf9bf702c
y.create.l HWIO_PERIPH_SS_BUS_TIMEOUT_0_ABT_SYND_ADDR1_ADDR A:0xf9bf7030
y.create.l HWIO_PERIPH_SS_BUS_TIMEOUT_0_ABT_SYND_HREADY_ADDR A:0xf9bf7034
y.create.l HWIO_PERIPH_SS_BUS_TIMEOUT_1_ABT_HW_VERSION_ADDR A:0xf9bf8000
y.create.l HWIO_PERIPH_SS_BUS_TIMEOUT_1_ABT_INST_ID_ADDR A:0xf9bf8004
y.create.l HWIO_PERIPH_SS_BUS_TIMEOUT_1_ABT_NUM_SLAVES_ADDR A:0xf9bf8008
y.create.l HWIO_PERIPH_SS_BUS_TIMEOUT_1_ABT_TIMER_LOADVAL_ADDR A:0xf9bf800c
y.create.l HWIO_PERIPH_SS_BUS_TIMEOUT_1_ABT_TIMER_MODE_ADDR A:0xf9bf8010
y.create.l HWIO_PERIPH_SS_BUS_TIMEOUT_1_ABT_INTR_STATUS_ADDR A:0xf9bf8014
y.create.l HWIO_PERIPH_SS_BUS_TIMEOUT_1_ABT_INTR_CLEAR_ADDR A:0xf9bf8018
y.create.l HWIO_PERIPH_SS_BUS_TIMEOUT_1_ABT_INTR_ENABLE_ADDR A:0xf9bf801c
y.create.l HWIO_PERIPH_SS_BUS_TIMEOUT_1_ABT_SYND_VALID_ADDR A:0xf9bf8020
y.create.l HWIO_PERIPH_SS_BUS_TIMEOUT_1_ABT_SYND_CLEAR_ADDR A:0xf9bf8024
y.create.l HWIO_PERIPH_SS_BUS_TIMEOUT_1_ABT_SYND_ID_ADDR A:0xf9bf8028
y.create.l HWIO_PERIPH_SS_BUS_TIMEOUT_1_ABT_SYND_ADDR0_ADDR A:0xf9bf802c
y.create.l HWIO_PERIPH_SS_BUS_TIMEOUT_1_ABT_SYND_ADDR1_ADDR A:0xf9bf8030
y.create.l HWIO_PERIPH_SS_BUS_TIMEOUT_1_ABT_SYND_HREADY_ADDR A:0xf9bf8034
y.create.l HWIO_PERIPH_SS_BUS_TIMEOUT_2_ABT_HW_VERSION_ADDR A:0xf9bf9000
y.create.l HWIO_PERIPH_SS_BUS_TIMEOUT_2_ABT_INST_ID_ADDR A:0xf9bf9004
y.create.l HWIO_PERIPH_SS_BUS_TIMEOUT_2_ABT_NUM_SLAVES_ADDR A:0xf9bf9008
y.create.l HWIO_PERIPH_SS_BUS_TIMEOUT_2_ABT_TIMER_LOADVAL_ADDR A:0xf9bf900c
y.create.l HWIO_PERIPH_SS_BUS_TIMEOUT_2_ABT_TIMER_MODE_ADDR A:0xf9bf9010
y.create.l HWIO_PERIPH_SS_BUS_TIMEOUT_2_ABT_INTR_STATUS_ADDR A:0xf9bf9014
y.create.l HWIO_PERIPH_SS_BUS_TIMEOUT_2_ABT_INTR_CLEAR_ADDR A:0xf9bf9018
y.create.l HWIO_PERIPH_SS_BUS_TIMEOUT_2_ABT_INTR_ENABLE_ADDR A:0xf9bf901c
y.create.l HWIO_PERIPH_SS_BUS_TIMEOUT_2_ABT_SYND_VALID_ADDR A:0xf9bf9020
y.create.l HWIO_PERIPH_SS_BUS_TIMEOUT_2_ABT_SYND_CLEAR_ADDR A:0xf9bf9024
y.create.l HWIO_PERIPH_SS_BUS_TIMEOUT_2_ABT_SYND_ID_ADDR A:0xf9bf9028
y.create.l HWIO_PERIPH_SS_BUS_TIMEOUT_2_ABT_SYND_ADDR0_ADDR A:0xf9bf902c
y.create.l HWIO_PERIPH_SS_BUS_TIMEOUT_2_ABT_SYND_ADDR1_ADDR A:0xf9bf9030
y.create.l HWIO_PERIPH_SS_BUS_TIMEOUT_2_ABT_SYND_HREADY_ADDR A:0xf9bf9034
y.create.l HWIO_PERIPH_SS_BUS_TIMEOUT_3_ABT_HW_VERSION_ADDR A:0xf9bfa000
y.create.l HWIO_PERIPH_SS_BUS_TIMEOUT_3_ABT_INST_ID_ADDR A:0xf9bfa004
y.create.l HWIO_PERIPH_SS_BUS_TIMEOUT_3_ABT_NUM_SLAVES_ADDR A:0xf9bfa008
y.create.l HWIO_PERIPH_SS_BUS_TIMEOUT_3_ABT_TIMER_LOADVAL_ADDR A:0xf9bfa00c
y.create.l HWIO_PERIPH_SS_BUS_TIMEOUT_3_ABT_TIMER_MODE_ADDR A:0xf9bfa010
y.create.l HWIO_PERIPH_SS_BUS_TIMEOUT_3_ABT_INTR_STATUS_ADDR A:0xf9bfa014
y.create.l HWIO_PERIPH_SS_BUS_TIMEOUT_3_ABT_INTR_CLEAR_ADDR A:0xf9bfa018
y.create.l HWIO_PERIPH_SS_BUS_TIMEOUT_3_ABT_INTR_ENABLE_ADDR A:0xf9bfa01c
y.create.l HWIO_PERIPH_SS_BUS_TIMEOUT_3_ABT_SYND_VALID_ADDR A:0xf9bfa020
y.create.l HWIO_PERIPH_SS_BUS_TIMEOUT_3_ABT_SYND_CLEAR_ADDR A:0xf9bfa024
y.create.l HWIO_PERIPH_SS_BUS_TIMEOUT_3_ABT_SYND_ID_ADDR A:0xf9bfa028
y.create.l HWIO_PERIPH_SS_BUS_TIMEOUT_3_ABT_SYND_ADDR0_ADDR A:0xf9bfa02c
y.create.l HWIO_PERIPH_SS_BUS_TIMEOUT_3_ABT_SYND_ADDR1_ADDR A:0xf9bfa030
y.create.l HWIO_PERIPH_SS_BUS_TIMEOUT_3_ABT_SYND_HREADY_ADDR A:0xf9bfa034
y.create.l HWIO_PERIPH_SS_BUS_TIMEOUT_4_ABT_HW_VERSION_ADDR A:0xf9bfb000
y.create.l HWIO_PERIPH_SS_BUS_TIMEOUT_4_ABT_INST_ID_ADDR A:0xf9bfb004
y.create.l HWIO_PERIPH_SS_BUS_TIMEOUT_4_ABT_NUM_SLAVES_ADDR A:0xf9bfb008
y.create.l HWIO_PERIPH_SS_BUS_TIMEOUT_4_ABT_TIMER_LOADVAL_ADDR A:0xf9bfb00c
y.create.l HWIO_PERIPH_SS_BUS_TIMEOUT_4_ABT_TIMER_MODE_ADDR A:0xf9bfb010
y.create.l HWIO_PERIPH_SS_BUS_TIMEOUT_4_ABT_INTR_STATUS_ADDR A:0xf9bfb014
y.create.l HWIO_PERIPH_SS_BUS_TIMEOUT_4_ABT_INTR_CLEAR_ADDR A:0xf9bfb018
y.create.l HWIO_PERIPH_SS_BUS_TIMEOUT_4_ABT_INTR_ENABLE_ADDR A:0xf9bfb01c
y.create.l HWIO_PERIPH_SS_BUS_TIMEOUT_4_ABT_SYND_VALID_ADDR A:0xf9bfb020
y.create.l HWIO_PERIPH_SS_BUS_TIMEOUT_4_ABT_SYND_CLEAR_ADDR A:0xf9bfb024
y.create.l HWIO_PERIPH_SS_BUS_TIMEOUT_4_ABT_SYND_ID_ADDR A:0xf9bfb028
y.create.l HWIO_PERIPH_SS_BUS_TIMEOUT_4_ABT_SYND_ADDR0_ADDR A:0xf9bfb02c
y.create.l HWIO_PERIPH_SS_BUS_TIMEOUT_4_ABT_SYND_ADDR1_ADDR A:0xf9bfb030
y.create.l HWIO_PERIPH_SS_BUS_TIMEOUT_4_ABT_SYND_HREADY_ADDR A:0xf9bfb034
y.create.l HWIO_PERIPH_SS_MPU_XPU_SCR_ADDR A:0xf9bfc000
y.create.l HWIO_PERIPH_SS_MPU_XPU_SWDR_ADDR A:0xf9bfc004
y.create.l HWIO_PERIPH_SS_MPU_XPU_PRTN_RACR_SSHADOW_ADDR A:0xf9bfc008
y.create.l HWIO_PERIPH_SS_MPU_XPU_PRTN_WACR_SSHADOW_ADDR A:0xf9bfc00c
y.create.l HWIO_PERIPH_SS_MPU_XPU_PRTN_START_SSHADOW0_ADDR A:0xf9bfc010
y.create.l HWIO_PERIPH_SS_MPU_XPU_PRTN_END_SSHADOW0_ADDR A:0xf9bfc018
y.create.l HWIO_PERIPH_SS_MPU_XPU_SEAR0_ADDR A:0xf9bfc040
y.create.l HWIO_PERIPH_SS_MPU_XPU_SESR_ADDR A:0xf9bfc048
y.create.l HWIO_PERIPH_SS_MPU_XPU_SESRRESTORE_ADDR A:0xf9bfc04c
y.create.l HWIO_PERIPH_SS_MPU_XPU_SESYNR0_ADDR A:0xf9bfc050
y.create.l HWIO_PERIPH_SS_MPU_XPU_SESYNR1_ADDR A:0xf9bfc054
y.create.l HWIO_PERIPH_SS_MPU_XPU_SESYNR2_ADDR A:0xf9bfc058
y.create.l HWIO_PERIPH_SS_MPU_XPU_MCR_ADDR A:0xf9bfc100
y.create.l HWIO_PERIPH_SS_MPU_XPU_MEAR0_ADDR A:0xf9bfc140
y.create.l HWIO_PERIPH_SS_MPU_XPU_MESR_ADDR A:0xf9bfc148
y.create.l HWIO_PERIPH_SS_MPU_XPU_MESRRESTORE_ADDR A:0xf9bfc14c
y.create.l HWIO_PERIPH_SS_MPU_XPU_MESYNR0_ADDR A:0xf9bfc150
y.create.l HWIO_PERIPH_SS_MPU_XPU_MESYNR1_ADDR A:0xf9bfc154
y.create.l HWIO_PERIPH_SS_MPU_XPU_MESYNR2_ADDR A:0xf9bfc158
y.create.l HWIO_PERIPH_SS_MPU_XPU_CR_ADDR A:0xf9bfc080
y.create.l HWIO_PERIPH_SS_MPU_XPU_PRTN_RACR_SHADOW_ADDR A:0xf9bfc088
y.create.l HWIO_PERIPH_SS_MPU_XPU_PRTN_WACR_SHADOW_ADDR A:0xf9bfc08c
y.create.l HWIO_PERIPH_SS_MPU_XPU_PRTN_START_SHADOW0_ADDR A:0xf9bfc090
y.create.l HWIO_PERIPH_SS_MPU_XPU_PRTN_END_SHADOW0_ADDR A:0xf9bfc098
y.create.l HWIO_PERIPH_SS_MPU_XPU_RPU_ACR0_ADDR A:0xf9bfc0a0
y.create.l HWIO_PERIPH_SS_MPU_XPU_EAR0_ADDR A:0xf9bfc0c0
y.create.l HWIO_PERIPH_SS_MPU_XPU_ESR_ADDR A:0xf9bfc0c8
y.create.l HWIO_PERIPH_SS_MPU_XPU_ESRRESTORE_ADDR A:0xf9bfc0cc
y.create.l HWIO_PERIPH_SS_MPU_XPU_ESYNR0_ADDR A:0xf9bfc0d0
y.create.l HWIO_PERIPH_SS_MPU_XPU_ESYNR1_ADDR A:0xf9bfc0d4
y.create.l HWIO_PERIPH_SS_MPU_XPU_ESYNR2_ADDR A:0xf9bfc0d8
y.create.l HWIO_PERIPH_SS_MPU_XPU_UMR_RACR_ADDR A:0xf9bfc0e0
y.create.l HWIO_PERIPH_SS_MPU_XPU_UMR_WACR_ADDR A:0xf9bfc0e4
y.create.l HWIO_PERIPH_SS_MPU_XPU_IDR0_ADDR A:0xf9bfc074
y.create.l HWIO_PERIPH_SS_MPU_XPU_IDR1_ADDR A:0xf9bfc078
y.create.l HWIO_PERIPH_SS_MPU_XPU_REV_ADDR A:0xf9bfc07c
y.create.l HWIO_PERIPH_SS_MPU_XPU_PRT0_RACR0_ADDR A:0xf9bfc200
y.create.l HWIO_PERIPH_SS_MPU_XPU_PRT1_RACR0_ADDR A:0xf9bfc280
y.create.l HWIO_PERIPH_SS_MPU_XPU_PRT2_RACR0_ADDR A:0xf9bfc300
y.create.l HWIO_PERIPH_SS_MPU_XPU_PRT3_RACR0_ADDR A:0xf9bfc380
y.create.l HWIO_PERIPH_SS_MPU_XPU_PRT0_WACR0_ADDR A:0xf9bfc220
y.create.l HWIO_PERIPH_SS_MPU_XPU_PRT1_WACR0_ADDR A:0xf9bfc2a0
y.create.l HWIO_PERIPH_SS_MPU_XPU_PRT2_WACR0_ADDR A:0xf9bfc320
y.create.l HWIO_PERIPH_SS_MPU_XPU_PRT3_WACR0_ADDR A:0xf9bfc3a0
y.create.l HWIO_PERIPH_SS_MPU_XPU_PRT0_START0_ADDR A:0xf9bfc240
y.create.l HWIO_PERIPH_SS_MPU_XPU_PRT1_START0_ADDR A:0xf9bfc2c0
y.create.l HWIO_PERIPH_SS_MPU_XPU_PRT2_START0_ADDR A:0xf9bfc340
y.create.l HWIO_PERIPH_SS_MPU_XPU_PRT3_START0_ADDR A:0xf9bfc3c0
y.create.l HWIO_PERIPH_SS_MPU_XPU_PRT0_END0_ADDR A:0xf9bfc248
y.create.l HWIO_PERIPH_SS_MPU_XPU_PRT1_END0_ADDR A:0xf9bfc2c8
y.create.l HWIO_PERIPH_SS_MPU_XPU_PRT2_END0_ADDR A:0xf9bfc348
y.create.l HWIO_PERIPH_SS_MPU_XPU_PRT3_END0_ADDR A:0xf9bfc3c8
y.create.l HWIO_PERIPH_SS_MPU_XPU_PRT0_SCR_ADDR A:0xf9bfc250
y.create.l HWIO_PERIPH_SS_MPU_XPU_PRT1_SCR_ADDR A:0xf9bfc2d0
y.create.l HWIO_PERIPH_SS_MPU_XPU_PRT2_SCR_ADDR A:0xf9bfc350
y.create.l HWIO_PERIPH_SS_MPU_XPU_PRT3_SCR_ADDR A:0xf9bfc3d0
y.create.l HWIO_PERIPH_SS_MPU_XPU_PRT0_MCR_ADDR A:0xf9bfc254
y.create.l HWIO_PERIPH_SS_MPU_XPU_PRT1_MCR_ADDR A:0xf9bfc2d4
y.create.l HWIO_PERIPH_SS_MPU_XPU_PRT2_MCR_ADDR A:0xf9bfc354
y.create.l HWIO_PERIPH_SS_MPU_XPU_PRT3_MCR_ADDR A:0xf9bfc3d4
y.create.l HWIO_PERIPH_SS_MPU_XPU_PRT0_CNTL0_ADDR A:0xf9bfc258
y.create.l HWIO_PERIPH_SS_MPU_XPU_PRT1_CNTL0_ADDR A:0xf9bfc2d8
y.create.l HWIO_PERIPH_SS_MPU_XPU_PRT2_CNTL0_ADDR A:0xf9bfc358
y.create.l HWIO_PERIPH_SS_MPU_XPU_PRT3_CNTL0_ADDR A:0xf9bfc3d8
y.create.l HWIO_PERIPH_SS_MPU_XPU_PRT0_CNTL1_ADDR A:0xf9bfc25c
y.create.l HWIO_PERIPH_SS_MPU_XPU_PRT1_CNTL1_ADDR A:0xf9bfc2dc
y.create.l HWIO_PERIPH_SS_MPU_XPU_PRT2_CNTL1_ADDR A:0xf9bfc35c
y.create.l HWIO_PERIPH_SS_MPU_XPU_PRT3_CNTL1_ADDR A:0xf9bfc3dc
y.create.l HWIO_PERIPH_SS_APU_XPU_SCR_ADDR A:0xf9bfd000
y.create.l HWIO_PERIPH_SS_APU_XPU_SWDR_ADDR A:0xf9bfd004
y.create.l HWIO_PERIPH_SS_APU_XPU_SEAR0_ADDR A:0xf9bfd040
y.create.l HWIO_PERIPH_SS_APU_XPU_SESR_ADDR A:0xf9bfd048
y.create.l HWIO_PERIPH_SS_APU_XPU_SESRRESTORE_ADDR A:0xf9bfd04c
y.create.l HWIO_PERIPH_SS_APU_XPU_SESYNR0_ADDR A:0xf9bfd050
y.create.l HWIO_PERIPH_SS_APU_XPU_SESYNR1_ADDR A:0xf9bfd054
y.create.l HWIO_PERIPH_SS_APU_XPU_SESYNR2_ADDR A:0xf9bfd058
y.create.l HWIO_PERIPH_SS_APU_XPU_MCR_ADDR A:0xf9bfd100
y.create.l HWIO_PERIPH_SS_APU_XPU_MEAR0_ADDR A:0xf9bfd140
y.create.l HWIO_PERIPH_SS_APU_XPU_MESR_ADDR A:0xf9bfd148
y.create.l HWIO_PERIPH_SS_APU_XPU_MESRRESTORE_ADDR A:0xf9bfd14c
y.create.l HWIO_PERIPH_SS_APU_XPU_MESYNR0_ADDR A:0xf9bfd150
y.create.l HWIO_PERIPH_SS_APU_XPU_MESYNR1_ADDR A:0xf9bfd154
y.create.l HWIO_PERIPH_SS_APU_XPU_MESYNR2_ADDR A:0xf9bfd158
y.create.l HWIO_PERIPH_SS_APU_XPU_CR_ADDR A:0xf9bfd080
y.create.l HWIO_PERIPH_SS_APU_XPU_RPU_ACR0_ADDR A:0xf9bfd0a0
y.create.l HWIO_PERIPH_SS_APU_XPU_EAR0_ADDR A:0xf9bfd0c0
y.create.l HWIO_PERIPH_SS_APU_XPU_ESR_ADDR A:0xf9bfd0c8
y.create.l HWIO_PERIPH_SS_APU_XPU_ESRRESTORE_ADDR A:0xf9bfd0cc
y.create.l HWIO_PERIPH_SS_APU_XPU_ESYNR0_ADDR A:0xf9bfd0d0
y.create.l HWIO_PERIPH_SS_APU_XPU_ESYNR1_ADDR A:0xf9bfd0d4
y.create.l HWIO_PERIPH_SS_APU_XPU_ESYNR2_ADDR A:0xf9bfd0d8
y.create.l HWIO_PERIPH_SS_APU_XPU_IDR0_ADDR A:0xf9bfd074
y.create.l HWIO_PERIPH_SS_APU_XPU_IDR1_ADDR A:0xf9bfd078
y.create.l HWIO_PERIPH_SS_APU_XPU_REV_ADDR A:0xf9bfd07c
y.create.l HWIO_PERIPH_SS_APU_XPU_RG0_RACR0_ADDR A:0xf9bfd200
y.create.l HWIO_PERIPH_SS_APU_XPU_RG1_RACR0_ADDR A:0xf9bfd280
y.create.l HWIO_PERIPH_SS_APU_XPU_RG0_SCR_ADDR A:0xf9bfd250
y.create.l HWIO_PERIPH_SS_APU_XPU_RG1_SCR_ADDR A:0xf9bfd2d0
y.create.l HWIO_PERIPH_SS_APU_XPU_RG0_MCR_ADDR A:0xf9bfd254
y.create.l HWIO_PERIPH_SS_APU_XPU_RG1_MCR_ADDR A:0xf9bfd2d4
y.create.l HWIO_PERIPH_SS_PDM_TCXO_PDM_CTL_ADDR A:0xf9bfe040
y.create.l HWIO_PERIPH_SS_PDM_PDM0_CTL_ADDR A:0xf9bfe044
y.create.l HWIO_PERIPH_SS_PDM_PDM1_CTL_ADDR A:0xf9bfe048
y.create.l HWIO_PERIPH_SS_PDM_GP_MN_CLK_MDIV_ADDR A:0xf9bfe04c
y.create.l HWIO_PERIPH_SS_PDM_GP_MN_CLK_NDIV_ADDR A:0xf9bfe050
y.create.l HWIO_PERIPH_SS_PDM_GP_MN_CLK_DUTY_ADDR A:0xf9bfe054
y.create.l HWIO_PERIPH_SS_PDM_WEB_TCXO4_TEST_ADDR A:0xf9bfe058
y.create.l HWIO_PERIPH_SS_PDM_PDM2_CTL_ADDR A:0xf9bfe05c
y.create.l HWIO_PERIPH_SS_PRNG_PRNG_DATA_OUT_ADDR A:0xf9bff000
y.create.l HWIO_PERIPH_SS_PRNG_PRNG_STATUS_ADDR A:0xf9bff004
y.create.l HWIO_PERIPH_SS_PRNG_PRNG_HW_VERSION_ADDR A:0xf9bff008
y.create.l HWIO_PERIPH_SS_PRNG_PRNG_ENTROPY_CNTR_ADDR A:0xf9bff010
y.create.l HWIO_PERIPH_SS_PRNG_PRNG_SAMPLE_CNTR_ADDR A:0xf9bff014
y.create.l HWIO_PERIPH_SS_PRNG_PRNG_GEN_CNTR_ADDR A:0xf9bff018
y.create.l HWIO_PERIPH_SS_PRNG_PRNG_RESEED_CNTR_ADDR A:0xf9bff01c
y.create.l HWIO_PERIPH_SS_PRNG_PRNG_INSTANTIATE_CNTR_ADDR A:0xf9bff020
y.create.l HWIO_PERIPH_SS_PRNG_PRNG_DEBUG_ADDR A:0xf9bff024
y.create.l HWIO_PERIPH_SS_PRNG_PRNG_LFSR_CFG_ADDR A:0xf9bff100
y.create.l HWIO_PERIPH_SS_PRNG_PRNG_CONFIG_ADDR A:0xf9bff104
y.create.l HWIO_PERIPH_SS_PRNG_PRNG_PERSONALIZATION_STRING_ADDR A:0xf9bff108
y.create.l HWIO_PERIPH_SS_PRNG_PRNG_NUM_ENTROPY_ADDR A:0xf9bff110
y.create.l HWIO_PERIPH_SS_PRNG_PRNG_SAMPLE_FREQ_ADDR A:0xf9bff114
y.create.l HWIO_PERIPH_SS_PRNG_PRNG_GEN_WORDS_ADDR A:0xf9bff118
y.create.l HWIO_PERIPH_SS_PRNG_PRNG_RESEED_FREQ_ADDR A:0xf9bff11c
y.create.l HWIO_PERIPH_SS_PRNG_PRNG_INSTANTIATE_FREQ_ADDR A:0xf9bff120
y.create.l HWIO_TCSR_MUTEX_XPU_SCR_ADDR A:0xfd480000
y.create.l HWIO_TCSR_MUTEX_XPU_SWDR_ADDR A:0xfd480004
y.create.l HWIO_TCSR_MUTEX_XPU_SEAR0_ADDR A:0xfd480040
y.create.l HWIO_TCSR_MUTEX_XPU_SESR_ADDR A:0xfd480048
y.create.l HWIO_TCSR_MUTEX_XPU_SESRRESTORE_ADDR A:0xfd48004c
y.create.l HWIO_TCSR_MUTEX_XPU_SESYNR0_ADDR A:0xfd480050
y.create.l HWIO_TCSR_MUTEX_XPU_SESYNR1_ADDR A:0xfd480054
y.create.l HWIO_TCSR_MUTEX_XPU_SESYNR2_ADDR A:0xfd480058
y.create.l HWIO_TCSR_MUTEX_XPU_MCR_ADDR A:0xfd480100
y.create.l HWIO_TCSR_MUTEX_XPU_MEAR0_ADDR A:0xfd480140
y.create.l HWIO_TCSR_MUTEX_XPU_MESR_ADDR A:0xfd480148
y.create.l HWIO_TCSR_MUTEX_XPU_MESRRESTORE_ADDR A:0xfd48014c
y.create.l HWIO_TCSR_MUTEX_XPU_MESYNR0_ADDR A:0xfd480150
y.create.l HWIO_TCSR_MUTEX_XPU_MESYNR1_ADDR A:0xfd480154
y.create.l HWIO_TCSR_MUTEX_XPU_MESYNR2_ADDR A:0xfd480158
y.create.l HWIO_TCSR_MUTEX_XPU_CR_ADDR A:0xfd480080
y.create.l HWIO_TCSR_MUTEX_XPU_RPU_ACR0_ADDR A:0xfd4800a0
y.create.l HWIO_TCSR_MUTEX_XPU_EAR0_ADDR A:0xfd4800c0
y.create.l HWIO_TCSR_MUTEX_XPU_ESR_ADDR A:0xfd4800c8
y.create.l HWIO_TCSR_MUTEX_XPU_ESRRESTORE_ADDR A:0xfd4800cc
y.create.l HWIO_TCSR_MUTEX_XPU_ESYNR0_ADDR A:0xfd4800d0
y.create.l HWIO_TCSR_MUTEX_XPU_ESYNR1_ADDR A:0xfd4800d4
y.create.l HWIO_TCSR_MUTEX_XPU_ESYNR2_ADDR A:0xfd4800d8
y.create.l HWIO_TCSR_MUTEX_XPU_IDR0_ADDR A:0xfd480074
y.create.l HWIO_TCSR_MUTEX_XPU_IDR1_ADDR A:0xfd480078
y.create.l HWIO_TCSR_MUTEX_XPU_REV_ADDR A:0xfd48007c
y.create.l HWIO_TCSR_MUTEX_XPU_RG0_RACR0_ADDR A:0xfd480200
y.create.l HWIO_TCSR_MUTEX_XPU_RG1_RACR0_ADDR A:0xfd480280
y.create.l HWIO_TCSR_MUTEX_XPU_RG2_RACR0_ADDR A:0xfd480300
y.create.l HWIO_TCSR_MUTEX_XPU_RG3_RACR0_ADDR A:0xfd480380
y.create.l HWIO_TCSR_MUTEX_XPU_RG4_RACR0_ADDR A:0xfd480400
y.create.l HWIO_TCSR_MUTEX_XPU_RG5_RACR0_ADDR A:0xfd480480
y.create.l HWIO_TCSR_MUTEX_XPU_RG6_RACR0_ADDR A:0xfd480500
y.create.l HWIO_TCSR_MUTEX_XPU_RG7_RACR0_ADDR A:0xfd480580
y.create.l HWIO_TCSR_MUTEX_XPU_RG8_RACR0_ADDR A:0xfd480600
y.create.l HWIO_TCSR_MUTEX_XPU_RG9_RACR0_ADDR A:0xfd480680
y.create.l HWIO_TCSR_MUTEX_XPU_RG0_WACR0_ADDR A:0xfd480220
y.create.l HWIO_TCSR_MUTEX_XPU_RG1_WACR0_ADDR A:0xfd4802a0
y.create.l HWIO_TCSR_MUTEX_XPU_RG2_WACR0_ADDR A:0xfd480320
y.create.l HWIO_TCSR_MUTEX_XPU_RG3_WACR0_ADDR A:0xfd4803a0
y.create.l HWIO_TCSR_MUTEX_XPU_RG4_WACR0_ADDR A:0xfd480420
y.create.l HWIO_TCSR_MUTEX_XPU_RG5_WACR0_ADDR A:0xfd4804a0
y.create.l HWIO_TCSR_MUTEX_XPU_RG6_WACR0_ADDR A:0xfd480520
y.create.l HWIO_TCSR_MUTEX_XPU_RG7_WACR0_ADDR A:0xfd4805a0
y.create.l HWIO_TCSR_MUTEX_XPU_RG8_WACR0_ADDR A:0xfd480620
y.create.l HWIO_TCSR_MUTEX_XPU_RG9_WACR0_ADDR A:0xfd4806a0
y.create.l HWIO_TCSR_MUTEX_XPU_RG0_SCR_ADDR A:0xfd480250
y.create.l HWIO_TCSR_MUTEX_XPU_RG1_SCR_ADDR A:0xfd4802d0
y.create.l HWIO_TCSR_MUTEX_XPU_RG2_SCR_ADDR A:0xfd480350
y.create.l HWIO_TCSR_MUTEX_XPU_RG3_SCR_ADDR A:0xfd4803d0
y.create.l HWIO_TCSR_MUTEX_XPU_RG4_SCR_ADDR A:0xfd480450
y.create.l HWIO_TCSR_MUTEX_XPU_RG5_SCR_ADDR A:0xfd4804d0
y.create.l HWIO_TCSR_MUTEX_XPU_RG6_SCR_ADDR A:0xfd480550
y.create.l HWIO_TCSR_MUTEX_XPU_RG7_SCR_ADDR A:0xfd4805d0
y.create.l HWIO_TCSR_MUTEX_XPU_RG8_SCR_ADDR A:0xfd480650
y.create.l HWIO_TCSR_MUTEX_XPU_RG9_SCR_ADDR A:0xfd4806d0
y.create.l HWIO_TCSR_MUTEX_XPU_RG0_MCR_ADDR A:0xfd480254
y.create.l HWIO_TCSR_MUTEX_XPU_RG1_MCR_ADDR A:0xfd4802d4
y.create.l HWIO_TCSR_MUTEX_XPU_RG2_MCR_ADDR A:0xfd480354
y.create.l HWIO_TCSR_MUTEX_XPU_RG3_MCR_ADDR A:0xfd4803d4
y.create.l HWIO_TCSR_MUTEX_XPU_RG4_MCR_ADDR A:0xfd480454
y.create.l HWIO_TCSR_MUTEX_XPU_RG5_MCR_ADDR A:0xfd4804d4
y.create.l HWIO_TCSR_MUTEX_XPU_RG6_MCR_ADDR A:0xfd480554
y.create.l HWIO_TCSR_MUTEX_XPU_RG7_MCR_ADDR A:0xfd4805d4
y.create.l HWIO_TCSR_MUTEX_XPU_RG8_MCR_ADDR A:0xfd480654
y.create.l HWIO_TCSR_MUTEX_XPU_RG9_MCR_ADDR A:0xfd4806d4
y.create.l HWIO_TCSR_MUTEX_REG_0_ADDR A:0xfd484000
y.create.l HWIO_TCSR_MUTEX_REG_1_ADDR A:0xfd484080
y.create.l HWIO_TCSR_MUTEX_REG_2_ADDR A:0xfd484100
y.create.l HWIO_TCSR_MUTEX_REG_3_ADDR A:0xfd484180
y.create.l HWIO_TCSR_MUTEX_REG_4_ADDR A:0xfd484200
y.create.l HWIO_TCSR_MUTEX_REG_5_ADDR A:0xfd484280
y.create.l HWIO_TCSR_MUTEX_REG_6_ADDR A:0xfd484300
y.create.l HWIO_TCSR_MUTEX_REG_7_ADDR A:0xfd484380
y.create.l HWIO_TCSR_MUTEX_REG_8_ADDR A:0xfd484400
y.create.l HWIO_TCSR_MUTEX_REG_9_ADDR A:0xfd484480
y.create.l HWIO_TCSR_CRYPTO0_HALTREQ_ADDR A:0xfd485000
y.create.l HWIO_TCSR_CRYPTO0_HALTACK_ADDR A:0xfd485004
y.create.l HWIO_TCSR_CRYPTO0_MASTER_IDLE_ADDR A:0xfd485008
y.create.l HWIO_TCSR_CRYPTO1_HALTREQ_ADDR A:0xfd485080
y.create.l HWIO_TCSR_CRYPTO1_HALTACK_ADDR A:0xfd485084
y.create.l HWIO_TCSR_CRYPTO1_MASTER_IDLE_ADDR A:0xfd485088
y.create.l HWIO_TCSR_LPASS_HALTREQ_ADDR A:0xfd485100
y.create.l HWIO_TCSR_LPASS_HALTACK_ADDR A:0xfd485104
y.create.l HWIO_TCSR_LPASS_MASTER_IDLE_ADDR A:0xfd485108
y.create.l HWIO_TCSR_LPASSQ6_POWER_STATE_ADDR A:0xfd485110
y.create.l HWIO_TCSR_MSSQ6_HALTREQ_ADDR A:0xfd485180
y.create.l HWIO_TCSR_MSSQ6_HALTACK_ADDR A:0xfd485184
y.create.l HWIO_TCSR_MSSQ6_MASTER_IDLE_ADDR A:0xfd485188
y.create.l HWIO_TCSR_MSSQ6_POWER_STATE_ADDR A:0xfd485190
y.create.l HWIO_TCSR_MSS_MODEM_HALTREQ_ADDR A:0xfd485200
y.create.l HWIO_TCSR_MSS_MODEM_HALTACK_ADDR A:0xfd485204
y.create.l HWIO_TCSR_MSS_MODEM_MASTER_IDLE_ADDR A:0xfd485208
y.create.l HWIO_TCSR_MSS_NC_HALTREQ_ADDR A:0xfd485280
y.create.l HWIO_TCSR_MSS_NC_HALTACK_ADDR A:0xfd485284
y.create.l HWIO_TCSR_MSS_NC_MASTER_IDLE_ADDR A:0xfd485288
y.create.l HWIO_TCSR_WCSS_HALTREQ_ADDR A:0xfd485300
y.create.l HWIO_TCSR_WCSS_HALTACK_ADDR A:0xfd485304
y.create.l HWIO_TCSR_WCSS_MASTER_IDLE_ADDR A:0xfd485308
y.create.l HWIO_TCSR_MUTEX_REG_RESET_ADDR A:0xfd485380
y.create.l HWIO_TCSR_IPA_HALTREQ_ADDR A:0xfd485400
y.create.l HWIO_TCSR_IPA_HALTACK_ADDR A:0xfd485404
y.create.l HWIO_TCSR_REGS_XPU_SCR_ADDR A:0xfd498000
y.create.l HWIO_TCSR_REGS_XPU_SWDR_ADDR A:0xfd498004
y.create.l HWIO_TCSR_REGS_XPU_SEAR0_ADDR A:0xfd498040
y.create.l HWIO_TCSR_REGS_XPU_SESR_ADDR A:0xfd498048
y.create.l HWIO_TCSR_REGS_XPU_SESRRESTORE_ADDR A:0xfd49804c
y.create.l HWIO_TCSR_REGS_XPU_SESYNR0_ADDR A:0xfd498050
y.create.l HWIO_TCSR_REGS_XPU_SESYNR1_ADDR A:0xfd498054
y.create.l HWIO_TCSR_REGS_XPU_SESYNR2_ADDR A:0xfd498058
y.create.l HWIO_TCSR_REGS_XPU_MCR_ADDR A:0xfd498100
y.create.l HWIO_TCSR_REGS_XPU_MEAR0_ADDR A:0xfd498140
y.create.l HWIO_TCSR_REGS_XPU_MESR_ADDR A:0xfd498148
y.create.l HWIO_TCSR_REGS_XPU_MESRRESTORE_ADDR A:0xfd49814c
y.create.l HWIO_TCSR_REGS_XPU_MESYNR0_ADDR A:0xfd498150
y.create.l HWIO_TCSR_REGS_XPU_MESYNR1_ADDR A:0xfd498154
y.create.l HWIO_TCSR_REGS_XPU_MESYNR2_ADDR A:0xfd498158
y.create.l HWIO_TCSR_REGS_XPU_CR_ADDR A:0xfd498080
y.create.l HWIO_TCSR_REGS_XPU_RPU_ACR0_ADDR A:0xfd4980a0
y.create.l HWIO_TCSR_REGS_XPU_EAR0_ADDR A:0xfd4980c0
y.create.l HWIO_TCSR_REGS_XPU_ESR_ADDR A:0xfd4980c8
y.create.l HWIO_TCSR_REGS_XPU_ESRRESTORE_ADDR A:0xfd4980cc
y.create.l HWIO_TCSR_REGS_XPU_ESYNR0_ADDR A:0xfd4980d0
y.create.l HWIO_TCSR_REGS_XPU_ESYNR1_ADDR A:0xfd4980d4
y.create.l HWIO_TCSR_REGS_XPU_ESYNR2_ADDR A:0xfd4980d8
y.create.l HWIO_TCSR_REGS_XPU_IDR0_ADDR A:0xfd498074
y.create.l HWIO_TCSR_REGS_XPU_IDR1_ADDR A:0xfd498078
y.create.l HWIO_TCSR_REGS_XPU_REV_ADDR A:0xfd49807c
y.create.l HWIO_TCSR_REGS_XPU_RG0_RACR0_ADDR A:0xfd498200
y.create.l HWIO_TCSR_REGS_XPU_RG1_RACR0_ADDR A:0xfd498280
y.create.l HWIO_TCSR_REGS_XPU_RG2_RACR0_ADDR A:0xfd498300
y.create.l HWIO_TCSR_REGS_XPU_RG3_RACR0_ADDR A:0xfd498380
y.create.l HWIO_TCSR_REGS_XPU_RG4_RACR0_ADDR A:0xfd498400
y.create.l HWIO_TCSR_REGS_XPU_RG5_RACR0_ADDR A:0xfd498480
y.create.l HWIO_TCSR_REGS_XPU_RG6_RACR0_ADDR A:0xfd498500
y.create.l HWIO_TCSR_REGS_XPU_RG7_RACR0_ADDR A:0xfd498580
y.create.l HWIO_TCSR_REGS_XPU_RG8_RACR0_ADDR A:0xfd498600
y.create.l HWIO_TCSR_REGS_XPU_RG9_RACR0_ADDR A:0xfd498680
y.create.l HWIO_TCSR_REGS_XPU_RG0_WACR0_ADDR A:0xfd498220
y.create.l HWIO_TCSR_REGS_XPU_RG1_WACR0_ADDR A:0xfd4982a0
y.create.l HWIO_TCSR_REGS_XPU_RG2_WACR0_ADDR A:0xfd498320
y.create.l HWIO_TCSR_REGS_XPU_RG3_WACR0_ADDR A:0xfd4983a0
y.create.l HWIO_TCSR_REGS_XPU_RG4_WACR0_ADDR A:0xfd498420
y.create.l HWIO_TCSR_REGS_XPU_RG5_WACR0_ADDR A:0xfd4984a0
y.create.l HWIO_TCSR_REGS_XPU_RG6_WACR0_ADDR A:0xfd498520
y.create.l HWIO_TCSR_REGS_XPU_RG7_WACR0_ADDR A:0xfd4985a0
y.create.l HWIO_TCSR_REGS_XPU_RG8_WACR0_ADDR A:0xfd498620
y.create.l HWIO_TCSR_REGS_XPU_RG9_WACR0_ADDR A:0xfd4986a0
y.create.l HWIO_TCSR_REGS_XPU_RG0_SCR_ADDR A:0xfd498250
y.create.l HWIO_TCSR_REGS_XPU_RG1_SCR_ADDR A:0xfd4982d0
y.create.l HWIO_TCSR_REGS_XPU_RG2_SCR_ADDR A:0xfd498350
y.create.l HWIO_TCSR_REGS_XPU_RG3_SCR_ADDR A:0xfd4983d0
y.create.l HWIO_TCSR_REGS_XPU_RG4_SCR_ADDR A:0xfd498450
y.create.l HWIO_TCSR_REGS_XPU_RG5_SCR_ADDR A:0xfd4984d0
y.create.l HWIO_TCSR_REGS_XPU_RG6_SCR_ADDR A:0xfd498550
y.create.l HWIO_TCSR_REGS_XPU_RG7_SCR_ADDR A:0xfd4985d0
y.create.l HWIO_TCSR_REGS_XPU_RG8_SCR_ADDR A:0xfd498650
y.create.l HWIO_TCSR_REGS_XPU_RG9_SCR_ADDR A:0xfd4986d0
y.create.l HWIO_TCSR_REGS_XPU_RG0_MCR_ADDR A:0xfd498254
y.create.l HWIO_TCSR_REGS_XPU_RG1_MCR_ADDR A:0xfd4982d4
y.create.l HWIO_TCSR_REGS_XPU_RG2_MCR_ADDR A:0xfd498354
y.create.l HWIO_TCSR_REGS_XPU_RG3_MCR_ADDR A:0xfd4983d4
y.create.l HWIO_TCSR_REGS_XPU_RG4_MCR_ADDR A:0xfd498454
y.create.l HWIO_TCSR_REGS_XPU_RG5_MCR_ADDR A:0xfd4984d4
y.create.l HWIO_TCSR_REGS_XPU_RG6_MCR_ADDR A:0xfd498554
y.create.l HWIO_TCSR_REGS_XPU_RG7_MCR_ADDR A:0xfd4985d4
y.create.l HWIO_TCSR_REGS_XPU_RG8_MCR_ADDR A:0xfd498654
y.create.l HWIO_TCSR_REGS_XPU_RG9_MCR_ADDR A:0xfd4986d4
y.create.l HWIO_TCSR_KPSS_QRIB_XPU2_ADDR A:0xfd4a0080
y.create.l HWIO_TCSR_BIMC_CFG_QRIB_XPU2_INIT_ADDR A:0xfd4a0100
y.create.l HWIO_TCSR_BIMC_QXS0_QRIB_XPU2_INIT_ADDR A:0xfd4a0104
y.create.l HWIO_TCSR_BIMC_QXS1_QRIB_XPU2_INIT_ADDR A:0xfd4a0108
y.create.l HWIO_TCSR_LPASS_LPM_QRIB_XPU2_INIT_ADDR A:0xfd4a0180
y.create.l HWIO_TCSR_LPASS_LPC_CSR_QRIB_XPU2_INIT_ADDR A:0xfd4a0184
y.create.l HWIO_TCSR_LPASS_LPAIF_QRIB_XPU2_INIT_ADDR A:0xfd4a0188
y.create.l HWIO_TCSR_LPASS_RSMP_QRIB_XPU2_INIT_ADDR A:0xfd4a018c
y.create.l HWIO_TCSR_LPASS_LPC_COM_QRIB_XPU2_INIT_ADDR A:0xfd4a0190
y.create.l HWIO_TCSR_LPASS_SB_QRIB_XPU2_INIT_ADDR A:0xfd4a0194
y.create.l HWIO_TCSR_MPM_QDSS_QRIB_XPU2_INIT_ADDR A:0xfd4a0200
y.create.l HWIO_TCSR_MMSS_VENUS0_VBIF_QRIB_XPU2_INIT_ADDR A:0xfd4a0380
y.create.l HWIO_TCSR_MMSS_VENUS0_WRAPPER_QRIB_XPU2_INIT_ADDR A:0xfd4a0384
y.create.l HWIO_TCSR_MMSS_VFE_QRIB_XPU2_INIT_ADDR A:0xfd4a038c
y.create.l HWIO_TCSR_MMSS_JPEG_QRIB_XPU2_INIT_ADDR A:0xfd4a0390
y.create.l HWIO_TCSR_MMSS_MDP_QRIB_XPU2_INIT_ADDR A:0xfd4a0394
y.create.l HWIO_TCSR_MMSS_VENUS0_MMU_QRIB_NS_ADDR A:0xfd4a0400
y.create.l HWIO_TCSR_MMSS_VENUS0_MMU_QRIB_NS_EN_ADDR A:0xfd4a0404
y.create.l HWIO_TCSR_MMSS_VFE_MMU_QRIB_NS_ADDR A:0xfd4a0410
y.create.l HWIO_TCSR_MMSS_VFE_MMU_QRIB_NS_EN_ADDR A:0xfd4a0414
y.create.l HWIO_TCSR_MMSS_JPEG_MMU_QRIB_NS_ADDR A:0xfd4a0418
y.create.l HWIO_TCSR_MMSS_JPEG_MMU_QRIB_NS_EN_ADDR A:0xfd4a041c
y.create.l HWIO_TCSR_MMSS_MDP_MMU_QRIB_NS_ADDR A:0xfd4a0420
y.create.l HWIO_TCSR_MMSS_MDP_MMU_QRIB_NS_EN_ADDR A:0xfd4a0424
y.create.l HWIO_TCSR_MMSS_OXILI_MMU_QRIB_NS_ADDR A:0xfd4a0428
y.create.l HWIO_TCSR_MMSS_OXILI_MMU_QRIB_NS_EN_ADDR A:0xfd4a042c
y.create.l HWIO_TCSR_MMSS_OXILICX_QRIB_XPU2_INIT_ADDR A:0xfd4a0500
y.create.l HWIO_TCSR_MMSS_OXILI_VBIF_QRIB_XPU2_INIT_ADDR A:0xfd4a0504
y.create.l HWIO_TCSR_MMSS_OCMEM_DM_QRIB_XPU2_INIT_ADDR A:0xfd4a0600
y.create.l HWIO_TCSR_MMSS_OCMEM_QRIB_XPU2_INIT_ADDR A:0xfd4a0604
y.create.l HWIO_TCSR_MMSS_OCMEM_OSW0_QRIB_XPU2_INIT_ADDR A:0xfd4a0608
y.create.l HWIO_TCSR_MMSS_OCMEM_OSW1_QRIB_XPU2_INIT_ADDR A:0xfd4a060c
y.create.l HWIO_TCSR_MMSS_OCMEM_OSWDM_QRIB_XPU2_INIT_ADDR A:0xfd4a0610
y.create.l HWIO_TCSR_MMSS_OCMEM_OSWSYS_QRIB_XPU2_INIT_ADDR A:0xfd4a0614
y.create.l HWIO_TCSR_PHSS_USB1_HS_QRIB_XPU2_INIT_ADDR A:0xfd4a0700
y.create.l HWIO_TCSR_PHSS_USB2_HSIC_QRIB_XPU2_INIT_ADDR A:0xfd4a0704
y.create.l HWIO_TCSR_PHSS_BLSP1_QRIB_XPU2_INIT_ADDR A:0xfd4a0708
y.create.l HWIO_TCSR_PHSS_BLSP2_QRIB_XPU2_INIT_ADDR A:0xfd4a070c
y.create.l HWIO_TCSR_PHSS_TSIF_BAM_QRIB_XPU2_INIT_ADDR A:0xfd4a0710
y.create.l HWIO_TCSR_PHSS_BAM_DMA_QRIB_XPU2_INIT_ADDR A:0xfd4a0714
y.create.l HWIO_TCSR_TIMEOUT_SLAVE_GLB_EN_ADDR A:0xfd4a0800
y.create.l HWIO_TCSR_XPU_NSEN_STATUS_ADDR A:0xfd4a0820
y.create.l HWIO_TCSR_XPU_VMIDEN_STATUS_ADDR A:0xfd4a0824
y.create.l HWIO_TCSR_XPU_MSAEN_STATUS_ADDR A:0xfd4a0828
y.create.l HWIO_TCSR_IPA_BAM_XPU2_QRIB_XPU2_INIT_ADDR A:0xfd4a0900
y.create.l HWIO_TCSR_BIMC_CFG_QRIB_XPU2_ACR_ADDR A:0xfd4a1000
y.create.l HWIO_TCSR_BIMC_CFG_QRIB_XPU2_VMIDEN_INIT_ADDR A:0xfd4a1004
y.create.l HWIO_TCSR_BIMC_QXS0_QRIB_XPU2_ACR_ADDR A:0xfd4a1008
y.create.l HWIO_TCSR_BIMC_QXS0_QRIB_XPU2_VMIDEN_INIT_ADDR A:0xfd4a100c
y.create.l HWIO_TCSR_BIMC_QXS1_QRIB_XPU2_ACR_ADDR A:0xfd4a1010
y.create.l HWIO_TCSR_BIMC_QXS1_QRIB_XPU2_VMIDEN_INIT_ADDR A:0xfd4a1014
y.create.l HWIO_TCSR_LPASS_LPM_QRIB_XPU2_ACR_ADDR A:0xfd4a1180
y.create.l HWIO_TCSR_LPASS_LPM_QRIB_XPU2_VMIDEN_INIT_ADDR A:0xfd4a1184
y.create.l HWIO_TCSR_LPASS_LPC_CSR_QRIB_XPU2_ACR_ADDR A:0xfd4a1188
y.create.l HWIO_TCSR_LPASS_LPC_CSR_QRIB_XPU2_VMIDEN_INIT_ADDR A:0xfd4a118c
y.create.l HWIO_TCSR_LPASS_LPAIF_QRIB_XPU2_ACR_ADDR A:0xfd4a1190
y.create.l HWIO_TCSR_LPASS_LPAIF_QRIB_XPU2_VMIDEN_INIT_ADDR A:0xfd4a1194
y.create.l HWIO_TCSR_LPASS_RSMP_QRIB_XPU2_ACR_ADDR A:0xfd4a1198
y.create.l HWIO_TCSR_LPASS_RSMP_QRIB_XPU2_VMIDEN_INIT_ADDR A:0xfd4a119c
y.create.l HWIO_TCSR_LPASS_LPC_COM_QRIB_XPU2_ACR_ADDR A:0xfd4a1280
y.create.l HWIO_TCSR_LPASS_LPC_COM_QRIB_XPU2_VMIDEN_INIT_ADDR A:0xfd4a11a4
y.create.l HWIO_TCSR_LPASS_SB_QRIB_XPU2_ACR_ADDR A:0xfd4a11b8
y.create.l HWIO_TCSR_LPASS_SB_QRIB_XPU2_VMIDEN_INIT_ADDR A:0xfd4a11bc
y.create.l HWIO_TCSR_LPASS_SB_QRIB_VMIDMT_INIT_ACR_INIT_ADDR A:0xfd4a11c0
y.create.l HWIO_TCSR_LPASS_SB_QRIB_VMIDMT_EN_ADDR A:0xfd4a11c4
y.create.l HWIO_TCSR_LPASS_AIF_QRIB_VMIDMT_INIT_ACR_INIT_ADDR A:0xfd4a11c8
y.create.l HWIO_TCSR_LPASS_AIF_QRIB_VMIDMT_EN_ADDR A:0xfd4a11cc
y.create.l HWIO_TCSR_LPASS_DML_QRIB_VMIDMT_INIT_ACR_INIT_ADDR A:0xfd4a11d0
y.create.l HWIO_TCSR_LPASS_DML_QRIB_VMIDMT_EN_ADDR A:0xfd4a11d4
y.create.l HWIO_TCSR_LPASS_MIDI_QRIB_VMIDMT_INIT_ACR_INIT_ADDR A:0xfd4a11d8
y.create.l HWIO_TCSR_LPASS_MIDI_QRIB_VMIDMT_EN_ADDR A:0xfd4a11dc
y.create.l HWIO_TCSR_LPASS_RSMPLR_QRIB_VMIDMT_INIT_ACR_INIT_ADDR A:0xfd4a11e0
y.create.l HWIO_TCSR_LPASS_RSMPLR_QRIB_VMIDMT_EN_ADDR A:0xfd4a11e4
y.create.l HWIO_TCSR_MPM_QDSS_QRIB_XPU2_ACR_ADDR A:0xfd4a1200
y.create.l HWIO_TCSR_MPM_QDSS_QRIB_XPU2_VMIDEN_INIT_ADDR A:0xfd4a1204
y.create.l HWIO_TCSR_MMSS_VENUS0_VBIF_QRIB_XPU2_ACR_ADDR A:0xfd4a1380
y.create.l HWIO_TCSR_MMSS_VENUS0_VBIF_QRIB_XPU2_VMIDEN_INIT_ADDR A:0xfd4a1384
y.create.l HWIO_TCSR_MMSS_VENUS0_CPU_QRIB_VMIDMT_INIT_ACR_INIT_ADDR A:0xfd4a1388
y.create.l HWIO_TCSR_MMSS_VENUS0_CPU_QRIB_VMIDMT_EN_ADDR A:0xfd4a138c
y.create.l HWIO_TCSR_MMSS_VENUS0_WRAPPER_QRIB_XPU2_ACR_ADDR A:0xfd4a1390
y.create.l HWIO_TCSR_MMSS_VENUS0_WRAPPER_QRIB_XPU2_VMIDEN_INIT_ADDR A:0xfd4a1394
y.create.l HWIO_TCSR_MMSS_VENUS0_VBIF_QRIB_VMIDMT_INIT_ACR_INIT_ADDR A:0xfd4a1398
y.create.l HWIO_TCSR_MMSS_VENUS0_VBIF_QRIB_VMIDMT_EN_ADDR A:0xfd4a139c
y.create.l HWIO_TCSR_MMSS_VFE_QRIB_XPU2_ACR_ADDR A:0xfd4a13b0
y.create.l HWIO_TCSR_MMSS_VFE_QRIB_XPU2_VMIDEN_INIT_ADDR A:0xfd4a13b4
y.create.l HWIO_TCSR_MMSS_VFE_QRIB_VMIDMT_INIT_ACR_INIT_ADDR A:0xfd4a13b8
y.create.l HWIO_TCSR_MMSS_VFE_QRIB_VMIDMT_EN_ADDR A:0xfd4a13bc
y.create.l HWIO_TCSR_MMSS_JPEG_QRIB_XPU2_ACR_ADDR A:0xfd4a13c0
y.create.l HWIO_TCSR_MMSS_JPEG_QRIB_XPU2_VMIDEN_INIT_ADDR A:0xfd4a13c4
y.create.l HWIO_TCSR_MMSS_JPEG_QRIB_VMIDMT_INIT_ACR_INIT_ADDR A:0xfd4a13c8
y.create.l HWIO_TCSR_MMSS_JPEG_QRIB_VMIDMT_EN_ADDR A:0xfd4a13cc
y.create.l HWIO_TCSR_MMSS_MDP_QRIB_XPU2_ACR_ADDR A:0xfd4a13d0
y.create.l HWIO_TCSR_MMSS_MDP_QRIB_XPU2_VMIDEN_INIT_ADDR A:0xfd4a13d4
y.create.l HWIO_TCSR_MMSS_MDP_QRIB_VMIDMT_INIT_ACR_INIT_ADDR A:0xfd4a13d8
y.create.l HWIO_TCSR_MMSS_MDP_QRIB_VMIDMT_EN_ADDR A:0xfd4a13dc
y.create.l HWIO_TCSR_MMSS_VENUS0_MMU_QRIB_VMID_INIT_EN_ADDR A:0xfd4a1480
y.create.l HWIO_TCSR_MMSS_VENUS0_MMU_QRIB_VMID_INIT_ADDR A:0xfd4a1484
y.create.l HWIO_TCSR_MMSS_VENUS0_MMU_QRIB_VMID_EN_ADDR A:0xfd4a1488
y.create.l HWIO_TCSR_MMSS_VENUS0_MMU_QRIB_VMID_ADDR A:0xfd4a148c
y.create.l HWIO_TCSR_MMSS_VFE_MMU_QRIB_VMID_INIT_EN_ADDR A:0xfd4a14a0
y.create.l HWIO_TCSR_MMSS_VFE_MMU_QRIB_VMID_INIT_ADDR A:0xfd4a14a4
y.create.l HWIO_TCSR_MMSS_VFE_MMU_QRIB_VMID_EN_ADDR A:0xfd4a14a8
y.create.l HWIO_TCSR_MMSS_VFE_MMU_QRIB_VMID_ADDR A:0xfd4a14ac
y.create.l HWIO_TCSR_MMSS_JPEG_MMU_QRIB_VMID_INIT_EN_ADDR A:0xfd4a14b0
y.create.l HWIO_TCSR_MMSS_JPEG_MMU_QRIB_VMID_INIT_ADDR A:0xfd4a14b4
y.create.l HWIO_TCSR_MMSS_JPEG_MMU_QRIB_VMID_EN_ADDR A:0xfd4a14b8
y.create.l HWIO_TCSR_MMSS_JPEG_MMU_QRIB_VMID_ADDR A:0xfd4a14bc
y.create.l HWIO_TCSR_MMSS_MDP_MMU_QRIB_VMID_INIT_EN_ADDR A:0xfd4a14c0
y.create.l HWIO_TCSR_MMSS_MDP_MMU_QRIB_VMID_INIT_ADDR A:0xfd4a14c4
y.create.l HWIO_TCSR_MMSS_MDP_MMU_QRIB_VMID_EN_ADDR A:0xfd4a14c8
y.create.l HWIO_TCSR_MMSS_MDP_MMU_QRIB_VMID_ADDR A:0xfd4a14cc
y.create.l HWIO_TCSR_MMSS_OXILI_MMU_QRIB_VMID_INIT_EN_ADDR A:0xfd4a14d0
y.create.l HWIO_TCSR_MMSS_OXILI_MMU_QRIB_VMID_INIT_ADDR A:0xfd4a14d4
y.create.l HWIO_TCSR_MMSS_OXILI_MMU_QRIB_VMID_EN_ADDR A:0xfd4a14d8
y.create.l HWIO_TCSR_MMSS_OXILI_MMU_QRIB_VMID_ADDR A:0xfd4a14dc
y.create.l HWIO_TCSR_MMSS_OXILICX_QRIB_XPU2_ACR_ADDR A:0xfd4a1500
y.create.l HWIO_TCSR_MMSS_OXILICX_QRIB_XPU2_VMIDEN_INIT_ADDR A:0xfd4a1504
y.create.l HWIO_TCSR_MMSS_OXILI_RBBM_QRIB_VMIDMT_INIT_ACR_INIT_ADDR A:0xfd4a1508
y.create.l HWIO_TCSR_MMSS_OXILI_RBBM_QRIB_VMIDMT_EN_ADDR A:0xfd4a150c
y.create.l HWIO_TCSR_MMSS_OXILI_VBIF_QRIB_XPU2_ACR_ADDR A:0xfd4a1510
y.create.l HWIO_TCSR_MMSS_OXILI_VBIF_QRIB_XPU2_VMIDEN_INIT_ADDR A:0xfd4a1514
y.create.l HWIO_TCSR_MMSS_OCMEM_DM_QRIB_XPU2_ACR_ADDR A:0xfd4a1600
y.create.l HWIO_TCSR_MMSS_OCMEM_DM_QRIB_XPU2_VMIDEN_INIT_ADDR A:0xfd4a1604
y.create.l HWIO_TCSR_MMSS_OCMEM_DMOCMEM_QRIB_VMIDMT_INIT_ACR_INIT_ADDR A:0xfd4a1608
y.create.l HWIO_TCSR_MMSS_OCMEM_DMOCMEM_QRIB_VMIDMT_EN_ADDR A:0xfd4a160c
y.create.l HWIO_TCSR_MMSS_OCMEM_DMSYS_QRIB_VMIDMT_INIT_ACR_INIT_ADDR A:0xfd4a1610
y.create.l HWIO_TCSR_MMSS_OCMEM_DMSYS_QRIB_VMIDMT_EN_ADDR A:0xfd4a1614
y.create.l HWIO_TCSR_MMSS_OCMEM_QRIB_XPU2_ACR_ADDR A:0xfd4a1618
y.create.l HWIO_TCSR_MMSS_OCMEM_QRIB_XPU2_VMIDEN_INIT_ADDR A:0xfd4a161c
y.create.l HWIO_TCSR_MMSS_OCMEM_OSW0_QRIB_XPU2_ACR_ADDR A:0xfd4a1620
y.create.l HWIO_TCSR_MMSS_OCMEM_OSW0_QRIB_XPU2_VMIDEN_INIT_ADDR A:0xfd4a1624
y.create.l HWIO_TCSR_MMSS_OCMEM_OSW1_QRIB_XPU2_ACR_ADDR A:0xfd4a1628
y.create.l HWIO_TCSR_MMSS_OCMEM_OSW1_QRIB_XPU2_VMIDEN_INIT_ADDR A:0xfd4a162c
y.create.l HWIO_TCSR_MMSS_OCMEM_OSWDM_QRIB_XPU2_ACR_ADDR A:0xfd4a1630
y.create.l HWIO_TCSR_MMSS_OCMEM_OSWDM_QRIB_XPU2_VMIDEN_INIT_ADDR A:0xfd4a1634
y.create.l HWIO_TCSR_MMSS_OCMEM_OSWSYS_QRIB_XPU2_ACR_ADDR A:0xfd4a1638
y.create.l HWIO_TCSR_MMSS_OCMEM_OSWSYS_QRIB_XPU2_VMIDEN_INIT_ADDR A:0xfd4a163c
y.create.l HWIO_TCSR_PHSS_USB1_HS_QRIB_XPU2_ACR_ADDR A:0xfd4a1700
y.create.l HWIO_TCSR_PHSS_USB1_HS_QRIB_XPU2_VMIDEN_INIT_ADDR A:0xfd4a1704
y.create.l HWIO_TCSR_PHSS_USB2_HSIC_QRIB_XPU2_ACR_ADDR A:0xfd4a1708
y.create.l HWIO_TCSR_PHSS_USB2_HSIC_QRIB_XPU2_VMIDEN_INIT_ADDR A:0xfd4a170c
y.create.l HWIO_TCSR_PHSS_BLSP1_QRIB_XPU2_ACR_ADDR A:0xfd4a1710
y.create.l HWIO_TCSR_PHSS_BLSP1_QRIB_XPU2_VMIDEN_INIT_ADDR A:0xfd4a1714
y.create.l HWIO_TCSR_PHSS_BLSP2_QRIB_XPU2_ACR_ADDR A:0xfd4a1718
y.create.l HWIO_TCSR_PHSS_BLSP2_QRIB_XPU2_VMIDEN_INIT_ADDR A:0xfd4a171c
y.create.l HWIO_TCSR_PHSS_TSIF_BAM_QRIB_XPU2_ACR_ADDR A:0xfd4a1720
y.create.l HWIO_TCSR_PHSS_TSIF_BAM_QRIB_XPU2_VMIDEN_INIT_ADDR A:0xfd4a1724
y.create.l HWIO_TCSR_PHSS_BAM_DMA_QRIB_XPU2_ACR_ADDR A:0xfd4a1728
y.create.l HWIO_TCSR_PHSS_BAM_DMA_QRIB_XPU2_VMIDEN_INIT_ADDR A:0xfd4a172c
y.create.l HWIO_TCSR_PHSS_USB1_HS_QRIB_VMIDMT_INIT_ACR_INIT_ADDR A:0xfd4a1730
y.create.l HWIO_TCSR_PHSS_USB1_HS_QRIB_VMIDMT_EN_ADDR A:0xfd4a1734
y.create.l HWIO_TCSR_PHSS_USB2_HSIC_QRIB_VMIDMT_INIT_ACR_INIT_ADDR A:0xfd4a1738
y.create.l HWIO_TCSR_PHSS_USB2_HSIC_QRIB_VMIDMT_EN_ADDR A:0xfd4a173c
y.create.l HWIO_TCSR_PHSS_BLSP1_QRIB_VMIDMT_INIT_ACR_INIT_ADDR A:0xfd4a1740
y.create.l HWIO_TCSR_PHSS_BLSP1_QRIB_VMIDMT_EN_ADDR A:0xfd4a1744
y.create.l HWIO_TCSR_PHSS_BLSP2_QRIB_VMIDMT_INIT_ACR_INIT_ADDR A:0xfd4a1748
y.create.l HWIO_TCSR_PHSS_BLSP2_QRIB_VMIDMT_EN_ADDR A:0xfd4a174c
y.create.l HWIO_TCSR_PHSS_TSIF_BAM_QRIB_VMIDMT_INIT_ACR_INIT_ADDR A:0xfd4a1750
y.create.l HWIO_TCSR_PHSS_TSIF_BAM_QRIB_VMIDMT_EN_ADDR A:0xfd4a1754
y.create.l HWIO_TCSR_PHSS_BAM_DMA_QRIB_VMIDMT_INIT_ACR_INIT_ADDR A:0xfd4a1758
y.create.l HWIO_TCSR_PHSS_BAM_DMA_QRIB_VMIDMT_EN_ADDR A:0xfd4a175c
y.create.l HWIO_TCSR_IPA_BAM_XPU2_QRIB_XPU2_VMIDEN_INIT_ADDR A:0xfd4a1800
y.create.l HWIO_TCSR_IPA_BAM_XPU2_QRIB_XPU2_ACR_ADDR A:0xfd4a1804
y.create.l HWIO_TCSR_IPA_BAM_QRIB_VMIDMT_INIT_ACR_INIT_ADDR A:0xfd4a1808
y.create.l HWIO_TCSR_IPA_BAM_QRIB_VMIDMT_EN_ADDR A:0xfd4a180c
y.create.l HWIO_TCSR_IPA_QRIB_VMIDMT_INIT_ACR_INIT_ADDR A:0xfd4a1810
y.create.l HWIO_TCSR_IPA_QRIB_VMIDMT_EN_ADDR A:0xfd4a1814
y.create.l HWIO_TCSR_SS_XPU2_NON_SEC_INTR0_ADDR A:0xfd4a2000
y.create.l HWIO_TCSR_SS_XPU2_NON_SEC_INTR1_ADDR A:0xfd4a2004
y.create.l HWIO_TCSR_SS_XPU2_NON_SEC_INTR2_ADDR A:0xfd4a2008
y.create.l HWIO_TCSR_SS_XPU2_NON_SEC_INTR0_ENABLE_ADDR A:0xfd4a2040
y.create.l HWIO_TCSR_SS_XPU2_NON_SEC_INTR1_ENABLE_ADDR A:0xfd4a2044
y.create.l HWIO_TCSR_SS_XPU2_NON_SEC_INTR2_ENABLE_ADDR A:0xfd4a2048
y.create.l HWIO_TCSR_SS_VMIDMT_CLIENT_NON_SEC_INTR_ADDR A:0xfd4a2010
y.create.l HWIO_TCSR_SS_MMU_CLIENT_NON_SEC_INTR_ADDR A:0xfd4a2014
y.create.l HWIO_TCSR_SS_VMIDMT_CLIENT_NON_SEC_INTR1_ADDR A:0xfd4a2018
y.create.l HWIO_TCSR_SS_VMIDMT_CLIENT_NON_SEC_INTR_ENABLE_ADDR A:0xfd4a2050
y.create.l HWIO_TCSR_SS_MMU_CLIENT_NON_SEC_INTR_ENABLE_ADDR A:0xfd4a2054
y.create.l HWIO_TCSR_SS_VMIDMT_CLIENT_NON_SEC_INTR1_ENABLE_ADDR A:0xfd4a2058
y.create.l HWIO_TCSR_SS_VMIDMT_CFG_NON_SEC_INTR_ADDR A:0xfd4a3000
y.create.l HWIO_TCSR_SS_MMU_CFG_NON_SEC_INTR_ADDR A:0xfd4a3004
y.create.l HWIO_TCSR_SS_VMIDMT_CFG_NON_SEC_INTR1_ADDR A:0xfd4a3008
y.create.l HWIO_TCSR_SS_VMIDMT_CFG_NON_SEC_INTR_ENABLE_ADDR A:0xfd4a3040
y.create.l HWIO_TCSR_SS_MMU_CFG_NON_SEC_INTR_ENABLE_ADDR A:0xfd4a3044
y.create.l HWIO_TCSR_SS_VMIDMT_CFG_NON_SEC_INTR1_ENABLE_ADDR A:0xfd4a3048
y.create.l HWIO_TCSR_SS_XPU2_SEC_INTR0_ADDR A:0xfd4a4000
y.create.l HWIO_TCSR_SS_XPU2_SEC_INTR1_ADDR A:0xfd4a4004
y.create.l HWIO_TCSR_SS_XPU2_SEC_INTR2_ADDR A:0xfd4a4008
y.create.l HWIO_TCSR_SS_XPU2_SEC_INTR0_ENABLE_ADDR A:0xfd4a4040
y.create.l HWIO_TCSR_SS_XPU2_SEC_INTR1_ENABLE_ADDR A:0xfd4a4044
y.create.l HWIO_TCSR_SS_XPU2_SEC_INTR2_ENABLE_ADDR A:0xfd4a4048
y.create.l HWIO_TCSR_SS_VMIDMT_CLIENT_SEC_INTR_ADDR A:0xfd4a4010
y.create.l HWIO_TCSR_SS_MMU_CLIENT_SEC_INTR_ADDR A:0xfd4a4014
y.create.l HWIO_TCSR_SS_VMIDMT_CLIENT_SEC_INTR1_ADDR A:0xfd4a4018
y.create.l HWIO_TCSR_SS_VMIDMT_CLIENT_SEC_INTR_ENABLE_ADDR A:0xfd4a4050
y.create.l HWIO_TCSR_SS_MMU_CLIENT_SEC_INTR_ENABLE_ADDR A:0xfd4a4054
y.create.l HWIO_TCSR_SS_VMIDMT_CLIENT_SEC_INTR1_ENABLE_ADDR A:0xfd4a4058
y.create.l HWIO_TCSR_SS_VMIDMT_CFG_SEC_INTR_ADDR A:0xfd4a5000
y.create.l HWIO_TCSR_SS_MMU_CFG_SEC_INTR_ADDR A:0xfd4a5004
y.create.l HWIO_TCSR_SS_VMIDMT_CFG_SEC_INTR1_ADDR A:0xfd4a5008
y.create.l HWIO_TCSR_SS_VMIDMT_CFG_SEC_INTR_ENABLE_ADDR A:0xfd4a5040
y.create.l HWIO_TCSR_SS_MMU_CFG_SEC_INTR_ENABLE_ADDR A:0xfd4a5044
y.create.l HWIO_TCSR_SS_VMIDMT_CFG_SEC_INTR1_ENABLE_ADDR A:0xfd4a5048
y.create.l HWIO_TCSR_SS_XPU2_MSA_INTR0_ADDR A:0xfd4a6000
y.create.l HWIO_TCSR_SS_XPU2_MSA_INTR1_ADDR A:0xfd4a6004
y.create.l HWIO_TCSR_SS_XPU2_MSA_INTR2_ADDR A:0xfd4a6008
y.create.l HWIO_TCSR_SS_XPU2_MSA_INTR0_ENABLE_ADDR A:0xfd4a6040
y.create.l HWIO_TCSR_SS_XPU2_MSA_INTR1_ENABLE_ADDR A:0xfd4a6044
y.create.l HWIO_TCSR_SS_XPU2_MSA_INTR2_ENABLE_ADDR A:0xfd4a6048
y.create.l HWIO_TCSR_SPDM_CNT_CLK_CTRL_ADDR A:0xfd4a7000
y.create.l HWIO_TCSR_SPDM_DLY_FIFO_EN_ADDR A:0xfd4a7004
y.create.l HWIO_TCSR_SPDM_STG1_MUX_SEL_ADDR A:0xfd4a7008
y.create.l HWIO_TCSR_SPDM_STG2_A_MUX_SEL_ADDR A:0xfd4a700c
y.create.l HWIO_TCSR_SPDM_STG2_B_MUX_SEL_ADDR A:0xfd4a7010
y.create.l HWIO_TCSR_SPDM_STG3_A_MUX_SEL_ADDR A:0xfd4a7014
y.create.l HWIO_TCSR_SPDM_STG3_B_MUX_SEL_ADDR A:0xfd4a7018
y.create.l HWIO_TCSR_SOC_HW_VERSION_ADDR A:0xfd4a8000
y.create.l HWIO_TCSR_TIMEOUT_INTR_PENDING_ADDR A:0xfd4a8020
y.create.l HWIO_TCSR_TIMEOUT_INTR_RPM_ENABLE_ADDR A:0xfd4a8030
y.create.l HWIO_TCSR_TIMEOUT_INTR_KPSS_ENABLE_ADDR A:0xfd4a8040
y.create.l HWIO_TCSR_TIMEOUT_INTR_LPASS_ENABLE_ADDR A:0xfd4a8050
y.create.l HWIO_TCSR_TIMEOUT_INTR_MSS_ENABLE_ADDR A:0xfd4a8060
y.create.l HWIO_TCSR_TCSR_CLK_EN_ADDR A:0xfd4a907c
y.create.l HWIO_TCSR_SYS_POWER_CTRL_ADDR A:0xfd4aa000
y.create.l HWIO_TCSR_USB_CORE_ID_ADDR A:0xfd4aa004
y.create.l HWIO_TCSR_SPARE_REG0_ADDR A:0xfd4aa044
y.create.l HWIO_TCSR_SPARE_REG1_ADDR A:0xfd4aa048
y.create.l HWIO_TCSR_PHSS_USB2_PHY_SEL_ADDR A:0xfd4ab000
y.create.l HWIO_TCSR_PHSS_ATEST_USB2_PHY_SEL_ADDR A:0xfd4ab004
y.create.l HWIO_TCSR_PHSS_TEST_BUS_SEL_ADDR A:0xfd4ab008
y.create.l HWIO_TCSR_PHSS_QDSS_HW_EVENTS_CTRL_ADDR A:0xfd4ab00c
y.create.l HWIO_TCSR_PHSS_UART_LPASS_INT_SEL_0_ADDR A:0xfd4ab040
y.create.l HWIO_TCSR_PHSS_UART_LPASS_INT_SEL_1_ADDR A:0xfd4ab050
y.create.l HWIO_TCSR_PHSS_UART_PRONTO_INT_SEL_0_ADDR A:0xfd4ab080
y.create.l HWIO_TCSR_PHSS_UART_PRONTO_INT_SEL_1_ADDR A:0xfd4ab090
y.create.l HWIO_TCSR_PHSS_UART_MSS_INT_SEL_0_ADDR A:0xfd4ab0c0
y.create.l HWIO_TCSR_PHSS_UART_MSS_INT_SEL_1_ADDR A:0xfd4ab0d0
y.create.l HWIO_TCSR_PHSS_QUP_PRONTO_INT_SEL_0_ADDR A:0xfd4ab100
y.create.l HWIO_TCSR_PHSS_QUP_PRONTO_INT_SEL_1_ADDR A:0xfd4ab110
y.create.l HWIO_TCSR_PHSS_QUP_MSS_INT_SEL_0_ADDR A:0xfd4ab140
y.create.l HWIO_TCSR_PHSS_QUP_MSS_INT_SEL_1_ADDR A:0xfd4ab150
y.create.l HWIO_TCSR_LDO_SLEEP_CTRL_ADDR A:0xfd4ac000
y.create.l HWIO_TCSR_LDO_UPDATE_STATE_CTRL_ADDR A:0xfd4ac004
y.create.l HWIO_TCSR_LDO_OBIAS_CTRL_ADDR A:0xfd4ac008
y.create.l HWIO_TCSR_LDO_VREF_CONFIG_ADDR A:0xfd4ac00c
y.create.l HWIO_TCSR_LDO_IB_CONFIG_ADDR A:0xfd4ac010
y.create.l HWIO_TCSR_LDO_BGC_CONFIG_ADDR A:0xfd4ac014
y.create.l HWIO_TCSR_LDO_VREF_CTRL_ADDR A:0xfd4ac018
y.create.l HWIO_TCSR_LDO_LD_EN_ADDR A:0xfd4ac01c
y.create.l HWIO_TCSR_LDO_LD_CTRL_ADDR A:0xfd4ac020
y.create.l HWIO_TCSR_LDO_OSC_RESETB_ADDR A:0xfd4ac024
y.create.l HWIO_TCSR_LDO_OSC_CTRL_ADDR A:0xfd4ac028
y.create.l HWIO_TCSR_LDO_DFT_EN_CTRL_ADDR A:0xfd4ac02c
y.create.l HWIO_TCSR_LDO_DFT_CTRL_ADDR A:0xfd4ac030
y.create.l HWIO_TCSR_COMPILER_VDDMSS_ACC_0_ADDR A:0xfd4ad000
y.create.l HWIO_TCSR_COMPILER_VDDMSS_ACC_1_ADDR A:0xfd4ad004
y.create.l HWIO_TCSR_CUSTOM_ACC_MHPLRRFWITHBYPASS_VDDMSS_ADDR A:0xfd4ad010
y.create.l HWIO_TCSR_CUSTOM_ACC_6PRF_VDDMSS_ADDR A:0xfd4ad014
y.create.l HWIO_TCSR_CUSTOM_ACC_8PRF_VDDMSS_ADDR A:0xfd4ad018
y.create.l HWIO_TCSR_CUSTOM_ACC_MHPLLSP127VPESP_VDDMSS_ADDR A:0xfd4ad01c
y.create.l HWIO_TCSR_CUSTOM_ACC_MHPLLSP127RPMSP_VDDMSS_ADDR A:0xfd4ad020
y.create.l HWIO_TCSR_CUSTOM_ACC_MHPLLSP127OCMEM_VDDMSS_ADDR A:0xfd4ad024
y.create.l HWIO_TCSR_CUSTOM_ACC_MHPLLSP127MEMPOOL_VDDMSS_ADDR A:0xfd4ad028
y.create.l HWIO_TCSR_CUSTOM_ACC_QFPROM_VDDMSS_ADDR A:0xfd4ad02c
y.create.l HWIO_TCSR_COMPILER_VDDCX_ACC_0_ADDR A:0xfd4ad080
y.create.l HWIO_TCSR_COMPILER_VDDCX_ACC_1_ADDR A:0xfd4ad084
y.create.l HWIO_TCSR_CUSTOM_ACC_MHPLRRFWITHBYPASS_VDDCX_ADDR A:0xfd4ad090
y.create.l HWIO_TCSR_CUSTOM_ACC_6PRF_VDDCX_ADDR A:0xfd4ad094
y.create.l HWIO_TCSR_CUSTOM_ACC_8PRF_VDDCX_ADDR A:0xfd4ad098
y.create.l HWIO_TCSR_CUSTOM_ACC_MHPLLSP127VPESP_VDDCX_ADDR A:0xfd4ad09c
y.create.l HWIO_TCSR_CUSTOM_ACC_MHPLLSP127RPMSP_VDDCX_ADDR A:0xfd4ad0a0
y.create.l HWIO_TCSR_CUSTOM_ACC_MHPLLSP127OCMEM_VDDCX_ADDR A:0xfd4ad0a4
y.create.l HWIO_TCSR_CUSTOM_ACC_MHPLLSP127MEMPOOL_VDDCX_ADDR A:0xfd4ad0a8
y.create.l HWIO_TCSR_CUSTOM_ACC_QFPROM_VDDCX_ADDR A:0xfd4ad0ac
y.create.l HWIO_TCSR_COMPILER_VDDGFX_ACC_0_ADDR A:0xfd4ad100
y.create.l HWIO_TCSR_COMPILER_VDDGFX_ACC_1_ADDR A:0xfd4ad104
y.create.l HWIO_TCSR_CUSTOM_ACC_MHPLRRFWITHBYPASS_VDDGFX_ADDR A:0xfd4ad110
y.create.l HWIO_TCSR_CUSTOM_ACC_6PRF_VDDGFX_ADDR A:0xfd4ad114
y.create.l HWIO_TCSR_CUSTOM_ACC_8PRF_VDDGFX_ADDR A:0xfd4ad118
y.create.l HWIO_TCSR_CUSTOM_ACC_MHPLLSP127VPESP_VDDGFX_ADDR A:0xfd4ad11c
y.create.l HWIO_TCSR_CUSTOM_ACC_MHPLLSP127RPMSP_VDDGFX_ADDR A:0xfd4ad120
y.create.l HWIO_TCSR_CUSTOM_ACC_MHPLLSP127OCMEM_VDDGFX_ADDR A:0xfd4ad124
y.create.l HWIO_TCSR_CUSTOM_ACC_MHPLLSP127MEMPOOL_VDDGFX_ADDR A:0xfd4ad128
y.create.l HWIO_TCSR_CUSTOM_ACC_QFPROM_VDDGFX_ADDR A:0xfd4ad12c
y.create.l HWIO_TCSR_MEM_ARRY_STBY_ADDR A:0xfd4ad180
y.create.l HWIO_TCSR_MEM_ACC_SEL_VDDCX_ADDR A:0xfd4ae000
y.create.l HWIO_TCSR_MEM_ACC_SEL_VDDGFX_ADDR A:0xfd4af000
y.create.l HWIO_TCSR_DCS_CLK_CHG_WINDOW_ADDR A:0xfd4af100
y.create.l HWIO_TCSR_DCS_MSTR_PRIORITY_ADDR A:0xfd4af104
y.create.l HWIO_TCSR_DCS_ENABLE_ADDR A:0xfd4af108
y.create.l HWIO_CRYPTO0_CRYPTO_VERSION_ADDR A:0xfd41a000
y.create.l HWIO_CRYPTO0_CRYPTO_DATA_IN0_ADDR A:0xfd41a010
y.create.l HWIO_CRYPTO0_CRYPTO_DATA_IN1_ADDR A:0xfd41a014
y.create.l HWIO_CRYPTO0_CRYPTO_DATA_IN2_ADDR A:0xfd41a018
y.create.l HWIO_CRYPTO0_CRYPTO_DATA_IN3_ADDR A:0xfd41a01c
y.create.l HWIO_CRYPTO0_CRYPTO_DATA_OUT0_ADDR A:0xfd41a020
y.create.l HWIO_CRYPTO0_CRYPTO_DATA_OUT1_ADDR A:0xfd41a024
y.create.l HWIO_CRYPTO0_CRYPTO_DATA_OUT2_ADDR A:0xfd41a028
y.create.l HWIO_CRYPTO0_CRYPTO_DATA_OUT3_ADDR A:0xfd41a02c
y.create.l HWIO_CRYPTO0_CRYPTO_STATUS_ADDR A:0xfd41a100
y.create.l HWIO_CRYPTO0_CRYPTO_STATUS2_ADDR A:0xfd41a104
y.create.l HWIO_CRYPTO0_CRYPTO_ENGINES_AVAIL_ADDR A:0xfd41a108
y.create.l HWIO_CRYPTO0_CRYPTO_FIFO_SIZES_ADDR A:0xfd41a10c
y.create.l HWIO_CRYPTO0_CRYPTO_SEG_SIZE_ADDR A:0xfd41a110
y.create.l HWIO_CRYPTO0_CRYPTO_GOPROC_ADDR A:0xfd41a120
y.create.l HWIO_CRYPTO0_CRYPTO_GOPROC_QC_KEY_ADDR A:0xfd41b000
y.create.l HWIO_CRYPTO0_CRYPTO_GOPROC_OEM_KEY_ADDR A:0xfd41c000
y.create.l HWIO_CRYPTO0_CRYPTO_ENCR_SEG_CFG_ADDR A:0xfd41a200
y.create.l HWIO_CRYPTO0_CRYPTO_ENCR_SEG_SIZE_ADDR A:0xfd41a204
y.create.l HWIO_CRYPTO0_CRYPTO_ENCR_SEG_START_ADDR A:0xfd41a208
y.create.l HWIO_CRYPTO0_CRYPTO_ENCR_KEY0_ADDR A:0xfd41d000
y.create.l HWIO_CRYPTO0_CRYPTO_ENCR_KEY1_ADDR A:0xfd41d004
y.create.l HWIO_CRYPTO0_CRYPTO_ENCR_KEY2_ADDR A:0xfd41d008
y.create.l HWIO_CRYPTO0_CRYPTO_ENCR_KEY3_ADDR A:0xfd41d00c
y.create.l HWIO_CRYPTO0_CRYPTO_ENCR_KEY4_ADDR A:0xfd41d010
y.create.l HWIO_CRYPTO0_CRYPTO_ENCR_KEY5_ADDR A:0xfd41d014
y.create.l HWIO_CRYPTO0_CRYPTO_ENCR_KEY6_ADDR A:0xfd41d018
y.create.l HWIO_CRYPTO0_CRYPTO_ENCR_KEY7_ADDR A:0xfd41d01c
y.create.l HWIO_CRYPTO0_CRYPTO_ENCR_PIPE0_KEY0_ADDR A:0xfd41e000
y.create.l HWIO_CRYPTO0_CRYPTO_ENCR_PIPE0_KEY1_ADDR A:0xfd41e004
y.create.l HWIO_CRYPTO0_CRYPTO_ENCR_PIPE0_KEY2_ADDR A:0xfd41e008
y.create.l HWIO_CRYPTO0_CRYPTO_ENCR_PIPE0_KEY3_ADDR A:0xfd41e00c
y.create.l HWIO_CRYPTO0_CRYPTO_ENCR_PIPE1_KEY0_ADDR A:0xfd41e020
y.create.l HWIO_CRYPTO0_CRYPTO_ENCR_PIPE1_KEY1_ADDR A:0xfd41e024
y.create.l HWIO_CRYPTO0_CRYPTO_ENCR_PIPE1_KEY2_ADDR A:0xfd41e028
y.create.l HWIO_CRYPTO0_CRYPTO_ENCR_PIPE1_KEY3_ADDR A:0xfd41e02c
y.create.l HWIO_CRYPTO0_CRYPTO_ENCR_PIPE2_KEY0_ADDR A:0xfd41e040
y.create.l HWIO_CRYPTO0_CRYPTO_ENCR_PIPE2_KEY1_ADDR A:0xfd41e044
y.create.l HWIO_CRYPTO0_CRYPTO_ENCR_PIPE2_KEY2_ADDR A:0xfd41e048
y.create.l HWIO_CRYPTO0_CRYPTO_ENCR_PIPE2_KEY3_ADDR A:0xfd41e04c
y.create.l HWIO_CRYPTO0_CRYPTO_ENCR_PIPE3_KEY0_ADDR A:0xfd41e060
y.create.l HWIO_CRYPTO0_CRYPTO_ENCR_PIPE3_KEY1_ADDR A:0xfd41e064
y.create.l HWIO_CRYPTO0_CRYPTO_ENCR_PIPE3_KEY2_ADDR A:0xfd41e068
y.create.l HWIO_CRYPTO0_CRYPTO_ENCR_PIPE3_KEY3_ADDR A:0xfd41e06c
y.create.l HWIO_CRYPTO0_CRYPTO_ENCR_XTS_KEY0_ADDR A:0xfd41d020
y.create.l HWIO_CRYPTO0_CRYPTO_ENCR_XTS_KEY1_ADDR A:0xfd41d024
y.create.l HWIO_CRYPTO0_CRYPTO_ENCR_XTS_KEY2_ADDR A:0xfd41d028
y.create.l HWIO_CRYPTO0_CRYPTO_ENCR_XTS_KEY3_ADDR A:0xfd41d02c
y.create.l HWIO_CRYPTO0_CRYPTO_ENCR_XTS_KEY4_ADDR A:0xfd41d030
y.create.l HWIO_CRYPTO0_CRYPTO_ENCR_XTS_KEY5_ADDR A:0xfd41d034
y.create.l HWIO_CRYPTO0_CRYPTO_ENCR_XTS_KEY6_ADDR A:0xfd41d038
y.create.l HWIO_CRYPTO0_CRYPTO_ENCR_XTS_KEY7_ADDR A:0xfd41d03c
y.create.l HWIO_CRYPTO0_CRYPTO_ENCR_PIPE0_XTS_KEY0_ADDR A:0xfd41e200
y.create.l HWIO_CRYPTO0_CRYPTO_ENCR_PIPE0_XTS_KEY1_ADDR A:0xfd41e204
y.create.l HWIO_CRYPTO0_CRYPTO_ENCR_PIPE0_XTS_KEY2_ADDR A:0xfd41e208
y.create.l HWIO_CRYPTO0_CRYPTO_ENCR_PIPE0_XTS_KEY3_ADDR A:0xfd41e20c
y.create.l HWIO_CRYPTO0_CRYPTO_ENCR_PIPE1_XTS_KEY0_ADDR A:0xfd41e220
y.create.l HWIO_CRYPTO0_CRYPTO_ENCR_PIPE1_XTS_KEY1_ADDR A:0xfd41e224
y.create.l HWIO_CRYPTO0_CRYPTO_ENCR_PIPE1_XTS_KEY2_ADDR A:0xfd41e228
y.create.l HWIO_CRYPTO0_CRYPTO_ENCR_PIPE1_XTS_KEY3_ADDR A:0xfd41e22c
y.create.l HWIO_CRYPTO0_CRYPTO_ENCR_PIPE2_XTS_KEY0_ADDR A:0xfd41e240
y.create.l HWIO_CRYPTO0_CRYPTO_ENCR_PIPE2_XTS_KEY1_ADDR A:0xfd41e244
y.create.l HWIO_CRYPTO0_CRYPTO_ENCR_PIPE2_XTS_KEY2_ADDR A:0xfd41e248
y.create.l HWIO_CRYPTO0_CRYPTO_ENCR_PIPE2_XTS_KEY3_ADDR A:0xfd41e24c
y.create.l HWIO_CRYPTO0_CRYPTO_ENCR_PIPE3_XTS_KEY0_ADDR A:0xfd41e260
y.create.l HWIO_CRYPTO0_CRYPTO_ENCR_PIPE3_XTS_KEY1_ADDR A:0xfd41e264
y.create.l HWIO_CRYPTO0_CRYPTO_ENCR_PIPE3_XTS_KEY2_ADDR A:0xfd41e268
y.create.l HWIO_CRYPTO0_CRYPTO_ENCR_PIPE3_XTS_KEY3_ADDR A:0xfd41e26c
y.create.l HWIO_CRYPTO0_CRYPTO_ENCR_CNTR0_IV0_ADDR A:0xfd41a20c
y.create.l HWIO_CRYPTO0_CRYPTO_ENCR_CNTR1_IV1_ADDR A:0xfd41a210
y.create.l HWIO_CRYPTO0_CRYPTO_ENCR_CNTR2_IV2_ADDR A:0xfd41a214
y.create.l HWIO_CRYPTO0_CRYPTO_ENCR_CNTR3_IV3_ADDR A:0xfd41a218
y.create.l HWIO_CRYPTO0_CRYPTO_ENCR_CNTR_MASK_ADDR A:0xfd41a21c
y.create.l HWIO_CRYPTO0_CRYPTO_ENCR_CCM_INIT_CNTR0_ADDR A:0xfd41a220
y.create.l HWIO_CRYPTO0_CRYPTO_ENCR_CCM_INIT_CNTR1_ADDR A:0xfd41a224
y.create.l HWIO_CRYPTO0_CRYPTO_ENCR_CCM_INIT_CNTR2_ADDR A:0xfd41a228
y.create.l HWIO_CRYPTO0_CRYPTO_ENCR_CCM_INIT_CNTR3_ADDR A:0xfd41a22c
y.create.l HWIO_CRYPTO0_CRYPTO_ENCR_XTS_DU_SIZE_ADDR A:0xfd41a230
y.create.l HWIO_CRYPTO0_CRYPTO_AUTH_SEG_CFG_ADDR A:0xfd41a300
y.create.l HWIO_CRYPTO0_CRYPTO_AUTH_SEG_SIZE_ADDR A:0xfd41a304
y.create.l HWIO_CRYPTO0_CRYPTO_AUTH_SEG_START_ADDR A:0xfd41a308
y.create.l HWIO_CRYPTO0_CRYPTO_AUTH_KEY0_ADDR A:0xfd41d040
y.create.l HWIO_CRYPTO0_CRYPTO_AUTH_KEY1_ADDR A:0xfd41d044
y.create.l HWIO_CRYPTO0_CRYPTO_AUTH_KEY2_ADDR A:0xfd41d048
y.create.l HWIO_CRYPTO0_CRYPTO_AUTH_KEY3_ADDR A:0xfd41d04c
y.create.l HWIO_CRYPTO0_CRYPTO_AUTH_KEY4_ADDR A:0xfd41d050
y.create.l HWIO_CRYPTO0_CRYPTO_AUTH_KEY5_ADDR A:0xfd41d054
y.create.l HWIO_CRYPTO0_CRYPTO_AUTH_KEY6_ADDR A:0xfd41d058
y.create.l HWIO_CRYPTO0_CRYPTO_AUTH_KEY7_ADDR A:0xfd41d05c
y.create.l HWIO_CRYPTO0_CRYPTO_AUTH_KEY8_ADDR A:0xfd41d060
y.create.l HWIO_CRYPTO0_CRYPTO_AUTH_KEY9_ADDR A:0xfd41d064
y.create.l HWIO_CRYPTO0_CRYPTO_AUTH_PIPE0_KEY0_ADDR A:0xfd41e800
y.create.l HWIO_CRYPTO0_CRYPTO_AUTH_PIPE0_KEY1_ADDR A:0xfd41e804
y.create.l HWIO_CRYPTO0_CRYPTO_AUTH_PIPE0_KEY2_ADDR A:0xfd41e808
y.create.l HWIO_CRYPTO0_CRYPTO_AUTH_PIPE0_KEY3_ADDR A:0xfd41e80c
y.create.l HWIO_CRYPTO0_CRYPTO_AUTH_PIPE1_KEY0_ADDR A:0xfd41e880
y.create.l HWIO_CRYPTO0_CRYPTO_AUTH_PIPE1_KEY1_ADDR A:0xfd41e884
y.create.l HWIO_CRYPTO0_CRYPTO_AUTH_PIPE1_KEY2_ADDR A:0xfd41e888
y.create.l HWIO_CRYPTO0_CRYPTO_AUTH_PIPE1_KEY3_ADDR A:0xfd41e88c
y.create.l HWIO_CRYPTO0_CRYPTO_AUTH_PIPE2_KEY0_ADDR A:0xfd41e900
y.create.l HWIO_CRYPTO0_CRYPTO_AUTH_PIPE2_KEY1_ADDR A:0xfd41e904
y.create.l HWIO_CRYPTO0_CRYPTO_AUTH_PIPE2_KEY2_ADDR A:0xfd41e908
y.create.l HWIO_CRYPTO0_CRYPTO_AUTH_PIPE2_KEY3_ADDR A:0xfd41e90c
y.create.l HWIO_CRYPTO0_CRYPTO_AUTH_PIPE3_KEY0_ADDR A:0xfd41e980
y.create.l HWIO_CRYPTO0_CRYPTO_AUTH_PIPE3_KEY1_ADDR A:0xfd41e984
y.create.l HWIO_CRYPTO0_CRYPTO_AUTH_PIPE3_KEY2_ADDR A:0xfd41e988
y.create.l HWIO_CRYPTO0_CRYPTO_AUTH_PIPE3_KEY3_ADDR A:0xfd41e98c
y.create.l HWIO_CRYPTO0_CRYPTO_AUTH_IV0_ADDR A:0xfd41a310
y.create.l HWIO_CRYPTO0_CRYPTO_AUTH_IV1_ADDR A:0xfd41a314
y.create.l HWIO_CRYPTO0_CRYPTO_AUTH_IV2_ADDR A:0xfd41a318
y.create.l HWIO_CRYPTO0_CRYPTO_AUTH_IV3_ADDR A:0xfd41a31c
y.create.l HWIO_CRYPTO0_CRYPTO_AUTH_IV4_ADDR A:0xfd41a320
y.create.l HWIO_CRYPTO0_CRYPTO_AUTH_IV5_ADDR A:0xfd41a324
y.create.l HWIO_CRYPTO0_CRYPTO_AUTH_IV6_ADDR A:0xfd41a328
y.create.l HWIO_CRYPTO0_CRYPTO_AUTH_IV7_ADDR A:0xfd41a32c
y.create.l HWIO_CRYPTO0_CRYPTO_AUTH_INFO_NONCE0_ADDR A:0xfd41a350
y.create.l HWIO_CRYPTO0_CRYPTO_AUTH_INFO_NONCE1_ADDR A:0xfd41a354
y.create.l HWIO_CRYPTO0_CRYPTO_AUTH_INFO_NONCE2_ADDR A:0xfd41a358
y.create.l HWIO_CRYPTO0_CRYPTO_AUTH_INFO_NONCE3_ADDR A:0xfd41a35c
y.create.l HWIO_CRYPTO0_CRYPTO_AUTH_BYTECNT0_ADDR A:0xfd41a390
y.create.l HWIO_CRYPTO0_CRYPTO_AUTH_BYTECNT1_ADDR A:0xfd41a394
y.create.l HWIO_CRYPTO0_CRYPTO_AUTH_EXP_MAC0_ADDR A:0xfd41a3a0
y.create.l HWIO_CRYPTO0_CRYPTO_AUTH_EXP_MAC1_ADDR A:0xfd41a3a4
y.create.l HWIO_CRYPTO0_CRYPTO_AUTH_EXP_MAC2_ADDR A:0xfd41a3a8
y.create.l HWIO_CRYPTO0_CRYPTO_AUTH_EXP_MAC3_ADDR A:0xfd41a3ac
y.create.l HWIO_CRYPTO0_CRYPTO_AUTH_EXP_MAC4_ADDR A:0xfd41a3b0
y.create.l HWIO_CRYPTO0_CRYPTO_AUTH_EXP_MAC5_ADDR A:0xfd41a3b4
y.create.l HWIO_CRYPTO0_CRYPTO_AUTH_EXP_MAC6_ADDR A:0xfd41a3b8
y.create.l HWIO_CRYPTO0_CRYPTO_AUTH_EXP_MAC7_ADDR A:0xfd41a3bc
y.create.l HWIO_CRYPTO0_CRYPTO_CONFIG_ADDR A:0xfd41a400
y.create.l HWIO_CRYPTO0_CRYPTO_DEBUG_ENABLE_ADDR A:0xfd41f000
y.create.l HWIO_CRYPTO0_CRYPTO_DEBUG_ADDR A:0xfd41f004
y.create.l HWIO_CRYPTO0_CRYPTO_PWR_CTRL_ADDR A:0xfd41f008
y.create.l HWIO_CRYPTO0_CRYPTO_AXI_VMIDMT_SCR0_ADDR A:0xfd419000
y.create.l HWIO_CRYPTO0_CRYPTO_AXI_VMIDMT_SCR1_ADDR A:0xfd419004
y.create.l HWIO_CRYPTO0_CRYPTO_AXI_VMIDMT_SCR2_ADDR A:0xfd419008
y.create.l HWIO_CRYPTO0_CRYPTO_AXI_VMIDMT_SACR_ADDR A:0xfd419010
y.create.l HWIO_CRYPTO0_CRYPTO_AXI_VMIDMT_SIDR0_ADDR A:0xfd419020
y.create.l HWIO_CRYPTO0_CRYPTO_AXI_VMIDMT_SIDR1_ADDR A:0xfd419024
y.create.l HWIO_CRYPTO0_CRYPTO_AXI_VMIDMT_SIDR2_ADDR A:0xfd419028
y.create.l HWIO_CRYPTO0_CRYPTO_AXI_VMIDMT_SIDR4_ADDR A:0xfd419030
y.create.l HWIO_CRYPTO0_CRYPTO_AXI_VMIDMT_SIDR5_ADDR A:0xfd419034
y.create.l HWIO_CRYPTO0_CRYPTO_AXI_VMIDMT_SIDR7_ADDR A:0xfd41903c
y.create.l HWIO_CRYPTO0_CRYPTO_AXI_VMIDMT_SGFAR0_ADDR A:0xfd419040
y.create.l HWIO_CRYPTO0_CRYPTO_AXI_VMIDMT_SGFSR_ADDR A:0xfd419048
y.create.l HWIO_CRYPTO0_CRYPTO_AXI_VMIDMT_SGFSRRESTORE_ADDR A:0xfd41904c
y.create.l HWIO_CRYPTO0_CRYPTO_AXI_VMIDMT_SGFSYNDR0_ADDR A:0xfd419050
y.create.l HWIO_CRYPTO0_CRYPTO_AXI_VMIDMT_SGFSYNDR1_ADDR A:0xfd419054
y.create.l HWIO_CRYPTO0_CRYPTO_AXI_VMIDMT_SGFSYNDR2_ADDR A:0xfd419058
y.create.l HWIO_CRYPTO0_CRYPTO_AXI_VMIDMT_VMIDMTSCR0_ADDR A:0xfd419090
y.create.l HWIO_CRYPTO0_CRYPTO_AXI_VMIDMT_CR0_ADDR A:0xfd419000
y.create.l HWIO_CRYPTO0_CRYPTO_AXI_VMIDMT_CR2_ADDR A:0xfd419008
y.create.l HWIO_CRYPTO0_CRYPTO_AXI_VMIDMT_ACR_ADDR A:0xfd419010
y.create.l HWIO_CRYPTO0_CRYPTO_AXI_VMIDMT_IDR0_ADDR A:0xfd419020
y.create.l HWIO_CRYPTO0_CRYPTO_AXI_VMIDMT_IDR1_ADDR A:0xfd419024
y.create.l HWIO_CRYPTO0_CRYPTO_AXI_VMIDMT_IDR2_ADDR A:0xfd419028
y.create.l HWIO_CRYPTO0_CRYPTO_AXI_VMIDMT_IDR4_ADDR A:0xfd419030
y.create.l HWIO_CRYPTO0_CRYPTO_AXI_VMIDMT_IDR5_ADDR A:0xfd419034
y.create.l HWIO_CRYPTO0_CRYPTO_AXI_VMIDMT_IDR7_ADDR A:0xfd41903c
y.create.l HWIO_CRYPTO0_CRYPTO_AXI_VMIDMT_GFAR0_ADDR A:0xfd419040
y.create.l HWIO_CRYPTO0_CRYPTO_AXI_VMIDMT_GFSR_ADDR A:0xfd419048
y.create.l HWIO_CRYPTO0_CRYPTO_AXI_VMIDMT_GFSRRESTORE_ADDR A:0xfd41904c
y.create.l HWIO_CRYPTO0_CRYPTO_AXI_VMIDMT_GFSYNDR0_ADDR A:0xfd419050
y.create.l HWIO_CRYPTO0_CRYPTO_AXI_VMIDMT_GFSYNDR1_ADDR A:0xfd419054
y.create.l HWIO_CRYPTO0_CRYPTO_AXI_VMIDMT_GFSYNDR2_ADDR A:0xfd419058
y.create.l HWIO_CRYPTO0_CRYPTO_AXI_VMIDMT_VMIDMTCR0_ADDR A:0xfd419090
y.create.l HWIO_CRYPTO0_CRYPTO_AXI_VMIDMT_VMIDMTACR_ADDR A:0xfd41909c
y.create.l HWIO_CRYPTO0_CRYPTO_AXI_VMIDMT_NSCR0_ADDR A:0xfd419400
y.create.l HWIO_CRYPTO0_CRYPTO_AXI_VMIDMT_NSCR2_ADDR A:0xfd419408
y.create.l HWIO_CRYPTO0_CRYPTO_AXI_VMIDMT_NSACR_ADDR A:0xfd419410
y.create.l HWIO_CRYPTO0_CRYPTO_AXI_VMIDMT_NSGFAR0_ADDR A:0xfd419440
y.create.l HWIO_CRYPTO0_CRYPTO_AXI_VMIDMT_NSGFSR_ADDR A:0xfd419448
y.create.l HWIO_CRYPTO0_CRYPTO_AXI_VMIDMT_NSGFSRRESTORE_ADDR A:0xfd41944c
y.create.l HWIO_CRYPTO0_CRYPTO_AXI_VMIDMT_NSGFSYNDR0_ADDR A:0xfd419450
y.create.l HWIO_CRYPTO0_CRYPTO_AXI_VMIDMT_NSGFSYNDR1_ADDR A:0xfd419454
y.create.l HWIO_CRYPTO0_CRYPTO_AXI_VMIDMT_NSGFSYNDR2_ADDR A:0xfd419458
y.create.l HWIO_CRYPTO0_CRYPTO_AXI_VMIDMT_NSVMIDMTCR0_ADDR A:0xfd419490
y.create.l HWIO_CRYPTO0_CRYPTO_AXI_VMIDMT_SSDR0_ADDR A:0xfd419080
y.create.l HWIO_CRYPTO0_CRYPTO_AXI_VMIDMT_MSDR0_ADDR A:0xfd419480
y.create.l HWIO_CRYPTO0_CRYPTO_AXI_VMIDMT_MCR_ADDR A:0xfd419494
y.create.l HWIO_CRYPTO0_CRYPTO_AXI_VMIDMT_S2VR0_ADDR A:0xfd419c00
y.create.l HWIO_CRYPTO0_CRYPTO_AXI_VMIDMT_S2VR1_ADDR A:0xfd419c04
y.create.l HWIO_CRYPTO0_CRYPTO_AXI_VMIDMT_S2VR2_ADDR A:0xfd419c08
y.create.l HWIO_CRYPTO0_CRYPTO_AXI_VMIDMT_S2VR3_ADDR A:0xfd419c0c
y.create.l HWIO_CRYPTO0_CRYPTO_AXI_VMIDMT_S2VR4_ADDR A:0xfd419c10
y.create.l HWIO_CRYPTO0_CRYPTO_AXI_VMIDMT_S2VR5_ADDR A:0xfd419c14
y.create.l HWIO_CRYPTO0_CRYPTO_AXI_VMIDMT_S2VR6_ADDR A:0xfd419c18
y.create.l HWIO_CRYPTO0_CRYPTO_AXI_VMIDMT_S2VR7_ADDR A:0xfd419c1c
y.create.l HWIO_CRYPTO0_CRYPTO_AXI_VMIDMT_S2VR8_ADDR A:0xfd419c20
y.create.l HWIO_CRYPTO0_CRYPTO_AXI_VMIDMT_S2VR9_ADDR A:0xfd419c24
y.create.l HWIO_CRYPTO0_CRYPTO_AXI_VMIDMT_AS2VR0_ADDR A:0xfd419e00
y.create.l HWIO_CRYPTO0_CRYPTO_AXI_VMIDMT_AS2VR1_ADDR A:0xfd419e04
y.create.l HWIO_CRYPTO0_CRYPTO_AXI_VMIDMT_AS2VR2_ADDR A:0xfd419e08
y.create.l HWIO_CRYPTO0_CRYPTO_AXI_VMIDMT_AS2VR3_ADDR A:0xfd419e0c
y.create.l HWIO_CRYPTO0_CRYPTO_AXI_VMIDMT_AS2VR4_ADDR A:0xfd419e10
y.create.l HWIO_CRYPTO0_CRYPTO_AXI_VMIDMT_AS2VR5_ADDR A:0xfd419e14
y.create.l HWIO_CRYPTO0_CRYPTO_AXI_VMIDMT_AS2VR6_ADDR A:0xfd419e18
y.create.l HWIO_CRYPTO0_CRYPTO_AXI_VMIDMT_AS2VR7_ADDR A:0xfd419e1c
y.create.l HWIO_CRYPTO0_CRYPTO_AXI_VMIDMT_AS2VR8_ADDR A:0xfd419e20
y.create.l HWIO_CRYPTO0_CRYPTO_AXI_VMIDMT_AS2VR9_ADDR A:0xfd419e24
y.create.l HWIO_CRYPTO0_CRYPTO_AXI_VMIDMT_SMR0_ADDR A:0xfd419800
y.create.l HWIO_CRYPTO0_CRYPTO_AXI_VMIDMT_SMR1_ADDR A:0xfd419804
y.create.l HWIO_CRYPTO0_CRYPTO_AXI_VMIDMT_SMR2_ADDR A:0xfd419808
y.create.l HWIO_CRYPTO0_CRYPTO_AXI_VMIDMT_SMR3_ADDR A:0xfd41980c
y.create.l HWIO_CRYPTO0_CRYPTO_AXI_VMIDMT_SMR4_ADDR A:0xfd419810
y.create.l HWIO_CRYPTO0_CRYPTO_AXI_VMIDMT_SMR5_ADDR A:0xfd419814
y.create.l HWIO_CRYPTO0_CRYPTO_AXI_VMIDMT_SMR6_ADDR A:0xfd419818
y.create.l HWIO_CRYPTO0_CRYPTO_AXI_VMIDMT_SMR7_ADDR A:0xfd41981c
y.create.l HWIO_CRYPTO0_CRYPTO_AXI_VMIDMT_SMR8_ADDR A:0xfd419820
y.create.l HWIO_CRYPTO0_CRYPTO_AXI_VMIDMT_SMR9_ADDR A:0xfd419824
y.create.l HWIO_CRYPTO0_CRYPTO_BAM_CTRL_ADDR A:0xfd404000
y.create.l HWIO_CRYPTO0_CRYPTO_BAM_REVISION_ADDR A:0xfd404004
y.create.l HWIO_CRYPTO0_CRYPTO_BAM_SW_VERSION_ADDR A:0xfd404080
y.create.l HWIO_CRYPTO0_CRYPTO_BAM_NUM_PIPES_ADDR A:0xfd40403c
y.create.l HWIO_CRYPTO0_CRYPTO_BAM_TIMER_ADDR A:0xfd404040
y.create.l HWIO_CRYPTO0_CRYPTO_BAM_TIMER_CTRL_ADDR A:0xfd404044
y.create.l HWIO_CRYPTO0_CRYPTO_BAM_DESC_CNT_TRSHLD_ADDR A:0xfd404008
y.create.l HWIO_CRYPTO0_CRYPTO_BAM_IRQ_SRCS_ADDR A:0xfd40400c
y.create.l HWIO_CRYPTO0_CRYPTO_BAM_IRQ_SRCS_MSK_ADDR A:0xfd404010
y.create.l HWIO_CRYPTO0_CRYPTO_BAM_IRQ_SRCS_UNMASKED_ADDR A:0xfd404030
y.create.l HWIO_CRYPTO0_CRYPTO_BAM_IRQ_STTS_ADDR A:0xfd404014
y.create.l HWIO_CRYPTO0_CRYPTO_BAM_IRQ_CLR_ADDR A:0xfd404018
y.create.l HWIO_CRYPTO0_CRYPTO_BAM_IRQ_EN_ADDR A:0xfd40401c
y.create.l HWIO_CRYPTO0_CRYPTO_BAM_AHB_MASTER_ERR_CTRLS_ADDR A:0xfd404024
y.create.l HWIO_CRYPTO0_CRYPTO_BAM_AHB_MASTER_ERR_ADDR_ADDR A:0xfd404028
y.create.l HWIO_CRYPTO0_CRYPTO_BAM_AHB_MASTER_ERR_DATA_ADDR A:0xfd40402c
y.create.l HWIO_CRYPTO0_CRYPTO_BAM_TRUST_REG_ADDR A:0xfd404070
y.create.l HWIO_CRYPTO0_CRYPTO_BAM_TEST_BUS_SEL_ADDR A:0xfd404074
y.create.l HWIO_CRYPTO0_CRYPTO_BAM_TEST_BUS_REG_ADDR A:0xfd404078
y.create.l HWIO_CRYPTO0_CRYPTO_BAM_CNFG_BITS_ADDR A:0xfd40407c
y.create.l HWIO_CRYPTO0_CRYPTO_BAM_IRQ_SRCS_EE0_ADDR A:0xfd404800
y.create.l HWIO_CRYPTO0_CRYPTO_BAM_IRQ_SRCS_EE1_ADDR A:0xfd404880
y.create.l HWIO_CRYPTO0_CRYPTO_BAM_IRQ_SRCS_EE2_ADDR A:0xfd404900
y.create.l HWIO_CRYPTO0_CRYPTO_BAM_IRQ_SRCS_EE3_ADDR A:0xfd404980
y.create.l HWIO_CRYPTO0_CRYPTO_BAM_IRQ_SRCS_EE4_ADDR A:0xfd404a00
y.create.l HWIO_CRYPTO0_CRYPTO_BAM_IRQ_SRCS_EE5_ADDR A:0xfd404a80
y.create.l HWIO_CRYPTO0_CRYPTO_BAM_IRQ_SRCS_EE6_ADDR A:0xfd404b00
y.create.l HWIO_CRYPTO0_CRYPTO_BAM_IRQ_SRCS_EE7_ADDR A:0xfd404b80
y.create.l HWIO_CRYPTO0_CRYPTO_BAM_IRQ_SRCS_MSK_EE0_ADDR A:0xfd404804
y.create.l HWIO_CRYPTO0_CRYPTO_BAM_IRQ_SRCS_MSK_EE1_ADDR A:0xfd404884
y.create.l HWIO_CRYPTO0_CRYPTO_BAM_IRQ_SRCS_MSK_EE2_ADDR A:0xfd404904
y.create.l HWIO_CRYPTO0_CRYPTO_BAM_IRQ_SRCS_MSK_EE3_ADDR A:0xfd404984
y.create.l HWIO_CRYPTO0_CRYPTO_BAM_IRQ_SRCS_MSK_EE4_ADDR A:0xfd404a04
y.create.l HWIO_CRYPTO0_CRYPTO_BAM_IRQ_SRCS_MSK_EE5_ADDR A:0xfd404a84
y.create.l HWIO_CRYPTO0_CRYPTO_BAM_IRQ_SRCS_MSK_EE6_ADDR A:0xfd404b04
y.create.l HWIO_CRYPTO0_CRYPTO_BAM_IRQ_SRCS_MSK_EE7_ADDR A:0xfd404b84
y.create.l HWIO_CRYPTO0_CRYPTO_BAM_IRQ_SRCS_UNMASKED_EE0_ADDR A:0xfd404808
y.create.l HWIO_CRYPTO0_CRYPTO_BAM_IRQ_SRCS_UNMASKED_EE1_ADDR A:0xfd404888
y.create.l HWIO_CRYPTO0_CRYPTO_BAM_IRQ_SRCS_UNMASKED_EE2_ADDR A:0xfd404908
y.create.l HWIO_CRYPTO0_CRYPTO_BAM_IRQ_SRCS_UNMASKED_EE3_ADDR A:0xfd404988
y.create.l HWIO_CRYPTO0_CRYPTO_BAM_IRQ_SRCS_UNMASKED_EE4_ADDR A:0xfd404a08
y.create.l HWIO_CRYPTO0_CRYPTO_BAM_IRQ_SRCS_UNMASKED_EE5_ADDR A:0xfd404a88
y.create.l HWIO_CRYPTO0_CRYPTO_BAM_IRQ_SRCS_UNMASKED_EE6_ADDR A:0xfd404b08
y.create.l HWIO_CRYPTO0_CRYPTO_BAM_IRQ_SRCS_UNMASKED_EE7_ADDR A:0xfd404b88
y.create.l HWIO_CRYPTO0_CRYPTO_BAM_P_CTRL0_ADDR A:0xfd405000
y.create.l HWIO_CRYPTO0_CRYPTO_BAM_P_CTRL1_ADDR A:0xfd406000
y.create.l HWIO_CRYPTO0_CRYPTO_BAM_P_CTRL2_ADDR A:0xfd407000
y.create.l HWIO_CRYPTO0_CRYPTO_BAM_P_CTRL3_ADDR A:0xfd408000
y.create.l HWIO_CRYPTO0_CRYPTO_BAM_P_CTRL4_ADDR A:0xfd409000
y.create.l HWIO_CRYPTO0_CRYPTO_BAM_P_CTRL5_ADDR A:0xfd40a000
y.create.l HWIO_CRYPTO0_CRYPTO_BAM_P_CTRL6_ADDR A:0xfd40b000
y.create.l HWIO_CRYPTO0_CRYPTO_BAM_P_CTRL7_ADDR A:0xfd40c000
y.create.l HWIO_CRYPTO0_CRYPTO_BAM_P_RST0_ADDR A:0xfd405004
y.create.l HWIO_CRYPTO0_CRYPTO_BAM_P_RST1_ADDR A:0xfd406004
y.create.l HWIO_CRYPTO0_CRYPTO_BAM_P_RST2_ADDR A:0xfd407004
y.create.l HWIO_CRYPTO0_CRYPTO_BAM_P_RST3_ADDR A:0xfd408004
y.create.l HWIO_CRYPTO0_CRYPTO_BAM_P_RST4_ADDR A:0xfd409004
y.create.l HWIO_CRYPTO0_CRYPTO_BAM_P_RST5_ADDR A:0xfd40a004
y.create.l HWIO_CRYPTO0_CRYPTO_BAM_P_RST6_ADDR A:0xfd40b004
y.create.l HWIO_CRYPTO0_CRYPTO_BAM_P_RST7_ADDR A:0xfd40c004
y.create.l HWIO_CRYPTO0_CRYPTO_BAM_P_HALT0_ADDR A:0xfd405008
y.create.l HWIO_CRYPTO0_CRYPTO_BAM_P_HALT1_ADDR A:0xfd406008
y.create.l HWIO_CRYPTO0_CRYPTO_BAM_P_HALT2_ADDR A:0xfd407008
y.create.l HWIO_CRYPTO0_CRYPTO_BAM_P_HALT3_ADDR A:0xfd408008
y.create.l HWIO_CRYPTO0_CRYPTO_BAM_P_HALT4_ADDR A:0xfd409008
y.create.l HWIO_CRYPTO0_CRYPTO_BAM_P_HALT5_ADDR A:0xfd40a008
y.create.l HWIO_CRYPTO0_CRYPTO_BAM_P_HALT6_ADDR A:0xfd40b008
y.create.l HWIO_CRYPTO0_CRYPTO_BAM_P_HALT7_ADDR A:0xfd40c008
y.create.l HWIO_CRYPTO0_CRYPTO_BAM_P_TRUST_REG0_ADDR A:0xfd405030
y.create.l HWIO_CRYPTO0_CRYPTO_BAM_P_TRUST_REG1_ADDR A:0xfd406030
y.create.l HWIO_CRYPTO0_CRYPTO_BAM_P_TRUST_REG2_ADDR A:0xfd407030
y.create.l HWIO_CRYPTO0_CRYPTO_BAM_P_TRUST_REG3_ADDR A:0xfd408030
y.create.l HWIO_CRYPTO0_CRYPTO_BAM_P_TRUST_REG4_ADDR A:0xfd409030
y.create.l HWIO_CRYPTO0_CRYPTO_BAM_P_TRUST_REG5_ADDR A:0xfd40a030
y.create.l HWIO_CRYPTO0_CRYPTO_BAM_P_TRUST_REG6_ADDR A:0xfd40b030
y.create.l HWIO_CRYPTO0_CRYPTO_BAM_P_TRUST_REG7_ADDR A:0xfd40c030
y.create.l HWIO_CRYPTO0_CRYPTO_BAM_P_IRQ_STTS0_ADDR A:0xfd405010
y.create.l HWIO_CRYPTO0_CRYPTO_BAM_P_IRQ_STTS1_ADDR A:0xfd406010
y.create.l HWIO_CRYPTO0_CRYPTO_BAM_P_IRQ_STTS2_ADDR A:0xfd407010
y.create.l HWIO_CRYPTO0_CRYPTO_BAM_P_IRQ_STTS3_ADDR A:0xfd408010
y.create.l HWIO_CRYPTO0_CRYPTO_BAM_P_IRQ_STTS4_ADDR A:0xfd409010
y.create.l HWIO_CRYPTO0_CRYPTO_BAM_P_IRQ_STTS5_ADDR A:0xfd40a010
y.create.l HWIO_CRYPTO0_CRYPTO_BAM_P_IRQ_STTS6_ADDR A:0xfd40b010
y.create.l HWIO_CRYPTO0_CRYPTO_BAM_P_IRQ_STTS7_ADDR A:0xfd40c010
y.create.l HWIO_CRYPTO0_CRYPTO_BAM_P_IRQ_CLR0_ADDR A:0xfd405014
y.create.l HWIO_CRYPTO0_CRYPTO_BAM_P_IRQ_CLR1_ADDR A:0xfd406014
y.create.l HWIO_CRYPTO0_CRYPTO_BAM_P_IRQ_CLR2_ADDR A:0xfd407014
y.create.l HWIO_CRYPTO0_CRYPTO_BAM_P_IRQ_CLR3_ADDR A:0xfd408014
y.create.l HWIO_CRYPTO0_CRYPTO_BAM_P_IRQ_CLR4_ADDR A:0xfd409014
y.create.l HWIO_CRYPTO0_CRYPTO_BAM_P_IRQ_CLR5_ADDR A:0xfd40a014
y.create.l HWIO_CRYPTO0_CRYPTO_BAM_P_IRQ_CLR6_ADDR A:0xfd40b014
y.create.l HWIO_CRYPTO0_CRYPTO_BAM_P_IRQ_CLR7_ADDR A:0xfd40c014
y.create.l HWIO_CRYPTO0_CRYPTO_BAM_P_IRQ_EN0_ADDR A:0xfd405018
y.create.l HWIO_CRYPTO0_CRYPTO_BAM_P_IRQ_EN1_ADDR A:0xfd406018
y.create.l HWIO_CRYPTO0_CRYPTO_BAM_P_IRQ_EN2_ADDR A:0xfd407018
y.create.l HWIO_CRYPTO0_CRYPTO_BAM_P_IRQ_EN3_ADDR A:0xfd408018
y.create.l HWIO_CRYPTO0_CRYPTO_BAM_P_IRQ_EN4_ADDR A:0xfd409018
y.create.l HWIO_CRYPTO0_CRYPTO_BAM_P_IRQ_EN5_ADDR A:0xfd40a018
y.create.l HWIO_CRYPTO0_CRYPTO_BAM_P_IRQ_EN6_ADDR A:0xfd40b018
y.create.l HWIO_CRYPTO0_CRYPTO_BAM_P_IRQ_EN7_ADDR A:0xfd40c018
y.create.l HWIO_CRYPTO0_CRYPTO_BAM_P_TIMER0_ADDR A:0xfd40501c
y.create.l HWIO_CRYPTO0_CRYPTO_BAM_P_TIMER1_ADDR A:0xfd40601c
y.create.l HWIO_CRYPTO0_CRYPTO_BAM_P_TIMER2_ADDR A:0xfd40701c
y.create.l HWIO_CRYPTO0_CRYPTO_BAM_P_TIMER3_ADDR A:0xfd40801c
y.create.l HWIO_CRYPTO0_CRYPTO_BAM_P_TIMER4_ADDR A:0xfd40901c
y.create.l HWIO_CRYPTO0_CRYPTO_BAM_P_TIMER5_ADDR A:0xfd40a01c
y.create.l HWIO_CRYPTO0_CRYPTO_BAM_P_TIMER6_ADDR A:0xfd40b01c
y.create.l HWIO_CRYPTO0_CRYPTO_BAM_P_TIMER7_ADDR A:0xfd40c01c
y.create.l HWIO_CRYPTO0_CRYPTO_BAM_P_TIMER_CTRL0_ADDR A:0xfd405020
y.create.l HWIO_CRYPTO0_CRYPTO_BAM_P_TIMER_CTRL1_ADDR A:0xfd406020
y.create.l HWIO_CRYPTO0_CRYPTO_BAM_P_TIMER_CTRL2_ADDR A:0xfd407020
y.create.l HWIO_CRYPTO0_CRYPTO_BAM_P_TIMER_CTRL3_ADDR A:0xfd408020
y.create.l HWIO_CRYPTO0_CRYPTO_BAM_P_TIMER_CTRL4_ADDR A:0xfd409020
y.create.l HWIO_CRYPTO0_CRYPTO_BAM_P_TIMER_CTRL5_ADDR A:0xfd40a020
y.create.l HWIO_CRYPTO0_CRYPTO_BAM_P_TIMER_CTRL6_ADDR A:0xfd40b020
y.create.l HWIO_CRYPTO0_CRYPTO_BAM_P_TIMER_CTRL7_ADDR A:0xfd40c020
y.create.l HWIO_CRYPTO0_CRYPTO_BAM_P_PRDCR_SDBND0_ADDR A:0xfd405024
y.create.l HWIO_CRYPTO0_CRYPTO_BAM_P_PRDCR_SDBND1_ADDR A:0xfd406024
y.create.l HWIO_CRYPTO0_CRYPTO_BAM_P_PRDCR_SDBND2_ADDR A:0xfd407024
y.create.l HWIO_CRYPTO0_CRYPTO_BAM_P_PRDCR_SDBND3_ADDR A:0xfd408024
y.create.l HWIO_CRYPTO0_CRYPTO_BAM_P_PRDCR_SDBND4_ADDR A:0xfd409024
y.create.l HWIO_CRYPTO0_CRYPTO_BAM_P_PRDCR_SDBND5_ADDR A:0xfd40a024
y.create.l HWIO_CRYPTO0_CRYPTO_BAM_P_PRDCR_SDBND6_ADDR A:0xfd40b024
y.create.l HWIO_CRYPTO0_CRYPTO_BAM_P_PRDCR_SDBND7_ADDR A:0xfd40c024
y.create.l HWIO_CRYPTO0_CRYPTO_BAM_P_CNSMR_SDBND0_ADDR A:0xfd405028
y.create.l HWIO_CRYPTO0_CRYPTO_BAM_P_CNSMR_SDBND1_ADDR A:0xfd406028
y.create.l HWIO_CRYPTO0_CRYPTO_BAM_P_CNSMR_SDBND2_ADDR A:0xfd407028
y.create.l HWIO_CRYPTO0_CRYPTO_BAM_P_CNSMR_SDBND3_ADDR A:0xfd408028
y.create.l HWIO_CRYPTO0_CRYPTO_BAM_P_CNSMR_SDBND4_ADDR A:0xfd409028
y.create.l HWIO_CRYPTO0_CRYPTO_BAM_P_CNSMR_SDBND5_ADDR A:0xfd40a028
y.create.l HWIO_CRYPTO0_CRYPTO_BAM_P_CNSMR_SDBND6_ADDR A:0xfd40b028
y.create.l HWIO_CRYPTO0_CRYPTO_BAM_P_CNSMR_SDBND7_ADDR A:0xfd40c028
y.create.l HWIO_CRYPTO0_CRYPTO_BAM_P_EVNT_DEST_ADDR0_ADDR A:0xfd40582c
y.create.l HWIO_CRYPTO0_CRYPTO_BAM_P_EVNT_DEST_ADDR1_ADDR A:0xfd40682c
y.create.l HWIO_CRYPTO0_CRYPTO_BAM_P_EVNT_DEST_ADDR2_ADDR A:0xfd40782c
y.create.l HWIO_CRYPTO0_CRYPTO_BAM_P_EVNT_DEST_ADDR3_ADDR A:0xfd40882c
y.create.l HWIO_CRYPTO0_CRYPTO_BAM_P_EVNT_DEST_ADDR4_ADDR A:0xfd40982c
y.create.l HWIO_CRYPTO0_CRYPTO_BAM_P_EVNT_DEST_ADDR5_ADDR A:0xfd40a82c
y.create.l HWIO_CRYPTO0_CRYPTO_BAM_P_EVNT_DEST_ADDR6_ADDR A:0xfd40b82c
y.create.l HWIO_CRYPTO0_CRYPTO_BAM_P_EVNT_DEST_ADDR7_ADDR A:0xfd40c82c
y.create.l HWIO_CRYPTO0_CRYPTO_BAM_P_EVNT_REG0_ADDR A:0xfd405818
y.create.l HWIO_CRYPTO0_CRYPTO_BAM_P_EVNT_REG1_ADDR A:0xfd406818
y.create.l HWIO_CRYPTO0_CRYPTO_BAM_P_EVNT_REG2_ADDR A:0xfd407818
y.create.l HWIO_CRYPTO0_CRYPTO_BAM_P_EVNT_REG3_ADDR A:0xfd408818
y.create.l HWIO_CRYPTO0_CRYPTO_BAM_P_EVNT_REG4_ADDR A:0xfd409818
y.create.l HWIO_CRYPTO0_CRYPTO_BAM_P_EVNT_REG5_ADDR A:0xfd40a818
y.create.l HWIO_CRYPTO0_CRYPTO_BAM_P_EVNT_REG6_ADDR A:0xfd40b818
y.create.l HWIO_CRYPTO0_CRYPTO_BAM_P_EVNT_REG7_ADDR A:0xfd40c818
y.create.l HWIO_CRYPTO0_CRYPTO_BAM_P_SW_OFSTS0_ADDR A:0xfd405800
y.create.l HWIO_CRYPTO0_CRYPTO_BAM_P_SW_OFSTS1_ADDR A:0xfd406800
y.create.l HWIO_CRYPTO0_CRYPTO_BAM_P_SW_OFSTS2_ADDR A:0xfd407800
y.create.l HWIO_CRYPTO0_CRYPTO_BAM_P_SW_OFSTS3_ADDR A:0xfd408800
y.create.l HWIO_CRYPTO0_CRYPTO_BAM_P_SW_OFSTS4_ADDR A:0xfd409800
y.create.l HWIO_CRYPTO0_CRYPTO_BAM_P_SW_OFSTS5_ADDR A:0xfd40a800
y.create.l HWIO_CRYPTO0_CRYPTO_BAM_P_SW_OFSTS6_ADDR A:0xfd40b800
y.create.l HWIO_CRYPTO0_CRYPTO_BAM_P_SW_OFSTS7_ADDR A:0xfd40c800
y.create.l HWIO_CRYPTO0_CRYPTO_BAM_P_DATA_FIFO_ADDR0_ADDR A:0xfd405824
y.create.l HWIO_CRYPTO0_CRYPTO_BAM_P_DATA_FIFO_ADDR1_ADDR A:0xfd406824
y.create.l HWIO_CRYPTO0_CRYPTO_BAM_P_DATA_FIFO_ADDR2_ADDR A:0xfd407824
y.create.l HWIO_CRYPTO0_CRYPTO_BAM_P_DATA_FIFO_ADDR3_ADDR A:0xfd408824
y.create.l HWIO_CRYPTO0_CRYPTO_BAM_P_DATA_FIFO_ADDR4_ADDR A:0xfd409824
y.create.l HWIO_CRYPTO0_CRYPTO_BAM_P_DATA_FIFO_ADDR5_ADDR A:0xfd40a824
y.create.l HWIO_CRYPTO0_CRYPTO_BAM_P_DATA_FIFO_ADDR6_ADDR A:0xfd40b824
y.create.l HWIO_CRYPTO0_CRYPTO_BAM_P_DATA_FIFO_ADDR7_ADDR A:0xfd40c824
y.create.l HWIO_CRYPTO0_CRYPTO_BAM_P_DESC_FIFO_ADDR0_ADDR A:0xfd40581c
y.create.l HWIO_CRYPTO0_CRYPTO_BAM_P_DESC_FIFO_ADDR1_ADDR A:0xfd40681c
y.create.l HWIO_CRYPTO0_CRYPTO_BAM_P_DESC_FIFO_ADDR2_ADDR A:0xfd40781c
y.create.l HWIO_CRYPTO0_CRYPTO_BAM_P_DESC_FIFO_ADDR3_ADDR A:0xfd40881c
y.create.l HWIO_CRYPTO0_CRYPTO_BAM_P_DESC_FIFO_ADDR4_ADDR A:0xfd40981c
y.create.l HWIO_CRYPTO0_CRYPTO_BAM_P_DESC_FIFO_ADDR5_ADDR A:0xfd40a81c
y.create.l HWIO_CRYPTO0_CRYPTO_BAM_P_DESC_FIFO_ADDR6_ADDR A:0xfd40b81c
y.create.l HWIO_CRYPTO0_CRYPTO_BAM_P_DESC_FIFO_ADDR7_ADDR A:0xfd40c81c
y.create.l HWIO_CRYPTO0_CRYPTO_BAM_P_EVNT_GEN_TRSHLD0_ADDR A:0xfd405828
y.create.l HWIO_CRYPTO0_CRYPTO_BAM_P_EVNT_GEN_TRSHLD1_ADDR A:0xfd406828
y.create.l HWIO_CRYPTO0_CRYPTO_BAM_P_EVNT_GEN_TRSHLD2_ADDR A:0xfd407828
y.create.l HWIO_CRYPTO0_CRYPTO_BAM_P_EVNT_GEN_TRSHLD3_ADDR A:0xfd408828
y.create.l HWIO_CRYPTO0_CRYPTO_BAM_P_EVNT_GEN_TRSHLD4_ADDR A:0xfd409828
y.create.l HWIO_CRYPTO0_CRYPTO_BAM_P_EVNT_GEN_TRSHLD5_ADDR A:0xfd40a828
y.create.l HWIO_CRYPTO0_CRYPTO_BAM_P_EVNT_GEN_TRSHLD6_ADDR A:0xfd40b828
y.create.l HWIO_CRYPTO0_CRYPTO_BAM_P_EVNT_GEN_TRSHLD7_ADDR A:0xfd40c828
y.create.l HWIO_CRYPTO0_CRYPTO_BAM_P_FIFO_SIZES0_ADDR A:0xfd405820
y.create.l HWIO_CRYPTO0_CRYPTO_BAM_P_FIFO_SIZES1_ADDR A:0xfd406820
y.create.l HWIO_CRYPTO0_CRYPTO_BAM_P_FIFO_SIZES2_ADDR A:0xfd407820
y.create.l HWIO_CRYPTO0_CRYPTO_BAM_P_FIFO_SIZES3_ADDR A:0xfd408820
y.create.l HWIO_CRYPTO0_CRYPTO_BAM_P_FIFO_SIZES4_ADDR A:0xfd409820
y.create.l HWIO_CRYPTO0_CRYPTO_BAM_P_FIFO_SIZES5_ADDR A:0xfd40a820
y.create.l HWIO_CRYPTO0_CRYPTO_BAM_P_FIFO_SIZES6_ADDR A:0xfd40b820
y.create.l HWIO_CRYPTO0_CRYPTO_BAM_P_FIFO_SIZES7_ADDR A:0xfd40c820
y.create.l HWIO_CRYPTO0_CRYPTO_BAM_P_RETR_CNTXT_0_ADDR A:0xfd405834
y.create.l HWIO_CRYPTO0_CRYPTO_BAM_P_RETR_CNTXT_1_ADDR A:0xfd406834
y.create.l HWIO_CRYPTO0_CRYPTO_BAM_P_RETR_CNTXT_2_ADDR A:0xfd407834
y.create.l HWIO_CRYPTO0_CRYPTO_BAM_P_RETR_CNTXT_3_ADDR A:0xfd408834
y.create.l HWIO_CRYPTO0_CRYPTO_BAM_P_RETR_CNTXT_4_ADDR A:0xfd409834
y.create.l HWIO_CRYPTO0_CRYPTO_BAM_P_RETR_CNTXT_5_ADDR A:0xfd40a834
y.create.l HWIO_CRYPTO0_CRYPTO_BAM_P_RETR_CNTXT_6_ADDR A:0xfd40b834
y.create.l HWIO_CRYPTO0_CRYPTO_BAM_P_RETR_CNTXT_7_ADDR A:0xfd40c834
y.create.l HWIO_CRYPTO0_CRYPTO_BAM_P_SI_CNTXT_0_ADDR A:0xfd405838
y.create.l HWIO_CRYPTO0_CRYPTO_BAM_P_SI_CNTXT_1_ADDR A:0xfd406838
y.create.l HWIO_CRYPTO0_CRYPTO_BAM_P_SI_CNTXT_2_ADDR A:0xfd407838
y.create.l HWIO_CRYPTO0_CRYPTO_BAM_P_SI_CNTXT_3_ADDR A:0xfd408838
y.create.l HWIO_CRYPTO0_CRYPTO_BAM_P_SI_CNTXT_4_ADDR A:0xfd409838
y.create.l HWIO_CRYPTO0_CRYPTO_BAM_P_SI_CNTXT_5_ADDR A:0xfd40a838
y.create.l HWIO_CRYPTO0_CRYPTO_BAM_P_SI_CNTXT_6_ADDR A:0xfd40b838
y.create.l HWIO_CRYPTO0_CRYPTO_BAM_P_SI_CNTXT_7_ADDR A:0xfd40c838
y.create.l HWIO_CRYPTO0_CRYPTO_BAM_P_DF_CNTXT_0_ADDR A:0xfd405830
y.create.l HWIO_CRYPTO0_CRYPTO_BAM_P_DF_CNTXT_1_ADDR A:0xfd406830
y.create.l HWIO_CRYPTO0_CRYPTO_BAM_P_DF_CNTXT_2_ADDR A:0xfd407830
y.create.l HWIO_CRYPTO0_CRYPTO_BAM_P_DF_CNTXT_3_ADDR A:0xfd408830
y.create.l HWIO_CRYPTO0_CRYPTO_BAM_P_DF_CNTXT_4_ADDR A:0xfd409830
y.create.l HWIO_CRYPTO0_CRYPTO_BAM_P_DF_CNTXT_5_ADDR A:0xfd40a830
y.create.l HWIO_CRYPTO0_CRYPTO_BAM_P_DF_CNTXT_6_ADDR A:0xfd40b830
y.create.l HWIO_CRYPTO0_CRYPTO_BAM_P_DF_CNTXT_7_ADDR A:0xfd40c830
y.create.l HWIO_CRYPTO0_CRYPTO_BAM_P_AU_PSM_CNTXT_1_0_ADDR A:0xfd405804
y.create.l HWIO_CRYPTO0_CRYPTO_BAM_P_AU_PSM_CNTXT_1_1_ADDR A:0xfd406804
y.create.l HWIO_CRYPTO0_CRYPTO_BAM_P_AU_PSM_CNTXT_1_2_ADDR A:0xfd407804
y.create.l HWIO_CRYPTO0_CRYPTO_BAM_P_AU_PSM_CNTXT_1_3_ADDR A:0xfd408804
y.create.l HWIO_CRYPTO0_CRYPTO_BAM_P_AU_PSM_CNTXT_1_4_ADDR A:0xfd409804
y.create.l HWIO_CRYPTO0_CRYPTO_BAM_P_AU_PSM_CNTXT_1_5_ADDR A:0xfd40a804
y.create.l HWIO_CRYPTO0_CRYPTO_BAM_P_AU_PSM_CNTXT_1_6_ADDR A:0xfd40b804
y.create.l HWIO_CRYPTO0_CRYPTO_BAM_P_AU_PSM_CNTXT_1_7_ADDR A:0xfd40c804
y.create.l HWIO_CRYPTO0_CRYPTO_BAM_P_PSM_CNTXT_2_0_ADDR A:0xfd405808
y.create.l HWIO_CRYPTO0_CRYPTO_BAM_P_PSM_CNTXT_2_1_ADDR A:0xfd406808
y.create.l HWIO_CRYPTO0_CRYPTO_BAM_P_PSM_CNTXT_2_2_ADDR A:0xfd407808
y.create.l HWIO_CRYPTO0_CRYPTO_BAM_P_PSM_CNTXT_2_3_ADDR A:0xfd408808
y.create.l HWIO_CRYPTO0_CRYPTO_BAM_P_PSM_CNTXT_2_4_ADDR A:0xfd409808
y.create.l HWIO_CRYPTO0_CRYPTO_BAM_P_PSM_CNTXT_2_5_ADDR A:0xfd40a808
y.create.l HWIO_CRYPTO0_CRYPTO_BAM_P_PSM_CNTXT_2_6_ADDR A:0xfd40b808
y.create.l HWIO_CRYPTO0_CRYPTO_BAM_P_PSM_CNTXT_2_7_ADDR A:0xfd40c808
y.create.l HWIO_CRYPTO0_CRYPTO_BAM_P_PSM_CNTXT_3_0_ADDR A:0xfd40580c
y.create.l HWIO_CRYPTO0_CRYPTO_BAM_P_PSM_CNTXT_3_1_ADDR A:0xfd40680c
y.create.l HWIO_CRYPTO0_CRYPTO_BAM_P_PSM_CNTXT_3_2_ADDR A:0xfd40780c
y.create.l HWIO_CRYPTO0_CRYPTO_BAM_P_PSM_CNTXT_3_3_ADDR A:0xfd40880c
y.create.l HWIO_CRYPTO0_CRYPTO_BAM_P_PSM_CNTXT_3_4_ADDR A:0xfd40980c
y.create.l HWIO_CRYPTO0_CRYPTO_BAM_P_PSM_CNTXT_3_5_ADDR A:0xfd40a80c
y.create.l HWIO_CRYPTO0_CRYPTO_BAM_P_PSM_CNTXT_3_6_ADDR A:0xfd40b80c
y.create.l HWIO_CRYPTO0_CRYPTO_BAM_P_PSM_CNTXT_3_7_ADDR A:0xfd40c80c
y.create.l HWIO_CRYPTO0_CRYPTO_BAM_P_PSM_CNTXT_4_0_ADDR A:0xfd405810
y.create.l HWIO_CRYPTO0_CRYPTO_BAM_P_PSM_CNTXT_4_1_ADDR A:0xfd406810
y.create.l HWIO_CRYPTO0_CRYPTO_BAM_P_PSM_CNTXT_4_2_ADDR A:0xfd407810
y.create.l HWIO_CRYPTO0_CRYPTO_BAM_P_PSM_CNTXT_4_3_ADDR A:0xfd408810
y.create.l HWIO_CRYPTO0_CRYPTO_BAM_P_PSM_CNTXT_4_4_ADDR A:0xfd409810
y.create.l HWIO_CRYPTO0_CRYPTO_BAM_P_PSM_CNTXT_4_5_ADDR A:0xfd40a810
y.create.l HWIO_CRYPTO0_CRYPTO_BAM_P_PSM_CNTXT_4_6_ADDR A:0xfd40b810
y.create.l HWIO_CRYPTO0_CRYPTO_BAM_P_PSM_CNTXT_4_7_ADDR A:0xfd40c810
y.create.l HWIO_CRYPTO0_CRYPTO_BAM_P_PSM_CNTXT_5_0_ADDR A:0xfd405814
y.create.l HWIO_CRYPTO0_CRYPTO_BAM_P_PSM_CNTXT_5_1_ADDR A:0xfd406814
y.create.l HWIO_CRYPTO0_CRYPTO_BAM_P_PSM_CNTXT_5_2_ADDR A:0xfd407814
y.create.l HWIO_CRYPTO0_CRYPTO_BAM_P_PSM_CNTXT_5_3_ADDR A:0xfd408814
y.create.l HWIO_CRYPTO0_CRYPTO_BAM_P_PSM_CNTXT_5_4_ADDR A:0xfd409814
y.create.l HWIO_CRYPTO0_CRYPTO_BAM_P_PSM_CNTXT_5_5_ADDR A:0xfd40a814
y.create.l HWIO_CRYPTO0_CRYPTO_BAM_P_PSM_CNTXT_5_6_ADDR A:0xfd40b814
y.create.l HWIO_CRYPTO0_CRYPTO_BAM_P_PSM_CNTXT_5_7_ADDR A:0xfd40c814
y.create.l HWIO_CRYPTO0_CRYPTO_BAM_XPU_SCR_ADDR A:0xfd402000
y.create.l HWIO_CRYPTO0_CRYPTO_BAM_XPU_SWDR_ADDR A:0xfd402004
y.create.l HWIO_CRYPTO0_CRYPTO_BAM_XPU_SEAR0_ADDR A:0xfd402040
y.create.l HWIO_CRYPTO0_CRYPTO_BAM_XPU_SESR_ADDR A:0xfd402048
y.create.l HWIO_CRYPTO0_CRYPTO_BAM_XPU_SESRRESTORE_ADDR A:0xfd40204c
y.create.l HWIO_CRYPTO0_CRYPTO_BAM_XPU_SESYNR0_ADDR A:0xfd402050
y.create.l HWIO_CRYPTO0_CRYPTO_BAM_XPU_SESYNR1_ADDR A:0xfd402054
y.create.l HWIO_CRYPTO0_CRYPTO_BAM_XPU_SESYNR2_ADDR A:0xfd402058
y.create.l HWIO_CRYPTO0_CRYPTO_BAM_XPU_MCR_ADDR A:0xfd402100
y.create.l HWIO_CRYPTO0_CRYPTO_BAM_XPU_MEAR0_ADDR A:0xfd402140
y.create.l HWIO_CRYPTO0_CRYPTO_BAM_XPU_MESR_ADDR A:0xfd402148
y.create.l HWIO_CRYPTO0_CRYPTO_BAM_XPU_MESRRESTORE_ADDR A:0xfd40214c
y.create.l HWIO_CRYPTO0_CRYPTO_BAM_XPU_MESYNR0_ADDR A:0xfd402150
y.create.l HWIO_CRYPTO0_CRYPTO_BAM_XPU_MESYNR1_ADDR A:0xfd402154
y.create.l HWIO_CRYPTO0_CRYPTO_BAM_XPU_MESYNR2_ADDR A:0xfd402158
y.create.l HWIO_CRYPTO0_CRYPTO_BAM_XPU_CR_ADDR A:0xfd402080
y.create.l HWIO_CRYPTO0_CRYPTO_BAM_XPU_RPU_ACR0_ADDR A:0xfd4020a0
y.create.l HWIO_CRYPTO0_CRYPTO_BAM_XPU_EAR0_ADDR A:0xfd4020c0
y.create.l HWIO_CRYPTO0_CRYPTO_BAM_XPU_ESR_ADDR A:0xfd4020c8
y.create.l HWIO_CRYPTO0_CRYPTO_BAM_XPU_ESRRESTORE_ADDR A:0xfd4020cc
y.create.l HWIO_CRYPTO0_CRYPTO_BAM_XPU_ESYNR0_ADDR A:0xfd4020d0
y.create.l HWIO_CRYPTO0_CRYPTO_BAM_XPU_ESYNR1_ADDR A:0xfd4020d4
y.create.l HWIO_CRYPTO0_CRYPTO_BAM_XPU_ESYNR2_ADDR A:0xfd4020d8
y.create.l HWIO_CRYPTO0_CRYPTO_BAM_XPU_IDR0_ADDR A:0xfd402074
y.create.l HWIO_CRYPTO0_CRYPTO_BAM_XPU_IDR1_ADDR A:0xfd402078
y.create.l HWIO_CRYPTO0_CRYPTO_BAM_XPU_REV_ADDR A:0xfd40207c
y.create.l HWIO_CRYPTO0_CRYPTO_BAM_XPU_RG0_RACR0_ADDR A:0xfd402200
y.create.l HWIO_CRYPTO0_CRYPTO_BAM_XPU_RG1_RACR0_ADDR A:0xfd402280
y.create.l HWIO_CRYPTO0_CRYPTO_BAM_XPU_RG2_RACR0_ADDR A:0xfd402300
y.create.l HWIO_CRYPTO0_CRYPTO_BAM_XPU_RG3_RACR0_ADDR A:0xfd402380
y.create.l HWIO_CRYPTO0_CRYPTO_BAM_XPU_RG4_RACR0_ADDR A:0xfd402400
y.create.l HWIO_CRYPTO0_CRYPTO_BAM_XPU_RG5_RACR0_ADDR A:0xfd402480
y.create.l HWIO_CRYPTO0_CRYPTO_BAM_XPU_RG6_RACR0_ADDR A:0xfd402500
y.create.l HWIO_CRYPTO0_CRYPTO_BAM_XPU_RG7_RACR0_ADDR A:0xfd402580
y.create.l HWIO_CRYPTO0_CRYPTO_BAM_XPU_RG8_RACR0_ADDR A:0xfd402600
y.create.l HWIO_CRYPTO0_CRYPTO_BAM_XPU_RG9_RACR0_ADDR A:0xfd402680
y.create.l HWIO_CRYPTO0_CRYPTO_BAM_XPU_RG0_SCR_ADDR A:0xfd402250
y.create.l HWIO_CRYPTO0_CRYPTO_BAM_XPU_RG1_SCR_ADDR A:0xfd4022d0
y.create.l HWIO_CRYPTO0_CRYPTO_BAM_XPU_RG2_SCR_ADDR A:0xfd402350
y.create.l HWIO_CRYPTO0_CRYPTO_BAM_XPU_RG3_SCR_ADDR A:0xfd4023d0
y.create.l HWIO_CRYPTO0_CRYPTO_BAM_XPU_RG4_SCR_ADDR A:0xfd402450
y.create.l HWIO_CRYPTO0_CRYPTO_BAM_XPU_RG5_SCR_ADDR A:0xfd4024d0
y.create.l HWIO_CRYPTO0_CRYPTO_BAM_XPU_RG6_SCR_ADDR A:0xfd402550
y.create.l HWIO_CRYPTO0_CRYPTO_BAM_XPU_RG7_SCR_ADDR A:0xfd4025d0
y.create.l HWIO_CRYPTO0_CRYPTO_BAM_XPU_RG8_SCR_ADDR A:0xfd402650
y.create.l HWIO_CRYPTO0_CRYPTO_BAM_XPU_RG9_SCR_ADDR A:0xfd4026d0
y.create.l HWIO_CRYPTO0_CRYPTO_BAM_XPU_RG0_MCR_ADDR A:0xfd402254
y.create.l HWIO_CRYPTO0_CRYPTO_BAM_XPU_RG1_MCR_ADDR A:0xfd4022d4
y.create.l HWIO_CRYPTO0_CRYPTO_BAM_XPU_RG2_MCR_ADDR A:0xfd402354
y.create.l HWIO_CRYPTO0_CRYPTO_BAM_XPU_RG3_MCR_ADDR A:0xfd4023d4
y.create.l HWIO_CRYPTO0_CRYPTO_BAM_XPU_RG4_MCR_ADDR A:0xfd402454
y.create.l HWIO_CRYPTO0_CRYPTO_BAM_XPU_RG5_MCR_ADDR A:0xfd4024d4
y.create.l HWIO_CRYPTO0_CRYPTO_BAM_XPU_RG6_MCR_ADDR A:0xfd402554
y.create.l HWIO_CRYPTO0_CRYPTO_BAM_XPU_RG7_MCR_ADDR A:0xfd4025d4
y.create.l HWIO_CRYPTO0_CRYPTO_BAM_XPU_RG8_MCR_ADDR A:0xfd402654
y.create.l HWIO_CRYPTO0_CRYPTO_BAM_XPU_RG9_MCR_ADDR A:0xfd4026d4
y.create.l HWIO_CRYPTO0_CRYPTO_BAM_VMIDMT_SCR0_ADDR A:0xfd400000
y.create.l HWIO_CRYPTO0_CRYPTO_BAM_VMIDMT_SCR1_ADDR A:0xfd400004
y.create.l HWIO_CRYPTO0_CRYPTO_BAM_VMIDMT_SCR2_ADDR A:0xfd400008
y.create.l HWIO_CRYPTO0_CRYPTO_BAM_VMIDMT_SACR_ADDR A:0xfd400010
y.create.l HWIO_CRYPTO0_CRYPTO_BAM_VMIDMT_SIDR0_ADDR A:0xfd400020
y.create.l HWIO_CRYPTO0_CRYPTO_BAM_VMIDMT_SIDR1_ADDR A:0xfd400024
y.create.l HWIO_CRYPTO0_CRYPTO_BAM_VMIDMT_SIDR2_ADDR A:0xfd400028
y.create.l HWIO_CRYPTO0_CRYPTO_BAM_VMIDMT_SIDR4_ADDR A:0xfd400030
y.create.l HWIO_CRYPTO0_CRYPTO_BAM_VMIDMT_SIDR5_ADDR A:0xfd400034
y.create.l HWIO_CRYPTO0_CRYPTO_BAM_VMIDMT_SIDR7_ADDR A:0xfd40003c
y.create.l HWIO_CRYPTO0_CRYPTO_BAM_VMIDMT_SGFAR0_ADDR A:0xfd400040
y.create.l HWIO_CRYPTO0_CRYPTO_BAM_VMIDMT_SGFSR_ADDR A:0xfd400048
y.create.l HWIO_CRYPTO0_CRYPTO_BAM_VMIDMT_SGFSRRESTORE_ADDR A:0xfd40004c
y.create.l HWIO_CRYPTO0_CRYPTO_BAM_VMIDMT_SGFSYNDR0_ADDR A:0xfd400050
y.create.l HWIO_CRYPTO0_CRYPTO_BAM_VMIDMT_SGFSYNDR1_ADDR A:0xfd400054
y.create.l HWIO_CRYPTO0_CRYPTO_BAM_VMIDMT_SGFSYNDR2_ADDR A:0xfd400058
y.create.l HWIO_CRYPTO0_CRYPTO_BAM_VMIDMT_VMIDMTSCR0_ADDR A:0xfd400090
y.create.l HWIO_CRYPTO0_CRYPTO_BAM_VMIDMT_CR0_ADDR A:0xfd400000
y.create.l HWIO_CRYPTO0_CRYPTO_BAM_VMIDMT_CR2_ADDR A:0xfd400008
y.create.l HWIO_CRYPTO0_CRYPTO_BAM_VMIDMT_ACR_ADDR A:0xfd400010
y.create.l HWIO_CRYPTO0_CRYPTO_BAM_VMIDMT_IDR0_ADDR A:0xfd400020
y.create.l HWIO_CRYPTO0_CRYPTO_BAM_VMIDMT_IDR1_ADDR A:0xfd400024
y.create.l HWIO_CRYPTO0_CRYPTO_BAM_VMIDMT_IDR2_ADDR A:0xfd400028
y.create.l HWIO_CRYPTO0_CRYPTO_BAM_VMIDMT_IDR4_ADDR A:0xfd400030
y.create.l HWIO_CRYPTO0_CRYPTO_BAM_VMIDMT_IDR5_ADDR A:0xfd400034
y.create.l HWIO_CRYPTO0_CRYPTO_BAM_VMIDMT_IDR7_ADDR A:0xfd40003c
y.create.l HWIO_CRYPTO0_CRYPTO_BAM_VMIDMT_GFAR0_ADDR A:0xfd400040
y.create.l HWIO_CRYPTO0_CRYPTO_BAM_VMIDMT_GFSR_ADDR A:0xfd400048
y.create.l HWIO_CRYPTO0_CRYPTO_BAM_VMIDMT_GFSRRESTORE_ADDR A:0xfd40004c
y.create.l HWIO_CRYPTO0_CRYPTO_BAM_VMIDMT_GFSYNDR0_ADDR A:0xfd400050
y.create.l HWIO_CRYPTO0_CRYPTO_BAM_VMIDMT_GFSYNDR1_ADDR A:0xfd400054
y.create.l HWIO_CRYPTO0_CRYPTO_BAM_VMIDMT_GFSYNDR2_ADDR A:0xfd400058
y.create.l HWIO_CRYPTO0_CRYPTO_BAM_VMIDMT_VMIDMTCR0_ADDR A:0xfd400090
y.create.l HWIO_CRYPTO0_CRYPTO_BAM_VMIDMT_VMIDMTACR_ADDR A:0xfd40009c
y.create.l HWIO_CRYPTO0_CRYPTO_BAM_VMIDMT_NSCR0_ADDR A:0xfd400400
y.create.l HWIO_CRYPTO0_CRYPTO_BAM_VMIDMT_NSCR2_ADDR A:0xfd400408
y.create.l HWIO_CRYPTO0_CRYPTO_BAM_VMIDMT_NSACR_ADDR A:0xfd400410
y.create.l HWIO_CRYPTO0_CRYPTO_BAM_VMIDMT_NSGFAR0_ADDR A:0xfd400440
y.create.l HWIO_CRYPTO0_CRYPTO_BAM_VMIDMT_NSGFSR_ADDR A:0xfd400448
y.create.l HWIO_CRYPTO0_CRYPTO_BAM_VMIDMT_NSGFSRRESTORE_ADDR A:0xfd40044c
y.create.l HWIO_CRYPTO0_CRYPTO_BAM_VMIDMT_NSGFSYNDR0_ADDR A:0xfd400450
y.create.l HWIO_CRYPTO0_CRYPTO_BAM_VMIDMT_NSGFSYNDR1_ADDR A:0xfd400454
y.create.l HWIO_CRYPTO0_CRYPTO_BAM_VMIDMT_NSGFSYNDR2_ADDR A:0xfd400458
y.create.l HWIO_CRYPTO0_CRYPTO_BAM_VMIDMT_NSVMIDMTCR0_ADDR A:0xfd400490
y.create.l HWIO_CRYPTO0_CRYPTO_BAM_VMIDMT_SSDR0_ADDR A:0xfd400080
y.create.l HWIO_CRYPTO0_CRYPTO_BAM_VMIDMT_MSDR0_ADDR A:0xfd400480
y.create.l HWIO_CRYPTO0_CRYPTO_BAM_VMIDMT_MCR_ADDR A:0xfd400494
y.create.l HWIO_CRYPTO0_CRYPTO_BAM_VMIDMT_S2VR0_ADDR A:0xfd400c00
y.create.l HWIO_CRYPTO0_CRYPTO_BAM_VMIDMT_S2VR1_ADDR A:0xfd400c04
y.create.l HWIO_CRYPTO0_CRYPTO_BAM_VMIDMT_S2VR2_ADDR A:0xfd400c08
y.create.l HWIO_CRYPTO0_CRYPTO_BAM_VMIDMT_S2VR3_ADDR A:0xfd400c0c
y.create.l HWIO_CRYPTO0_CRYPTO_BAM_VMIDMT_S2VR4_ADDR A:0xfd400c10
y.create.l HWIO_CRYPTO0_CRYPTO_BAM_VMIDMT_S2VR5_ADDR A:0xfd400c14
y.create.l HWIO_CRYPTO0_CRYPTO_BAM_VMIDMT_S2VR6_ADDR A:0xfd400c18
y.create.l HWIO_CRYPTO0_CRYPTO_BAM_VMIDMT_S2VR7_ADDR A:0xfd400c1c
y.create.l HWIO_CRYPTO0_CRYPTO_BAM_VMIDMT_S2VR8_ADDR A:0xfd400c20
y.create.l HWIO_CRYPTO0_CRYPTO_BAM_VMIDMT_AS2VR0_ADDR A:0xfd400e00
y.create.l HWIO_CRYPTO0_CRYPTO_BAM_VMIDMT_AS2VR1_ADDR A:0xfd400e04
y.create.l HWIO_CRYPTO0_CRYPTO_BAM_VMIDMT_AS2VR2_ADDR A:0xfd400e08
y.create.l HWIO_CRYPTO0_CRYPTO_BAM_VMIDMT_AS2VR3_ADDR A:0xfd400e0c
y.create.l HWIO_CRYPTO0_CRYPTO_BAM_VMIDMT_AS2VR4_ADDR A:0xfd400e10
y.create.l HWIO_CRYPTO0_CRYPTO_BAM_VMIDMT_AS2VR5_ADDR A:0xfd400e14
y.create.l HWIO_CRYPTO0_CRYPTO_BAM_VMIDMT_AS2VR6_ADDR A:0xfd400e18
y.create.l HWIO_CRYPTO0_CRYPTO_BAM_VMIDMT_AS2VR7_ADDR A:0xfd400e1c
y.create.l HWIO_CRYPTO0_CRYPTO_BAM_VMIDMT_AS2VR8_ADDR A:0xfd400e20
y.create.l HWIO_CRYPTO0_CRYPTO_BAM_VMIDMT_SMR0_ADDR A:0xfd400800
y.create.l HWIO_CRYPTO0_CRYPTO_BAM_VMIDMT_SMR1_ADDR A:0xfd400804
y.create.l HWIO_CRYPTO0_CRYPTO_BAM_VMIDMT_SMR2_ADDR A:0xfd400808
y.create.l HWIO_CRYPTO0_CRYPTO_BAM_VMIDMT_SMR3_ADDR A:0xfd40080c
y.create.l HWIO_CRYPTO0_CRYPTO_BAM_VMIDMT_SMR4_ADDR A:0xfd400810
y.create.l HWIO_CRYPTO0_CRYPTO_BAM_VMIDMT_SMR5_ADDR A:0xfd400814
y.create.l HWIO_CRYPTO0_CRYPTO_BAM_VMIDMT_SMR6_ADDR A:0xfd400818
y.create.l HWIO_CRYPTO0_CRYPTO_BAM_VMIDMT_SMR7_ADDR A:0xfd40081c
y.create.l HWIO_CRYPTO0_CRYPTO_BAM_VMIDMT_SMR8_ADDR A:0xfd400820
y.create.l HWIO_DEHR_BIMC_DEHR_HW_VERSION_ADDR A:0xfc49a000
y.create.l HWIO_DEHR_BIMC_DEHR_HW_INFO_ADDR A:0xfc49a004
y.create.l HWIO_DEHR_BIMC_DEHR_CGC_CFG_ADDR A:0xfc49a010
y.create.l HWIO_DEHR_BIMC_DEHR_SEC_CFG_ADDR A:0xfc49a100
y.create.l HWIO_DEHR_BIMC_DEHR_RAM_CFG_ADDR A:0xfc49a140
y.create.l HWIO_DEHR_BIMC_DEHR_DMA_STATUS_ADDR A:0xfc49a200
y.create.l HWIO_DEHR_BIMC_DEHR_DBG_CFG_ADDR A:0xfc49a400
y.create.l HWIO_DEHR_BIMC_DEHR_SW_DMA_CFG_ADDR A:0xfc49a404
y.create.l HWIO_DEHR_BIMC_DEHR_DBG_ADDR_ADDR A:0xfc49a408
y.create.l HWIO_DEHR_XPU_SCR_ADDR A:0xfc498000
y.create.l HWIO_DEHR_XPU_SWDR_ADDR A:0xfc498004
y.create.l HWIO_DEHR_XPU_SEAR0_ADDR A:0xfc498040
y.create.l HWIO_DEHR_XPU_SESR_ADDR A:0xfc498048
y.create.l HWIO_DEHR_XPU_SESRRESTORE_ADDR A:0xfc49804c
y.create.l HWIO_DEHR_XPU_SESYNR0_ADDR A:0xfc498050
y.create.l HWIO_DEHR_XPU_SESYNR1_ADDR A:0xfc498054
y.create.l HWIO_DEHR_XPU_SESYNR2_ADDR A:0xfc498058
y.create.l HWIO_DEHR_XPU_MCR_ADDR A:0xfc498100
y.create.l HWIO_DEHR_XPU_MEAR0_ADDR A:0xfc498140
y.create.l HWIO_DEHR_XPU_MESR_ADDR A:0xfc498148
y.create.l HWIO_DEHR_XPU_MESRRESTORE_ADDR A:0xfc49814c
y.create.l HWIO_DEHR_XPU_MESYNR0_ADDR A:0xfc498150
y.create.l HWIO_DEHR_XPU_MESYNR1_ADDR A:0xfc498154
y.create.l HWIO_DEHR_XPU_MESYNR2_ADDR A:0xfc498158
y.create.l HWIO_DEHR_XPU_CR_ADDR A:0xfc498080
y.create.l HWIO_DEHR_XPU_RPU_ACR0_ADDR A:0xfc4980a0
y.create.l HWIO_DEHR_XPU_EAR0_ADDR A:0xfc4980c0
y.create.l HWIO_DEHR_XPU_ESR_ADDR A:0xfc4980c8
y.create.l HWIO_DEHR_XPU_ESRRESTORE_ADDR A:0xfc4980cc
y.create.l HWIO_DEHR_XPU_ESYNR0_ADDR A:0xfc4980d0
y.create.l HWIO_DEHR_XPU_ESYNR1_ADDR A:0xfc4980d4
y.create.l HWIO_DEHR_XPU_ESYNR2_ADDR A:0xfc4980d8
y.create.l HWIO_DEHR_XPU_IDR0_ADDR A:0xfc498074
y.create.l HWIO_DEHR_XPU_IDR1_ADDR A:0xfc498078
y.create.l HWIO_DEHR_XPU_REV_ADDR A:0xfc49807c
y.create.l HWIO_DEHR_XPU_RG0_RACR0_ADDR A:0xfc498200
y.create.l HWIO_DEHR_XPU_RG1_RACR0_ADDR A:0xfc498280
y.create.l HWIO_DEHR_XPU_RG0_SCR_ADDR A:0xfc498250
y.create.l HWIO_DEHR_XPU_RG1_SCR_ADDR A:0xfc4982d0
y.create.l HWIO_DEHR_XPU_RG0_MCR_ADDR A:0xfc498254
y.create.l HWIO_DEHR_XPU_RG1_MCR_ADDR A:0xfc4982d4
y.create.l HWIO_DEHR_VMIDMT_SCR0_ADDR A:0xfc499000
y.create.l HWIO_DEHR_VMIDMT_SCR1_ADDR A:0xfc499004
y.create.l HWIO_DEHR_VMIDMT_SCR2_ADDR A:0xfc499008
y.create.l HWIO_DEHR_VMIDMT_SACR_ADDR A:0xfc499010
y.create.l HWIO_DEHR_VMIDMT_SIDR0_ADDR A:0xfc499020
y.create.l HWIO_DEHR_VMIDMT_SIDR1_ADDR A:0xfc499024
y.create.l HWIO_DEHR_VMIDMT_SIDR2_ADDR A:0xfc499028
y.create.l HWIO_DEHR_VMIDMT_SIDR4_ADDR A:0xfc499030
y.create.l HWIO_DEHR_VMIDMT_SIDR5_ADDR A:0xfc499034
y.create.l HWIO_DEHR_VMIDMT_SIDR7_ADDR A:0xfc49903c
y.create.l HWIO_DEHR_VMIDMT_SGFAR0_ADDR A:0xfc499040
y.create.l HWIO_DEHR_VMIDMT_SGFSR_ADDR A:0xfc499048
y.create.l HWIO_DEHR_VMIDMT_SGFSRRESTORE_ADDR A:0xfc49904c
y.create.l HWIO_DEHR_VMIDMT_SGFSYNDR0_ADDR A:0xfc499050
y.create.l HWIO_DEHR_VMIDMT_SGFSYNDR1_ADDR A:0xfc499054
y.create.l HWIO_DEHR_VMIDMT_SGFSYNDR2_ADDR A:0xfc499058
y.create.l HWIO_DEHR_VMIDMT_VMIDMTSCR0_ADDR A:0xfc499090
y.create.l HWIO_DEHR_VMIDMT_CR0_ADDR A:0xfc499000
y.create.l HWIO_DEHR_VMIDMT_CR2_ADDR A:0xfc499008
y.create.l HWIO_DEHR_VMIDMT_ACR_ADDR A:0xfc499010
y.create.l HWIO_DEHR_VMIDMT_IDR0_ADDR A:0xfc499020
y.create.l HWIO_DEHR_VMIDMT_IDR1_ADDR A:0xfc499024
y.create.l HWIO_DEHR_VMIDMT_IDR2_ADDR A:0xfc499028
y.create.l HWIO_DEHR_VMIDMT_IDR4_ADDR A:0xfc499030
y.create.l HWIO_DEHR_VMIDMT_IDR5_ADDR A:0xfc499034
y.create.l HWIO_DEHR_VMIDMT_IDR7_ADDR A:0xfc49903c
y.create.l HWIO_DEHR_VMIDMT_GFAR0_ADDR A:0xfc499040
y.create.l HWIO_DEHR_VMIDMT_GFSR_ADDR A:0xfc499048
y.create.l HWIO_DEHR_VMIDMT_GFSRRESTORE_ADDR A:0xfc49904c
y.create.l HWIO_DEHR_VMIDMT_GFSYNDR0_ADDR A:0xfc499050
y.create.l HWIO_DEHR_VMIDMT_GFSYNDR1_ADDR A:0xfc499054
y.create.l HWIO_DEHR_VMIDMT_GFSYNDR2_ADDR A:0xfc499058
y.create.l HWIO_DEHR_VMIDMT_VMIDMTCR0_ADDR A:0xfc499090
y.create.l HWIO_DEHR_VMIDMT_VMIDMTACR_ADDR A:0xfc49909c
y.create.l HWIO_DEHR_VMIDMT_NSCR0_ADDR A:0xfc499400
y.create.l HWIO_DEHR_VMIDMT_NSCR2_ADDR A:0xfc499408
y.create.l HWIO_DEHR_VMIDMT_NSACR_ADDR A:0xfc499410
y.create.l HWIO_DEHR_VMIDMT_NSGFAR0_ADDR A:0xfc499440
y.create.l HWIO_DEHR_VMIDMT_NSGFSR_ADDR A:0xfc499448
y.create.l HWIO_DEHR_VMIDMT_NSGFSRRESTORE_ADDR A:0xfc49944c
y.create.l HWIO_DEHR_VMIDMT_NSGFSYNDR0_ADDR A:0xfc499450
y.create.l HWIO_DEHR_VMIDMT_NSGFSYNDR1_ADDR A:0xfc499454
y.create.l HWIO_DEHR_VMIDMT_NSGFSYNDR2_ADDR A:0xfc499458
y.create.l HWIO_DEHR_VMIDMT_NSVMIDMTCR0_ADDR A:0xfc499490
y.create.l HWIO_DEHR_VMIDMT_SSDR0_ADDR A:0xfc499080
y.create.l HWIO_DEHR_VMIDMT_MSDR0_ADDR A:0xfc499480
y.create.l HWIO_DEHR_VMIDMT_MCR_ADDR A:0xfc499494
y.create.l HWIO_DEHR_VMIDMT_S2VR0_ADDR A:0xfc499c00
y.create.l HWIO_DEHR_VMIDMT_AS2VR0_ADDR A:0xfc499e00
y.create.l HWIO_DIM_C00_DIM_CA_TOP_CFG_ADDR A:0xfc4e0000
y.create.l HWIO_DIM_C00_DIM_CA_HW_INFO_ADDR A:0xfc4e0004
y.create.l HWIO_DIM_C00_DIM_CA_HW_VERSION_ADDR A:0xfc4e0008
y.create.l HWIO_DIM_C00_DIM_CA_PAD_CFG0_ADDR A:0xfc4e0010
y.create.l HWIO_DIM_C00_DIM_CA_PAD_CFG1_ADDR A:0xfc4e0014
y.create.l HWIO_DIM_C00_DIM_CA_PAD_CFG2_ADDR A:0xfc4e0018
y.create.l HWIO_DIM_C00_DIM_CA_PAD_CFG3_ADDR A:0xfc4e001c
y.create.l HWIO_DIM_C00_DIM_CA_PAD_CFG4_ADDR A:0xfc4e0020
y.create.l HWIO_DIM_C00_DDRPHY_CA_MISR_CFG_ADDR A:0xfc4e0024
y.create.l HWIO_DIM_C00_DDRPHY_CA_MISR_EVEN_STATUS_ADDR A:0xfc4e0028
y.create.l HWIO_DIM_C00_DDRPHY_CA_MISR_ODD_STATUS_ADDR A:0xfc4e002c
y.create.l HWIO_DIM_C00_DIM_CA_CDC_CTLR_CFG0_ADDR A:0xfc4e0030
y.create.l HWIO_DIM_C00_DIM_CA_CDC_CTLR_CFG1_ADDR A:0xfc4e0034
y.create.l HWIO_DIM_C00_DIM_CA_CDC_CAL_TIMER_CFG0_ADDR A:0xfc4e0038
y.create.l HWIO_DIM_C00_DIM_CA_CDC_CAL_TIMER_CFG1_ADDR A:0xfc4e003c
y.create.l HWIO_DIM_C00_DIM_CA_CDC_REFCOUNT_CFG_ADDR A:0xfc4e0040
y.create.l HWIO_DIM_C00_DIM_CA_CDC_COARSE_CAL_CFG_ADDR A:0xfc4e0044
y.create.l HWIO_DIM_C00_DIM_CA_CDC_RSVD_CFG_ADDR A:0xfc4e0048
y.create.l HWIO_DIM_C00_DIM_CA_CDC_OFFSET_CFG_ADDR A:0xfc4e004c
y.create.l HWIO_DIM_C00_DIM_CA_CDC_DELAY_CFG_ADDR A:0xfc4e0050
y.create.l HWIO_DIM_C00_DIM_CA_CDC_SW_MODE_CFG_ADDR A:0xfc4e0054
y.create.l HWIO_DIM_C00_DIM_CA_CDC_TEST_CFG_ADDR A:0xfc4e0058
y.create.l HWIO_DIM_C00_DIM_CA_CDC_SW_OVRD_CFG_ADDR A:0xfc4e005c
y.create.l HWIO_DIM_C00_DIM_CA_CDC_STATUS0_ADDR A:0xfc4e0070
y.create.l HWIO_DIM_C00_DIM_CA_CDC_STATUS1_ADDR A:0xfc4e0074
y.create.l HWIO_DIM_C00_DIM_CA_CDC_STATUS2_ADDR A:0xfc4e0078
y.create.l HWIO_DIM_C00_DIM_CA_CDC_STATUS3_ADDR A:0xfc4e007c
y.create.l HWIO_DIM_C00_DIM_CA_IOC_CTLR_CFG_ADDR A:0xfc4e00e0
y.create.l HWIO_DIM_C00_DIM_CA_IOC_CTLR_PNCNT_CFG_ADDR A:0xfc4e00e4
y.create.l HWIO_DIM_C00_DIM_CA_IOC_CTLR_TIMER_CFG_ADDR A:0xfc4e00e8
y.create.l HWIO_DIM_C00_DIM_CA_IOC_CTLR_TIMER_STATUS_ADDR A:0xfc4e00ec
y.create.l HWIO_DIM_C00_DIM_CA_IOC_CTLR_CHAR_CFG_ADDR A:0xfc4e00f0
y.create.l HWIO_DIM_C00_DIM_CA_IOC_CTLR_STATUS_ADDR A:0xfc4e00f4
y.create.l HWIO_DIM_C00_DIM_CA_CA_IOC_SLV_CFG_ADDR A:0xfc4e0100
y.create.l HWIO_DIM_C00_DIM_CA_CA_IOC_SLV_STATUS_ADDR A:0xfc4e0104
y.create.l HWIO_DIM_C00_DIM_CA_CK_IOC_SLV_CFG_ADDR A:0xfc4e0110
y.create.l HWIO_DIM_C00_DIM_CA_CK_IOC_SLV_STATUS_ADDR A:0xfc4e0114
y.create.l HWIO_DIM_D00_DIM_DQ_TOP_CFG_ADDR A:0xfc4e0800
y.create.l HWIO_DIM_D00_DIM_DQ_HW_INFO_ADDR A:0xfc4e0804
y.create.l HWIO_DIM_D00_DIM_DQ_HW_VERSION_ADDR A:0xfc4e0808
y.create.l HWIO_DIM_D00_DIM_DQ_PAD_CFG0_ADDR A:0xfc4e0810
y.create.l HWIO_DIM_D00_DIM_DQ_PAD_CFG1_ADDR A:0xfc4e0814
y.create.l HWIO_DIM_D00_DIM_DQ_PAD_CFG2_ADDR A:0xfc4e0818
y.create.l HWIO_DIM_D00_DIM_DQ_PAD_CFG3_ADDR A:0xfc4e0820
y.create.l HWIO_DIM_D00_DIM_DQ_PAD_CFG4_ADDR A:0xfc4e0824
y.create.l HWIO_DIM_D00_DDRPHY_DQ_MISR_CFG_ADDR A:0xfc4e080c
y.create.l HWIO_DIM_D00_DDRPHY_DQ_MISR_EVEN_STATUS_ADDR A:0xfc4e0828
y.create.l HWIO_DIM_D00_DDRPHY_DQ_MISR_ODD_STATUS_ADDR A:0xfc4e082c
y.create.l HWIO_DIM_D00_DIM_DQ_CDC_CTLR_CFG0_ADDR A:0xfc4e0830
y.create.l HWIO_DIM_D00_DIM_DQ_CDC_CTLR_CFG1_ADDR A:0xfc4e0834
y.create.l HWIO_DIM_D00_DIM_DQ_CDC_CAL_TIMER_CFG0_ADDR A:0xfc4e0838
y.create.l HWIO_DIM_D00_DIM_DQ_CDC_CAL_TIMER_CFG1_ADDR A:0xfc4e083c
y.create.l HWIO_DIM_D00_DIM_DQ_CDC_REFCOUNT_CFG_ADDR A:0xfc4e0840
y.create.l HWIO_DIM_D00_DIM_DQ_CDC_COARSE_CAL_CFG_ADDR A:0xfc4e0844
y.create.l HWIO_DIM_D00_DIM_DQ_CDC_RSVD_CFG_ADDR A:0xfc4e0848
y.create.l HWIO_DIM_D00_DIM_DQ_RD_CDC_OFFSET_CFG_ADDR A:0xfc4e084c
y.create.l HWIO_DIM_D00_DIM_DQ_RD_CDC_DELAY_CFG_ADDR A:0xfc4e0850
y.create.l HWIO_DIM_D00_DIM_DQ_RD_CDC_SW_MODE_CFG_ADDR A:0xfc4e0854
y.create.l HWIO_DIM_D00_DIM_DQ_RD_CDC_TEST_CFG_ADDR A:0xfc4e0858
y.create.l HWIO_DIM_D00_DIM_DQ_RD_CDC_SW_OVRD_CFG_ADDR A:0xfc4e085c
y.create.l HWIO_DIM_D00_DIM_DQ_RD_CDC_SLAVE_DDA_CFG_ADDR A:0xfc4e0860
y.create.l HWIO_DIM_D00_DIM_DQ_RD_CDC_STATUS0_ADDR A:0xfc4e0870
y.create.l HWIO_DIM_D00_DIM_DQ_RD_CDC_STATUS1_ADDR A:0xfc4e0874
y.create.l HWIO_DIM_D00_DIM_DQ_RD_CDC_STATUS2_ADDR A:0xfc4e0878
y.create.l HWIO_DIM_D00_DIM_DQ_RD_CDC_STATUS3_ADDR A:0xfc4e087c
y.create.l HWIO_DIM_D00_DIM_DQ_RD_CDC_STATUS4_ADDR A:0xfc4e0880
y.create.l HWIO_DIM_D00_DIM_DQ_WR_CDC_OFFSET_CFG_ADDR A:0xfc4e08ac
y.create.l HWIO_DIM_D00_DIM_DQ_WR_CDC_DELAY_CFG_ADDR A:0xfc4e08b0
y.create.l HWIO_DIM_D00_DIM_DQ_WR_CDC_SW_MODE_CFG_ADDR A:0xfc4e08b4
y.create.l HWIO_DIM_D00_DIM_DQ_WR_CDC_TEST_CFG_ADDR A:0xfc4e08b8
y.create.l HWIO_DIM_D00_DIM_DQ_WR_CDC_SW_OVRD_CFG_ADDR A:0xfc4e08bc
y.create.l HWIO_DIM_D00_DIM_DQ_WR_CDC_STATUS0_ADDR A:0xfc4e08d0
y.create.l HWIO_DIM_D00_DIM_DQ_WR_CDC_STATUS1_ADDR A:0xfc4e08d4
y.create.l HWIO_DIM_D00_DIM_DQ_WR_CDC_STATUS2_ADDR A:0xfc4e08d8
y.create.l HWIO_DIM_D00_DIM_DQ_WR_CDC_STATUS3_ADDR A:0xfc4e08dc
y.create.l HWIO_DIM_D00_DIM_DQ_DQ_IOC_SLV_CFG_ADDR A:0xfc4e0900
y.create.l HWIO_DIM_D00_DIM_DQ_DQ_IOC_SLV_STATUS_ADDR A:0xfc4e0904
y.create.l HWIO_DIM_D00_DIM_DQ_DQS_IOC_SLV_CFG_ADDR A:0xfc4e0910
y.create.l HWIO_DIM_D00_DIM_DQ_DQS_IOC_SLV_STATUS_ADDR A:0xfc4e0914
y.create.l HWIO_DIM_D01_DIM_DQ_TOP_CFG_ADDR A:0xfc4e1000
y.create.l HWIO_DIM_D01_DIM_DQ_HW_INFO_ADDR A:0xfc4e1004
y.create.l HWIO_DIM_D01_DIM_DQ_HW_VERSION_ADDR A:0xfc4e1008
y.create.l HWIO_DIM_D01_DIM_DQ_PAD_CFG0_ADDR A:0xfc4e1010
y.create.l HWIO_DIM_D01_DIM_DQ_PAD_CFG1_ADDR A:0xfc4e1014
y.create.l HWIO_DIM_D01_DIM_DQ_PAD_CFG2_ADDR A:0xfc4e1018
y.create.l HWIO_DIM_D01_DIM_DQ_PAD_CFG3_ADDR A:0xfc4e1020
y.create.l HWIO_DIM_D01_DIM_DQ_PAD_CFG4_ADDR A:0xfc4e1024
y.create.l HWIO_DIM_D01_DDRPHY_DQ_MISR_CFG_ADDR A:0xfc4e100c
y.create.l HWIO_DIM_D01_DDRPHY_DQ_MISR_EVEN_STATUS_ADDR A:0xfc4e1028
y.create.l HWIO_DIM_D01_DDRPHY_DQ_MISR_ODD_STATUS_ADDR A:0xfc4e102c
y.create.l HWIO_DIM_D01_DIM_DQ_CDC_CTLR_CFG0_ADDR A:0xfc4e1030
y.create.l HWIO_DIM_D01_DIM_DQ_CDC_CTLR_CFG1_ADDR A:0xfc4e1034
y.create.l HWIO_DIM_D01_DIM_DQ_CDC_CAL_TIMER_CFG0_ADDR A:0xfc4e1038
y.create.l HWIO_DIM_D01_DIM_DQ_CDC_CAL_TIMER_CFG1_ADDR A:0xfc4e103c
y.create.l HWIO_DIM_D01_DIM_DQ_CDC_REFCOUNT_CFG_ADDR A:0xfc4e1040
y.create.l HWIO_DIM_D01_DIM_DQ_CDC_COARSE_CAL_CFG_ADDR A:0xfc4e1044
y.create.l HWIO_DIM_D01_DIM_DQ_CDC_RSVD_CFG_ADDR A:0xfc4e1048
y.create.l HWIO_DIM_D01_DIM_DQ_RD_CDC_OFFSET_CFG_ADDR A:0xfc4e104c
y.create.l HWIO_DIM_D01_DIM_DQ_RD_CDC_DELAY_CFG_ADDR A:0xfc4e1050
y.create.l HWIO_DIM_D01_DIM_DQ_RD_CDC_SW_MODE_CFG_ADDR A:0xfc4e1054
y.create.l HWIO_DIM_D01_DIM_DQ_RD_CDC_TEST_CFG_ADDR A:0xfc4e1058
y.create.l HWIO_DIM_D01_DIM_DQ_RD_CDC_SW_OVRD_CFG_ADDR A:0xfc4e105c
y.create.l HWIO_DIM_D01_DIM_DQ_RD_CDC_SLAVE_DDA_CFG_ADDR A:0xfc4e1060
y.create.l HWIO_DIM_D01_DIM_DQ_RD_CDC_STATUS0_ADDR A:0xfc4e1070
y.create.l HWIO_DIM_D01_DIM_DQ_RD_CDC_STATUS1_ADDR A:0xfc4e1074
y.create.l HWIO_DIM_D01_DIM_DQ_RD_CDC_STATUS2_ADDR A:0xfc4e1078
y.create.l HWIO_DIM_D01_DIM_DQ_RD_CDC_STATUS3_ADDR A:0xfc4e107c
y.create.l HWIO_DIM_D01_DIM_DQ_RD_CDC_STATUS4_ADDR A:0xfc4e1080
y.create.l HWIO_DIM_D01_DIM_DQ_WR_CDC_OFFSET_CFG_ADDR A:0xfc4e10ac
y.create.l HWIO_DIM_D01_DIM_DQ_WR_CDC_DELAY_CFG_ADDR A:0xfc4e10b0
y.create.l HWIO_DIM_D01_DIM_DQ_WR_CDC_SW_MODE_CFG_ADDR A:0xfc4e10b4
y.create.l HWIO_DIM_D01_DIM_DQ_WR_CDC_TEST_CFG_ADDR A:0xfc4e10b8
y.create.l HWIO_DIM_D01_DIM_DQ_WR_CDC_SW_OVRD_CFG_ADDR A:0xfc4e10bc
y.create.l HWIO_DIM_D01_DIM_DQ_WR_CDC_STATUS0_ADDR A:0xfc4e10d0
y.create.l HWIO_DIM_D01_DIM_DQ_WR_CDC_STATUS1_ADDR A:0xfc4e10d4
y.create.l HWIO_DIM_D01_DIM_DQ_WR_CDC_STATUS2_ADDR A:0xfc4e10d8
y.create.l HWIO_DIM_D01_DIM_DQ_WR_CDC_STATUS3_ADDR A:0xfc4e10dc
y.create.l HWIO_DIM_D01_DIM_DQ_DQ_IOC_SLV_CFG_ADDR A:0xfc4e1100
y.create.l HWIO_DIM_D01_DIM_DQ_DQ_IOC_SLV_STATUS_ADDR A:0xfc4e1104
y.create.l HWIO_DIM_D01_DIM_DQ_DQS_IOC_SLV_CFG_ADDR A:0xfc4e1110
y.create.l HWIO_DIM_D01_DIM_DQ_DQS_IOC_SLV_STATUS_ADDR A:0xfc4e1114
y.create.l HWIO_DIM_D02_DIM_DQ_TOP_CFG_ADDR A:0xfc4e1800
y.create.l HWIO_DIM_D02_DIM_DQ_HW_INFO_ADDR A:0xfc4e1804
y.create.l HWIO_DIM_D02_DIM_DQ_HW_VERSION_ADDR A:0xfc4e1808
y.create.l HWIO_DIM_D02_DIM_DQ_PAD_CFG0_ADDR A:0xfc4e1810
y.create.l HWIO_DIM_D02_DIM_DQ_PAD_CFG1_ADDR A:0xfc4e1814
y.create.l HWIO_DIM_D02_DIM_DQ_PAD_CFG2_ADDR A:0xfc4e1818
y.create.l HWIO_DIM_D02_DIM_DQ_PAD_CFG3_ADDR A:0xfc4e1820
y.create.l HWIO_DIM_D02_DIM_DQ_PAD_CFG4_ADDR A:0xfc4e1824
y.create.l HWIO_DIM_D02_DDRPHY_DQ_MISR_CFG_ADDR A:0xfc4e180c
y.create.l HWIO_DIM_D02_DDRPHY_DQ_MISR_EVEN_STATUS_ADDR A:0xfc4e1828
y.create.l HWIO_DIM_D02_DDRPHY_DQ_MISR_ODD_STATUS_ADDR A:0xfc4e182c
y.create.l HWIO_DIM_D02_DIM_DQ_CDC_CTLR_CFG0_ADDR A:0xfc4e1830
y.create.l HWIO_DIM_D02_DIM_DQ_CDC_CTLR_CFG1_ADDR A:0xfc4e1834
y.create.l HWIO_DIM_D02_DIM_DQ_CDC_CAL_TIMER_CFG0_ADDR A:0xfc4e1838
y.create.l HWIO_DIM_D02_DIM_DQ_CDC_CAL_TIMER_CFG1_ADDR A:0xfc4e183c
y.create.l HWIO_DIM_D02_DIM_DQ_CDC_REFCOUNT_CFG_ADDR A:0xfc4e1840
y.create.l HWIO_DIM_D02_DIM_DQ_CDC_COARSE_CAL_CFG_ADDR A:0xfc4e1844
y.create.l HWIO_DIM_D02_DIM_DQ_CDC_RSVD_CFG_ADDR A:0xfc4e1848
y.create.l HWIO_DIM_D02_DIM_DQ_RD_CDC_OFFSET_CFG_ADDR A:0xfc4e184c
y.create.l HWIO_DIM_D02_DIM_DQ_RD_CDC_DELAY_CFG_ADDR A:0xfc4e1850
y.create.l HWIO_DIM_D02_DIM_DQ_RD_CDC_SW_MODE_CFG_ADDR A:0xfc4e1854
y.create.l HWIO_DIM_D02_DIM_DQ_RD_CDC_TEST_CFG_ADDR A:0xfc4e1858
y.create.l HWIO_DIM_D02_DIM_DQ_RD_CDC_SW_OVRD_CFG_ADDR A:0xfc4e185c
y.create.l HWIO_DIM_D02_DIM_DQ_RD_CDC_SLAVE_DDA_CFG_ADDR A:0xfc4e1860
y.create.l HWIO_DIM_D02_DIM_DQ_RD_CDC_STATUS0_ADDR A:0xfc4e1870
y.create.l HWIO_DIM_D02_DIM_DQ_RD_CDC_STATUS1_ADDR A:0xfc4e1874
y.create.l HWIO_DIM_D02_DIM_DQ_RD_CDC_STATUS2_ADDR A:0xfc4e1878
y.create.l HWIO_DIM_D02_DIM_DQ_RD_CDC_STATUS3_ADDR A:0xfc4e187c
y.create.l HWIO_DIM_D02_DIM_DQ_RD_CDC_STATUS4_ADDR A:0xfc4e1880
y.create.l HWIO_DIM_D02_DIM_DQ_WR_CDC_OFFSET_CFG_ADDR A:0xfc4e18ac
y.create.l HWIO_DIM_D02_DIM_DQ_WR_CDC_DELAY_CFG_ADDR A:0xfc4e18b0
y.create.l HWIO_DIM_D02_DIM_DQ_WR_CDC_SW_MODE_CFG_ADDR A:0xfc4e18b4
y.create.l HWIO_DIM_D02_DIM_DQ_WR_CDC_TEST_CFG_ADDR A:0xfc4e18b8
y.create.l HWIO_DIM_D02_DIM_DQ_WR_CDC_SW_OVRD_CFG_ADDR A:0xfc4e18bc
y.create.l HWIO_DIM_D02_DIM_DQ_WR_CDC_STATUS0_ADDR A:0xfc4e18d0
y.create.l HWIO_DIM_D02_DIM_DQ_WR_CDC_STATUS1_ADDR A:0xfc4e18d4
y.create.l HWIO_DIM_D02_DIM_DQ_WR_CDC_STATUS2_ADDR A:0xfc4e18d8
y.create.l HWIO_DIM_D02_DIM_DQ_WR_CDC_STATUS3_ADDR A:0xfc4e18dc
y.create.l HWIO_DIM_D02_DIM_DQ_DQ_IOC_SLV_CFG_ADDR A:0xfc4e1900
y.create.l HWIO_DIM_D02_DIM_DQ_DQ_IOC_SLV_STATUS_ADDR A:0xfc4e1904
y.create.l HWIO_DIM_D02_DIM_DQ_DQS_IOC_SLV_CFG_ADDR A:0xfc4e1910
y.create.l HWIO_DIM_D02_DIM_DQ_DQS_IOC_SLV_STATUS_ADDR A:0xfc4e1914
y.create.l HWIO_DIM_D03_DIM_DQ_TOP_CFG_ADDR A:0xfc4e2000
y.create.l HWIO_DIM_D03_DIM_DQ_HW_INFO_ADDR A:0xfc4e2004
y.create.l HWIO_DIM_D03_DIM_DQ_HW_VERSION_ADDR A:0xfc4e2008
y.create.l HWIO_DIM_D03_DIM_DQ_PAD_CFG0_ADDR A:0xfc4e2010
y.create.l HWIO_DIM_D03_DIM_DQ_PAD_CFG1_ADDR A:0xfc4e2014
y.create.l HWIO_DIM_D03_DIM_DQ_PAD_CFG2_ADDR A:0xfc4e2018
y.create.l HWIO_DIM_D03_DIM_DQ_PAD_CFG3_ADDR A:0xfc4e2020
y.create.l HWIO_DIM_D03_DIM_DQ_PAD_CFG4_ADDR A:0xfc4e2024
y.create.l HWIO_DIM_D03_DDRPHY_DQ_MISR_CFG_ADDR A:0xfc4e200c
y.create.l HWIO_DIM_D03_DDRPHY_DQ_MISR_EVEN_STATUS_ADDR A:0xfc4e2028
y.create.l HWIO_DIM_D03_DDRPHY_DQ_MISR_ODD_STATUS_ADDR A:0xfc4e202c
y.create.l HWIO_DIM_D03_DIM_DQ_CDC_CTLR_CFG0_ADDR A:0xfc4e2030
y.create.l HWIO_DIM_D03_DIM_DQ_CDC_CTLR_CFG1_ADDR A:0xfc4e2034
y.create.l HWIO_DIM_D03_DIM_DQ_CDC_CAL_TIMER_CFG0_ADDR A:0xfc4e2038
y.create.l HWIO_DIM_D03_DIM_DQ_CDC_CAL_TIMER_CFG1_ADDR A:0xfc4e203c
y.create.l HWIO_DIM_D03_DIM_DQ_CDC_REFCOUNT_CFG_ADDR A:0xfc4e2040
y.create.l HWIO_DIM_D03_DIM_DQ_CDC_COARSE_CAL_CFG_ADDR A:0xfc4e2044
y.create.l HWIO_DIM_D03_DIM_DQ_CDC_RSVD_CFG_ADDR A:0xfc4e2048
y.create.l HWIO_DIM_D03_DIM_DQ_RD_CDC_OFFSET_CFG_ADDR A:0xfc4e204c
y.create.l HWIO_DIM_D03_DIM_DQ_RD_CDC_DELAY_CFG_ADDR A:0xfc4e2050
y.create.l HWIO_DIM_D03_DIM_DQ_RD_CDC_SW_MODE_CFG_ADDR A:0xfc4e2054
y.create.l HWIO_DIM_D03_DIM_DQ_RD_CDC_TEST_CFG_ADDR A:0xfc4e2058
y.create.l HWIO_DIM_D03_DIM_DQ_RD_CDC_SW_OVRD_CFG_ADDR A:0xfc4e205c
y.create.l HWIO_DIM_D03_DIM_DQ_RD_CDC_SLAVE_DDA_CFG_ADDR A:0xfc4e2060
y.create.l HWIO_DIM_D03_DIM_DQ_RD_CDC_STATUS0_ADDR A:0xfc4e2070
y.create.l HWIO_DIM_D03_DIM_DQ_RD_CDC_STATUS1_ADDR A:0xfc4e2074
y.create.l HWIO_DIM_D03_DIM_DQ_RD_CDC_STATUS2_ADDR A:0xfc4e2078
y.create.l HWIO_DIM_D03_DIM_DQ_RD_CDC_STATUS3_ADDR A:0xfc4e207c
y.create.l HWIO_DIM_D03_DIM_DQ_RD_CDC_STATUS4_ADDR A:0xfc4e2080
y.create.l HWIO_DIM_D03_DIM_DQ_WR_CDC_OFFSET_CFG_ADDR A:0xfc4e20ac
y.create.l HWIO_DIM_D03_DIM_DQ_WR_CDC_DELAY_CFG_ADDR A:0xfc4e20b0
y.create.l HWIO_DIM_D03_DIM_DQ_WR_CDC_SW_MODE_CFG_ADDR A:0xfc4e20b4
y.create.l HWIO_DIM_D03_DIM_DQ_WR_CDC_TEST_CFG_ADDR A:0xfc4e20b8
y.create.l HWIO_DIM_D03_DIM_DQ_WR_CDC_SW_OVRD_CFG_ADDR A:0xfc4e20bc
y.create.l HWIO_DIM_D03_DIM_DQ_WR_CDC_STATUS0_ADDR A:0xfc4e20d0
y.create.l HWIO_DIM_D03_DIM_DQ_WR_CDC_STATUS1_ADDR A:0xfc4e20d4
y.create.l HWIO_DIM_D03_DIM_DQ_WR_CDC_STATUS2_ADDR A:0xfc4e20d8
y.create.l HWIO_DIM_D03_DIM_DQ_WR_CDC_STATUS3_ADDR A:0xfc4e20dc
y.create.l HWIO_DIM_D03_DIM_DQ_DQ_IOC_SLV_CFG_ADDR A:0xfc4e2100
y.create.l HWIO_DIM_D03_DIM_DQ_DQ_IOC_SLV_STATUS_ADDR A:0xfc4e2104
y.create.l HWIO_DIM_D03_DIM_DQ_DQS_IOC_SLV_CFG_ADDR A:0xfc4e2110
y.create.l HWIO_DIM_D03_DIM_DQ_DQS_IOC_SLV_STATUS_ADDR A:0xfc4e2114
y.create.l HWIO_EBI1_HW_VERSION_ADDR A:0xfc4ff000
y.create.l HWIO_EBI1_HW_INFO_ADDR A:0xfc4ff004
y.create.l HWIO_EBI1_AHB2PHY_BROADCAST_EN_CFG_LOWER_ADDR A:0xfc4ff008
y.create.l HWIO_EBI1_AHB2PHY_BROADCAST_EN_CFG_UPPER_ADDR A:0xfc4ff00c
y.create.l HWIO_EBI1_AHB2PHY_TOP_CFG_ADDR A:0xfc4ff010
y.create.l HWIO_EBI1_AHB2PHY_DEBUG_BUS_CFG_ADDR A:0xfc4ff014
y.create.l HWIO_EBI1_AHB2PHY_BROADCAST_ADDRESS_SPACE_0_ADDR A:0xfc4ff800
y.create.l HWIO_EBI1_AHB2PHY_BROADCAST_ADDRESS_SPACE_1_ADDR A:0xfc4ff804
y.create.l HWIO_EBI1_AHB2PHY_BROADCAST_ADDRESS_SPACE_2_ADDR A:0xfc4ff808
y.create.l HWIO_EBI1_AHB2PHY_BROADCAST_ADDRESS_SPACE_3_ADDR A:0xfc4ff80c
y.create.l HWIO_EBI1_AHB2PHY_BROADCAST_ADDRESS_SPACE_4_ADDR A:0xfc4ff810
y.create.l HWIO_EBI1_AHB2PHY_BROADCAST_ADDRESS_SPACE_5_ADDR A:0xfc4ff814
y.create.l HWIO_EBI1_AHB2PHY_BROADCAST_ADDRESS_SPACE_6_ADDR A:0xfc4ff818
y.create.l HWIO_EBI1_AHB2PHY_BROADCAST_ADDRESS_SPACE_7_ADDR A:0xfc4ff81c
y.create.l HWIO_EBI1_AHB2PHY_BROADCAST_ADDRESS_SPACE_8_ADDR A:0xfc4ff820
y.create.l HWIO_EBI1_AHB2PHY_BROADCAST_ADDRESS_SPACE_9_ADDR A:0xfc4ff824
y.create.l HWIO_APCS_GICD_CTLR_ADDR A:0xf9000000
y.create.l HWIO_APCS_GICD_TYPER_ADDR A:0xf9000004
y.create.l HWIO_APCS_GICD_IIDR_ADDR A:0xf9000008
y.create.l HWIO_APCS_GICD_ANSACR_ADDR A:0xf9000020
y.create.l HWIO_APCS_GICD_CGCR_ADDR A:0xf9000024
y.create.l HWIO_APCS_GICD_HW_VERSION_ADDR A:0xf9000030
y.create.l HWIO_APCS_GICD_ISR0_ADDR A:0xf9000080
y.create.l HWIO_APCS_GICD_ISR1_ADDR A:0xf9000084
y.create.l HWIO_APCS_GICD_ISR2_ADDR A:0xf9000088
y.create.l HWIO_APCS_GICD_ISR3_ADDR A:0xf900008c
y.create.l HWIO_APCS_GICD_ISR4_ADDR A:0xf9000090
y.create.l HWIO_APCS_GICD_ISR5_ADDR A:0xf9000094
y.create.l HWIO_APCS_GICD_ISR6_ADDR A:0xf9000098
y.create.l HWIO_APCS_GICD_ISR7_ADDR A:0xf900009c
y.create.l HWIO_APCS_GICD_ISR8_ADDR A:0xf90000a0
y.create.l HWIO_APCS_GICD_ISENABLER0_ADDR A:0xf9000100
y.create.l HWIO_APCS_GICD_ISENABLER1_ADDR A:0xf9000104
y.create.l HWIO_APCS_GICD_ISENABLER2_ADDR A:0xf9000108
y.create.l HWIO_APCS_GICD_ISENABLER3_ADDR A:0xf900010c
y.create.l HWIO_APCS_GICD_ISENABLER4_ADDR A:0xf9000110
y.create.l HWIO_APCS_GICD_ISENABLER5_ADDR A:0xf9000114
y.create.l HWIO_APCS_GICD_ISENABLER6_ADDR A:0xf9000118
y.create.l HWIO_APCS_GICD_ISENABLER7_ADDR A:0xf900011c
y.create.l HWIO_APCS_GICD_ISENABLER8_ADDR A:0xf9000120
y.create.l HWIO_APCS_GICD_ICENABLER0_ADDR A:0xf9000180
y.create.l HWIO_APCS_GICD_ICENABLER1_ADDR A:0xf9000184
y.create.l HWIO_APCS_GICD_ICENABLER2_ADDR A:0xf9000188
y.create.l HWIO_APCS_GICD_ICENABLER3_ADDR A:0xf900018c
y.create.l HWIO_APCS_GICD_ICENABLER4_ADDR A:0xf9000190
y.create.l HWIO_APCS_GICD_ICENABLER5_ADDR A:0xf9000194
y.create.l HWIO_APCS_GICD_ICENABLER6_ADDR A:0xf9000198
y.create.l HWIO_APCS_GICD_ICENABLER7_ADDR A:0xf900019c
y.create.l HWIO_APCS_GICD_ICENABLER8_ADDR A:0xf90001a0
y.create.l HWIO_APCS_GICD_ISPENDR0_ADDR A:0xf9000200
y.create.l HWIO_APCS_GICD_ISPENDR1_ADDR A:0xf9000204
y.create.l HWIO_APCS_GICD_ISPENDR2_ADDR A:0xf9000208
y.create.l HWIO_APCS_GICD_ISPENDR3_ADDR A:0xf900020c
y.create.l HWIO_APCS_GICD_ISPENDR4_ADDR A:0xf9000210
y.create.l HWIO_APCS_GICD_ISPENDR5_ADDR A:0xf9000214
y.create.l HWIO_APCS_GICD_ISPENDR6_ADDR A:0xf9000218
y.create.l HWIO_APCS_GICD_ISPENDR7_ADDR A:0xf900021c
y.create.l HWIO_APCS_GICD_ISPENDR8_ADDR A:0xf9000220
y.create.l HWIO_APCS_GICD_ICPENDR0_ADDR A:0xf9000280
y.create.l HWIO_APCS_GICD_ICPENDR1_ADDR A:0xf9000284
y.create.l HWIO_APCS_GICD_ICPENDR2_ADDR A:0xf9000288
y.create.l HWIO_APCS_GICD_ICPENDR3_ADDR A:0xf900028c
y.create.l HWIO_APCS_GICD_ICPENDR4_ADDR A:0xf9000290
y.create.l HWIO_APCS_GICD_ICPENDR5_ADDR A:0xf9000294
y.create.l HWIO_APCS_GICD_ICPENDR6_ADDR A:0xf9000298
y.create.l HWIO_APCS_GICD_ICPENDR7_ADDR A:0xf900029c
y.create.l HWIO_APCS_GICD_ICPENDR8_ADDR A:0xf90002a0
y.create.l HWIO_APCS_GICD_ISACTIVER0_ADDR A:0xf9000300
y.create.l HWIO_APCS_GICD_ISACTIVER1_ADDR A:0xf9000304
y.create.l HWIO_APCS_GICD_ISACTIVER2_ADDR A:0xf9000308
y.create.l HWIO_APCS_GICD_ISACTIVER3_ADDR A:0xf900030c
y.create.l HWIO_APCS_GICD_ISACTIVER4_ADDR A:0xf9000310
y.create.l HWIO_APCS_GICD_ISACTIVER5_ADDR A:0xf9000314
y.create.l HWIO_APCS_GICD_ISACTIVER6_ADDR A:0xf9000318
y.create.l HWIO_APCS_GICD_ISACTIVER7_ADDR A:0xf900031c
y.create.l HWIO_APCS_GICD_ISACTIVER8_ADDR A:0xf9000320
y.create.l HWIO_APCS_GICD_ICACTIVER0_ADDR A:0xf9000380
y.create.l HWIO_APCS_GICD_ICACTIVER1_ADDR A:0xf9000384
y.create.l HWIO_APCS_GICD_ICACTIVER2_ADDR A:0xf9000388
y.create.l HWIO_APCS_GICD_ICACTIVER3_ADDR A:0xf900038c
y.create.l HWIO_APCS_GICD_ICACTIVER4_ADDR A:0xf9000390
y.create.l HWIO_APCS_GICD_ICACTIVER5_ADDR A:0xf9000394
y.create.l HWIO_APCS_GICD_ICACTIVER6_ADDR A:0xf9000398
y.create.l HWIO_APCS_GICD_ICACTIVER7_ADDR A:0xf900039c
y.create.l HWIO_APCS_GICD_ICACTIVER8_ADDR A:0xf90003a0
y.create.l HWIO_APCS_GICD_IPRIORITYR0_ADDR A:0xf9000400
y.create.l HWIO_APCS_GICD_IPRIORITYR1_ADDR A:0xf9000404
y.create.l HWIO_APCS_GICD_IPRIORITYR2_ADDR A:0xf9000408
y.create.l HWIO_APCS_GICD_IPRIORITYR3_ADDR A:0xf900040c
y.create.l HWIO_APCS_GICD_IPRIORITYR4_ADDR A:0xf9000410
y.create.l HWIO_APCS_GICD_IPRIORITYR5_ADDR A:0xf9000414
y.create.l HWIO_APCS_GICD_IPRIORITYR6_ADDR A:0xf9000418
y.create.l HWIO_APCS_GICD_IPRIORITYR7_ADDR A:0xf900041c
y.create.l HWIO_APCS_GICD_IPRIORITYR8_ADDR A:0xf9000420
y.create.l HWIO_APCS_GICD_IPRIORITYR9_ADDR A:0xf9000424
y.create.l HWIO_APCS_GICD_ITARGETSR0_ADDR A:0xf9000800
y.create.l HWIO_APCS_GICD_ITARGETSR1_ADDR A:0xf9000804
y.create.l HWIO_APCS_GICD_ITARGETSR2_ADDR A:0xf9000808
y.create.l HWIO_APCS_GICD_ITARGETSR3_ADDR A:0xf900080c
y.create.l HWIO_APCS_GICD_ITARGETSR4_ADDR A:0xf9000810
y.create.l HWIO_APCS_GICD_ITARGETSR5_ADDR A:0xf9000814
y.create.l HWIO_APCS_GICD_ITARGETSR6_ADDR A:0xf9000818
y.create.l HWIO_APCS_GICD_ITARGETSR7_ADDR A:0xf900081c
y.create.l HWIO_APCS_GICD_ITARGETSR8_ADDR A:0xf9000820
y.create.l HWIO_APCS_GICD_ITARGETSR9_ADDR A:0xf9000824
y.create.l HWIO_APCS_GICD_ICFGR0_ADDR A:0xf9000c00
y.create.l HWIO_APCS_GICD_ICFGR1_ADDR A:0xf9000c04
y.create.l HWIO_APCS_GICD_ICFGR2_ADDR A:0xf9000c08
y.create.l HWIO_APCS_GICD_ICFGR3_ADDR A:0xf9000c0c
y.create.l HWIO_APCS_GICD_ICFGR4_ADDR A:0xf9000c10
y.create.l HWIO_APCS_GICD_ICFGR5_ADDR A:0xf9000c14
y.create.l HWIO_APCS_GICD_ICFGR6_ADDR A:0xf9000c18
y.create.l HWIO_APCS_GICD_ICFGR7_ADDR A:0xf9000c1c
y.create.l HWIO_APCS_GICD_ICFGR8_ADDR A:0xf9000c20
y.create.l HWIO_APCS_GICD_ICFGR9_ADDR A:0xf9000c24
y.create.l HWIO_APCS_GICD_SGIR_ADDR A:0xf9000f00
y.create.l HWIO_APCS_GICD_CPENDSGIR0_ADDR A:0xf9000f10
y.create.l HWIO_APCS_GICD_CPENDSGIR1_ADDR A:0xf9000f14
y.create.l HWIO_APCS_GICD_CPENDSGIR2_ADDR A:0xf9000f18
y.create.l HWIO_APCS_GICD_CPENDSGIR3_ADDR A:0xf9000f1c
y.create.l HWIO_APCS_GICD_SPENDSGIR0_ADDR A:0xf9000f20
y.create.l HWIO_APCS_GICD_SPENDSGIR1_ADDR A:0xf9000f24
y.create.l HWIO_APCS_GICD_SPENDSGIR2_ADDR A:0xf9000f28
y.create.l HWIO_APCS_GICD_SPENDSGIR3_ADDR A:0xf9000f2c
y.create.l HWIO_APCS_GICD_PIDR0_ADDR A:0xf9000fd0
y.create.l HWIO_APCS_GICD_PIDR1_ADDR A:0xf9000fd4
y.create.l HWIO_APCS_GICD_PIDR2_ADDR A:0xf9000fd8
y.create.l HWIO_APCS_GICD_PIDR3_ADDR A:0xf9000fdc
y.create.l HWIO_APCS_GICD_PIDR4_ADDR A:0xf9000fe0
y.create.l HWIO_APCS_GICD_PIDR5_ADDR A:0xf9000fe4
y.create.l HWIO_APCS_GICD_PIDR6_ADDR A:0xf9000fe8
y.create.l HWIO_APCS_GICD_PIDR7_ADDR A:0xf9000fec
y.create.l HWIO_APCS_GICD_CIDR0_ADDR A:0xf9000ff0
y.create.l HWIO_APCS_GICD_CIDR1_ADDR A:0xf9000ff4
y.create.l HWIO_APCS_GICD_CIDR2_ADDR A:0xf9000ff8
y.create.l HWIO_APCS_GICD_CIDR3_ADDR A:0xf9000ffc
y.create.l HWIO_APCS_GICH_HCR_ADDR A:0xf9001000
y.create.l HWIO_APCS_GICH_VTR_ADDR A:0xf9001004
y.create.l HWIO_APCS_GICH_VMCR_ADDR A:0xf9001008
y.create.l HWIO_APCS_GICH_MISR_ADDR A:0xf9001010
y.create.l HWIO_APCS_GICH_EISR_ADDR A:0xf9001020
y.create.l HWIO_APCS_GICH_ELRSR_ADDR A:0xf9001030
y.create.l HWIO_APCS_GICH_APR_ADDR A:0xf90010f0
y.create.l HWIO_APCS_GICH_LR0_ADDR A:0xf9001100
y.create.l HWIO_APCS_GICH_LR1_ADDR A:0xf9001104
y.create.l HWIO_APCS_GICH_LR2_ADDR A:0xf9001108
y.create.l HWIO_APCS_GICH_LR3_ADDR A:0xf900110c
y.create.l HWIO_APCS_GICH_SW_LR_ADDR A:0xf9001120
y.create.l HWIO_APCS_GICC_CTLR_ADDR A:0xf9002000
y.create.l HWIO_APCS_GICC_PMR_ADDR A:0xf9002004
y.create.l HWIO_APCS_GICC_BPR_ADDR A:0xf9002008
y.create.l HWIO_APCS_GICC_IAR_ADDR A:0xf900200c
y.create.l HWIO_APCS_GICC_EOIR_ADDR A:0xf9002010
y.create.l HWIO_APCS_GICC_RPR_ADDR A:0xf9002014
y.create.l HWIO_APCS_GICC_HPPIR_ADDR A:0xf9002018
y.create.l HWIO_APCS_GICC_ABPR_ADDR A:0xf900201c
y.create.l HWIO_APCS_GICC_AIAR_ADDR A:0xf9002020
y.create.l HWIO_APCS_GICC_AEOIR_ADDR A:0xf9002024
y.create.l HWIO_APCS_GICC_AHPPIR_ADDR A:0xf9002028
y.create.l HWIO_APCS_GICC_APR_ADDR A:0xf90020d0
y.create.l HWIO_APCS_GICC_NSAPR_ADDR A:0xf90020e0
y.create.l HWIO_APCS_GICC_IIDR_ADDR A:0xf90020fc
y.create.l HWIO_APCS_GICC_DIR_ADDR A:0xf9003000
y.create.l HWIO_APCS_GICV_CTLR_ADDR A:0xf9004000
y.create.l HWIO_APCS_GICV_PMR_ADDR A:0xf9004004
y.create.l HWIO_APCS_GICV_BPR_ADDR A:0xf9004008
y.create.l HWIO_APCS_GICV_IAR_ADDR A:0xf900400c
y.create.l HWIO_APCS_GICV_EOIR_ADDR A:0xf9004010
y.create.l HWIO_APCS_GICV_RPR_ADDR A:0xf9004014
y.create.l HWIO_APCS_GICV_HPPIR_ADDR A:0xf9004018
y.create.l HWIO_APCS_GICV_ABPR_ADDR A:0xf900401c
y.create.l HWIO_APCS_GICV_AIAR_ADDR A:0xf9004020
y.create.l HWIO_APCS_GICV_AEOIR_ADDR A:0xf9004024
y.create.l HWIO_APCS_GICV_AHPPIR_ADDR A:0xf9004028
y.create.l HWIO_APCS_GICV_APR_ADDR A:0xf90040d0
y.create.l HWIO_APCS_GICV_IIDR_ADDR A:0xf90040fc
y.create.l HWIO_APCS_GICV_DIR_ADDR A:0xf9005000
y.create.l HWIO_APCS_ACCSECURE_ADDR A:0xf9008000
y.create.l HWIO_APCS_CPU_PWR_CTL_ADDR A:0xf9008004
y.create.l HWIO_APCS_ACC_STS_ADDR A:0xf9008008
y.create.l HWIO_APCS_ATSTBUS_SEL_ADDR A:0xf900800c
y.create.l HWIO_APCS_CPU_TRGTD_DBG_RST_ADDR A:0xf9008010
y.create.l HWIO_APCS_CPU_AUX_CLK_SEL_ADDR A:0xf9008014
y.create.l HWIO_APCS_CPU_PLL_AUX_CONFIG_CTL_ADDR A:0xf9008018
y.create.l HWIO_APCS_CPU_PLL_L_VAL_ADDR A:0xf900801c
y.create.l HWIO_APCS_CPU_PLL_M_VAL_ADDR A:0xf9008020
y.create.l HWIO_APCS_CPU_PLL_N_VAL_ADDR A:0xf9008024
y.create.l HWIO_APCS_CPU_PLL_USER_CTL_ADDR A:0xf9008028
y.create.l HWIO_APCS_CPU_PLL_CONFIG_CTL_ADDR A:0xf900802c
y.create.l HWIO_APCS_CPU_PLL_TEST_CTL_ADDR A:0xf9008030
y.create.l HWIO_APCS_CPU_PLL_STATUS_ADDR A:0xf9008034
y.create.l HWIO_APCS_TZIPC_INTERRUPT_ADDR A:0xf9008038
y.create.l HWIO_APCS_SAW2_SECURE_ADDR A:0xf9009000
y.create.l HWIO_APCS_SAW2_ID_ADDR A:0xf9009004
y.create.l HWIO_APCS_SAW2_CFG_ADDR A:0xf9009008
y.create.l HWIO_APCS_SAW2_SPM_STS_ADDR A:0xf900900c
y.create.l HWIO_APCS_SAW2_AVS_STS_ADDR A:0xf9009010
y.create.l HWIO_APCS_SAW2_PMIC_STS_ADDR A:0xf9009014
y.create.l HWIO_APCS_SAW2_RST_ADDR A:0xf9009018
y.create.l HWIO_APCS_SAW2_SPM_CTL_ADDR A:0xf9009030
y.create.l HWIO_APCS_SAW2_SPM_DLY_ADDR A:0xf9009034
y.create.l HWIO_APCS_SAW2_SPM_SLP_SEQ_ENTRY_0_ADDR A:0xf9009080
y.create.l HWIO_APCS_SAW2_SPM_SLP_SEQ_ENTRY_1_ADDR A:0xf9009084
y.create.l HWIO_APCS_SAW2_SPM_SLP_SEQ_ENTRY_2_ADDR A:0xf9009088
y.create.l HWIO_APCS_SAW2_SPM_SLP_SEQ_ENTRY_3_ADDR A:0xf900908c
y.create.l HWIO_APCS_SAW2_SPM_SLP_SEQ_ENTRY_4_ADDR A:0xf9009090
y.create.l HWIO_APCS_SAW2_SPM_SLP_SEQ_ENTRY_5_ADDR A:0xf9009094
y.create.l HWIO_APCS_SAW2_SPM_SLP_SEQ_ENTRY_6_ADDR A:0xf9009098
y.create.l HWIO_APCS_SAW2_SPM_SLP_SEQ_ENTRY_7_ADDR A:0xf900909c
y.create.l HWIO_APCS_SAW2_SPM_SLP_SEQ_ENTRY_8_ADDR A:0xf90090a0
y.create.l HWIO_APCS_SAW2_SPM_SLP_SEQ_ENTRY_9_ADDR A:0xf90090a4
y.create.l HWIO_APCS_SAW2_VERSION_ADDR A:0xf9009fd0
y.create.l HWIO_QTMR_AC_CNTFRQ_ADDR A:0xf9020000
y.create.l HWIO_QTMR_AC_CNTSR_ADDR A:0xf9020004
y.create.l HWIO_QTMR_AC_CNTTID_ADDR A:0xf9020008
y.create.l HWIO_QTMR_AC_CNTACR_0_ADDR A:0xf9020040
y.create.l HWIO_QTMR_AC_CNTACR_1_ADDR A:0xf9020044
y.create.l HWIO_QTMR_AC_CNTACR_2_ADDR A:0xf9020048
y.create.l HWIO_QTMR_AC_CNTACR_3_ADDR A:0xf902004c
y.create.l HWIO_QTMR_AC_CNTACR_4_ADDR A:0xf9020050
y.create.l HWIO_QTMR_AC_CNTACR_5_ADDR A:0xf9020054
y.create.l HWIO_QTMR_AC_CNTACR_6_ADDR A:0xf9020058
y.create.l HWIO_QTMR_AC_CNTACR_7_ADDR A:0xf902005c
y.create.l HWIO_QTMR_AC_CNTVOFF_LO_0_ADDR A:0xf9020080
y.create.l HWIO_QTMR_AC_CNTVOFF_LO_1_ADDR A:0xf9020088
y.create.l HWIO_QTMR_AC_CNTVOFF_LO_2_ADDR A:0xf9020090
y.create.l HWIO_QTMR_AC_CNTVOFF_LO_3_ADDR A:0xf9020098
y.create.l HWIO_QTMR_AC_CNTVOFF_LO_4_ADDR A:0xf90200a0
y.create.l HWIO_QTMR_AC_CNTVOFF_LO_5_ADDR A:0xf90200a8
y.create.l HWIO_QTMR_AC_CNTVOFF_LO_6_ADDR A:0xf90200b0
y.create.l HWIO_QTMR_AC_CNTVOFF_LO_7_ADDR A:0xf90200b8
y.create.l HWIO_QTMR_AC_CNTVOFF_HI_0_ADDR A:0xf9020084
y.create.l HWIO_QTMR_AC_CNTVOFF_HI_1_ADDR A:0xf902008c
y.create.l HWIO_QTMR_AC_CNTVOFF_HI_2_ADDR A:0xf9020094
y.create.l HWIO_QTMR_AC_CNTVOFF_HI_3_ADDR A:0xf902009c
y.create.l HWIO_QTMR_AC_CNTVOFF_HI_4_ADDR A:0xf90200a4
y.create.l HWIO_QTMR_AC_CNTVOFF_HI_5_ADDR A:0xf90200ac
y.create.l HWIO_QTMR_AC_CNTVOFF_HI_6_ADDR A:0xf90200b4
y.create.l HWIO_QTMR_AC_CNTVOFF_HI_7_ADDR A:0xf90200bc
y.create.l HWIO_QTMR_AC_VERSION_ADDR A:0xf9020fd0
y.create.l HWIO_APCS_F0_QTMR_V1_CNTPCT_LO_ADDR A:0xf9021000
y.create.l HWIO_APCS_F0_QTMR_V1_CNTPCT_HI_ADDR A:0xf9021004
y.create.l HWIO_APCS_F0_QTMR_V1_CNTVCT_LO_ADDR A:0xf9021008
y.create.l HWIO_APCS_F0_QTMR_V1_CNTVCT_HI_ADDR A:0xf902100c
y.create.l HWIO_APCS_F0_QTMR_V1_CNTFRQ_ADDR A:0xf9021010
y.create.l HWIO_APCS_F0_QTMR_V1_CNTPL0ACR_ADDR A:0xf9021014
y.create.l HWIO_APCS_F0_QTMR_V1_CNTVOFF_LO_ADDR A:0xf9021018
y.create.l HWIO_APCS_F0_QTMR_V1_CNTVOFF_HI_ADDR A:0xf902101c
y.create.l HWIO_APCS_F0_QTMR_V1_CNTP_CVAL_LO_ADDR A:0xf9021020
y.create.l HWIO_APCS_F0_QTMR_V1_CNTP_CVAL_HI_ADDR A:0xf9021024
y.create.l HWIO_APCS_F0_QTMR_V1_CNTP_TVAL_ADDR A:0xf9021028
y.create.l HWIO_APCS_F0_QTMR_V1_CNTP_CTL_ADDR A:0xf902102c
y.create.l HWIO_APCS_F0_QTMR_V1_CNTV_CVAL_LO_ADDR A:0xf9021030
y.create.l HWIO_APCS_F0_QTMR_V1_CNTV_CVAL_HI_ADDR A:0xf9021034
y.create.l HWIO_APCS_F0_QTMR_V1_CNTV_TVAL_ADDR A:0xf9021038
y.create.l HWIO_APCS_F0_QTMR_V1_CNTV_CTL_ADDR A:0xf902103c
y.create.l HWIO_APCS_F0_QTMR_V1_VERSION_ADDR A:0xf9021fd0
y.create.l HWIO_APCS_F0_QTMR_V2_CNTPCT_LO_ADDR A:0xf9022000
y.create.l HWIO_APCS_F0_QTMR_V2_CNTPCT_HI_ADDR A:0xf9022004
y.create.l HWIO_APCS_F0_QTMR_V2_CNTVCT_LO_ADDR A:0xf9022008
y.create.l HWIO_APCS_F0_QTMR_V2_CNTVCT_HI_ADDR A:0xf902200c
y.create.l HWIO_APCS_F0_QTMR_V2_CNTFRQ_ADDR A:0xf9022010
y.create.l HWIO_APCS_F0_QTMR_V2_CNTP_CVAL_LO_ADDR A:0xf9022020
y.create.l HWIO_APCS_F0_QTMR_V2_CNTP_CVAL_HI_ADDR A:0xf9022024
y.create.l HWIO_APCS_F0_QTMR_V2_CNTP_TVAL_ADDR A:0xf9022028
y.create.l HWIO_APCS_F0_QTMR_V2_CNTP_CTL_ADDR A:0xf902202c
y.create.l HWIO_APCS_F0_QTMR_V2_CNTV_CVAL_LO_ADDR A:0xf9022030
y.create.l HWIO_APCS_F0_QTMR_V2_CNTV_CVAL_HI_ADDR A:0xf9022034
y.create.l HWIO_APCS_F0_QTMR_V2_CNTV_TVAL_ADDR A:0xf9022038
y.create.l HWIO_APCS_F0_QTMR_V2_CNTV_CTL_ADDR A:0xf902203c
y.create.l HWIO_APCS_F0_QTMR_V2_VERSION_ADDR A:0xf9022fd0
y.create.l HWIO_APCS_F1_QTMR_V1_CNTPCT_LO_ADDR A:0xf9023000
y.create.l HWIO_APCS_F1_QTMR_V1_CNTPCT_HI_ADDR A:0xf9023004
y.create.l HWIO_APCS_F1_QTMR_V1_CNTVCT_LO_ADDR A:0xf9023008
y.create.l HWIO_APCS_F1_QTMR_V1_CNTVCT_HI_ADDR A:0xf902300c
y.create.l HWIO_APCS_F1_QTMR_V1_CNTFRQ_ADDR A:0xf9023010
y.create.l HWIO_APCS_F1_QTMR_V1_CNTPL0ACR_ADDR A:0xf9023014
y.create.l HWIO_APCS_F1_QTMR_V1_CNTVOFF_LO_ADDR A:0xf9023018
y.create.l HWIO_APCS_F1_QTMR_V1_CNTVOFF_HI_ADDR A:0xf902301c
y.create.l HWIO_APCS_F1_QTMR_V1_CNTP_CVAL_LO_ADDR A:0xf9023020
y.create.l HWIO_APCS_F1_QTMR_V1_CNTP_CVAL_HI_ADDR A:0xf9023024
y.create.l HWIO_APCS_F1_QTMR_V1_CNTP_TVAL_ADDR A:0xf9023028
y.create.l HWIO_APCS_F1_QTMR_V1_CNTP_CTL_ADDR A:0xf902302c
y.create.l HWIO_APCS_F1_QTMR_V1_CNTV_CVAL_LO_ADDR A:0xf9023030
y.create.l HWIO_APCS_F1_QTMR_V1_CNTV_CVAL_HI_ADDR A:0xf9023034
y.create.l HWIO_APCS_F1_QTMR_V1_CNTV_TVAL_ADDR A:0xf9023038
y.create.l HWIO_APCS_F1_QTMR_V1_CNTV_CTL_ADDR A:0xf902303c
y.create.l HWIO_APCS_F1_QTMR_V1_VERSION_ADDR A:0xf9023fd0
y.create.l HWIO_APCS_F2_QTMR_V1_CNTPCT_LO_ADDR A:0xf9024000
y.create.l HWIO_APCS_F2_QTMR_V1_CNTPCT_HI_ADDR A:0xf9024004
y.create.l HWIO_APCS_F2_QTMR_V1_CNTVCT_LO_ADDR A:0xf9024008
y.create.l HWIO_APCS_F2_QTMR_V1_CNTVCT_HI_ADDR A:0xf902400c
y.create.l HWIO_APCS_F2_QTMR_V1_CNTFRQ_ADDR A:0xf9024010
y.create.l HWIO_APCS_F2_QTMR_V1_CNTPL0ACR_ADDR A:0xf9024014
y.create.l HWIO_APCS_F2_QTMR_V1_CNTVOFF_LO_ADDR A:0xf9024018
y.create.l HWIO_APCS_F2_QTMR_V1_CNTVOFF_HI_ADDR A:0xf902401c
y.create.l HWIO_APCS_F2_QTMR_V1_CNTP_CVAL_LO_ADDR A:0xf9024020
y.create.l HWIO_APCS_F2_QTMR_V1_CNTP_CVAL_HI_ADDR A:0xf9024024
y.create.l HWIO_APCS_F2_QTMR_V1_CNTP_TVAL_ADDR A:0xf9024028
y.create.l HWIO_APCS_F2_QTMR_V1_CNTP_CTL_ADDR A:0xf902402c
y.create.l HWIO_APCS_F2_QTMR_V1_CNTV_CVAL_LO_ADDR A:0xf9024030
y.create.l HWIO_APCS_F2_QTMR_V1_CNTV_CVAL_HI_ADDR A:0xf9024034
y.create.l HWIO_APCS_F2_QTMR_V1_CNTV_TVAL_ADDR A:0xf9024038
y.create.l HWIO_APCS_F2_QTMR_V1_CNTV_CTL_ADDR A:0xf902403c
y.create.l HWIO_APCS_F2_QTMR_V1_VERSION_ADDR A:0xf9024fd0
y.create.l HWIO_APCS_F3_QTMR_V1_CNTPCT_LO_ADDR A:0xf9025000
y.create.l HWIO_APCS_F3_QTMR_V1_CNTPCT_HI_ADDR A:0xf9025004
y.create.l HWIO_APCS_F3_QTMR_V1_CNTVCT_LO_ADDR A:0xf9025008
y.create.l HWIO_APCS_F3_QTMR_V1_CNTVCT_HI_ADDR A:0xf902500c
y.create.l HWIO_APCS_F3_QTMR_V1_CNTFRQ_ADDR A:0xf9025010
y.create.l HWIO_APCS_F3_QTMR_V1_CNTPL0ACR_ADDR A:0xf9025014
y.create.l HWIO_APCS_F3_QTMR_V1_CNTVOFF_LO_ADDR A:0xf9025018
y.create.l HWIO_APCS_F3_QTMR_V1_CNTVOFF_HI_ADDR A:0xf902501c
y.create.l HWIO_APCS_F3_QTMR_V1_CNTP_CVAL_LO_ADDR A:0xf9025020
y.create.l HWIO_APCS_F3_QTMR_V1_CNTP_CVAL_HI_ADDR A:0xf9025024
y.create.l HWIO_APCS_F3_QTMR_V1_CNTP_TVAL_ADDR A:0xf9025028
y.create.l HWIO_APCS_F3_QTMR_V1_CNTP_CTL_ADDR A:0xf902502c
y.create.l HWIO_APCS_F3_QTMR_V1_CNTV_CVAL_LO_ADDR A:0xf9025030
y.create.l HWIO_APCS_F3_QTMR_V1_CNTV_CVAL_HI_ADDR A:0xf9025034
y.create.l HWIO_APCS_F3_QTMR_V1_CNTV_TVAL_ADDR A:0xf9025038
y.create.l HWIO_APCS_F3_QTMR_V1_CNTV_CTL_ADDR A:0xf902503c
y.create.l HWIO_APCS_F3_QTMR_V1_VERSION_ADDR A:0xf9025fd0
y.create.l HWIO_APCS_F4_QTMR_V1_CNTPCT_LO_ADDR A:0xf9026000
y.create.l HWIO_APCS_F4_QTMR_V1_CNTPCT_HI_ADDR A:0xf9026004
y.create.l HWIO_APCS_F4_QTMR_V1_CNTVCT_LO_ADDR A:0xf9026008
y.create.l HWIO_APCS_F4_QTMR_V1_CNTVCT_HI_ADDR A:0xf902600c
y.create.l HWIO_APCS_F4_QTMR_V1_CNTFRQ_ADDR A:0xf9026010
y.create.l HWIO_APCS_F4_QTMR_V1_CNTPL0ACR_ADDR A:0xf9026014
y.create.l HWIO_APCS_F4_QTMR_V1_CNTVOFF_LO_ADDR A:0xf9026018
y.create.l HWIO_APCS_F4_QTMR_V1_CNTVOFF_HI_ADDR A:0xf902601c
y.create.l HWIO_APCS_F4_QTMR_V1_CNTP_CVAL_LO_ADDR A:0xf9026020
y.create.l HWIO_APCS_F4_QTMR_V1_CNTP_CVAL_HI_ADDR A:0xf9026024
y.create.l HWIO_APCS_F4_QTMR_V1_CNTP_TVAL_ADDR A:0xf9026028
y.create.l HWIO_APCS_F4_QTMR_V1_CNTP_CTL_ADDR A:0xf902602c
y.create.l HWIO_APCS_F4_QTMR_V1_CNTV_CVAL_LO_ADDR A:0xf9026030
y.create.l HWIO_APCS_F4_QTMR_V1_CNTV_CVAL_HI_ADDR A:0xf9026034
y.create.l HWIO_APCS_F4_QTMR_V1_CNTV_TVAL_ADDR A:0xf9026038
y.create.l HWIO_APCS_F4_QTMR_V1_CNTV_CTL_ADDR A:0xf902603c
y.create.l HWIO_APCS_F4_QTMR_V1_VERSION_ADDR A:0xf9026fd0
y.create.l HWIO_APCS_F5_QTMR_V1_CNTPCT_LO_ADDR A:0xf9027000
y.create.l HWIO_APCS_F5_QTMR_V1_CNTPCT_HI_ADDR A:0xf9027004
y.create.l HWIO_APCS_F5_QTMR_V1_CNTVCT_LO_ADDR A:0xf9027008
y.create.l HWIO_APCS_F5_QTMR_V1_CNTVCT_HI_ADDR A:0xf902700c
y.create.l HWIO_APCS_F5_QTMR_V1_CNTFRQ_ADDR A:0xf9027010
y.create.l HWIO_APCS_F5_QTMR_V1_CNTPL0ACR_ADDR A:0xf9027014
y.create.l HWIO_APCS_F5_QTMR_V1_CNTVOFF_LO_ADDR A:0xf9027018
y.create.l HWIO_APCS_F5_QTMR_V1_CNTVOFF_HI_ADDR A:0xf902701c
y.create.l HWIO_APCS_F5_QTMR_V1_CNTP_CVAL_LO_ADDR A:0xf9027020
y.create.l HWIO_APCS_F5_QTMR_V1_CNTP_CVAL_HI_ADDR A:0xf9027024
y.create.l HWIO_APCS_F5_QTMR_V1_CNTP_TVAL_ADDR A:0xf9027028
y.create.l HWIO_APCS_F5_QTMR_V1_CNTP_CTL_ADDR A:0xf902702c
y.create.l HWIO_APCS_F5_QTMR_V1_CNTV_CVAL_LO_ADDR A:0xf9027030
y.create.l HWIO_APCS_F5_QTMR_V1_CNTV_CVAL_HI_ADDR A:0xf9027034
y.create.l HWIO_APCS_F5_QTMR_V1_CNTV_TVAL_ADDR A:0xf9027038
y.create.l HWIO_APCS_F5_QTMR_V1_CNTV_CTL_ADDR A:0xf902703c
y.create.l HWIO_APCS_F5_QTMR_V1_VERSION_ADDR A:0xf9027fd0
y.create.l HWIO_APCS_F6_QTMR_V1_CNTPCT_LO_ADDR A:0xf9028000
y.create.l HWIO_APCS_F6_QTMR_V1_CNTPCT_HI_ADDR A:0xf9028004
y.create.l HWIO_APCS_F6_QTMR_V1_CNTVCT_LO_ADDR A:0xf9028008
y.create.l HWIO_APCS_F6_QTMR_V1_CNTVCT_HI_ADDR A:0xf902800c
y.create.l HWIO_APCS_F6_QTMR_V1_CNTFRQ_ADDR A:0xf9028010
y.create.l HWIO_APCS_F6_QTMR_V1_CNTPL0ACR_ADDR A:0xf9028014
y.create.l HWIO_APCS_F6_QTMR_V1_CNTVOFF_LO_ADDR A:0xf9028018
y.create.l HWIO_APCS_F6_QTMR_V1_CNTVOFF_HI_ADDR A:0xf902801c
y.create.l HWIO_APCS_F6_QTMR_V1_CNTP_CVAL_LO_ADDR A:0xf9028020
y.create.l HWIO_APCS_F6_QTMR_V1_CNTP_CVAL_HI_ADDR A:0xf9028024
y.create.l HWIO_APCS_F6_QTMR_V1_CNTP_TVAL_ADDR A:0xf9028028
y.create.l HWIO_APCS_F6_QTMR_V1_CNTP_CTL_ADDR A:0xf902802c
y.create.l HWIO_APCS_F6_QTMR_V1_CNTV_CVAL_LO_ADDR A:0xf9028030
y.create.l HWIO_APCS_F6_QTMR_V1_CNTV_CVAL_HI_ADDR A:0xf9028034
y.create.l HWIO_APCS_F6_QTMR_V1_CNTV_TVAL_ADDR A:0xf9028038
y.create.l HWIO_APCS_F6_QTMR_V1_CNTV_CTL_ADDR A:0xf902803c
y.create.l HWIO_APCS_F6_QTMR_V1_VERSION_ADDR A:0xf9028fd0
y.create.l HWIO_APCS_F7_QTMR_V1_CNTPCT_LO_ADDR A:0xf9029000
y.create.l HWIO_APCS_F7_QTMR_V1_CNTPCT_HI_ADDR A:0xf9029004
y.create.l HWIO_APCS_F7_QTMR_V1_CNTVCT_LO_ADDR A:0xf9029008
y.create.l HWIO_APCS_F7_QTMR_V1_CNTVCT_HI_ADDR A:0xf902900c
y.create.l HWIO_APCS_F7_QTMR_V1_CNTFRQ_ADDR A:0xf9029010
y.create.l HWIO_APCS_F7_QTMR_V1_CNTPL0ACR_ADDR A:0xf9029014
y.create.l HWIO_APCS_F7_QTMR_V1_CNTVOFF_LO_ADDR A:0xf9029018
y.create.l HWIO_APCS_F7_QTMR_V1_CNTVOFF_HI_ADDR A:0xf902901c
y.create.l HWIO_APCS_F7_QTMR_V1_CNTP_CVAL_LO_ADDR A:0xf9029020
y.create.l HWIO_APCS_F7_QTMR_V1_CNTP_CVAL_HI_ADDR A:0xf9029024
y.create.l HWIO_APCS_F7_QTMR_V1_CNTP_TVAL_ADDR A:0xf9029028
y.create.l HWIO_APCS_F7_QTMR_V1_CNTP_CTL_ADDR A:0xf902902c
y.create.l HWIO_APCS_F7_QTMR_V1_CNTV_CVAL_LO_ADDR A:0xf9029030
y.create.l HWIO_APCS_F7_QTMR_V1_CNTV_CVAL_HI_ADDR A:0xf9029034
y.create.l HWIO_APCS_F7_QTMR_V1_CNTV_TVAL_ADDR A:0xf9029038
y.create.l HWIO_APCS_F7_QTMR_V1_CNTV_CTL_ADDR A:0xf902903c
y.create.l HWIO_APCS_F7_QTMR_V1_VERSION_ADDR A:0xf9029fd0
y.create.l HWIO_WDOG_SECURE_ADDR A:0xf9017000
y.create.l HWIO_WDOG_RESET_ADDR A:0xf9017004
y.create.l HWIO_WDOG_CTL_ADDR A:0xf9017008
y.create.l HWIO_WDOG_STATUS_ADDR A:0xf901700c
y.create.l HWIO_WDOG_BARK_TIME_ADDR A:0xf9017010
y.create.l HWIO_WDOG_BITE_TIME_ADDR A:0xf9017014
y.create.l HWIO_WDOG_TEST_LOAD_STATUS_ADDR A:0xf9017018
y.create.l HWIO_WDOG_TEST_LOAD_ADDR A:0xf901701c
y.create.l HWIO_WDOG_TEST_ADDR A:0xf9017020
y.create.l HWIO_APCS_GLBSECURE_ADDR A:0xf9010000
y.create.l HWIO_APCS_START_ADDR_ADDR A:0xf9010004
y.create.l HWIO_APCS_RCG_CONFIG_ADDR A:0xf9010008
y.create.l HWIO_APCS_RCG_STATUS_ADDR A:0xf901000c
y.create.l HWIO_APCS_CPU_CLK_GATE_CFG_ADDR A:0xf9010010
y.create.l HWIO_APCS_GLB_CLK_GATE_STATUS_ADDR A:0xf9010014
y.create.l HWIO_APCS_GLB_CLKOUTSEL_ADDR A:0xf9010018
y.create.l HWIO_APCS_GLB_CXC_ADDR A:0xf901001c
y.create.l HWIO_APCS_GLB_CFG_ADDR A:0xf9010020
y.create.l HWIO_APCS_GLB_BOOT_REMAP_ADDR A:0xf9010024
y.create.l HWIO_APCS_GLB_TEST_BUSSEL_ADDR A:0xf9010028
y.create.l HWIO_APCS_GLB_EN_PWR_ST_ADDR A:0xf901002c
y.create.l HWIO_APCS_GLB_QSB_LP_ADDR A:0xf9010030
y.create.l HWIO_APCS_GLB_AHB_CLKON_ADDR A:0xf9010034
y.create.l HWIO_APCS_GLB_QGIC_CFG_ADDR A:0xf9010038
y.create.l HWIO_APCS_GLB_GHDS_CNTR_ADDR A:0xf901003c
y.create.l HWIO_APCS_GCCSECURE_ADDR A:0xf9011000
y.create.l HWIO_APCS_IPC_SECURITY_ADDR A:0xf9011004
y.create.l HWIO_APCS_IPC_ADDR A:0xf9011008
y.create.l HWIO_APCS_PWR_CTL_OVERRIDE_ADDR A:0xf901100c
y.create.l HWIO_APCS_GCLK_STS_ADDR A:0xf9011010
y.create.l HWIO_APCS_L2_PWR_CTL_ADDR A:0xf9011014
y.create.l HWIO_APCS_PWR_STS_ADDR A:0xf9011018
y.create.l HWIO_APCS_CLK_DIAG_ADDR A:0xf901101c
y.create.l HWIO_APCS_ALL_TSTBUS_SEL_ADDR A:0xf9011020
y.create.l HWIO_APCS_DBG_PWR_CTL_ADDR A:0xf9011024
y.create.l HWIO_APCS_L2_AUX_CLK_SEL_ADDR A:0xf9011028
y.create.l HWIO_APCS_SPARE_ADDR A:0xf901102c
y.create.l HWIO_APCS_SPARE_STS_ADDR A:0xf9011030
y.create.l HWIO_XPU_STATUS_ADDR A:0xf9011034
y.create.l HWIO_APCS_XPU_SCR_ADDR A:0xf9013000
y.create.l HWIO_APCS_XPU_SWDR_ADDR A:0xf9013004
y.create.l HWIO_APCS_XPU_PRTN_RACR_SSHADOW_ADDR A:0xf9013008
y.create.l HWIO_APCS_XPU_PRTN_START_SSHADOW0_ADDR A:0xf9013010
y.create.l HWIO_APCS_XPU_PRTN_END_SSHADOW0_ADDR A:0xf9013018
y.create.l HWIO_APCS_XPU_SEAR0_ADDR A:0xf9013040
y.create.l HWIO_APCS_XPU_SESR_ADDR A:0xf9013048
y.create.l HWIO_APCS_XPU_SESRRESTORE_ADDR A:0xf901304c
y.create.l HWIO_APCS_XPU_SESYNR0_ADDR A:0xf9013050
y.create.l HWIO_APCS_XPU_SESYNR1_ADDR A:0xf9013054
y.create.l HWIO_APCS_XPU_SESYNR2_ADDR A:0xf9013058
y.create.l HWIO_APCS_XPU_MCR_ADDR A:0xf9013100
y.create.l HWIO_APCS_XPU_MEAR0_ADDR A:0xf9013140
y.create.l HWIO_APCS_XPU_MESR_ADDR A:0xf9013148
y.create.l HWIO_APCS_XPU_MESRRESTORE_ADDR A:0xf901314c
y.create.l HWIO_APCS_XPU_MESYNR0_ADDR A:0xf9013150
y.create.l HWIO_APCS_XPU_MESYNR1_ADDR A:0xf9013154
y.create.l HWIO_APCS_XPU_MESYNR2_ADDR A:0xf9013158
y.create.l HWIO_APCS_XPU_CR_ADDR A:0xf9013080
y.create.l HWIO_APCS_XPU_PRTN_RACR_SHADOW_ADDR A:0xf9013088
y.create.l HWIO_APCS_XPU_PRTN_START_SHADOW0_ADDR A:0xf9013090
y.create.l HWIO_APCS_XPU_PRTN_END_SHADOW0_ADDR A:0xf9013098
y.create.l HWIO_APCS_XPU_RPU_ACR0_ADDR A:0xf90130a0
y.create.l HWIO_APCS_XPU_EAR0_ADDR A:0xf90130c0
y.create.l HWIO_APCS_XPU_ESR_ADDR A:0xf90130c8
y.create.l HWIO_APCS_XPU_ESRRESTORE_ADDR A:0xf90130cc
y.create.l HWIO_APCS_XPU_ESYNR0_ADDR A:0xf90130d0
y.create.l HWIO_APCS_XPU_ESYNR1_ADDR A:0xf90130d4
y.create.l HWIO_APCS_XPU_ESYNR2_ADDR A:0xf90130d8
y.create.l HWIO_APCS_XPU_UMR_RACR_ADDR A:0xf90130e0
y.create.l HWIO_APCS_XPU_UMR_WACR_ADDR A:0xf90130e4
y.create.l HWIO_APCS_XPU_IDR0_ADDR A:0xf9013074
y.create.l HWIO_APCS_XPU_IDR1_ADDR A:0xf9013078
y.create.l HWIO_APCS_XPU_REV_ADDR A:0xf901307c
y.create.l HWIO_APCS_XPU_PRT0_RACR0_ADDR A:0xf9013200
y.create.l HWIO_APCS_XPU_PRT1_RACR0_ADDR A:0xf9013280
y.create.l HWIO_APCS_XPU_PRT2_RACR0_ADDR A:0xf9013300
y.create.l HWIO_APCS_XPU_PRT3_RACR0_ADDR A:0xf9013380
y.create.l HWIO_APCS_XPU_PRT4_RACR0_ADDR A:0xf9013400
y.create.l HWIO_APCS_XPU_PRT5_RACR0_ADDR A:0xf9013480
y.create.l HWIO_APCS_XPU_PRT6_RACR0_ADDR A:0xf9013500
y.create.l HWIO_APCS_XPU_PRT7_RACR0_ADDR A:0xf9013580
y.create.l HWIO_APCS_XPU_PRT8_RACR0_ADDR A:0xf9013600
y.create.l HWIO_APCS_XPU_PRT9_RACR0_ADDR A:0xf9013680
y.create.l HWIO_APCS_XPU_PRT0_START0_ADDR A:0xf9013240
y.create.l HWIO_APCS_XPU_PRT1_START0_ADDR A:0xf90132c0
y.create.l HWIO_APCS_XPU_PRT2_START0_ADDR A:0xf9013340
y.create.l HWIO_APCS_XPU_PRT3_START0_ADDR A:0xf90133c0
y.create.l HWIO_APCS_XPU_PRT4_START0_ADDR A:0xf9013440
y.create.l HWIO_APCS_XPU_PRT5_START0_ADDR A:0xf90134c0
y.create.l HWIO_APCS_XPU_PRT6_START0_ADDR A:0xf9013540
y.create.l HWIO_APCS_XPU_PRT7_START0_ADDR A:0xf90135c0
y.create.l HWIO_APCS_XPU_PRT8_START0_ADDR A:0xf9013640
y.create.l HWIO_APCS_XPU_PRT9_START0_ADDR A:0xf90136c0
y.create.l HWIO_APCS_XPU_PRT0_END0_ADDR A:0xf9013248
y.create.l HWIO_APCS_XPU_PRT1_END0_ADDR A:0xf90132c8
y.create.l HWIO_APCS_XPU_PRT2_END0_ADDR A:0xf9013348
y.create.l HWIO_APCS_XPU_PRT3_END0_ADDR A:0xf90133c8
y.create.l HWIO_APCS_XPU_PRT4_END0_ADDR A:0xf9013448
y.create.l HWIO_APCS_XPU_PRT5_END0_ADDR A:0xf90134c8
y.create.l HWIO_APCS_XPU_PRT6_END0_ADDR A:0xf9013548
y.create.l HWIO_APCS_XPU_PRT7_END0_ADDR A:0xf90135c8
y.create.l HWIO_APCS_XPU_PRT8_END0_ADDR A:0xf9013648
y.create.l HWIO_APCS_XPU_PRT9_END0_ADDR A:0xf90136c8
y.create.l HWIO_APCS_XPU_PRT0_SCR_ADDR A:0xf9013250
y.create.l HWIO_APCS_XPU_PRT1_SCR_ADDR A:0xf90132d0
y.create.l HWIO_APCS_XPU_PRT2_SCR_ADDR A:0xf9013350
y.create.l HWIO_APCS_XPU_PRT3_SCR_ADDR A:0xf90133d0
y.create.l HWIO_APCS_XPU_PRT4_SCR_ADDR A:0xf9013450
y.create.l HWIO_APCS_XPU_PRT5_SCR_ADDR A:0xf90134d0
y.create.l HWIO_APCS_XPU_PRT6_SCR_ADDR A:0xf9013550
y.create.l HWIO_APCS_XPU_PRT7_SCR_ADDR A:0xf90135d0
y.create.l HWIO_APCS_XPU_PRT8_SCR_ADDR A:0xf9013650
y.create.l HWIO_APCS_XPU_PRT9_SCR_ADDR A:0xf90136d0
y.create.l HWIO_APCS_XPU_PRT0_MCR_ADDR A:0xf9013254
y.create.l HWIO_APCS_XPU_PRT1_MCR_ADDR A:0xf90132d4
y.create.l HWIO_APCS_XPU_PRT2_MCR_ADDR A:0xf9013354
y.create.l HWIO_APCS_XPU_PRT3_MCR_ADDR A:0xf90133d4
y.create.l HWIO_APCS_XPU_PRT4_MCR_ADDR A:0xf9013454
y.create.l HWIO_APCS_XPU_PRT5_MCR_ADDR A:0xf90134d4
y.create.l HWIO_APCS_XPU_PRT6_MCR_ADDR A:0xf9013554
y.create.l HWIO_APCS_XPU_PRT7_MCR_ADDR A:0xf90135d4
y.create.l HWIO_APCS_XPU_PRT8_MCR_ADDR A:0xf9013654
y.create.l HWIO_APCS_XPU_PRT9_MCR_ADDR A:0xf90136d4
y.create.l HWIO_APCS_XPU_PRT0_TRANS_COMM_ADDR A:0xf901325c
y.create.l HWIO_APCS_XPU_PRT1_TRANS_COMM_ADDR A:0xf90132dc
y.create.l HWIO_APCS_XPU_PRT2_TRANS_COMM_ADDR A:0xf901335c
y.create.l HWIO_APCS_XPU_PRT3_TRANS_COMM_ADDR A:0xf90133dc
y.create.l HWIO_APCS_XPU_PRT4_TRANS_COMM_ADDR A:0xf901345c
y.create.l HWIO_APCS_XPU_PRT5_TRANS_COMM_ADDR A:0xf90134dc
y.create.l HWIO_APCS_XPU_PRT6_TRANS_COMM_ADDR A:0xf901355c
y.create.l HWIO_APCS_XPU_PRT7_TRANS_COMM_ADDR A:0xf90135dc
y.create.l HWIO_APCS_XPU_PRT8_TRANS_COMM_ADDR A:0xf901365c
y.create.l HWIO_APCS_XPU_PRT9_TRANS_COMM_ADDR A:0xf90136dc
y.create.l HWIO_APCS_VMIDMT_SCR0_ADDR A:0xf902a000
y.create.l HWIO_APCS_VMIDMT_SCR1_ADDR A:0xf902a004
y.create.l HWIO_APCS_VMIDMT_SCR2_ADDR A:0xf902a008
y.create.l HWIO_APCS_VMIDMT_SACR_ADDR A:0xf902a010
y.create.l HWIO_APCS_VMIDMT_SIDR0_ADDR A:0xf902a020
y.create.l HWIO_APCS_VMIDMT_SIDR1_ADDR A:0xf902a024
y.create.l HWIO_APCS_VMIDMT_SIDR2_ADDR A:0xf902a028
y.create.l HWIO_APCS_VMIDMT_SIDR4_ADDR A:0xf902a030
y.create.l HWIO_APCS_VMIDMT_SIDR5_ADDR A:0xf902a034
y.create.l HWIO_APCS_VMIDMT_SIDR7_ADDR A:0xf902a03c
y.create.l HWIO_APCS_VMIDMT_SGFAR0_ADDR A:0xf902a040
y.create.l HWIO_APCS_VMIDMT_SGFSR_ADDR A:0xf902a048
y.create.l HWIO_APCS_VMIDMT_SGFSRRESTORE_ADDR A:0xf902a04c
y.create.l HWIO_APCS_VMIDMT_SGFSYNDR0_ADDR A:0xf902a050
y.create.l HWIO_APCS_VMIDMT_SGFSYNDR1_ADDR A:0xf902a054
y.create.l HWIO_APCS_VMIDMT_SGFSYNDR2_ADDR A:0xf902a058
y.create.l HWIO_APCS_VMIDMT_VMIDMTSCR0_ADDR A:0xf902a090
y.create.l HWIO_APCS_VMIDMT_CR0_ADDR A:0xf902a000
y.create.l HWIO_APCS_VMIDMT_CR2_ADDR A:0xf902a008
y.create.l HWIO_APCS_VMIDMT_ACR_ADDR A:0xf902a010
y.create.l HWIO_APCS_VMIDMT_IDR0_ADDR A:0xf902a020
y.create.l HWIO_APCS_VMIDMT_IDR1_ADDR A:0xf902a024
y.create.l HWIO_APCS_VMIDMT_IDR2_ADDR A:0xf902a028
y.create.l HWIO_APCS_VMIDMT_IDR4_ADDR A:0xf902a030
y.create.l HWIO_APCS_VMIDMT_IDR5_ADDR A:0xf902a034
y.create.l HWIO_APCS_VMIDMT_IDR7_ADDR A:0xf902a03c
y.create.l HWIO_APCS_VMIDMT_GFAR0_ADDR A:0xf902a040
y.create.l HWIO_APCS_VMIDMT_GFSR_ADDR A:0xf902a048
y.create.l HWIO_APCS_VMIDMT_GFSRRESTORE_ADDR A:0xf902a04c
y.create.l HWIO_APCS_VMIDMT_GFSYNDR0_ADDR A:0xf902a050
y.create.l HWIO_APCS_VMIDMT_GFSYNDR1_ADDR A:0xf902a054
y.create.l HWIO_APCS_VMIDMT_GFSYNDR2_ADDR A:0xf902a058
y.create.l HWIO_APCS_VMIDMT_VMIDMTCR0_ADDR A:0xf902a090
y.create.l HWIO_APCS_VMIDMT_VMIDMTACR_ADDR A:0xf902a09c
y.create.l HWIO_APCS_VMIDMT_NSCR0_ADDR A:0xf902a400
y.create.l HWIO_APCS_VMIDMT_NSCR2_ADDR A:0xf902a408
y.create.l HWIO_APCS_VMIDMT_NSACR_ADDR A:0xf902a410
y.create.l HWIO_APCS_VMIDMT_NSGFAR0_ADDR A:0xf902a440
y.create.l HWIO_APCS_VMIDMT_NSGFSR_ADDR A:0xf902a448
y.create.l HWIO_APCS_VMIDMT_NSGFSRRESTORE_ADDR A:0xf902a44c
y.create.l HWIO_APCS_VMIDMT_NSGFSYNDR0_ADDR A:0xf902a450
y.create.l HWIO_APCS_VMIDMT_NSGFSYNDR1_ADDR A:0xf902a454
y.create.l HWIO_APCS_VMIDMT_NSGFSYNDR2_ADDR A:0xf902a458
y.create.l HWIO_APCS_VMIDMT_NSVMIDMTCR0_ADDR A:0xf902a490
y.create.l HWIO_APCS_VMIDMT_SSDR0_ADDR A:0xf902a080
y.create.l HWIO_APCS_VMIDMT_S2VR0_ADDR A:0xf902ac00
y.create.l HWIO_APCS_VMIDMT_S2VR1_ADDR A:0xf902ac04
y.create.l HWIO_APCS_VMIDMT_AS2VR0_ADDR A:0xf902ae00
y.create.l HWIO_APCS_VMIDMT_AS2VR1_ADDR A:0xf902ae04
y.create.l HWIO_L2CC_EMMC_ADDR A:0xf9030000
y.create.l HWIO_L2CC_EMCS_ADDR A:0xf9030004
y.create.l HWIO_L2CC_EMCC0_ADDR A:0xf9030100
y.create.l HWIO_L2CC_EMCC1_ADDR A:0xf9030104
y.create.l HWIO_L2CC_EMCC2_ADDR A:0xf9030108
y.create.l HWIO_L2CC_EMCC3_ADDR A:0xf903010c
y.create.l HWIO_L2CC_EMC0_ADDR A:0xf9030200
y.create.l HWIO_L2CC_EMC1_ADDR A:0xf9030204
y.create.l HWIO_L2CC_EMC2_ADDR A:0xf9030208
y.create.l HWIO_L2CC_EMC3_ADDR A:0xf903020c
y.create.l HWIO_L2CC_CACHE_ID_ADDR A:0xf9040000
y.create.l HWIO_L2CC_CACHE_TYPE_ADDR A:0xf9040004
y.create.l HWIO_L2CC_CONTROL_ADDR A:0xf9040100
y.create.l HWIO_L2CC_AUX_CONTROL_ADDR A:0xf9040104
y.create.l HWIO_L2CC_TAG_RAM_CONTROL_ADDR A:0xf9040108
y.create.l HWIO_L2CC_DATA_RAM_CONTROL_ADDR A:0xf904010c
y.create.l HWIO_L2CC_EV_COUNTER_CTRL_ADDR A:0xf9040200
y.create.l HWIO_L2CC_EV_COUNTER1_CFG_ADDR A:0xf9040204
y.create.l HWIO_L2CC_EV_COUNTER0_CFG_ADDR A:0xf9040208
y.create.l HWIO_L2CC_EV_COUNTER1_ADDR A:0xf904020c
y.create.l HWIO_L2CC_EV_COUNTER0_ADDR A:0xf9040210
y.create.l HWIO_L2CC_INT_MASK_ADDR A:0xf9040214
y.create.l HWIO_L2CC_INT_MASK_STATUS_ADDR A:0xf9040218
y.create.l HWIO_L2CC_INT_RAW_STATUS_ADDR A:0xf904021c
y.create.l HWIO_L2CC_INT_CLEAR_ADDR A:0xf9040220
y.create.l HWIO_L2CC_CACHE_SYNC_ADDR A:0xf9040730
y.create.l HWIO_L2CC_INV_PA_ADDR A:0xf9040770
y.create.l HWIO_L2CC_CLEAN_PA_ADDR A:0xf90407b0
y.create.l HWIO_L2CC_CLEAN_INV_PA_ADDR A:0xf90407f0
y.create.l HWIO_L2CC_CLEAN_IW_ADDR A:0xf90407b8
y.create.l HWIO_L2CC_CLEAN_INV_IW_ADDR A:0xf90407f8
y.create.l HWIO_L2CC_INV_WAY_ADDR A:0xf904077c
y.create.l HWIO_L2CC_CLEAN_WAY_ADDR A:0xf90407bc
y.create.l HWIO_L2CC_CLEAN_INV_WAY_ADDR A:0xf90407fc
y.create.l HWIO_L2CC_DATALOCKDOWN0_ADDR A:0xf9040900
y.create.l HWIO_L2CC_INSRUCTION_LOCKDOWN0_ADDR A:0xf9040904
y.create.l HWIO_L2CC_DATALOCKDOWN1_ADDR A:0xf9040908
y.create.l HWIO_L2CC_INSRUCTION_LOCKDOWN1_ADDR A:0xf904090c
y.create.l HWIO_L2CC_DATALOCKDOWN2_ADDR A:0xf9040910
y.create.l HWIO_L2CC_INSRUCTION_LOCKDOWN2_ADDR A:0xf9040914
y.create.l HWIO_L2CC_DATALOCKDOWN3_ADDR A:0xf9040918
y.create.l HWIO_L2CC_INSRUCTION_LOCKDOWN3_ADDR A:0xf904091c
y.create.l HWIO_L2CC_DATALOCKDOWN4_ADDR A:0xf9040920
y.create.l HWIO_L2CC_INSRUCTION_LOCKDOWN4_ADDR A:0xf9040924
y.create.l HWIO_L2CC_DATALOCKDOWN5_ADDR A:0xf9040928
y.create.l HWIO_L2CC_INSRUCTION_LOCKDOWN5_ADDR A:0xf904092c
y.create.l HWIO_L2CC_DATALOCKDOWN6_ADDR A:0xf9040930
y.create.l HWIO_L2CC_INSRUCTION_LOCKDOWN6_ADDR A:0xf9040934
y.create.l HWIO_L2CC_DATALOCKDOWN7_ADDR A:0xf9040938
y.create.l HWIO_L2CC_INSRUCTION_LOCKDOWN7_ADDR A:0xf904093c
y.create.l HWIO_L2CC_LOCK_LINE_EN_ADDR A:0xf9040950
y.create.l HWIO_L2CC_UNLOCK_WAY_ADDR A:0xf9040954
y.create.l HWIO_L2CC_ADDR_FILTERING_END_ADDR A:0xf9040c04
y.create.l HWIO_L2CC_DBG_CTL_ADDR A:0xf9040f40
y.create.l HWIO_L2CC_PREFETCH_CTRL_ADDR A:0xf9040f60
y.create.l HWIO_L2CC_POWER_CTRL_ADDR A:0xf9040f80
y.create.l HWIO_BAM_CTRL_ADDR A:0xfd4c4000
y.create.l HWIO_BAM_REVISION_ADDR A:0xfd4c4004
y.create.l HWIO_BAM_SW_VERSION_ADDR A:0xfd4c4080
y.create.l HWIO_BAM_NUM_PIPES_ADDR A:0xfd4c403c
y.create.l HWIO_BAM_TIMER_ADDR A:0xfd4c4040
y.create.l HWIO_BAM_TIMER_CTRL_ADDR A:0xfd4c4044
y.create.l HWIO_BAM_DESC_CNT_TRSHLD_ADDR A:0xfd4c4008
y.create.l HWIO_BAM_IRQ_SRCS_ADDR A:0xfd4c400c
y.create.l HWIO_BAM_IRQ_SRCS_MSK_ADDR A:0xfd4c4010
y.create.l HWIO_BAM_IRQ_SRCS_UNMASKED_ADDR A:0xfd4c4030
y.create.l HWIO_BAM_IRQ_STTS_ADDR A:0xfd4c4014
y.create.l HWIO_BAM_IRQ_CLR_ADDR A:0xfd4c4018
y.create.l HWIO_BAM_IRQ_EN_ADDR A:0xfd4c401c
y.create.l HWIO_BAM_AHB_MASTER_ERR_CTRLS_ADDR A:0xfd4c4024
y.create.l HWIO_BAM_AHB_MASTER_ERR_ADDR_ADDR A:0xfd4c4028
y.create.l HWIO_BAM_AHB_MASTER_ERR_DATA_ADDR A:0xfd4c402c
y.create.l HWIO_BAM_TRUST_REG_ADDR A:0xfd4c4070
y.create.l HWIO_BAM_TEST_BUS_SEL_ADDR A:0xfd4c4074
y.create.l HWIO_BAM_TEST_BUS_REG_ADDR A:0xfd4c4078
y.create.l HWIO_BAM_CNFG_BITS_ADDR A:0xfd4c407c
y.create.l HWIO_BAM_IRQ_SRCS_EE0_ADDR A:0xfd4c4800
y.create.l HWIO_BAM_IRQ_SRCS_EE1_ADDR A:0xfd4c4880
y.create.l HWIO_BAM_IRQ_SRCS_EE2_ADDR A:0xfd4c4900
y.create.l HWIO_BAM_IRQ_SRCS_EE3_ADDR A:0xfd4c4980
y.create.l HWIO_BAM_IRQ_SRCS_EE4_ADDR A:0xfd4c4a00
y.create.l HWIO_BAM_IRQ_SRCS_EE5_ADDR A:0xfd4c4a80
y.create.l HWIO_BAM_IRQ_SRCS_EE6_ADDR A:0xfd4c4b00
y.create.l HWIO_BAM_IRQ_SRCS_EE7_ADDR A:0xfd4c4b80
y.create.l HWIO_BAM_IRQ_SRCS_MSK_EE0_ADDR A:0xfd4c4804
y.create.l HWIO_BAM_IRQ_SRCS_MSK_EE1_ADDR A:0xfd4c4884
y.create.l HWIO_BAM_IRQ_SRCS_MSK_EE2_ADDR A:0xfd4c4904
y.create.l HWIO_BAM_IRQ_SRCS_MSK_EE3_ADDR A:0xfd4c4984
y.create.l HWIO_BAM_IRQ_SRCS_MSK_EE4_ADDR A:0xfd4c4a04
y.create.l HWIO_BAM_IRQ_SRCS_MSK_EE5_ADDR A:0xfd4c4a84
y.create.l HWIO_BAM_IRQ_SRCS_MSK_EE6_ADDR A:0xfd4c4b04
y.create.l HWIO_BAM_IRQ_SRCS_MSK_EE7_ADDR A:0xfd4c4b84
y.create.l HWIO_BAM_IRQ_SRCS_UNMASKED_EE0_ADDR A:0xfd4c4808
y.create.l HWIO_BAM_IRQ_SRCS_UNMASKED_EE1_ADDR A:0xfd4c4888
y.create.l HWIO_BAM_IRQ_SRCS_UNMASKED_EE2_ADDR A:0xfd4c4908
y.create.l HWIO_BAM_IRQ_SRCS_UNMASKED_EE3_ADDR A:0xfd4c4988
y.create.l HWIO_BAM_IRQ_SRCS_UNMASKED_EE4_ADDR A:0xfd4c4a08
y.create.l HWIO_BAM_IRQ_SRCS_UNMASKED_EE5_ADDR A:0xfd4c4a88
y.create.l HWIO_BAM_IRQ_SRCS_UNMASKED_EE6_ADDR A:0xfd4c4b08
y.create.l HWIO_BAM_IRQ_SRCS_UNMASKED_EE7_ADDR A:0xfd4c4b88
y.create.l HWIO_BAM_P_CTRL0_ADDR A:0xfd4c5000
y.create.l HWIO_BAM_P_CTRL1_ADDR A:0xfd4c6000
y.create.l HWIO_BAM_P_CTRL2_ADDR A:0xfd4c7000
y.create.l HWIO_BAM_P_CTRL3_ADDR A:0xfd4c8000
y.create.l HWIO_BAM_P_CTRL4_ADDR A:0xfd4c9000
y.create.l HWIO_BAM_P_CTRL5_ADDR A:0xfd4ca000
y.create.l HWIO_BAM_P_CTRL6_ADDR A:0xfd4cb000
y.create.l HWIO_BAM_P_CTRL7_ADDR A:0xfd4cc000
y.create.l HWIO_BAM_P_CTRL8_ADDR A:0xfd4cd000
y.create.l HWIO_BAM_P_CTRL9_ADDR A:0xfd4ce000
y.create.l HWIO_BAM_P_RST0_ADDR A:0xfd4c5004
y.create.l HWIO_BAM_P_RST1_ADDR A:0xfd4c6004
y.create.l HWIO_BAM_P_RST2_ADDR A:0xfd4c7004
y.create.l HWIO_BAM_P_RST3_ADDR A:0xfd4c8004
y.create.l HWIO_BAM_P_RST4_ADDR A:0xfd4c9004
y.create.l HWIO_BAM_P_RST5_ADDR A:0xfd4ca004
y.create.l HWIO_BAM_P_RST6_ADDR A:0xfd4cb004
y.create.l HWIO_BAM_P_RST7_ADDR A:0xfd4cc004
y.create.l HWIO_BAM_P_RST8_ADDR A:0xfd4cd004
y.create.l HWIO_BAM_P_RST9_ADDR A:0xfd4ce004
y.create.l HWIO_BAM_P_HALT0_ADDR A:0xfd4c5008
y.create.l HWIO_BAM_P_HALT1_ADDR A:0xfd4c6008
y.create.l HWIO_BAM_P_HALT2_ADDR A:0xfd4c7008
y.create.l HWIO_BAM_P_HALT3_ADDR A:0xfd4c8008
y.create.l HWIO_BAM_P_HALT4_ADDR A:0xfd4c9008
y.create.l HWIO_BAM_P_HALT5_ADDR A:0xfd4ca008
y.create.l HWIO_BAM_P_HALT6_ADDR A:0xfd4cb008
y.create.l HWIO_BAM_P_HALT7_ADDR A:0xfd4cc008
y.create.l HWIO_BAM_P_HALT8_ADDR A:0xfd4cd008
y.create.l HWIO_BAM_P_HALT9_ADDR A:0xfd4ce008
y.create.l HWIO_BAM_P_TRUST_REG0_ADDR A:0xfd4c5030
y.create.l HWIO_BAM_P_TRUST_REG1_ADDR A:0xfd4c6030
y.create.l HWIO_BAM_P_TRUST_REG2_ADDR A:0xfd4c7030
y.create.l HWIO_BAM_P_TRUST_REG3_ADDR A:0xfd4c8030
y.create.l HWIO_BAM_P_TRUST_REG4_ADDR A:0xfd4c9030
y.create.l HWIO_BAM_P_TRUST_REG5_ADDR A:0xfd4ca030
y.create.l HWIO_BAM_P_TRUST_REG6_ADDR A:0xfd4cb030
y.create.l HWIO_BAM_P_TRUST_REG7_ADDR A:0xfd4cc030
y.create.l HWIO_BAM_P_TRUST_REG8_ADDR A:0xfd4cd030
y.create.l HWIO_BAM_P_TRUST_REG9_ADDR A:0xfd4ce030
y.create.l HWIO_BAM_P_IRQ_STTS0_ADDR A:0xfd4c5010
y.create.l HWIO_BAM_P_IRQ_STTS1_ADDR A:0xfd4c6010
y.create.l HWIO_BAM_P_IRQ_STTS2_ADDR A:0xfd4c7010
y.create.l HWIO_BAM_P_IRQ_STTS3_ADDR A:0xfd4c8010
y.create.l HWIO_BAM_P_IRQ_STTS4_ADDR A:0xfd4c9010
y.create.l HWIO_BAM_P_IRQ_STTS5_ADDR A:0xfd4ca010
y.create.l HWIO_BAM_P_IRQ_STTS6_ADDR A:0xfd4cb010
y.create.l HWIO_BAM_P_IRQ_STTS7_ADDR A:0xfd4cc010
y.create.l HWIO_BAM_P_IRQ_STTS8_ADDR A:0xfd4cd010
y.create.l HWIO_BAM_P_IRQ_STTS9_ADDR A:0xfd4ce010
y.create.l HWIO_BAM_P_IRQ_CLR0_ADDR A:0xfd4c5014
y.create.l HWIO_BAM_P_IRQ_CLR1_ADDR A:0xfd4c6014
y.create.l HWIO_BAM_P_IRQ_CLR2_ADDR A:0xfd4c7014
y.create.l HWIO_BAM_P_IRQ_CLR3_ADDR A:0xfd4c8014
y.create.l HWIO_BAM_P_IRQ_CLR4_ADDR A:0xfd4c9014
y.create.l HWIO_BAM_P_IRQ_CLR5_ADDR A:0xfd4ca014
y.create.l HWIO_BAM_P_IRQ_CLR6_ADDR A:0xfd4cb014
y.create.l HWIO_BAM_P_IRQ_CLR7_ADDR A:0xfd4cc014
y.create.l HWIO_BAM_P_IRQ_CLR8_ADDR A:0xfd4cd014
y.create.l HWIO_BAM_P_IRQ_CLR9_ADDR A:0xfd4ce014
y.create.l HWIO_BAM_P_IRQ_EN0_ADDR A:0xfd4c5018
y.create.l HWIO_BAM_P_IRQ_EN1_ADDR A:0xfd4c6018
y.create.l HWIO_BAM_P_IRQ_EN2_ADDR A:0xfd4c7018
y.create.l HWIO_BAM_P_IRQ_EN3_ADDR A:0xfd4c8018
y.create.l HWIO_BAM_P_IRQ_EN4_ADDR A:0xfd4c9018
y.create.l HWIO_BAM_P_IRQ_EN5_ADDR A:0xfd4ca018
y.create.l HWIO_BAM_P_IRQ_EN6_ADDR A:0xfd4cb018
y.create.l HWIO_BAM_P_IRQ_EN7_ADDR A:0xfd4cc018
y.create.l HWIO_BAM_P_IRQ_EN8_ADDR A:0xfd4cd018
y.create.l HWIO_BAM_P_IRQ_EN9_ADDR A:0xfd4ce018
y.create.l HWIO_BAM_P_TIMER0_ADDR A:0xfd4c501c
y.create.l HWIO_BAM_P_TIMER1_ADDR A:0xfd4c601c
y.create.l HWIO_BAM_P_TIMER2_ADDR A:0xfd4c701c
y.create.l HWIO_BAM_P_TIMER3_ADDR A:0xfd4c801c
y.create.l HWIO_BAM_P_TIMER4_ADDR A:0xfd4c901c
y.create.l HWIO_BAM_P_TIMER5_ADDR A:0xfd4ca01c
y.create.l HWIO_BAM_P_TIMER6_ADDR A:0xfd4cb01c
y.create.l HWIO_BAM_P_TIMER7_ADDR A:0xfd4cc01c
y.create.l HWIO_BAM_P_TIMER8_ADDR A:0xfd4cd01c
y.create.l HWIO_BAM_P_TIMER9_ADDR A:0xfd4ce01c
y.create.l HWIO_BAM_P_TIMER_CTRL0_ADDR A:0xfd4c5020
y.create.l HWIO_BAM_P_TIMER_CTRL1_ADDR A:0xfd4c6020
y.create.l HWIO_BAM_P_TIMER_CTRL2_ADDR A:0xfd4c7020
y.create.l HWIO_BAM_P_TIMER_CTRL3_ADDR A:0xfd4c8020
y.create.l HWIO_BAM_P_TIMER_CTRL4_ADDR A:0xfd4c9020
y.create.l HWIO_BAM_P_TIMER_CTRL5_ADDR A:0xfd4ca020
y.create.l HWIO_BAM_P_TIMER_CTRL6_ADDR A:0xfd4cb020
y.create.l HWIO_BAM_P_TIMER_CTRL7_ADDR A:0xfd4cc020
y.create.l HWIO_BAM_P_TIMER_CTRL8_ADDR A:0xfd4cd020
y.create.l HWIO_BAM_P_TIMER_CTRL9_ADDR A:0xfd4ce020
y.create.l HWIO_BAM_P_PRDCR_SDBND0_ADDR A:0xfd4c5024
y.create.l HWIO_BAM_P_PRDCR_SDBND1_ADDR A:0xfd4c6024
y.create.l HWIO_BAM_P_PRDCR_SDBND2_ADDR A:0xfd4c7024
y.create.l HWIO_BAM_P_PRDCR_SDBND3_ADDR A:0xfd4c8024
y.create.l HWIO_BAM_P_PRDCR_SDBND4_ADDR A:0xfd4c9024
y.create.l HWIO_BAM_P_PRDCR_SDBND5_ADDR A:0xfd4ca024
y.create.l HWIO_BAM_P_PRDCR_SDBND6_ADDR A:0xfd4cb024
y.create.l HWIO_BAM_P_PRDCR_SDBND7_ADDR A:0xfd4cc024
y.create.l HWIO_BAM_P_PRDCR_SDBND8_ADDR A:0xfd4cd024
y.create.l HWIO_BAM_P_PRDCR_SDBND9_ADDR A:0xfd4ce024
y.create.l HWIO_BAM_P_CNSMR_SDBND0_ADDR A:0xfd4c5028
y.create.l HWIO_BAM_P_CNSMR_SDBND1_ADDR A:0xfd4c6028
y.create.l HWIO_BAM_P_CNSMR_SDBND2_ADDR A:0xfd4c7028
y.create.l HWIO_BAM_P_CNSMR_SDBND3_ADDR A:0xfd4c8028
y.create.l HWIO_BAM_P_CNSMR_SDBND4_ADDR A:0xfd4c9028
y.create.l HWIO_BAM_P_CNSMR_SDBND5_ADDR A:0xfd4ca028
y.create.l HWIO_BAM_P_CNSMR_SDBND6_ADDR A:0xfd4cb028
y.create.l HWIO_BAM_P_CNSMR_SDBND7_ADDR A:0xfd4cc028
y.create.l HWIO_BAM_P_CNSMR_SDBND8_ADDR A:0xfd4cd028
y.create.l HWIO_BAM_P_CNSMR_SDBND9_ADDR A:0xfd4ce028
y.create.l HWIO_BAM_P_EVNT_DEST_ADDR0_ADDR A:0xfd4c582c
y.create.l HWIO_BAM_P_EVNT_DEST_ADDR1_ADDR A:0xfd4c682c
y.create.l HWIO_BAM_P_EVNT_DEST_ADDR2_ADDR A:0xfd4c782c
y.create.l HWIO_BAM_P_EVNT_DEST_ADDR3_ADDR A:0xfd4c882c
y.create.l HWIO_BAM_P_EVNT_DEST_ADDR4_ADDR A:0xfd4c982c
y.create.l HWIO_BAM_P_EVNT_DEST_ADDR5_ADDR A:0xfd4ca82c
y.create.l HWIO_BAM_P_EVNT_DEST_ADDR6_ADDR A:0xfd4cb82c
y.create.l HWIO_BAM_P_EVNT_DEST_ADDR7_ADDR A:0xfd4cc82c
y.create.l HWIO_BAM_P_EVNT_DEST_ADDR8_ADDR A:0xfd4cd82c
y.create.l HWIO_BAM_P_EVNT_DEST_ADDR9_ADDR A:0xfd4ce82c
y.create.l HWIO_BAM_P_EVNT_REG0_ADDR A:0xfd4c5818
y.create.l HWIO_BAM_P_EVNT_REG1_ADDR A:0xfd4c6818
y.create.l HWIO_BAM_P_EVNT_REG2_ADDR A:0xfd4c7818
y.create.l HWIO_BAM_P_EVNT_REG3_ADDR A:0xfd4c8818
y.create.l HWIO_BAM_P_EVNT_REG4_ADDR A:0xfd4c9818
y.create.l HWIO_BAM_P_EVNT_REG5_ADDR A:0xfd4ca818
y.create.l HWIO_BAM_P_EVNT_REG6_ADDR A:0xfd4cb818
y.create.l HWIO_BAM_P_EVNT_REG7_ADDR A:0xfd4cc818
y.create.l HWIO_BAM_P_EVNT_REG8_ADDR A:0xfd4cd818
y.create.l HWIO_BAM_P_EVNT_REG9_ADDR A:0xfd4ce818
y.create.l HWIO_BAM_P_SW_OFSTS0_ADDR A:0xfd4c5800
y.create.l HWIO_BAM_P_SW_OFSTS1_ADDR A:0xfd4c6800
y.create.l HWIO_BAM_P_SW_OFSTS2_ADDR A:0xfd4c7800
y.create.l HWIO_BAM_P_SW_OFSTS3_ADDR A:0xfd4c8800
y.create.l HWIO_BAM_P_SW_OFSTS4_ADDR A:0xfd4c9800
y.create.l HWIO_BAM_P_SW_OFSTS5_ADDR A:0xfd4ca800
y.create.l HWIO_BAM_P_SW_OFSTS6_ADDR A:0xfd4cb800
y.create.l HWIO_BAM_P_SW_OFSTS7_ADDR A:0xfd4cc800
y.create.l HWIO_BAM_P_SW_OFSTS8_ADDR A:0xfd4cd800
y.create.l HWIO_BAM_P_SW_OFSTS9_ADDR A:0xfd4ce800
y.create.l HWIO_BAM_P_DATA_FIFO_ADDR0_ADDR A:0xfd4c5824
y.create.l HWIO_BAM_P_DATA_FIFO_ADDR1_ADDR A:0xfd4c6824
y.create.l HWIO_BAM_P_DATA_FIFO_ADDR2_ADDR A:0xfd4c7824
y.create.l HWIO_BAM_P_DATA_FIFO_ADDR3_ADDR A:0xfd4c8824
y.create.l HWIO_BAM_P_DATA_FIFO_ADDR4_ADDR A:0xfd4c9824
y.create.l HWIO_BAM_P_DATA_FIFO_ADDR5_ADDR A:0xfd4ca824
y.create.l HWIO_BAM_P_DATA_FIFO_ADDR6_ADDR A:0xfd4cb824
y.create.l HWIO_BAM_P_DATA_FIFO_ADDR7_ADDR A:0xfd4cc824
y.create.l HWIO_BAM_P_DATA_FIFO_ADDR8_ADDR A:0xfd4cd824
y.create.l HWIO_BAM_P_DATA_FIFO_ADDR9_ADDR A:0xfd4ce824
y.create.l HWIO_BAM_P_DESC_FIFO_ADDR0_ADDR A:0xfd4c581c
y.create.l HWIO_BAM_P_DESC_FIFO_ADDR1_ADDR A:0xfd4c681c
y.create.l HWIO_BAM_P_DESC_FIFO_ADDR2_ADDR A:0xfd4c781c
y.create.l HWIO_BAM_P_DESC_FIFO_ADDR3_ADDR A:0xfd4c881c
y.create.l HWIO_BAM_P_DESC_FIFO_ADDR4_ADDR A:0xfd4c981c
y.create.l HWIO_BAM_P_DESC_FIFO_ADDR5_ADDR A:0xfd4ca81c
y.create.l HWIO_BAM_P_DESC_FIFO_ADDR6_ADDR A:0xfd4cb81c
y.create.l HWIO_BAM_P_DESC_FIFO_ADDR7_ADDR A:0xfd4cc81c
y.create.l HWIO_BAM_P_DESC_FIFO_ADDR8_ADDR A:0xfd4cd81c
y.create.l HWIO_BAM_P_DESC_FIFO_ADDR9_ADDR A:0xfd4ce81c
y.create.l HWIO_BAM_P_EVNT_GEN_TRSHLD0_ADDR A:0xfd4c5828
y.create.l HWIO_BAM_P_EVNT_GEN_TRSHLD1_ADDR A:0xfd4c6828
y.create.l HWIO_BAM_P_EVNT_GEN_TRSHLD2_ADDR A:0xfd4c7828
y.create.l HWIO_BAM_P_EVNT_GEN_TRSHLD3_ADDR A:0xfd4c8828
y.create.l HWIO_BAM_P_EVNT_GEN_TRSHLD4_ADDR A:0xfd4c9828
y.create.l HWIO_BAM_P_EVNT_GEN_TRSHLD5_ADDR A:0xfd4ca828
y.create.l HWIO_BAM_P_EVNT_GEN_TRSHLD6_ADDR A:0xfd4cb828
y.create.l HWIO_BAM_P_EVNT_GEN_TRSHLD7_ADDR A:0xfd4cc828
y.create.l HWIO_BAM_P_EVNT_GEN_TRSHLD8_ADDR A:0xfd4cd828
y.create.l HWIO_BAM_P_EVNT_GEN_TRSHLD9_ADDR A:0xfd4ce828
y.create.l HWIO_BAM_P_FIFO_SIZES0_ADDR A:0xfd4c5820
y.create.l HWIO_BAM_P_FIFO_SIZES1_ADDR A:0xfd4c6820
y.create.l HWIO_BAM_P_FIFO_SIZES2_ADDR A:0xfd4c7820
y.create.l HWIO_BAM_P_FIFO_SIZES3_ADDR A:0xfd4c8820
y.create.l HWIO_BAM_P_FIFO_SIZES4_ADDR A:0xfd4c9820
y.create.l HWIO_BAM_P_FIFO_SIZES5_ADDR A:0xfd4ca820
y.create.l HWIO_BAM_P_FIFO_SIZES6_ADDR A:0xfd4cb820
y.create.l HWIO_BAM_P_FIFO_SIZES7_ADDR A:0xfd4cc820
y.create.l HWIO_BAM_P_FIFO_SIZES8_ADDR A:0xfd4cd820
y.create.l HWIO_BAM_P_FIFO_SIZES9_ADDR A:0xfd4ce820
y.create.l HWIO_BAM_P_RETR_CNTXT_0_ADDR A:0xfd4c5834
y.create.l HWIO_BAM_P_RETR_CNTXT_1_ADDR A:0xfd4c6834
y.create.l HWIO_BAM_P_RETR_CNTXT_2_ADDR A:0xfd4c7834
y.create.l HWIO_BAM_P_RETR_CNTXT_3_ADDR A:0xfd4c8834
y.create.l HWIO_BAM_P_RETR_CNTXT_4_ADDR A:0xfd4c9834
y.create.l HWIO_BAM_P_RETR_CNTXT_5_ADDR A:0xfd4ca834
y.create.l HWIO_BAM_P_RETR_CNTXT_6_ADDR A:0xfd4cb834
y.create.l HWIO_BAM_P_RETR_CNTXT_7_ADDR A:0xfd4cc834
y.create.l HWIO_BAM_P_RETR_CNTXT_8_ADDR A:0xfd4cd834
y.create.l HWIO_BAM_P_RETR_CNTXT_9_ADDR A:0xfd4ce834
y.create.l HWIO_BAM_P_SI_CNTXT_0_ADDR A:0xfd4c5838
y.create.l HWIO_BAM_P_SI_CNTXT_1_ADDR A:0xfd4c6838
y.create.l HWIO_BAM_P_SI_CNTXT_2_ADDR A:0xfd4c7838
y.create.l HWIO_BAM_P_SI_CNTXT_3_ADDR A:0xfd4c8838
y.create.l HWIO_BAM_P_SI_CNTXT_4_ADDR A:0xfd4c9838
y.create.l HWIO_BAM_P_SI_CNTXT_5_ADDR A:0xfd4ca838
y.create.l HWIO_BAM_P_SI_CNTXT_6_ADDR A:0xfd4cb838
y.create.l HWIO_BAM_P_SI_CNTXT_7_ADDR A:0xfd4cc838
y.create.l HWIO_BAM_P_SI_CNTXT_8_ADDR A:0xfd4cd838
y.create.l HWIO_BAM_P_SI_CNTXT_9_ADDR A:0xfd4ce838
y.create.l HWIO_BAM_P_DF_CNTXT_0_ADDR A:0xfd4c5830
y.create.l HWIO_BAM_P_DF_CNTXT_1_ADDR A:0xfd4c6830
y.create.l HWIO_BAM_P_DF_CNTXT_2_ADDR A:0xfd4c7830
y.create.l HWIO_BAM_P_DF_CNTXT_3_ADDR A:0xfd4c8830
y.create.l HWIO_BAM_P_DF_CNTXT_4_ADDR A:0xfd4c9830
y.create.l HWIO_BAM_P_DF_CNTXT_5_ADDR A:0xfd4ca830
y.create.l HWIO_BAM_P_DF_CNTXT_6_ADDR A:0xfd4cb830
y.create.l HWIO_BAM_P_DF_CNTXT_7_ADDR A:0xfd4cc830
y.create.l HWIO_BAM_P_DF_CNTXT_8_ADDR A:0xfd4cd830
y.create.l HWIO_BAM_P_DF_CNTXT_9_ADDR A:0xfd4ce830
y.create.l HWIO_BAM_P_AU_PSM_CNTXT_1_0_ADDR A:0xfd4c5804
y.create.l HWIO_BAM_P_AU_PSM_CNTXT_1_1_ADDR A:0xfd4c6804
y.create.l HWIO_BAM_P_AU_PSM_CNTXT_1_2_ADDR A:0xfd4c7804
y.create.l HWIO_BAM_P_AU_PSM_CNTXT_1_3_ADDR A:0xfd4c8804
y.create.l HWIO_BAM_P_AU_PSM_CNTXT_1_4_ADDR A:0xfd4c9804
y.create.l HWIO_BAM_P_AU_PSM_CNTXT_1_5_ADDR A:0xfd4ca804
y.create.l HWIO_BAM_P_AU_PSM_CNTXT_1_6_ADDR A:0xfd4cb804
y.create.l HWIO_BAM_P_AU_PSM_CNTXT_1_7_ADDR A:0xfd4cc804
y.create.l HWIO_BAM_P_AU_PSM_CNTXT_1_8_ADDR A:0xfd4cd804
y.create.l HWIO_BAM_P_AU_PSM_CNTXT_1_9_ADDR A:0xfd4ce804
y.create.l HWIO_BAM_P_PSM_CNTXT_2_0_ADDR A:0xfd4c5808
y.create.l HWIO_BAM_P_PSM_CNTXT_2_1_ADDR A:0xfd4c6808
y.create.l HWIO_BAM_P_PSM_CNTXT_2_2_ADDR A:0xfd4c7808
y.create.l HWIO_BAM_P_PSM_CNTXT_2_3_ADDR A:0xfd4c8808
y.create.l HWIO_BAM_P_PSM_CNTXT_2_4_ADDR A:0xfd4c9808
y.create.l HWIO_BAM_P_PSM_CNTXT_2_5_ADDR A:0xfd4ca808
y.create.l HWIO_BAM_P_PSM_CNTXT_2_6_ADDR A:0xfd4cb808
y.create.l HWIO_BAM_P_PSM_CNTXT_2_7_ADDR A:0xfd4cc808
y.create.l HWIO_BAM_P_PSM_CNTXT_2_8_ADDR A:0xfd4cd808
y.create.l HWIO_BAM_P_PSM_CNTXT_2_9_ADDR A:0xfd4ce808
y.create.l HWIO_BAM_P_PSM_CNTXT_3_0_ADDR A:0xfd4c580c
y.create.l HWIO_BAM_P_PSM_CNTXT_3_1_ADDR A:0xfd4c680c
y.create.l HWIO_BAM_P_PSM_CNTXT_3_2_ADDR A:0xfd4c780c
y.create.l HWIO_BAM_P_PSM_CNTXT_3_3_ADDR A:0xfd4c880c
y.create.l HWIO_BAM_P_PSM_CNTXT_3_4_ADDR A:0xfd4c980c
y.create.l HWIO_BAM_P_PSM_CNTXT_3_5_ADDR A:0xfd4ca80c
y.create.l HWIO_BAM_P_PSM_CNTXT_3_6_ADDR A:0xfd4cb80c
y.create.l HWIO_BAM_P_PSM_CNTXT_3_7_ADDR A:0xfd4cc80c
y.create.l HWIO_BAM_P_PSM_CNTXT_3_8_ADDR A:0xfd4cd80c
y.create.l HWIO_BAM_P_PSM_CNTXT_3_9_ADDR A:0xfd4ce80c
y.create.l HWIO_BAM_P_PSM_CNTXT_4_0_ADDR A:0xfd4c5810
y.create.l HWIO_BAM_P_PSM_CNTXT_4_1_ADDR A:0xfd4c6810
y.create.l HWIO_BAM_P_PSM_CNTXT_4_2_ADDR A:0xfd4c7810
y.create.l HWIO_BAM_P_PSM_CNTXT_4_3_ADDR A:0xfd4c8810
y.create.l HWIO_BAM_P_PSM_CNTXT_4_4_ADDR A:0xfd4c9810
y.create.l HWIO_BAM_P_PSM_CNTXT_4_5_ADDR A:0xfd4ca810
y.create.l HWIO_BAM_P_PSM_CNTXT_4_6_ADDR A:0xfd4cb810
y.create.l HWIO_BAM_P_PSM_CNTXT_4_7_ADDR A:0xfd4cc810
y.create.l HWIO_BAM_P_PSM_CNTXT_4_8_ADDR A:0xfd4cd810
y.create.l HWIO_BAM_P_PSM_CNTXT_4_9_ADDR A:0xfd4ce810
y.create.l HWIO_BAM_P_PSM_CNTXT_5_0_ADDR A:0xfd4c5814
y.create.l HWIO_BAM_P_PSM_CNTXT_5_1_ADDR A:0xfd4c6814
y.create.l HWIO_BAM_P_PSM_CNTXT_5_2_ADDR A:0xfd4c7814
y.create.l HWIO_BAM_P_PSM_CNTXT_5_3_ADDR A:0xfd4c8814
y.create.l HWIO_BAM_P_PSM_CNTXT_5_4_ADDR A:0xfd4c9814
y.create.l HWIO_BAM_P_PSM_CNTXT_5_5_ADDR A:0xfd4ca814
y.create.l HWIO_BAM_P_PSM_CNTXT_5_6_ADDR A:0xfd4cb814
y.create.l HWIO_BAM_P_PSM_CNTXT_5_7_ADDR A:0xfd4cc814
y.create.l HWIO_BAM_P_PSM_CNTXT_5_8_ADDR A:0xfd4cd814
y.create.l HWIO_BAM_P_PSM_CNTXT_5_9_ADDR A:0xfd4ce814
y.create.l HWIO_XPU_SCR_ADDR A:0xfd4c2000
y.create.l HWIO_XPU_SWDR_ADDR A:0xfd4c2004
y.create.l HWIO_XPU_SEAR0_ADDR A:0xfd4c2040
y.create.l HWIO_XPU_SESR_ADDR A:0xfd4c2048
y.create.l HWIO_XPU_SESRRESTORE_ADDR A:0xfd4c204c
y.create.l HWIO_XPU_SESYNR0_ADDR A:0xfd4c2050
y.create.l HWIO_XPU_SESYNR1_ADDR A:0xfd4c2054
y.create.l HWIO_XPU_SESYNR2_ADDR A:0xfd4c2058
y.create.l HWIO_XPU_MCR_ADDR A:0xfd4c2100
y.create.l HWIO_XPU_MEAR0_ADDR A:0xfd4c2140
y.create.l HWIO_XPU_MESR_ADDR A:0xfd4c2148
y.create.l HWIO_XPU_MESRRESTORE_ADDR A:0xfd4c214c
y.create.l HWIO_XPU_MESYNR0_ADDR A:0xfd4c2150
y.create.l HWIO_XPU_MESYNR1_ADDR A:0xfd4c2154
y.create.l HWIO_XPU_MESYNR2_ADDR A:0xfd4c2158
y.create.l HWIO_XPU_CR_ADDR A:0xfd4c2080
y.create.l HWIO_XPU_RPU_ACR0_ADDR A:0xfd4c20a0
y.create.l HWIO_XPU_EAR0_ADDR A:0xfd4c20c0
y.create.l HWIO_XPU_ESR_ADDR A:0xfd4c20c8
y.create.l HWIO_XPU_ESRRESTORE_ADDR A:0xfd4c20cc
y.create.l HWIO_XPU_ESYNR0_ADDR A:0xfd4c20d0
y.create.l HWIO_XPU_ESYNR1_ADDR A:0xfd4c20d4
y.create.l HWIO_XPU_ESYNR2_ADDR A:0xfd4c20d8
y.create.l HWIO_XPU_IDR0_ADDR A:0xfd4c2074
y.create.l HWIO_XPU_IDR1_ADDR A:0xfd4c2078
y.create.l HWIO_XPU_REV_ADDR A:0xfd4c207c
y.create.l HWIO_XPU_RG0_RACR0_ADDR A:0xfd4c2200
y.create.l HWIO_XPU_RG1_RACR0_ADDR A:0xfd4c2280
y.create.l HWIO_XPU_RG2_RACR0_ADDR A:0xfd4c2300
y.create.l HWIO_XPU_RG3_RACR0_ADDR A:0xfd4c2380
y.create.l HWIO_XPU_RG4_RACR0_ADDR A:0xfd4c2400
y.create.l HWIO_XPU_RG5_RACR0_ADDR A:0xfd4c2480
y.create.l HWIO_XPU_RG6_RACR0_ADDR A:0xfd4c2500
y.create.l HWIO_XPU_RG7_RACR0_ADDR A:0xfd4c2580
y.create.l HWIO_XPU_RG8_RACR0_ADDR A:0xfd4c2600
y.create.l HWIO_XPU_RG9_RACR0_ADDR A:0xfd4c2680
y.create.l HWIO_XPU_RG0_SCR_ADDR A:0xfd4c2250
y.create.l HWIO_XPU_RG1_SCR_ADDR A:0xfd4c22d0
y.create.l HWIO_XPU_RG2_SCR_ADDR A:0xfd4c2350
y.create.l HWIO_XPU_RG3_SCR_ADDR A:0xfd4c23d0
y.create.l HWIO_XPU_RG4_SCR_ADDR A:0xfd4c2450
y.create.l HWIO_XPU_RG5_SCR_ADDR A:0xfd4c24d0
y.create.l HWIO_XPU_RG6_SCR_ADDR A:0xfd4c2550
y.create.l HWIO_XPU_RG7_SCR_ADDR A:0xfd4c25d0
y.create.l HWIO_XPU_RG8_SCR_ADDR A:0xfd4c2650
y.create.l HWIO_XPU_RG9_SCR_ADDR A:0xfd4c26d0
y.create.l HWIO_XPU_RG0_MCR_ADDR A:0xfd4c2254
y.create.l HWIO_XPU_RG1_MCR_ADDR A:0xfd4c22d4
y.create.l HWIO_XPU_RG2_MCR_ADDR A:0xfd4c2354
y.create.l HWIO_XPU_RG3_MCR_ADDR A:0xfd4c23d4
y.create.l HWIO_XPU_RG4_MCR_ADDR A:0xfd4c2454
y.create.l HWIO_XPU_RG5_MCR_ADDR A:0xfd4c24d4
y.create.l HWIO_XPU_RG6_MCR_ADDR A:0xfd4c2554
y.create.l HWIO_XPU_RG7_MCR_ADDR A:0xfd4c25d4
y.create.l HWIO_XPU_RG8_MCR_ADDR A:0xfd4c2654
y.create.l HWIO_XPU_RG9_MCR_ADDR A:0xfd4c26d4
y.create.l HWIO_VMIDMT_SCR0_ADDR A:0xfd4d9000
y.create.l HWIO_VMIDMT_SCR1_ADDR A:0xfd4d9004
y.create.l HWIO_VMIDMT_SCR2_ADDR A:0xfd4d9008
y.create.l HWIO_VMIDMT_SACR_ADDR A:0xfd4d9010
y.create.l HWIO_VMIDMT_SIDR0_ADDR A:0xfd4d9020
y.create.l HWIO_VMIDMT_SIDR1_ADDR A:0xfd4d9024
y.create.l HWIO_VMIDMT_SIDR2_ADDR A:0xfd4d9028
y.create.l HWIO_VMIDMT_SIDR4_ADDR A:0xfd4d9030
y.create.l HWIO_VMIDMT_SIDR5_ADDR A:0xfd4d9034
y.create.l HWIO_VMIDMT_SIDR7_ADDR A:0xfd4d903c
y.create.l HWIO_VMIDMT_SGFAR0_ADDR A:0xfd4d9040
y.create.l HWIO_VMIDMT_SGFSR_ADDR A:0xfd4d9048
y.create.l HWIO_VMIDMT_SGFSRRESTORE_ADDR A:0xfd4d904c
y.create.l HWIO_VMIDMT_SGFSYNDR0_ADDR A:0xfd4d9050
y.create.l HWIO_VMIDMT_SGFSYNDR1_ADDR A:0xfd4d9054
y.create.l HWIO_VMIDMT_SGFSYNDR2_ADDR A:0xfd4d9058
y.create.l HWIO_VMIDMT_VMIDMTSCR0_ADDR A:0xfd4d9090
y.create.l HWIO_VMIDMT_CR0_ADDR A:0xfd4d9000
y.create.l HWIO_VMIDMT_CR2_ADDR A:0xfd4d9008
y.create.l HWIO_VMIDMT_ACR_ADDR A:0xfd4d9010
y.create.l HWIO_VMIDMT_IDR0_ADDR A:0xfd4d9020
y.create.l HWIO_VMIDMT_IDR1_ADDR A:0xfd4d9024
y.create.l HWIO_VMIDMT_IDR2_ADDR A:0xfd4d9028
y.create.l HWIO_VMIDMT_IDR4_ADDR A:0xfd4d9030
y.create.l HWIO_VMIDMT_IDR5_ADDR A:0xfd4d9034
y.create.l HWIO_VMIDMT_IDR7_ADDR A:0xfd4d903c
y.create.l HWIO_VMIDMT_GFAR0_ADDR A:0xfd4d9040
y.create.l HWIO_VMIDMT_GFSR_ADDR A:0xfd4d9048
y.create.l HWIO_VMIDMT_GFSRRESTORE_ADDR A:0xfd4d904c
y.create.l HWIO_VMIDMT_GFSYNDR0_ADDR A:0xfd4d9050
y.create.l HWIO_VMIDMT_GFSYNDR1_ADDR A:0xfd4d9054
y.create.l HWIO_VMIDMT_GFSYNDR2_ADDR A:0xfd4d9058
y.create.l HWIO_VMIDMT_VMIDMTCR0_ADDR A:0xfd4d9090
y.create.l HWIO_VMIDMT_VMIDMTACR_ADDR A:0xfd4d909c
y.create.l HWIO_VMIDMT_NSCR0_ADDR A:0xfd4d9400
y.create.l HWIO_VMIDMT_NSCR2_ADDR A:0xfd4d9408
y.create.l HWIO_VMIDMT_NSACR_ADDR A:0xfd4d9410
y.create.l HWIO_VMIDMT_NSGFAR0_ADDR A:0xfd4d9440
y.create.l HWIO_VMIDMT_NSGFSR_ADDR A:0xfd4d9448
y.create.l HWIO_VMIDMT_NSGFSRRESTORE_ADDR A:0xfd4d944c
y.create.l HWIO_VMIDMT_NSGFSYNDR0_ADDR A:0xfd4d9450
y.create.l HWIO_VMIDMT_NSGFSYNDR1_ADDR A:0xfd4d9454
y.create.l HWIO_VMIDMT_NSGFSYNDR2_ADDR A:0xfd4d9458
y.create.l HWIO_VMIDMT_NSVMIDMTCR0_ADDR A:0xfd4d9490
y.create.l HWIO_VMIDMT_SSDR0_ADDR A:0xfd4d9080
y.create.l HWIO_VMIDMT_MSDR0_ADDR A:0xfd4d9480
y.create.l HWIO_VMIDMT_MCR_ADDR A:0xfd4d9494
y.create.l HWIO_VMIDMT_S2VR0_ADDR A:0xfd4d9c00
y.create.l HWIO_VMIDMT_S2VR1_ADDR A:0xfd4d9c04
y.create.l HWIO_VMIDMT_S2VR2_ADDR A:0xfd4d9c08
y.create.l HWIO_VMIDMT_S2VR3_ADDR A:0xfd4d9c0c
y.create.l HWIO_VMIDMT_S2VR4_ADDR A:0xfd4d9c10
y.create.l HWIO_VMIDMT_S2VR5_ADDR A:0xfd4d9c14
y.create.l HWIO_VMIDMT_S2VR6_ADDR A:0xfd4d9c18
y.create.l HWIO_VMIDMT_S2VR7_ADDR A:0xfd4d9c1c
y.create.l HWIO_VMIDMT_S2VR8_ADDR A:0xfd4d9c20
y.create.l HWIO_VMIDMT_S2VR9_ADDR A:0xfd4d9c24
y.create.l HWIO_VMIDMT_AS2VR0_ADDR A:0xfd4d9e00
y.create.l HWIO_VMIDMT_AS2VR1_ADDR A:0xfd4d9e04
y.create.l HWIO_VMIDMT_AS2VR2_ADDR A:0xfd4d9e08
y.create.l HWIO_VMIDMT_AS2VR3_ADDR A:0xfd4d9e0c
y.create.l HWIO_VMIDMT_AS2VR4_ADDR A:0xfd4d9e10
y.create.l HWIO_VMIDMT_AS2VR5_ADDR A:0xfd4d9e14
y.create.l HWIO_VMIDMT_AS2VR6_ADDR A:0xfd4d9e18
y.create.l HWIO_VMIDMT_AS2VR7_ADDR A:0xfd4d9e1c
y.create.l HWIO_VMIDMT_AS2VR8_ADDR A:0xfd4d9e20
y.create.l HWIO_VMIDMT_AS2VR9_ADDR A:0xfd4d9e24
y.create.l HWIO_VMIDMT_SMR0_ADDR A:0xfd4d9800
y.create.l HWIO_VMIDMT_SMR1_ADDR A:0xfd4d9804
y.create.l HWIO_VMIDMT_SMR2_ADDR A:0xfd4d9808
y.create.l HWIO_VMIDMT_SMR3_ADDR A:0xfd4d980c
y.create.l HWIO_VMIDMT_SMR4_ADDR A:0xfd4d9810
y.create.l HWIO_VMIDMT_SMR5_ADDR A:0xfd4d9814
y.create.l HWIO_VMIDMT_SMR6_ADDR A:0xfd4d9818
y.create.l HWIO_VMIDMT_SMR7_ADDR A:0xfd4d981c
y.create.l HWIO_VMIDMT_SMR8_ADDR A:0xfd4d9820
y.create.l HWIO_VMIDMT_SMR9_ADDR A:0xfd4d9824
y.create.l HWIO_IPA_IRQ_SRCS_EE_0_ADDR A:0xfd4e0000
y.create.l HWIO_IPA_IRQ_SRCS_EE_1_ADDR A:0xfd4e1000
y.create.l HWIO_IPA_IRQ_SRCS_EE_2_ADDR A:0xfd4e2000
y.create.l HWIO_IPA_IRQ_SRCS_EE_3_ADDR A:0xfd4e3000
y.create.l HWIO_IPA_IRQ_SRCS_MSK_EE_0_ADDR A:0xfd4e0004
y.create.l HWIO_IPA_IRQ_SRCS_MSK_EE_1_ADDR A:0xfd4e1004
y.create.l HWIO_IPA_IRQ_SRCS_MSK_EE_2_ADDR A:0xfd4e2004
y.create.l HWIO_IPA_IRQ_SRCS_MSK_EE_3_ADDR A:0xfd4e3004
y.create.l HWIO_IPA_IRQ_EN_EE_0_ADDR A:0xfd4e0008
y.create.l HWIO_IPA_IRQ_EN_EE_1_ADDR A:0xfd4e1008
y.create.l HWIO_IPA_IRQ_EN_EE_2_ADDR A:0xfd4e2008
y.create.l HWIO_IPA_IRQ_EN_EE_3_ADDR A:0xfd4e3008
y.create.l HWIO_IPA_IRQ_CLR_EE_0_ADDR A:0xfd4e000c
y.create.l HWIO_IPA_IRQ_CLR_EE_1_ADDR A:0xfd4e100c
y.create.l HWIO_IPA_IRQ_CLR_EE_2_ADDR A:0xfd4e200c
y.create.l HWIO_IPA_IRQ_CLR_EE_3_ADDR A:0xfd4e300c
y.create.l HWIO_IPA_IRQ_STTS_EE_0_ADDR A:0xfd4e0010
y.create.l HWIO_IPA_IRQ_STTS_EE_1_ADDR A:0xfd4e1010
y.create.l HWIO_IPA_IRQ_STTS_EE_2_ADDR A:0xfd4e2010
y.create.l HWIO_IPA_IRQ_STTS_EE_3_ADDR A:0xfd4e3010
y.create.l HWIO_IPA_SNOC_FEC_ADDR A:0xfd4e0014
y.create.l HWIO_IPA_COMP_HW_VERSION_ADDR A:0xfd4e0030
y.create.l HWIO_IPA_VERSION_ADDR A:0xfd4e0034
y.create.l HWIO_IPA_COMP_CFG_ADDR A:0xfd4e0038
y.create.l HWIO_IPA_COMP_SW_RESET_ADDR A:0xfd4e003c
y.create.l HWIO_IPA_CLKON_CFG_ADDR A:0xfd4e0040
y.create.l HWIO_IPA_HEAD_OF_LINE_BLOCK_EN_ADDR A:0xfd4e0044
y.create.l HWIO_IPA_HEAD_OF_LINE_BLOCK_TIMER_ADDR A:0xfd4e0048
y.create.l HWIO_IPA_ROUTE_ADDR A:0xfd4e004c
y.create.l HWIO_IPA_FILTER_ADDR A:0xfd4e0050
y.create.l HWIO_IPA_MASTER_PRIORITY_ADDR A:0xfd4e0054
y.create.l HWIO_IPA_SHARED_MEM_SIZE_ADDR A:0xfd4e0058
y.create.l HWIO_IPA_NAT_TIMER_ADDR A:0xfd4e005c
y.create.l HWIO_IPA_NAT_TIMER_RESET_ADDR A:0xfd4e0060
y.create.l HWIO_IPA_ENDP_INIT_NAT_0_ADDR A:0xfd4e0080
y.create.l HWIO_IPA_ENDP_INIT_NAT_1_ADDR A:0xfd4e0084
y.create.l HWIO_IPA_ENDP_INIT_NAT_2_ADDR A:0xfd4e0088
y.create.l HWIO_IPA_ENDP_INIT_NAT_3_ADDR A:0xfd4e008c
y.create.l HWIO_IPA_ENDP_INIT_NAT_4_ADDR A:0xfd4e0090
y.create.l HWIO_IPA_ENDP_INIT_NAT_5_ADDR A:0xfd4e0094
y.create.l HWIO_IPA_ENDP_INIT_NAT_6_ADDR A:0xfd4e0098
y.create.l HWIO_IPA_ENDP_INIT_NAT_7_ADDR A:0xfd4e009c
y.create.l HWIO_IPA_ENDP_INIT_NAT_8_ADDR A:0xfd4e00a0
y.create.l HWIO_IPA_ENDP_INIT_NAT_9_ADDR A:0xfd4e00a4
y.create.l HWIO_IPA_ENDP_INIT_HDR_0_ADDR A:0xfd4e00e0
y.create.l HWIO_IPA_ENDP_INIT_HDR_1_ADDR A:0xfd4e00e4
y.create.l HWIO_IPA_ENDP_INIT_HDR_2_ADDR A:0xfd4e00e8
y.create.l HWIO_IPA_ENDP_INIT_HDR_3_ADDR A:0xfd4e00ec
y.create.l HWIO_IPA_ENDP_INIT_HDR_4_ADDR A:0xfd4e00f0
y.create.l HWIO_IPA_ENDP_INIT_HDR_5_ADDR A:0xfd4e00f4
y.create.l HWIO_IPA_ENDP_INIT_HDR_6_ADDR A:0xfd4e00f8
y.create.l HWIO_IPA_ENDP_INIT_HDR_7_ADDR A:0xfd4e00fc
y.create.l HWIO_IPA_ENDP_INIT_HDR_8_ADDR A:0xfd4e0100
y.create.l HWIO_IPA_ENDP_INIT_HDR_9_ADDR A:0xfd4e0104
y.create.l HWIO_IPA_ENDP_INIT_MODE_0_ADDR A:0xfd4e0140
y.create.l HWIO_IPA_ENDP_INIT_MODE_1_ADDR A:0xfd4e0144
y.create.l HWIO_IPA_ENDP_INIT_MODE_2_ADDR A:0xfd4e0148
y.create.l HWIO_IPA_ENDP_INIT_MODE_3_ADDR A:0xfd4e014c
y.create.l HWIO_IPA_ENDP_INIT_MODE_4_ADDR A:0xfd4e0150
y.create.l HWIO_IPA_ENDP_INIT_MODE_5_ADDR A:0xfd4e0154
y.create.l HWIO_IPA_ENDP_INIT_MODE_6_ADDR A:0xfd4e0158
y.create.l HWIO_IPA_ENDP_INIT_MODE_7_ADDR A:0xfd4e015c
y.create.l HWIO_IPA_ENDP_INIT_MODE_8_ADDR A:0xfd4e0160
y.create.l HWIO_IPA_ENDP_INIT_MODE_9_ADDR A:0xfd4e0164
y.create.l HWIO_IPA_ENDP_INIT_AGGR_0_ADDR A:0xfd4e01a0
y.create.l HWIO_IPA_ENDP_INIT_AGGR_1_ADDR A:0xfd4e01a4
y.create.l HWIO_IPA_ENDP_INIT_AGGR_2_ADDR A:0xfd4e01a8
y.create.l HWIO_IPA_ENDP_INIT_AGGR_3_ADDR A:0xfd4e01ac
y.create.l HWIO_IPA_ENDP_INIT_AGGR_4_ADDR A:0xfd4e01b0
y.create.l HWIO_IPA_ENDP_INIT_AGGR_5_ADDR A:0xfd4e01b4
y.create.l HWIO_IPA_ENDP_INIT_AGGR_6_ADDR A:0xfd4e01b8
y.create.l HWIO_IPA_ENDP_INIT_AGGR_7_ADDR A:0xfd4e01bc
y.create.l HWIO_IPA_ENDP_INIT_AGGR_8_ADDR A:0xfd4e01c0
y.create.l HWIO_IPA_ENDP_INIT_AGGR_9_ADDR A:0xfd4e01c4
y.create.l HWIO_IPA_ENDP_INIT_ROUTE_0_ADDR A:0xfd4e0200
y.create.l HWIO_IPA_ENDP_INIT_ROUTE_1_ADDR A:0xfd4e0204
y.create.l HWIO_IPA_ENDP_INIT_ROUTE_2_ADDR A:0xfd4e0208
y.create.l HWIO_IPA_ENDP_INIT_ROUTE_3_ADDR A:0xfd4e020c
y.create.l HWIO_IPA_ENDP_INIT_ROUTE_4_ADDR A:0xfd4e0210
y.create.l HWIO_IPA_ENDP_INIT_ROUTE_5_ADDR A:0xfd4e0214
y.create.l HWIO_IPA_ENDP_INIT_ROUTE_6_ADDR A:0xfd4e0218
y.create.l HWIO_IPA_ENDP_INIT_ROUTE_7_ADDR A:0xfd4e021c
y.create.l HWIO_IPA_ENDP_INIT_ROUTE_8_ADDR A:0xfd4e0220
y.create.l HWIO_IPA_ENDP_INIT_ROUTE_9_ADDR A:0xfd4e0224
y.create.l HWIO_IPA_DEBUG_COUNTER_REG_0_ADDR A:0xfd4e0300
y.create.l HWIO_IPA_DEBUG_COUNTER_REG_1_ADDR A:0xfd4e0304
y.create.l HWIO_IPA_DEBUG_COUNTER_REG_2_ADDR A:0xfd4e0308
y.create.l HWIO_IPA_DEBUG_COUNTER_REG_3_ADDR A:0xfd4e030c
y.create.l HWIO_IPA_DEBUG_COUNTER_REG_4_ADDR A:0xfd4e0310
y.create.l HWIO_IPA_DEBUG_COUNTER_REG_5_ADDR A:0xfd4e0314
y.create.l HWIO_IPA_DEBUG_COUNTER_REG_6_ADDR A:0xfd4e0318
y.create.l HWIO_IPA_DEBUG_COUNTER_REG_7_ADDR A:0xfd4e031c
y.create.l HWIO_IPA_DEBUG_COUNTER_REG_8_ADDR A:0xfd4e0320
y.create.l HWIO_IPA_DEBUG_COUNTER_REG_9_ADDR A:0xfd4e0324
y.create.l HWIO_IPA_DEBUG_COUNTER_CTRL_0_ADDR A:0xfd4e0340
y.create.l HWIO_IPA_DEBUG_COUNTER_CTRL_1_ADDR A:0xfd4e0344
y.create.l HWIO_IPA_DEBUG_COUNTER_CTRL_2_ADDR A:0xfd4e0348
y.create.l HWIO_IPA_DEBUG_COUNTER_CTRL_3_ADDR A:0xfd4e034c
y.create.l HWIO_IPA_DEBUG_COUNTER_CTRL_4_ADDR A:0xfd4e0350
y.create.l HWIO_IPA_DEBUG_COUNTER_CTRL_5_ADDR A:0xfd4e0354
y.create.l HWIO_IPA_DEBUG_COUNTER_CTRL_6_ADDR A:0xfd4e0358
y.create.l HWIO_IPA_DEBUG_COUNTER_CTRL_7_ADDR A:0xfd4e035c
y.create.l HWIO_IPA_DEBUG_COUNTER_CTRL_8_ADDR A:0xfd4e0360
y.create.l HWIO_IPA_DEBUG_COUNTER_CTRL_9_ADDR A:0xfd4e0364
y.create.l HWIO_IPA_DEBUG_SEL_ADDR A:0xfd4e2030
y.create.l HWIO_IPA_RX_DEBUG_CMD_ADDR A:0xfd4e2034
y.create.l HWIO_IPA_RX_DEBUG_CMD_CFG_ADDR A:0xfd4e2038
y.create.l HWIO_IPA_RX_DEBUG_CMD_DATA_WR_0_ADDR A:0xfd4e203c
y.create.l HWIO_IPA_RX_DEBUG_CMD_DATA_WR_1_ADDR A:0xfd4e2040
y.create.l HWIO_IPA_RX_DEBUG_CMD_DATA_WR_2_ADDR A:0xfd4e2044
y.create.l HWIO_IPA_RX_DEBUG_CMD_DATA_RD_0_ADDR A:0xfd4e2048
y.create.l HWIO_IPA_RX_DEBUG_CMD_DATA_RD_1_ADDR A:0xfd4e204c
y.create.l HWIO_IPA_RX_DEBUG_CMD_DATA_RD_2_ADDR A:0xfd4e2050
y.create.l HWIO_IPA_RX_DEBUG_CMD_STATUS_ADDR A:0xfd4e2054
y.create.l HWIO_IPA_TX_DEBUG_CMD_ADDR A:0xfd4e2058
y.create.l HWIO_IPA_TX_DEBUG_CMD_CFG_ADDR A:0xfd4e205c
y.create.l HWIO_IPA_TX_DEBUG_CMD_DATA_WR_0_ADDR A:0xfd4e2060
y.create.l HWIO_IPA_TX_DEBUG_CMD_DATA_WR_1_ADDR A:0xfd4e2064
y.create.l HWIO_IPA_TX_DEBUG_CMD_DATA_RD_0_ADDR A:0xfd4e2068
y.create.l HWIO_IPA_TX_DEBUG_CMD_DATA_RD_1_ADDR A:0xfd4e206c
y.create.l HWIO_IPA_TX_DEBUG_CMD_STATUS_ADDR A:0xfd4e2070
y.create.l HWIO_IPA_STEP_MODE_REG_ADDR A:0xfd4e2080
y.create.l HWIO_IPA_SPARE_REG_1_ADDR A:0xfd4e2090
y.create.l HWIO_IPA_SPARE_REG_2_ADDR A:0xfd4e2094
y.create.l HWIO_IPA_SRAM_DIRECT_ACCESS_0_ADDR A:0xfd4e4000
y.create.l HWIO_IPA_SRAM_DIRECT_ACCESS_1_ADDR A:0xfd4e4004
y.create.l HWIO_IPA_SRAM_DIRECT_ACCESS_2_ADDR A:0xfd4e4008
y.create.l HWIO_IPA_SRAM_DIRECT_ACCESS_3_ADDR A:0xfd4e400c
y.create.l HWIO_IPA_SRAM_DIRECT_ACCESS_4_ADDR A:0xfd4e4010
y.create.l HWIO_IPA_SRAM_DIRECT_ACCESS_5_ADDR A:0xfd4e4014
y.create.l HWIO_IPA_SRAM_DIRECT_ACCESS_6_ADDR A:0xfd4e4018
y.create.l HWIO_IPA_SRAM_DIRECT_ACCESS_7_ADDR A:0xfd4e401c
y.create.l HWIO_IPA_SRAM_DIRECT_ACCESS_8_ADDR A:0xfd4e4020
y.create.l HWIO_IPA_SRAM_DIRECT_ACCESS_9_ADDR A:0xfd4e4024
y.create.l HWIO_LPASS_LPAAUDIO_PLL_MODE_ADDR A:0xfe000000
y.create.l HWIO_LPASS_LPAAUDIO_PLL_L_ADDR A:0xfe000004
y.create.l HWIO_LPASS_LPAAUDIO_PLL_M_ADDR A:0xfe000008
y.create.l HWIO_LPASS_LPAAUDIO_PLL_N_ADDR A:0xfe00000c
y.create.l HWIO_LPASS_LPAAUDIO_PLL_USER_CTL_ADDR A:0xfe000010
y.create.l HWIO_LPASS_LPAAUDIO_PLL_CONFIG_CTL_ADDR A:0xfe000014
y.create.l HWIO_LPASS_LPAAUDIO_PLL_TEST_CTL_ADDR A:0xfe000018
y.create.l HWIO_LPASS_LPAAUDIO_PLL_STATUS_ADDR A:0xfe00001c
y.create.l HWIO_LPASS_LPAAUDIO_PLL_CLK_SRC_SEL_ADDR A:0xfe000020
y.create.l HWIO_LPASS_LPAQ6_PLL_MODE_ADDR A:0xfe001000
y.create.l HWIO_LPASS_LPAQ6_PLL_L_ADDR A:0xfe001004
y.create.l HWIO_LPASS_LPAQ6_PLL_M_ADDR A:0xfe001008
y.create.l HWIO_LPASS_LPAQ6_PLL_N_ADDR A:0xfe00100c
y.create.l HWIO_LPASS_LPAQ6_PLL_USER_CTL_ADDR A:0xfe001010
y.create.l HWIO_LPASS_LPAQ6_PLL_CONFIG_CTL_ADDR A:0xfe001014
y.create.l HWIO_LPASS_LPAQ6_PLL_TEST_CTL_ADDR A:0xfe001018
y.create.l HWIO_LPASS_LPAQ6_PLL_STATUS_ADDR A:0xfe00101c
y.create.l HWIO_LPASS_LPA_PLL_VOTE_APPS_ADDR A:0xfe002000
y.create.l HWIO_LPASS_LPA_PLL_VOTE_LPASSQ6_ADDR A:0xfe003000
y.create.l HWIO_LPASS_AUDIO_CORE_BCR_ADDR A:0xfe004000
y.create.l HWIO_LPASS_AUDIO_CORE_BCR_SLP_CBCR_ADDR A:0xfe004004
y.create.l HWIO_LPASS_AUDIO_WRAPPER_BCR_ADDR A:0xfe005000
y.create.l HWIO_LPASS_Q6SS_BCR_ADDR A:0xfe006000
y.create.l HWIO_LPASS_Q6SS_BCR_SLP_CBCR_ADDR A:0xfe006004
y.create.l HWIO_LPASS_AUDIO_CORE_GDSCR_ADDR A:0xfe007000
y.create.l HWIO_LPASS_AUDIO_CORE_GDSC_XO_CBCR_ADDR A:0xfe007004
y.create.l HWIO_LPASS_MIDI_CMD_RCGR_ADDR A:0xfe008000
y.create.l HWIO_LPASS_MIDI_CFG_RCGR_ADDR A:0xfe008004
y.create.l HWIO_LPASS_AUDIO_CORE_MIDI_CORE_CBCR_ADDR A:0xfe008014
y.create.l HWIO_LPASS_AUDIO_CORE_MIDI_LFABIF_CBCR_ADDR A:0xfe008018
y.create.l HWIO_LPASS_AUDIO_CORE_LPAIF_DMA_CBCR_ADDR A:0xfe009000
y.create.l HWIO_LPASS_AUDIO_CORE_LPAIF_CSR_CBCR_ADDR A:0xfe009004
y.create.l HWIO_LPASS_LPAIF_SPKR_CMD_RCGR_ADDR A:0xfe00a000
y.create.l HWIO_LPASS_LPAIF_SPKR_CFG_RCGR_ADDR A:0xfe00a004
y.create.l HWIO_LPASS_LPAIF_SPKR_M_ADDR A:0xfe00a008
y.create.l HWIO_LPASS_LPAIF_SPKR_N_ADDR A:0xfe00a00c
y.create.l HWIO_LPASS_LPAIF_SPKR_D_ADDR A:0xfe00a010
y.create.l HWIO_LPASS_AUDIO_CORE_LPAIF_CODEC_SPKR_OSR_CBCR_ADDR A:0xfe00a014
y.create.l HWIO_LPASS_AUDIO_CORE_LPAIF_CODEC_SPKR_IBIT_CBCR_ADDR A:0xfe00a018
y.create.l HWIO_LPASS_AUDIO_CORE_LPAIF_CODEC_SPKR_EBIT_CBCR_ADDR A:0xfe00a01c
y.create.l HWIO_LPASS_LPAIF_PRI_CMD_RCGR_ADDR A:0xfe00b000
y.create.l HWIO_LPASS_LPAIF_PRI_CFG_RCGR_ADDR A:0xfe00b004
y.create.l HWIO_LPASS_LPAIF_PRI_M_ADDR A:0xfe00b008
y.create.l HWIO_LPASS_LPAIF_PRI_N_ADDR A:0xfe00b00c
y.create.l HWIO_LPASS_LPAIF_PRI_D_ADDR A:0xfe00b010
y.create.l HWIO_LPASS_AUDIO_CORE_LPAIF_PRI_OSR_CBCR_ADDR A:0xfe00b014
y.create.l HWIO_LPASS_AUDIO_CORE_LPAIF_PRI_IBIT_CBCR_ADDR A:0xfe00b018
y.create.l HWIO_LPASS_AUDIO_CORE_LPAIF_PRI_EBIT_CBCR_ADDR A:0xfe00b01c
y.create.l HWIO_LPASS_LPAIF_SEC_CMD_RCGR_ADDR A:0xfe00c000
y.create.l HWIO_LPASS_LPAIF_SEC_CFG_RCGR_ADDR A:0xfe00c004
y.create.l HWIO_LPASS_LPAIF_SEC_M_ADDR A:0xfe00c008
y.create.l HWIO_LPASS_LPAIF_SEC_N_ADDR A:0xfe00c00c
y.create.l HWIO_LPASS_LPAIF_SEC_D_ADDR A:0xfe00c010
y.create.l HWIO_LPASS_AUDIO_CORE_LPAIF_SEC_OSR_CBCR_ADDR A:0xfe00c014
y.create.l HWIO_LPASS_AUDIO_CORE_LPAIF_SEC_IBIT_CBCR_ADDR A:0xfe00c018
y.create.l HWIO_LPASS_AUDIO_CORE_LPAIF_SEC_EBIT_CBCR_ADDR A:0xfe00c01c
y.create.l HWIO_LPASS_LPAIF_TER_CMD_RCGR_ADDR A:0xfe00d000
y.create.l HWIO_LPASS_LPAIF_TER_CFG_RCGR_ADDR A:0xfe00d004
y.create.l HWIO_LPASS_LPAIF_TER_M_ADDR A:0xfe00d008
y.create.l HWIO_LPASS_LPAIF_TER_N_ADDR A:0xfe00d00c
y.create.l HWIO_LPASS_LPAIF_TER_D_ADDR A:0xfe00d010
y.create.l HWIO_LPASS_AUDIO_CORE_LPAIF_TER_OSR_CBCR_ADDR A:0xfe00d014
y.create.l HWIO_LPASS_AUDIO_CORE_LPAIF_TER_IBIT_CBCR_ADDR A:0xfe00d018
y.create.l HWIO_LPASS_AUDIO_CORE_LPAIF_TER_EBIT_CBCR_ADDR A:0xfe00d01c
y.create.l HWIO_LPASS_LPAIF_QUAD_CMD_RCGR_ADDR A:0xfe00e000
y.create.l HWIO_LPASS_LPAIF_QUAD_CFG_RCGR_ADDR A:0xfe00e004
y.create.l HWIO_LPASS_LPAIF_QUAD_M_ADDR A:0xfe00e008
y.create.l HWIO_LPASS_LPAIF_QUAD_N_ADDR A:0xfe00e00c
y.create.l HWIO_LPASS_LPAIF_QUAD_D_ADDR A:0xfe00e010
y.create.l HWIO_LPASS_AUDIO_CORE_LPAIF_QUAD_OSR_CBCR_ADDR A:0xfe00e014
y.create.l HWIO_LPASS_AUDIO_CORE_LPAIF_QUAD_IBIT_CBCR_ADDR A:0xfe00e018
y.create.l HWIO_LPASS_AUDIO_CORE_LPAIF_QUAD_EBIT_CBCR_ADDR A:0xfe00e01c
y.create.l HWIO_LPASS_LPAIF_PCM0_CMD_RCGR_ADDR A:0xfe00f000
y.create.l HWIO_LPASS_LPAIF_PCM0_CFG_RCGR_ADDR A:0xfe00f004
y.create.l HWIO_LPASS_LPAIF_PCM0_M_ADDR A:0xfe00f008
y.create.l HWIO_LPASS_LPAIF_PCM0_N_ADDR A:0xfe00f00c
y.create.l HWIO_LPASS_LPAIF_PCM0_D_ADDR A:0xfe00f010
y.create.l HWIO_LPASS_AUDIO_CORE_LPAIF_PCM0_IBIT_CBCR_ADDR A:0xfe00f014
y.create.l HWIO_LPASS_AUDIO_CORE_LPAIF_PCM0_EBIT_CBCR_ADDR A:0xfe00f018
y.create.l HWIO_LPASS_LPAIF_PCM1_CMD_RCGR_ADDR A:0xfe010000
y.create.l HWIO_LPASS_LPAIF_PCM1_CFG_RCGR_ADDR A:0xfe010004
y.create.l HWIO_LPASS_LPAIF_PCM1_M_ADDR A:0xfe010008
y.create.l HWIO_LPASS_LPAIF_PCM1_N_ADDR A:0xfe01000c
y.create.l HWIO_LPASS_LPAIF_PCM1_D_ADDR A:0xfe010010
y.create.l HWIO_LPASS_AUDIO_CORE_LPAIF_PCM1_IBIT_CBCR_ADDR A:0xfe010014
y.create.l HWIO_LPASS_AUDIO_CORE_LPAIF_PCM1_EBIT_CBCR_ADDR A:0xfe010018
y.create.l HWIO_LPASS_RESAMPLER_CMD_RCGR_ADDR A:0xfe011000
y.create.l HWIO_LPASS_RESAMPLER_CFG_RCGR_ADDR A:0xfe011004
y.create.l HWIO_LPASS_RESAMPLER_M_ADDR A:0xfe011008
y.create.l HWIO_LPASS_RESAMPLER_N_ADDR A:0xfe01100c
y.create.l HWIO_LPASS_RESAMPLER_D_ADDR A:0xfe011010
y.create.l HWIO_LPASS_AUDIO_CORE_RESAMPLER_CORE_CBCR_ADDR A:0xfe011014
y.create.l HWIO_LPASS_AUDIO_CORE_RESAMPLER_LFABIF_CBCR_ADDR A:0xfe011018
y.create.l HWIO_LPASS_SLIMBUS_CMD_RCGR_ADDR A:0xfe012000
y.create.l HWIO_LPASS_SLIMBUS_CFG_RCGR_ADDR A:0xfe012004
y.create.l HWIO_LPASS_SLIMBUS_M_ADDR A:0xfe012008
y.create.l HWIO_LPASS_SLIMBUS_N_ADDR A:0xfe01200c
y.create.l HWIO_LPASS_SLIMBUS_D_ADDR A:0xfe012010
y.create.l HWIO_LPASS_AUDIO_CORE_SLIMBUS_CORE_CBCR_ADDR A:0xfe012014
y.create.l HWIO_LPASS_AUDIO_CORE_SLIMBUS_LFABIF_CBCR_ADDR A:0xfe012018
y.create.l HWIO_LPASS_LPAIF_PCMOE_CMD_RCGR_ADDR A:0xfe013000
y.create.l HWIO_LPASS_LPAIF_PCMOE_CFG_RCGR_ADDR A:0xfe013004
y.create.l HWIO_LPASS_LPAIF_PCMOE_M_ADDR A:0xfe013008
y.create.l HWIO_LPASS_LPAIF_PCMOE_N_ADDR A:0xfe01300c
y.create.l HWIO_LPASS_LPAIF_PCMOE_D_ADDR A:0xfe013010
y.create.l HWIO_LPASS_AUDIO_CORE_LPAIF_PCM_DATA_OE_CBCR_ADDR A:0xfe013014
y.create.l HWIO_LPASS_Q6CORE_CMD_RCGR_ADDR A:0xfe014000
y.create.l HWIO_LPASS_Q6CORE_CFG_RCGR_ADDR A:0xfe014004
y.create.l HWIO_LPASS_Q6CORE_M_ADDR A:0xfe014008
y.create.l HWIO_LPASS_Q6CORE_N_ADDR A:0xfe01400c
y.create.l HWIO_LPASS_Q6CORE_D_ADDR A:0xfe014010
y.create.l HWIO_LPASS_SLEEP_CMD_RCGR_ADDR A:0xfe015000
y.create.l HWIO_LPASS_SLEEP_CFG_RCGR_ADDR A:0xfe015004
y.create.l HWIO_LPASS_SPDM_CMD_RCGR_ADDR A:0xfe016000
y.create.l HWIO_LPASS_SPDM_CFG_RCGR_ADDR A:0xfe016004
y.create.l HWIO_LPASS_AUDIO_WRAPPER_SPDM_CBCR_ADDR A:0xfe016014
y.create.l HWIO_LPASS_XO_CMD_RCGR_ADDR A:0xfe017000
y.create.l HWIO_LPASS_XO_CFG_RCGR_ADDR A:0xfe017004
y.create.l HWIO_LPASS_AHBFABRIC_CMD_RCGR_ADDR A:0xfe018000
y.create.l HWIO_LPASS_AHBFABRIC_CFG_RCGR_ADDR A:0xfe018004
y.create.l HWIO_LPASS_AHBFABRIC_M_ADDR A:0xfe018008
y.create.l HWIO_LPASS_AHBFABRIC_N_ADDR A:0xfe01800c
y.create.l HWIO_LPASS_AHBFABRIC_D_ADDR A:0xfe018010
y.create.l HWIO_LPASS_AUDIO_CORE_LPM_CBCR_ADDR A:0xfe019000
y.create.l HWIO_LPASS_AUDIO_CORE_LPM_MEM0_CBCR_ADDR A:0xfe019004
y.create.l HWIO_LPASS_AUDIO_CORE_LPM_MEM1_CBCR_ADDR A:0xfe019008
y.create.l HWIO_LPASS_AUDIO_CORE_LPM_MEM2_CBCR_ADDR A:0xfe01900c
y.create.l HWIO_LPASS_AUDIO_CORE_LPM_MEM3_CBCR_ADDR A:0xfe019010
y.create.l HWIO_LPASS_AUDIO_CORE_AVSYNC_CSR_CBCR_ADDR A:0xfe01a000
y.create.l HWIO_LPASS_AUDIO_CORE_AVSYNC_XO_CBCR_ADDR A:0xfe01a004
y.create.l HWIO_LPASS_AUDIO_CORE_AVSYNC_BT_XO_CBCR_ADDR A:0xfe01a008
y.create.l HWIO_LPASS_AUDIO_CORE_AVSYNC_FM_XO_CBCR_ADDR A:0xfe01a00c
y.create.l HWIO_LPASS_AUDIO_CORE_IXFABRIC_CBCR_ADDR A:0xfe01b000
y.create.l HWIO_LPASS_AUDIO_WRAPPER_EFABRIC_CBCR_ADDR A:0xfe01b004
y.create.l HWIO_LPASS_AUDIO_CORE_TCM_SLAVE_CBCR_ADDR A:0xfe01c000
y.create.l HWIO_LPASS_AUDIO_CORE_CSR_CBCR_ADDR A:0xfe01d000
y.create.l HWIO_LPASS_AUDIO_CORE_DML_CBCR_ADDR A:0xfe01e000
y.create.l HWIO_LPASS_AUDIO_CORE_SYSNOC_CBCR_ADDR A:0xfe01f000
y.create.l HWIO_LPASS_AUDIO_WRAPPER_SYSNOC_SWAY_CBCR_ADDR A:0xfe01f004
y.create.l HWIO_LPASS_AUDIO_CORE_TIMEOUT_CBCR_ADDR A:0xfe020000
y.create.l HWIO_LPASS_AUDIO_WRAPPER_TIMEOUT_CBCR_ADDR A:0xfe020004
y.create.l HWIO_LPASS_AUDIO_CORE_SECURITY_CBCR_ADDR A:0xfe021000
y.create.l HWIO_LPASS_AUDIO_WRAPPER_SECURITY_CBCR_ADDR A:0xfe021004
y.create.l HWIO_LPASS_Q6SS_AHB_LFABIF_CBCR_ADDR A:0xfe022000
y.create.l HWIO_LPASS_Q6SS_AHBM_CBCR_ADDR A:0xfe022004
y.create.l HWIO_LPASS_AUDIO_WRAPPER_LCC_CSR_CBCR_ADDR A:0xfe023000
y.create.l HWIO_LPASS_AUDIO_WRAPPER_BR_CBCR_ADDR A:0xfe024000
y.create.l HWIO_LPASS_AUDIO_WRAPPER_SMEM_CBCR_ADDR A:0xfe025000
y.create.l HWIO_LPASS_Q6SS_XO_CBCR_ADDR A:0xfe026000
y.create.l HWIO_LPASS_Q6SS_SLP_CBCR_ADDR A:0xfe026004
y.create.l HWIO_LPASS_AUDIO_WRAPPER_STM_XO_CBCR_ADDR A:0xfe027000
y.create.l HWIO_LPASS_AUDIO_CORE_IXFABRIC_SPDMTM_CSR_CBCR_ADDR A:0xfe028000
y.create.l HWIO_LPASS_AUDIO_WRAPPER_EFABRIC_SPDMTM_CSR_CBCR_ADDR A:0xfe028004
y.create.l HWIO_LPASS_DBG_CLK_ADDR A:0xfe029000
y.create.l HWIO_LPASS_AUDIO_CORE_LPAIF_CODEC_SPKR_MODE_MUXSEL_ADDR A:0xfe02a000
y.create.l HWIO_LPASS_AUDIO_CORE_LPAIF_PRI_MODE_MUXSEL_ADDR A:0xfe02b000
y.create.l HWIO_LPASS_AUDIO_CORE_LPAIF_SEC_MODE_MUXSEL_ADDR A:0xfe02c000
y.create.l HWIO_LPASS_AUDIO_CORE_LPAIF_TER_MODE_MUXSEL_ADDR A:0xfe02d000
y.create.l HWIO_LPASS_AUDIO_CORE_LPAIF_QUAD_MODE_MUXSEL_ADDR A:0xfe02e000
y.create.l HWIO_LPASS_AUDIO_CORE_LPAIF_PCM0_MODE_MUXSEL_ADDR A:0xfe02f000
y.create.l HWIO_LPASS_AUDIO_CORE_LPAIF_PCM1_MODE_MUXSEL_ADDR A:0xfe030000
y.create.l HWIO_LPASS_AUDIO_CORE_XFABRIC_SPDMTM_CGC_ADDR A:0xfe031000
y.create.l HWIO_LPASS_AUDIO_CORE_IFABRIC_SPDMTM_CGC_ADDR A:0xfe031004
y.create.l HWIO_LPASS_AUDIO_WRAPPER_EFABRIC_SPDMTM_CGC_ADDR A:0xfe031008
y.create.l HWIO_LPASS_Q6SS_RST_EVB_SEL_ADDR A:0xfe032000
y.create.l HWIO_LPASS_Q6SS_RST_EVB_ADDR A:0xfe032004
y.create.l HWIO_LPASS_VFR_IRQ_MUX_CTL_ADDR A:0xfe033000
y.create.l HWIO_LPASS_SYSNOC_HYSTERESIS_CLK_GRP_0_ADDR A:0xfe034000
y.create.l HWIO_LPASS_SYSNOC_HYSTERESIS_CLK_GRP_1_ADDR A:0xfe034004
y.create.l HWIO_LPASS_SYSNOC_HYSTERESIS_CLK_GRP_2_ADDR A:0xfe034008
y.create.l HWIO_LPASS_SYSNOC_HYSTERESIS_CLK_GRP_3_ADDR A:0xfe03400c
y.create.l HWIO_LPASS_Q6SS_HYSTERESIS_CLK_GRP_0_ADDR A:0xfe034010
y.create.l HWIO_LPASS_Q6SS_HYSTERESIS_CLK_GRP_1_ADDR A:0xfe034014
y.create.l HWIO_LPASS_Q6SS_HYSTERESIS_CLK_GRP_2_ADDR A:0xfe034018
y.create.l HWIO_LPASS_Q6SS_HYSTERESIS_CLK_GRP_3_ADDR A:0xfe03401c
y.create.l HWIO_LPASS_STM_MUXSEL_0_ADDR A:0xfe035000
y.create.l HWIO_LPASS_STM_MUXSEL_1_ADDR A:0xfe035004
y.create.l HWIO_LPASS_STM_MUXSEL_2_ADDR A:0xfe035008
y.create.l HWIO_LPASS_STM_MUXSEL_3_ADDR A:0xfe03500c
y.create.l HWIO_LPASS_STM_MUXSEL_4_ADDR A:0xfe035010
y.create.l HWIO_LPASS_STM_MUXSEL_5_ADDR A:0xfe035014
y.create.l HWIO_LPASS_STM_MUXSEL_6_ADDR A:0xfe035018
y.create.l HWIO_LPASS_STM_MUXSEL_7_ADDR A:0xfe03501c
y.create.l HWIO_LPASS_STM_MUXSEL_8_ADDR A:0xfe035020
y.create.l HWIO_LPASS_STM_MUXSEL_9_ADDR A:0xfe035024
y.create.l HWIO_LPASS_HW_VERSION_ADDR A:0xfe037000
y.create.l HWIO_LPASS_TCSR_DEBUG_CTL_ADDR A:0xfe037004
y.create.l HWIO_LPASS_AHBE_CFG_ADDR A:0xfe037100
y.create.l HWIO_LPASS_AHBE_LOCK_CTL_ADDR A:0xfe037104
y.create.l HWIO_LPASS_AHBE_STATUS_ADDR A:0xfe037108
y.create.l HWIO_LPASS_AHBE_ACK_ADDR A:0xfe03710c
y.create.l HWIO_LPASS_AHBE_SPARE_ADDR A:0xfe037110
y.create.l HWIO_LPASS_AHBE_ABT_HW_VERSION_ADDR A:0xfe03a000
y.create.l HWIO_LPASS_AHBE_ABT_INST_ID_ADDR A:0xfe03a004
y.create.l HWIO_LPASS_AHBE_ABT_NUM_SLAVES_ADDR A:0xfe03a008
y.create.l HWIO_LPASS_AHBE_ABT_TIMER_LOADVAL_ADDR A:0xfe03a00c
y.create.l HWIO_LPASS_AHBE_ABT_TIMER_MODE_ADDR A:0xfe03a010
y.create.l HWIO_LPASS_AHBE_ABT_INTR_STATUS_ADDR A:0xfe03a014
y.create.l HWIO_LPASS_AHBE_ABT_INTR_CLEAR_ADDR A:0xfe03a018
y.create.l HWIO_LPASS_AHBE_ABT_INTR_ENABLE_ADDR A:0xfe03a01c
y.create.l HWIO_LPASS_AHBE_ABT_SYND_VALID_ADDR A:0xfe03a020
y.create.l HWIO_LPASS_AHBE_ABT_SYND_CLEAR_ADDR A:0xfe03a024
y.create.l HWIO_LPASS_AHBE_ABT_SYND_ID_ADDR A:0xfe03a028
y.create.l HWIO_LPASS_AHBE_ABT_SYND_ADDR0_ADDR A:0xfe03a02c
y.create.l HWIO_LPASS_AHBE_ABT_SYND_ADDR1_ADDR A:0xfe03a030
y.create.l HWIO_LPASS_AHBE_ABT_SYND_HREADY_ADDR A:0xfe03a034
y.create.l HWIO_LPASS_Q6AHB_VMIDMT_SCR0_ADDR A:0xfe03b000
y.create.l HWIO_LPASS_Q6AHB_VMIDMT_SCR1_ADDR A:0xfe03b004
y.create.l HWIO_LPASS_Q6AHB_VMIDMT_SCR2_ADDR A:0xfe03b008
y.create.l HWIO_LPASS_Q6AHB_VMIDMT_SACR_ADDR A:0xfe03b010
y.create.l HWIO_LPASS_Q6AHB_VMIDMT_SIDR0_ADDR A:0xfe03b020
y.create.l HWIO_LPASS_Q6AHB_VMIDMT_SIDR1_ADDR A:0xfe03b024
y.create.l HWIO_LPASS_Q6AHB_VMIDMT_SIDR2_ADDR A:0xfe03b028
y.create.l HWIO_LPASS_Q6AHB_VMIDMT_SIDR4_ADDR A:0xfe03b030
y.create.l HWIO_LPASS_Q6AHB_VMIDMT_SIDR5_ADDR A:0xfe03b034
y.create.l HWIO_LPASS_Q6AHB_VMIDMT_SIDR7_ADDR A:0xfe03b03c
y.create.l HWIO_LPASS_Q6AHB_VMIDMT_SGFAR0_ADDR A:0xfe03b040
y.create.l HWIO_LPASS_Q6AHB_VMIDMT_SGFSR_ADDR A:0xfe03b048
y.create.l HWIO_LPASS_Q6AHB_VMIDMT_SGFSRRESTORE_ADDR A:0xfe03b04c
y.create.l HWIO_LPASS_Q6AHB_VMIDMT_SGFSYNDR0_ADDR A:0xfe03b050
y.create.l HWIO_LPASS_Q6AHB_VMIDMT_SGFSYNDR1_ADDR A:0xfe03b054
y.create.l HWIO_LPASS_Q6AHB_VMIDMT_SGFSYNDR2_ADDR A:0xfe03b058
y.create.l HWIO_LPASS_Q6AHB_VMIDMT_VMIDMTSCR0_ADDR A:0xfe03b090
y.create.l HWIO_LPASS_Q6AHB_VMIDMT_CR0_ADDR A:0xfe03b000
y.create.l HWIO_LPASS_Q6AHB_VMIDMT_CR2_ADDR A:0xfe03b008
y.create.l HWIO_LPASS_Q6AHB_VMIDMT_ACR_ADDR A:0xfe03b010
y.create.l HWIO_LPASS_Q6AHB_VMIDMT_IDR0_ADDR A:0xfe03b020
y.create.l HWIO_LPASS_Q6AHB_VMIDMT_IDR1_ADDR A:0xfe03b024
y.create.l HWIO_LPASS_Q6AHB_VMIDMT_IDR2_ADDR A:0xfe03b028
y.create.l HWIO_LPASS_Q6AHB_VMIDMT_IDR4_ADDR A:0xfe03b030
y.create.l HWIO_LPASS_Q6AHB_VMIDMT_IDR5_ADDR A:0xfe03b034
y.create.l HWIO_LPASS_Q6AHB_VMIDMT_IDR7_ADDR A:0xfe03b03c
y.create.l HWIO_LPASS_Q6AHB_VMIDMT_GFAR0_ADDR A:0xfe03b040
y.create.l HWIO_LPASS_Q6AHB_VMIDMT_GFSR_ADDR A:0xfe03b048
y.create.l HWIO_LPASS_Q6AHB_VMIDMT_GFSRRESTORE_ADDR A:0xfe03b04c
y.create.l HWIO_LPASS_Q6AHB_VMIDMT_GFSYNDR0_ADDR A:0xfe03b050
y.create.l HWIO_LPASS_Q6AHB_VMIDMT_GFSYNDR1_ADDR A:0xfe03b054
y.create.l HWIO_LPASS_Q6AHB_VMIDMT_GFSYNDR2_ADDR A:0xfe03b058
y.create.l HWIO_LPASS_Q6AHB_VMIDMT_VMIDMTCR0_ADDR A:0xfe03b090
y.create.l HWIO_LPASS_Q6AHB_VMIDMT_VMIDMTACR_ADDR A:0xfe03b09c
y.create.l HWIO_LPASS_Q6AHB_VMIDMT_NSCR0_ADDR A:0xfe03b400
y.create.l HWIO_LPASS_Q6AHB_VMIDMT_NSCR2_ADDR A:0xfe03b408
y.create.l HWIO_LPASS_Q6AHB_VMIDMT_NSACR_ADDR A:0xfe03b410
y.create.l HWIO_LPASS_Q6AHB_VMIDMT_NSGFAR0_ADDR A:0xfe03b440
y.create.l HWIO_LPASS_Q6AHB_VMIDMT_NSGFSR_ADDR A:0xfe03b448
y.create.l HWIO_LPASS_Q6AHB_VMIDMT_NSGFSRRESTORE_ADDR A:0xfe03b44c
y.create.l HWIO_LPASS_Q6AHB_VMIDMT_NSGFSYNDR0_ADDR A:0xfe03b450
y.create.l HWIO_LPASS_Q6AHB_VMIDMT_NSGFSYNDR1_ADDR A:0xfe03b454
y.create.l HWIO_LPASS_Q6AHB_VMIDMT_NSGFSYNDR2_ADDR A:0xfe03b458
y.create.l HWIO_LPASS_Q6AHB_VMIDMT_NSVMIDMTCR0_ADDR A:0xfe03b490
y.create.l HWIO_LPASS_Q6AHB_VMIDMT_SSDR0_ADDR A:0xfe03b080
y.create.l HWIO_LPASS_Q6AHB_VMIDMT_S2VR0_ADDR A:0xfe03bc00
y.create.l HWIO_LPASS_Q6AHB_VMIDMT_AS2VR0_ADDR A:0xfe03be00
y.create.l HWIO_LPASS_Q6AXI_VMIDMT_SCR0_ADDR A:0xfe03c000
y.create.l HWIO_LPASS_Q6AXI_VMIDMT_SCR1_ADDR A:0xfe03c004
y.create.l HWIO_LPASS_Q6AXI_VMIDMT_SCR2_ADDR A:0xfe03c008
y.create.l HWIO_LPASS_Q6AXI_VMIDMT_SACR_ADDR A:0xfe03c010
y.create.l HWIO_LPASS_Q6AXI_VMIDMT_SIDR0_ADDR A:0xfe03c020
y.create.l HWIO_LPASS_Q6AXI_VMIDMT_SIDR1_ADDR A:0xfe03c024
y.create.l HWIO_LPASS_Q6AXI_VMIDMT_SIDR2_ADDR A:0xfe03c028
y.create.l HWIO_LPASS_Q6AXI_VMIDMT_SIDR4_ADDR A:0xfe03c030
y.create.l HWIO_LPASS_Q6AXI_VMIDMT_SIDR5_ADDR A:0xfe03c034
y.create.l HWIO_LPASS_Q6AXI_VMIDMT_SIDR7_ADDR A:0xfe03c03c
y.create.l HWIO_LPASS_Q6AXI_VMIDMT_SGFAR0_ADDR A:0xfe03c040
y.create.l HWIO_LPASS_Q6AXI_VMIDMT_SGFSR_ADDR A:0xfe03c048
y.create.l HWIO_LPASS_Q6AXI_VMIDMT_SGFSRRESTORE_ADDR A:0xfe03c04c
y.create.l HWIO_LPASS_Q6AXI_VMIDMT_SGFSYNDR0_ADDR A:0xfe03c050
y.create.l HWIO_LPASS_Q6AXI_VMIDMT_SGFSYNDR1_ADDR A:0xfe03c054
y.create.l HWIO_LPASS_Q6AXI_VMIDMT_SGFSYNDR2_ADDR A:0xfe03c058
y.create.l HWIO_LPASS_Q6AXI_VMIDMT_VMIDMTSCR0_ADDR A:0xfe03c090
y.create.l HWIO_LPASS_Q6AXI_VMIDMT_CR0_ADDR A:0xfe03c000
y.create.l HWIO_LPASS_Q6AXI_VMIDMT_CR2_ADDR A:0xfe03c008
y.create.l HWIO_LPASS_Q6AXI_VMIDMT_ACR_ADDR A:0xfe03c010
y.create.l HWIO_LPASS_Q6AXI_VMIDMT_IDR0_ADDR A:0xfe03c020
y.create.l HWIO_LPASS_Q6AXI_VMIDMT_IDR1_ADDR A:0xfe03c024
y.create.l HWIO_LPASS_Q6AXI_VMIDMT_IDR2_ADDR A:0xfe03c028
y.create.l HWIO_LPASS_Q6AXI_VMIDMT_IDR4_ADDR A:0xfe03c030
y.create.l HWIO_LPASS_Q6AXI_VMIDMT_IDR5_ADDR A:0xfe03c034
y.create.l HWIO_LPASS_Q6AXI_VMIDMT_IDR7_ADDR A:0xfe03c03c
y.create.l HWIO_LPASS_Q6AXI_VMIDMT_GFAR0_ADDR A:0xfe03c040
y.create.l HWIO_LPASS_Q6AXI_VMIDMT_GFSR_ADDR A:0xfe03c048
y.create.l HWIO_LPASS_Q6AXI_VMIDMT_GFSRRESTORE_ADDR A:0xfe03c04c
y.create.l HWIO_LPASS_Q6AXI_VMIDMT_GFSYNDR0_ADDR A:0xfe03c050
y.create.l HWIO_LPASS_Q6AXI_VMIDMT_GFSYNDR1_ADDR A:0xfe03c054
y.create.l HWIO_LPASS_Q6AXI_VMIDMT_GFSYNDR2_ADDR A:0xfe03c058
y.create.l HWIO_LPASS_Q6AXI_VMIDMT_VMIDMTCR0_ADDR A:0xfe03c090
y.create.l HWIO_LPASS_Q6AXI_VMIDMT_VMIDMTACR_ADDR A:0xfe03c09c
y.create.l HWIO_LPASS_Q6AXI_VMIDMT_NSCR0_ADDR A:0xfe03c400
y.create.l HWIO_LPASS_Q6AXI_VMIDMT_NSCR2_ADDR A:0xfe03c408
y.create.l HWIO_LPASS_Q6AXI_VMIDMT_NSACR_ADDR A:0xfe03c410
y.create.l HWIO_LPASS_Q6AXI_VMIDMT_NSGFAR0_ADDR A:0xfe03c440
y.create.l HWIO_LPASS_Q6AXI_VMIDMT_NSGFSR_ADDR A:0xfe03c448
y.create.l HWIO_LPASS_Q6AXI_VMIDMT_NSGFSRRESTORE_ADDR A:0xfe03c44c
y.create.l HWIO_LPASS_Q6AXI_VMIDMT_NSGFSYNDR0_ADDR A:0xfe03c450
y.create.l HWIO_LPASS_Q6AXI_VMIDMT_NSGFSYNDR1_ADDR A:0xfe03c454
y.create.l HWIO_LPASS_Q6AXI_VMIDMT_NSGFSYNDR2_ADDR A:0xfe03c458
y.create.l HWIO_LPASS_Q6AXI_VMIDMT_NSVMIDMTCR0_ADDR A:0xfe03c490
y.create.l HWIO_LPASS_Q6AXI_VMIDMT_SSDR0_ADDR A:0xfe03c080
y.create.l HWIO_LPASS_Q6AXI_VMIDMT_S2VR0_ADDR A:0xfe03cc00
y.create.l HWIO_LPASS_Q6AXI_VMIDMT_S2VR1_ADDR A:0xfe03cc04
y.create.l HWIO_LPASS_Q6AXI_VMIDMT_S2VR2_ADDR A:0xfe03cc08
y.create.l HWIO_LPASS_Q6AXI_VMIDMT_S2VR3_ADDR A:0xfe03cc0c
y.create.l HWIO_LPASS_Q6AXI_VMIDMT_AS2VR0_ADDR A:0xfe03ce00
y.create.l HWIO_LPASS_Q6AXI_VMIDMT_AS2VR1_ADDR A:0xfe03ce04
y.create.l HWIO_LPASS_Q6AXI_VMIDMT_AS2VR2_ADDR A:0xfe03ce08
y.create.l HWIO_LPASS_Q6AXI_VMIDMT_AS2VR3_ADDR A:0xfe03ce0c
y.create.l HWIO_LPASS_LCC_XPU_SCR_ADDR A:0xfe03e000
y.create.l HWIO_LPASS_LCC_XPU_SWDR_ADDR A:0xfe03e004
y.create.l HWIO_LPASS_LCC_XPU_SEAR0_ADDR A:0xfe03e040
y.create.l HWIO_LPASS_LCC_XPU_SESR_ADDR A:0xfe03e048
y.create.l HWIO_LPASS_LCC_XPU_SESRRESTORE_ADDR A:0xfe03e04c
y.create.l HWIO_LPASS_LCC_XPU_SESYNR0_ADDR A:0xfe03e050
y.create.l HWIO_LPASS_LCC_XPU_SESYNR1_ADDR A:0xfe03e054
y.create.l HWIO_LPASS_LCC_XPU_SESYNR2_ADDR A:0xfe03e058
y.create.l HWIO_LPASS_LCC_XPU_MCR_ADDR A:0xfe03e100
y.create.l HWIO_LPASS_LCC_XPU_MEAR0_ADDR A:0xfe03e140
y.create.l HWIO_LPASS_LCC_XPU_MESR_ADDR A:0xfe03e148
y.create.l HWIO_LPASS_LCC_XPU_MESRRESTORE_ADDR A:0xfe03e14c
y.create.l HWIO_LPASS_LCC_XPU_MESYNR0_ADDR A:0xfe03e150
y.create.l HWIO_LPASS_LCC_XPU_MESYNR1_ADDR A:0xfe03e154
y.create.l HWIO_LPASS_LCC_XPU_MESYNR2_ADDR A:0xfe03e158
y.create.l HWIO_LPASS_LCC_XPU_CR_ADDR A:0xfe03e080
y.create.l HWIO_LPASS_LCC_XPU_RPU_ACR0_ADDR A:0xfe03e0a0
y.create.l HWIO_LPASS_LCC_XPU_EAR0_ADDR A:0xfe03e0c0
y.create.l HWIO_LPASS_LCC_XPU_ESR_ADDR A:0xfe03e0c8
y.create.l HWIO_LPASS_LCC_XPU_ESRRESTORE_ADDR A:0xfe03e0cc
y.create.l HWIO_LPASS_LCC_XPU_ESYNR0_ADDR A:0xfe03e0d0
y.create.l HWIO_LPASS_LCC_XPU_ESYNR1_ADDR A:0xfe03e0d4
y.create.l HWIO_LPASS_LCC_XPU_ESYNR2_ADDR A:0xfe03e0d8
y.create.l HWIO_LPASS_LCC_XPU_IDR0_ADDR A:0xfe03e074
y.create.l HWIO_LPASS_LCC_XPU_IDR1_ADDR A:0xfe03e078
y.create.l HWIO_LPASS_LCC_XPU_REV_ADDR A:0xfe03e07c
y.create.l HWIO_LPASS_LCC_XPU_RG0_RACR0_ADDR A:0xfe03e200
y.create.l HWIO_LPASS_LCC_XPU_RG1_RACR0_ADDR A:0xfe03e280
y.create.l HWIO_LPASS_LCC_XPU_RG2_RACR0_ADDR A:0xfe03e300
y.create.l HWIO_LPASS_LCC_XPU_RG3_RACR0_ADDR A:0xfe03e380
y.create.l HWIO_LPASS_LCC_XPU_RG4_RACR0_ADDR A:0xfe03e400
y.create.l HWIO_LPASS_LCC_XPU_RG5_RACR0_ADDR A:0xfe03e480
y.create.l HWIO_LPASS_LCC_XPU_RG6_RACR0_ADDR A:0xfe03e500
y.create.l HWIO_LPASS_LCC_XPU_RG7_RACR0_ADDR A:0xfe03e580
y.create.l HWIO_LPASS_LCC_XPU_RG8_RACR0_ADDR A:0xfe03e600
y.create.l HWIO_LPASS_LCC_XPU_RG9_RACR0_ADDR A:0xfe03e680
y.create.l HWIO_LPASS_LCC_XPU_RG0_WACR0_ADDR A:0xfe03e220
y.create.l HWIO_LPASS_LCC_XPU_RG1_WACR0_ADDR A:0xfe03e2a0
y.create.l HWIO_LPASS_LCC_XPU_RG2_WACR0_ADDR A:0xfe03e320
y.create.l HWIO_LPASS_LCC_XPU_RG3_WACR0_ADDR A:0xfe03e3a0
y.create.l HWIO_LPASS_LCC_XPU_RG4_WACR0_ADDR A:0xfe03e420
y.create.l HWIO_LPASS_LCC_XPU_RG5_WACR0_ADDR A:0xfe03e4a0
y.create.l HWIO_LPASS_LCC_XPU_RG6_WACR0_ADDR A:0xfe03e520
y.create.l HWIO_LPASS_LCC_XPU_RG7_WACR0_ADDR A:0xfe03e5a0
y.create.l HWIO_LPASS_LCC_XPU_RG8_WACR0_ADDR A:0xfe03e620
y.create.l HWIO_LPASS_LCC_XPU_RG9_WACR0_ADDR A:0xfe03e6a0
y.create.l HWIO_LPASS_LCC_XPU_RG0_SCR_ADDR A:0xfe03e250
y.create.l HWIO_LPASS_LCC_XPU_RG1_SCR_ADDR A:0xfe03e2d0
y.create.l HWIO_LPASS_LCC_XPU_RG2_SCR_ADDR A:0xfe03e350
y.create.l HWIO_LPASS_LCC_XPU_RG3_SCR_ADDR A:0xfe03e3d0
y.create.l HWIO_LPASS_LCC_XPU_RG4_SCR_ADDR A:0xfe03e450
y.create.l HWIO_LPASS_LCC_XPU_RG5_SCR_ADDR A:0xfe03e4d0
y.create.l HWIO_LPASS_LCC_XPU_RG6_SCR_ADDR A:0xfe03e550
y.create.l HWIO_LPASS_LCC_XPU_RG7_SCR_ADDR A:0xfe03e5d0
y.create.l HWIO_LPASS_LCC_XPU_RG8_SCR_ADDR A:0xfe03e650
y.create.l HWIO_LPASS_LCC_XPU_RG9_SCR_ADDR A:0xfe03e6d0
y.create.l HWIO_LPASS_LCC_XPU_RG0_MCR_ADDR A:0xfe03e254
y.create.l HWIO_LPASS_LCC_XPU_RG1_MCR_ADDR A:0xfe03e2d4
y.create.l HWIO_LPASS_LCC_XPU_RG2_MCR_ADDR A:0xfe03e354
y.create.l HWIO_LPASS_LCC_XPU_RG3_MCR_ADDR A:0xfe03e3d4
y.create.l HWIO_LPASS_LCC_XPU_RG4_MCR_ADDR A:0xfe03e454
y.create.l HWIO_LPASS_LCC_XPU_RG5_MCR_ADDR A:0xfe03e4d4
y.create.l HWIO_LPASS_LCC_XPU_RG6_MCR_ADDR A:0xfe03e554
y.create.l HWIO_LPASS_LCC_XPU_RG7_MCR_ADDR A:0xfe03e5d4
y.create.l HWIO_LPASS_LCC_XPU_RG8_MCR_ADDR A:0xfe03e654
y.create.l HWIO_LPASS_LCC_XPU_RG9_MCR_ADDR A:0xfe03e6d4
y.create.l HWIO_LPASS_TOP_XPU_SCR_ADDR A:0xfe040000
y.create.l HWIO_LPASS_TOP_XPU_SWDR_ADDR A:0xfe040004
y.create.l HWIO_LPASS_TOP_XPU_SEAR0_ADDR A:0xfe040040
y.create.l HWIO_LPASS_TOP_XPU_SESR_ADDR A:0xfe040048
y.create.l HWIO_LPASS_TOP_XPU_SESRRESTORE_ADDR A:0xfe04004c
y.create.l HWIO_LPASS_TOP_XPU_SESYNR0_ADDR A:0xfe040050
y.create.l HWIO_LPASS_TOP_XPU_SESYNR1_ADDR A:0xfe040054
y.create.l HWIO_LPASS_TOP_XPU_SESYNR2_ADDR A:0xfe040058
y.create.l HWIO_LPASS_TOP_XPU_MCR_ADDR A:0xfe040100
y.create.l HWIO_LPASS_TOP_XPU_MEAR0_ADDR A:0xfe040140
y.create.l HWIO_LPASS_TOP_XPU_MESR_ADDR A:0xfe040148
y.create.l HWIO_LPASS_TOP_XPU_MESRRESTORE_ADDR A:0xfe04014c
y.create.l HWIO_LPASS_TOP_XPU_MESYNR0_ADDR A:0xfe040150
y.create.l HWIO_LPASS_TOP_XPU_MESYNR1_ADDR A:0xfe040154
y.create.l HWIO_LPASS_TOP_XPU_MESYNR2_ADDR A:0xfe040158
y.create.l HWIO_LPASS_TOP_XPU_CR_ADDR A:0xfe040080
y.create.l HWIO_LPASS_TOP_XPU_RPU_ACR0_ADDR A:0xfe0400a0
y.create.l HWIO_LPASS_TOP_XPU_EAR0_ADDR A:0xfe0400c0
y.create.l HWIO_LPASS_TOP_XPU_ESR_ADDR A:0xfe0400c8
y.create.l HWIO_LPASS_TOP_XPU_ESRRESTORE_ADDR A:0xfe0400cc
y.create.l HWIO_LPASS_TOP_XPU_ESYNR0_ADDR A:0xfe0400d0
y.create.l HWIO_LPASS_TOP_XPU_ESYNR1_ADDR A:0xfe0400d4
y.create.l HWIO_LPASS_TOP_XPU_ESYNR2_ADDR A:0xfe0400d8
y.create.l HWIO_LPASS_TOP_XPU_IDR0_ADDR A:0xfe040074
y.create.l HWIO_LPASS_TOP_XPU_IDR1_ADDR A:0xfe040078
y.create.l HWIO_LPASS_TOP_XPU_REV_ADDR A:0xfe04007c
y.create.l HWIO_LPASS_TOP_XPU_RG0_RACR0_ADDR A:0xfe040200
y.create.l HWIO_LPASS_TOP_XPU_RG1_RACR0_ADDR A:0xfe040280
y.create.l HWIO_LPASS_TOP_XPU_RG2_RACR0_ADDR A:0xfe040300
y.create.l HWIO_LPASS_TOP_XPU_RG3_RACR0_ADDR A:0xfe040380
y.create.l HWIO_LPASS_TOP_XPU_RG4_RACR0_ADDR A:0xfe040400
y.create.l HWIO_LPASS_TOP_XPU_RG0_SCR_ADDR A:0xfe040250
y.create.l HWIO_LPASS_TOP_XPU_RG1_SCR_ADDR A:0xfe0402d0
y.create.l HWIO_LPASS_TOP_XPU_RG2_SCR_ADDR A:0xfe040350
y.create.l HWIO_LPASS_TOP_XPU_RG3_SCR_ADDR A:0xfe0403d0
y.create.l HWIO_LPASS_TOP_XPU_RG4_SCR_ADDR A:0xfe040450
y.create.l HWIO_LPASS_TOP_XPU_RG0_MCR_ADDR A:0xfe040254
y.create.l HWIO_LPASS_TOP_XPU_RG1_MCR_ADDR A:0xfe0402d4
y.create.l HWIO_LPASS_TOP_XPU_RG2_MCR_ADDR A:0xfe040354
y.create.l HWIO_LPASS_TOP_XPU_RG3_MCR_ADDR A:0xfe0403d4
y.create.l HWIO_LPASS_TOP_XPU_RG4_MCR_ADDR A:0xfe040454
y.create.l HWIO_LPASS_CSR_GP_CTL_ADDR A:0xfe048000
y.create.l HWIO_LPASS_CSR_DEBUG_CTL_ADDR A:0xfe048010
y.create.l HWIO_LPASS_CSR_DEBUG_BUS_ADDR A:0xfe048014
y.create.l HWIO_LPASS_AHBI_CFG_ADDR A:0xfe049004
y.create.l HWIO_LPASS_AHBI_LOCK_CTL_ADDR A:0xfe049008
y.create.l HWIO_LPASS_AHBX_CFG_ADDR A:0xfe049020
y.create.l HWIO_LPASS_AHBX_LOCK_CTL_ADDR A:0xfe049024
y.create.l HWIO_LPASS_AHBIX_STATUS_ADDR A:0xfe049030
y.create.l HWIO_LPASS_AHBIX_ACK_ADDR A:0xfe049034
y.create.l HWIO_LPASS_DML_CTL_ADDR A:0xfe04a000
y.create.l HWIO_LPASS_DML_SRC_ADDR A:0xfe04a004
y.create.l HWIO_LPASS_DML_DST_ADDR A:0xfe04a008
y.create.l HWIO_LPASS_DML_TRAN_ADDR A:0xfe04a00c
y.create.l HWIO_LPASS_DML_STATUS_ADDR A:0xfe04a010
y.create.l HWIO_LPASS_DML_ACK_ADDR A:0xfe04a014
y.create.l HWIO_LPASS_LPM_CTL_ADDR A:0xfe04b000
y.create.l HWIO_LPASS_RESAMPLER_CTL_ADDR A:0xfe04c000
y.create.l HWIO_LPASS_MIDI_CTL_ADDR A:0xfe04d000
y.create.l HWIO_LPASS_LPAIF_CTL_ADDR A:0xfe04e000
y.create.l HWIO_LPASS_AHBTM_CFG_ADDR A:0xfe051000
y.create.l HWIO_LPASS_AHBTM_C0_CFG0_ADDR A:0xfe051020
y.create.l HWIO_LPASS_AHBTM_C1_CFG0_ADDR A:0xfe051040
y.create.l HWIO_LPASS_AHBTM_C2_CFG0_ADDR A:0xfe051060
y.create.l HWIO_LPASS_AHBTM_C3_CFG0_ADDR A:0xfe051080
y.create.l HWIO_LPASS_AHBTM_C4_CFG0_ADDR A:0xfe0510a0
y.create.l HWIO_LPASS_AHBTM_C5_CFG0_ADDR A:0xfe0510c0
y.create.l HWIO_LPASS_AHBTM_C6_CFG0_ADDR A:0xfe0510e0
y.create.l HWIO_LPASS_AHBTM_C7_CFG0_ADDR A:0xfe051100
y.create.l HWIO_LPASS_AHBTM_C0_CFG1_ADDR A:0xfe051024
y.create.l HWIO_LPASS_AHBTM_C1_CFG1_ADDR A:0xfe051044
y.create.l HWIO_LPASS_AHBTM_C2_CFG1_ADDR A:0xfe051064
y.create.l HWIO_LPASS_AHBTM_C3_CFG1_ADDR A:0xfe051084
y.create.l HWIO_LPASS_AHBTM_C4_CFG1_ADDR A:0xfe0510a4
y.create.l HWIO_LPASS_AHBTM_C5_CFG1_ADDR A:0xfe0510c4
y.create.l HWIO_LPASS_AHBTM_C6_CFG1_ADDR A:0xfe0510e4
y.create.l HWIO_LPASS_AHBTM_C7_CFG1_ADDR A:0xfe051104
y.create.l HWIO_LPASS_AHBTM_C0_CFG2_ADDR A:0xfe051028
y.create.l HWIO_LPASS_AHBTM_C1_CFG2_ADDR A:0xfe051048
y.create.l HWIO_LPASS_AHBTM_C2_CFG2_ADDR A:0xfe051068
y.create.l HWIO_LPASS_AHBTM_C3_CFG2_ADDR A:0xfe051088
y.create.l HWIO_LPASS_AHBTM_C4_CFG2_ADDR A:0xfe0510a8
y.create.l HWIO_LPASS_AHBTM_C5_CFG2_ADDR A:0xfe0510c8
y.create.l HWIO_LPASS_AHBTM_C6_CFG2_ADDR A:0xfe0510e8
y.create.l HWIO_LPASS_AHBTM_C7_CFG2_ADDR A:0xfe051108
y.create.l HWIO_LPASS_AHBTM_C0_CFG3_ADDR A:0xfe05102c
y.create.l HWIO_LPASS_AHBTM_C1_CFG3_ADDR A:0xfe05104c
y.create.l HWIO_LPASS_AHBTM_C2_CFG3_ADDR A:0xfe05106c
y.create.l HWIO_LPASS_AHBTM_C3_CFG3_ADDR A:0xfe05108c
y.create.l HWIO_LPASS_AHBTM_C4_CFG3_ADDR A:0xfe0510ac
y.create.l HWIO_LPASS_AHBTM_C5_CFG3_ADDR A:0xfe0510cc
y.create.l HWIO_LPASS_AHBTM_C6_CFG3_ADDR A:0xfe0510ec
y.create.l HWIO_LPASS_AHBTM_C7_CFG3_ADDR A:0xfe05110c
y.create.l HWIO_LPASS_AHBTM_C0_CFG4_ADDR A:0xfe051030
y.create.l HWIO_LPASS_AHBTM_C1_CFG4_ADDR A:0xfe051050
y.create.l HWIO_LPASS_AHBTM_C2_CFG4_ADDR A:0xfe051070
y.create.l HWIO_LPASS_AHBTM_C3_CFG4_ADDR A:0xfe051090
y.create.l HWIO_LPASS_AHBTM_C4_CFG4_ADDR A:0xfe0510b0
y.create.l HWIO_LPASS_AHBTM_C5_CFG4_ADDR A:0xfe0510d0
y.create.l HWIO_LPASS_AHBTM_C6_CFG4_ADDR A:0xfe0510f0
y.create.l HWIO_LPASS_AHBTM_C7_CFG4_ADDR A:0xfe051110
y.create.l HWIO_LPASS_AHBTM_C0_CFG5_ADDR A:0xfe051034
y.create.l HWIO_LPASS_AHBTM_C1_CFG5_ADDR A:0xfe051054
y.create.l HWIO_LPASS_AHBTM_C2_CFG5_ADDR A:0xfe051074
y.create.l HWIO_LPASS_AHBTM_C3_CFG5_ADDR A:0xfe051094
y.create.l HWIO_LPASS_AHBTM_C4_CFG5_ADDR A:0xfe0510b4
y.create.l HWIO_LPASS_AHBTM_C5_CFG5_ADDR A:0xfe0510d4
y.create.l HWIO_LPASS_AHBTM_C6_CFG5_ADDR A:0xfe0510f4
y.create.l HWIO_LPASS_AHBTM_C7_CFG5_ADDR A:0xfe051114
y.create.l HWIO_LPASS_AHBTM_C0_CFG6_ADDR A:0xfe051038
y.create.l HWIO_LPASS_AHBTM_C1_CFG6_ADDR A:0xfe051058
y.create.l HWIO_LPASS_AHBTM_C2_CFG6_ADDR A:0xfe051078
y.create.l HWIO_LPASS_AHBTM_C3_CFG6_ADDR A:0xfe051098
y.create.l HWIO_LPASS_AHBTM_C4_CFG6_ADDR A:0xfe0510b8
y.create.l HWIO_LPASS_AHBTM_C5_CFG6_ADDR A:0xfe0510d8
y.create.l HWIO_LPASS_AHBTM_C6_CFG6_ADDR A:0xfe0510f8
y.create.l HWIO_LPASS_AHBTM_C7_CFG6_ADDR A:0xfe051118
y.create.l HWIO_LPASS_AHBI_ABT_HW_VERSION_ADDR A:0xfe052000
y.create.l HWIO_LPASS_AHBI_ABT_INST_ID_ADDR A:0xfe052004
y.create.l HWIO_LPASS_AHBI_ABT_NUM_SLAVES_ADDR A:0xfe052008
y.create.l HWIO_LPASS_AHBI_ABT_TIMER_LOADVAL_ADDR A:0xfe05200c
y.create.l HWIO_LPASS_AHBI_ABT_TIMER_MODE_ADDR A:0xfe052010
y.create.l HWIO_LPASS_AHBI_ABT_INTR_STATUS_ADDR A:0xfe052014
y.create.l HWIO_LPASS_AHBI_ABT_INTR_CLEAR_ADDR A:0xfe052018
y.create.l HWIO_LPASS_AHBI_ABT_INTR_ENABLE_ADDR A:0xfe05201c
y.create.l HWIO_LPASS_AHBI_ABT_SYND_VALID_ADDR A:0xfe052020
y.create.l HWIO_LPASS_AHBI_ABT_SYND_CLEAR_ADDR A:0xfe052024
y.create.l HWIO_LPASS_AHBI_ABT_SYND_ID_ADDR A:0xfe052028
y.create.l HWIO_LPASS_AHBI_ABT_SYND_ADDR0_ADDR A:0xfe05202c
y.create.l HWIO_LPASS_AHBI_ABT_SYND_ADDR1_ADDR A:0xfe052030
y.create.l HWIO_LPASS_AHBI_ABT_SYND_HREADY_ADDR A:0xfe052034
y.create.l HWIO_LPASS_AVTIMER_CTL_ADDR A:0xfe053000
y.create.l HWIO_LPASS_AVTIMER_RESMOD_ADDR A:0xfe053004
y.create.l HWIO_LPASS_AVTIMER_TIMER_LSB_ADDR A:0xfe053008
y.create.l HWIO_LPASS_AVTIMER_TIMER_MSB_ADDR A:0xfe05300c
y.create.l HWIO_LPASS_AVTIMER_INT0_LSB_ADDR A:0xfe053010
y.create.l HWIO_LPASS_AVTIMER_INT0_MSB_ADDR A:0xfe053014
y.create.l HWIO_LPASS_AVTIMER_INT1_LSB_ADDR A:0xfe053018
y.create.l HWIO_LPASS_AVTIMER_INT1_MSB_ADDR A:0xfe05301c
y.create.l HWIO_LPASS_AVTIMER_DRE_TARGET_VALUE_ADDR A:0xfe053020
y.create.l HWIO_LPASS_AVTIMER_TIMEOUT_VAL_ADDR A:0xfe053024
y.create.l HWIO_LPASS_AVTIMER_DRE_CNT_PXO_ADDR A:0xfe053028
y.create.l HWIO_LPASS_AUD_SYNC_CTL_ADDR A:0xfe053400
y.create.l HWIO_LPASS_AUD_SYNC_STATUS_ADDR A:0xfe053404
y.create.l HWIO_LPASS_AUD_SYNC_BT_REF_INC_ADDR A:0xfe053408
y.create.l HWIO_LPASS_AUD_SYNC_BT_XO_DIV_MOD_ADDR A:0xfe05340c
y.create.l HWIO_LPASS_AUD_SYNC_BT_PHASE_CHK_XO1_ADDR A:0xfe053410
y.create.l HWIO_LPASS_AUD_SYNC_BT_PHASE_CHK_REF1_ADDR A:0xfe053414
y.create.l HWIO_LPASS_AUD_SYNC_BT_VFR_TIMESTAMP_ADDR A:0xfe053418
y.create.l HWIO_LPASS_AUD_SYNC_BT_COUNT_LOAD_XO1_ADDR A:0xfe05341c
y.create.l HWIO_LPASS_AUD_SYNC_BT_COUNT_LOAD_REF1_ADDR A:0xfe053420
y.create.l HWIO_LPASS_AUD_SYNC_BT_PHASE_CHK_XO2_ADDR A:0xfe053424
y.create.l HWIO_LPASS_AUD_SYNC_BT_PHASE_CHK_REF2_ADDR A:0xfe053428
y.create.l HWIO_LPASS_AUD_SYNC_BT_COUNT_LOAD_XO2_ADDR A:0xfe05342c
y.create.l HWIO_LPASS_AUD_SYNC_BT_COUNT_LOAD_REF2_ADDR A:0xfe053430
y.create.l HWIO_LPASS_AUD_SYNC_FM_REF_INC_ADDR A:0xfe053434
y.create.l HWIO_LPASS_AUD_SYNC_FM_XO_DIV_MOD_ADDR A:0xfe053438
y.create.l HWIO_LPASS_AUD_SYNC_FM_PHASE_CHK_XO_ADDR A:0xfe05343c
y.create.l HWIO_LPASS_AUD_SYNC_FM_PHASE_CHK_REF_ADDR A:0xfe053440
y.create.l HWIO_LPASS_AUD_SYNC_FM_VFR_TIMESTAMP_ADDR A:0xfe053444
y.create.l HWIO_LPASS_AUD_SYNC_FM_COUNT_LOAD_XO_ADDR A:0xfe053448
y.create.l HWIO_LPASS_AUD_SYNC_FM_COUNT_LOAD_REF_ADDR A:0xfe05344c
y.create.l HWIO_LPASS_DM_VMIDMT_SCR0_ADDR A:0xfe056000
y.create.l HWIO_LPASS_DM_VMIDMT_SCR1_ADDR A:0xfe056004
y.create.l HWIO_LPASS_DM_VMIDMT_SCR2_ADDR A:0xfe056008
y.create.l HWIO_LPASS_DM_VMIDMT_SACR_ADDR A:0xfe056010
y.create.l HWIO_LPASS_DM_VMIDMT_SIDR0_ADDR A:0xfe056020
y.create.l HWIO_LPASS_DM_VMIDMT_SIDR1_ADDR A:0xfe056024
y.create.l HWIO_LPASS_DM_VMIDMT_SIDR2_ADDR A:0xfe056028
y.create.l HWIO_LPASS_DM_VMIDMT_SIDR4_ADDR A:0xfe056030
y.create.l HWIO_LPASS_DM_VMIDMT_SIDR5_ADDR A:0xfe056034
y.create.l HWIO_LPASS_DM_VMIDMT_SIDR7_ADDR A:0xfe05603c
y.create.l HWIO_LPASS_DM_VMIDMT_SGFAR0_ADDR A:0xfe056040
y.create.l HWIO_LPASS_DM_VMIDMT_SGFSR_ADDR A:0xfe056048
y.create.l HWIO_LPASS_DM_VMIDMT_SGFSRRESTORE_ADDR A:0xfe05604c
y.create.l HWIO_LPASS_DM_VMIDMT_SGFSYNDR0_ADDR A:0xfe056050
y.create.l HWIO_LPASS_DM_VMIDMT_SGFSYNDR1_ADDR A:0xfe056054
y.create.l HWIO_LPASS_DM_VMIDMT_SGFSYNDR2_ADDR A:0xfe056058
y.create.l HWIO_LPASS_DM_VMIDMT_VMIDMTSCR0_ADDR A:0xfe056090
y.create.l HWIO_LPASS_DM_VMIDMT_CR0_ADDR A:0xfe056000
y.create.l HWIO_LPASS_DM_VMIDMT_CR2_ADDR A:0xfe056008
y.create.l HWIO_LPASS_DM_VMIDMT_ACR_ADDR A:0xfe056010
y.create.l HWIO_LPASS_DM_VMIDMT_IDR0_ADDR A:0xfe056020
y.create.l HWIO_LPASS_DM_VMIDMT_IDR1_ADDR A:0xfe056024
y.create.l HWIO_LPASS_DM_VMIDMT_IDR2_ADDR A:0xfe056028
y.create.l HWIO_LPASS_DM_VMIDMT_IDR4_ADDR A:0xfe056030
y.create.l HWIO_LPASS_DM_VMIDMT_IDR5_ADDR A:0xfe056034
y.create.l HWIO_LPASS_DM_VMIDMT_IDR7_ADDR A:0xfe05603c
y.create.l HWIO_LPASS_DM_VMIDMT_GFAR0_ADDR A:0xfe056040
y.create.l HWIO_LPASS_DM_VMIDMT_GFSR_ADDR A:0xfe056048
y.create.l HWIO_LPASS_DM_VMIDMT_GFSRRESTORE_ADDR A:0xfe05604c
y.create.l HWIO_LPASS_DM_VMIDMT_GFSYNDR0_ADDR A:0xfe056050
y.create.l HWIO_LPASS_DM_VMIDMT_GFSYNDR1_ADDR A:0xfe056054
y.create.l HWIO_LPASS_DM_VMIDMT_GFSYNDR2_ADDR A:0xfe056058
y.create.l HWIO_LPASS_DM_VMIDMT_VMIDMTCR0_ADDR A:0xfe056090
y.create.l HWIO_LPASS_DM_VMIDMT_VMIDMTACR_ADDR A:0xfe05609c
y.create.l HWIO_LPASS_DM_VMIDMT_NSCR0_ADDR A:0xfe056400
y.create.l HWIO_LPASS_DM_VMIDMT_NSCR2_ADDR A:0xfe056408
y.create.l HWIO_LPASS_DM_VMIDMT_NSACR_ADDR A:0xfe056410
y.create.l HWIO_LPASS_DM_VMIDMT_NSGFAR0_ADDR A:0xfe056440
y.create.l HWIO_LPASS_DM_VMIDMT_NSGFSR_ADDR A:0xfe056448
y.create.l HWIO_LPASS_DM_VMIDMT_NSGFSRRESTORE_ADDR A:0xfe05644c
y.create.l HWIO_LPASS_DM_VMIDMT_NSGFSYNDR0_ADDR A:0xfe056450
y.create.l HWIO_LPASS_DM_VMIDMT_NSGFSYNDR1_ADDR A:0xfe056454
y.create.l HWIO_LPASS_DM_VMIDMT_NSGFSYNDR2_ADDR A:0xfe056458
y.create.l HWIO_LPASS_DM_VMIDMT_NSVMIDMTCR0_ADDR A:0xfe056490
y.create.l HWIO_LPASS_DM_VMIDMT_SSDR0_ADDR A:0xfe056080
y.create.l HWIO_LPASS_DM_VMIDMT_S2VR0_ADDR A:0xfe056c00
y.create.l HWIO_LPASS_DM_VMIDMT_AS2VR0_ADDR A:0xfe056e00
y.create.l HWIO_LPASS_DM_VMIDMT_SMR0_ADDR A:0xfe056800
y.create.l HWIO_LPASS_LPAIF_VMIDMT_SCR0_ADDR A:0xfe057000
y.create.l HWIO_LPASS_LPAIF_VMIDMT_SCR1_ADDR A:0xfe057004
y.create.l HWIO_LPASS_LPAIF_VMIDMT_SCR2_ADDR A:0xfe057008
y.create.l HWIO_LPASS_LPAIF_VMIDMT_SACR_ADDR A:0xfe057010
y.create.l HWIO_LPASS_LPAIF_VMIDMT_SIDR0_ADDR A:0xfe057020
y.create.l HWIO_LPASS_LPAIF_VMIDMT_SIDR1_ADDR A:0xfe057024
y.create.l HWIO_LPASS_LPAIF_VMIDMT_SIDR2_ADDR A:0xfe057028
y.create.l HWIO_LPASS_LPAIF_VMIDMT_SIDR4_ADDR A:0xfe057030
y.create.l HWIO_LPASS_LPAIF_VMIDMT_SIDR5_ADDR A:0xfe057034
y.create.l HWIO_LPASS_LPAIF_VMIDMT_SIDR7_ADDR A:0xfe05703c
y.create.l HWIO_LPASS_LPAIF_VMIDMT_SGFAR0_ADDR A:0xfe057040
y.create.l HWIO_LPASS_LPAIF_VMIDMT_SGFSR_ADDR A:0xfe057048
y.create.l HWIO_LPASS_LPAIF_VMIDMT_SGFSRRESTORE_ADDR A:0xfe05704c
y.create.l HWIO_LPASS_LPAIF_VMIDMT_SGFSYNDR0_ADDR A:0xfe057050
y.create.l HWIO_LPASS_LPAIF_VMIDMT_SGFSYNDR1_ADDR A:0xfe057054
y.create.l HWIO_LPASS_LPAIF_VMIDMT_SGFSYNDR2_ADDR A:0xfe057058
y.create.l HWIO_LPASS_LPAIF_VMIDMT_VMIDMTSCR0_ADDR A:0xfe057090
y.create.l HWIO_LPASS_LPAIF_VMIDMT_CR0_ADDR A:0xfe057000
y.create.l HWIO_LPASS_LPAIF_VMIDMT_CR2_ADDR A:0xfe057008
y.create.l HWIO_LPASS_LPAIF_VMIDMT_ACR_ADDR A:0xfe057010
y.create.l HWIO_LPASS_LPAIF_VMIDMT_IDR0_ADDR A:0xfe057020
y.create.l HWIO_LPASS_LPAIF_VMIDMT_IDR1_ADDR A:0xfe057024
y.create.l HWIO_LPASS_LPAIF_VMIDMT_IDR2_ADDR A:0xfe057028
y.create.l HWIO_LPASS_LPAIF_VMIDMT_IDR4_ADDR A:0xfe057030
y.create.l HWIO_LPASS_LPAIF_VMIDMT_IDR5_ADDR A:0xfe057034
y.create.l HWIO_LPASS_LPAIF_VMIDMT_IDR7_ADDR A:0xfe05703c
y.create.l HWIO_LPASS_LPAIF_VMIDMT_GFAR0_ADDR A:0xfe057040
y.create.l HWIO_LPASS_LPAIF_VMIDMT_GFSR_ADDR A:0xfe057048
y.create.l HWIO_LPASS_LPAIF_VMIDMT_GFSRRESTORE_ADDR A:0xfe05704c
y.create.l HWIO_LPASS_LPAIF_VMIDMT_GFSYNDR0_ADDR A:0xfe057050
y.create.l HWIO_LPASS_LPAIF_VMIDMT_GFSYNDR1_ADDR A:0xfe057054
y.create.l HWIO_LPASS_LPAIF_VMIDMT_GFSYNDR2_ADDR A:0xfe057058
y.create.l HWIO_LPASS_LPAIF_VMIDMT_VMIDMTCR0_ADDR A:0xfe057090
y.create.l HWIO_LPASS_LPAIF_VMIDMT_VMIDMTACR_ADDR A:0xfe05709c
y.create.l HWIO_LPASS_LPAIF_VMIDMT_NSCR0_ADDR A:0xfe057400
y.create.l HWIO_LPASS_LPAIF_VMIDMT_NSCR2_ADDR A:0xfe057408
y.create.l HWIO_LPASS_LPAIF_VMIDMT_NSACR_ADDR A:0xfe057410
y.create.l HWIO_LPASS_LPAIF_VMIDMT_NSGFAR0_ADDR A:0xfe057440
y.create.l HWIO_LPASS_LPAIF_VMIDMT_NSGFSR_ADDR A:0xfe057448
y.create.l HWIO_LPASS_LPAIF_VMIDMT_NSGFSRRESTORE_ADDR A:0xfe05744c
y.create.l HWIO_LPASS_LPAIF_VMIDMT_NSGFSYNDR0_ADDR A:0xfe057450
y.create.l HWIO_LPASS_LPAIF_VMIDMT_NSGFSYNDR1_ADDR A:0xfe057454
y.create.l HWIO_LPASS_LPAIF_VMIDMT_NSGFSYNDR2_ADDR A:0xfe057458
y.create.l HWIO_LPASS_LPAIF_VMIDMT_NSVMIDMTCR0_ADDR A:0xfe057490
y.create.l HWIO_LPASS_LPAIF_VMIDMT_SSDR0_ADDR A:0xfe057080
y.create.l HWIO_LPASS_LPAIF_VMIDMT_S2VR0_ADDR A:0xfe057c00
y.create.l HWIO_LPASS_LPAIF_VMIDMT_S2VR1_ADDR A:0xfe057c04
y.create.l HWIO_LPASS_LPAIF_VMIDMT_S2VR2_ADDR A:0xfe057c08
y.create.l HWIO_LPASS_LPAIF_VMIDMT_S2VR3_ADDR A:0xfe057c0c
y.create.l HWIO_LPASS_LPAIF_VMIDMT_S2VR4_ADDR A:0xfe057c10
y.create.l HWIO_LPASS_LPAIF_VMIDMT_S2VR5_ADDR A:0xfe057c14
y.create.l HWIO_LPASS_LPAIF_VMIDMT_S2VR6_ADDR A:0xfe057c18
y.create.l HWIO_LPASS_LPAIF_VMIDMT_S2VR7_ADDR A:0xfe057c1c
y.create.l HWIO_LPASS_LPAIF_VMIDMT_S2VR8_ADDR A:0xfe057c20
y.create.l HWIO_LPASS_LPAIF_VMIDMT_AS2VR0_ADDR A:0xfe057e00
y.create.l HWIO_LPASS_LPAIF_VMIDMT_AS2VR1_ADDR A:0xfe057e04
y.create.l HWIO_LPASS_LPAIF_VMIDMT_AS2VR2_ADDR A:0xfe057e08
y.create.l HWIO_LPASS_LPAIF_VMIDMT_AS2VR3_ADDR A:0xfe057e0c
y.create.l HWIO_LPASS_LPAIF_VMIDMT_AS2VR4_ADDR A:0xfe057e10
y.create.l HWIO_LPASS_LPAIF_VMIDMT_AS2VR5_ADDR A:0xfe057e14
y.create.l HWIO_LPASS_LPAIF_VMIDMT_AS2VR6_ADDR A:0xfe057e18
y.create.l HWIO_LPASS_LPAIF_VMIDMT_AS2VR7_ADDR A:0xfe057e1c
y.create.l HWIO_LPASS_LPAIF_VMIDMT_AS2VR8_ADDR A:0xfe057e20
y.create.l HWIO_LPASS_LPAIF_VMIDMT_SMR0_ADDR A:0xfe057800
y.create.l HWIO_LPASS_LPAIF_VMIDMT_SMR1_ADDR A:0xfe057804
y.create.l HWIO_LPASS_LPAIF_VMIDMT_SMR2_ADDR A:0xfe057808
y.create.l HWIO_LPASS_LPAIF_VMIDMT_SMR3_ADDR A:0xfe05780c
y.create.l HWIO_LPASS_LPAIF_VMIDMT_SMR4_ADDR A:0xfe057810
y.create.l HWIO_LPASS_LPAIF_VMIDMT_SMR5_ADDR A:0xfe057814
y.create.l HWIO_LPASS_LPAIF_VMIDMT_SMR6_ADDR A:0xfe057818
y.create.l HWIO_LPASS_LPAIF_VMIDMT_SMR7_ADDR A:0xfe05781c
y.create.l HWIO_LPASS_LPAIF_VMIDMT_SMR8_ADDR A:0xfe057820
y.create.l HWIO_LPASS_LPM_XPU_SCR_ADDR A:0xfe065000
y.create.l HWIO_LPASS_LPM_XPU_SWDR_ADDR A:0xfe065004
y.create.l HWIO_LPASS_LPM_XPU_PRTN_RACR_SSHADOW_ADDR A:0xfe065008
y.create.l HWIO_LPASS_LPM_XPU_PRTN_WACR_SSHADOW_ADDR A:0xfe06500c
y.create.l HWIO_LPASS_LPM_XPU_PRTN_START_SSHADOW0_ADDR A:0xfe065010
y.create.l HWIO_LPASS_LPM_XPU_PRTN_END_SSHADOW0_ADDR A:0xfe065018
y.create.l HWIO_LPASS_LPM_XPU_SEAR0_ADDR A:0xfe065040
y.create.l HWIO_LPASS_LPM_XPU_SESR_ADDR A:0xfe065048
y.create.l HWIO_LPASS_LPM_XPU_SESRRESTORE_ADDR A:0xfe06504c
y.create.l HWIO_LPASS_LPM_XPU_SESYNR0_ADDR A:0xfe065050
y.create.l HWIO_LPASS_LPM_XPU_SESYNR1_ADDR A:0xfe065054
y.create.l HWIO_LPASS_LPM_XPU_SESYNR2_ADDR A:0xfe065058
y.create.l HWIO_LPASS_LPM_XPU_MCR_ADDR A:0xfe065100
y.create.l HWIO_LPASS_LPM_XPU_MEAR0_ADDR A:0xfe065140
y.create.l HWIO_LPASS_LPM_XPU_MESR_ADDR A:0xfe065148
y.create.l HWIO_LPASS_LPM_XPU_MESRRESTORE_ADDR A:0xfe06514c
y.create.l HWIO_LPASS_LPM_XPU_MESYNR0_ADDR A:0xfe065150
y.create.l HWIO_LPASS_LPM_XPU_MESYNR1_ADDR A:0xfe065154
y.create.l HWIO_LPASS_LPM_XPU_MESYNR2_ADDR A:0xfe065158
y.create.l HWIO_LPASS_LPM_XPU_CR_ADDR A:0xfe065080
y.create.l HWIO_LPASS_LPM_XPU_PRTN_RACR_SHADOW_ADDR A:0xfe065088
y.create.l HWIO_LPASS_LPM_XPU_PRTN_WACR_SHADOW_ADDR A:0xfe06508c
y.create.l HWIO_LPASS_LPM_XPU_PRTN_START_SHADOW0_ADDR A:0xfe065090
y.create.l HWIO_LPASS_LPM_XPU_PRTN_END_SHADOW0_ADDR A:0xfe065098
y.create.l HWIO_LPASS_LPM_XPU_RPU_ACR0_ADDR A:0xfe0650a0
y.create.l HWIO_LPASS_LPM_XPU_EAR0_ADDR A:0xfe0650c0
y.create.l HWIO_LPASS_LPM_XPU_ESR_ADDR A:0xfe0650c8
y.create.l HWIO_LPASS_LPM_XPU_ESRRESTORE_ADDR A:0xfe0650cc
y.create.l HWIO_LPASS_LPM_XPU_ESYNR0_ADDR A:0xfe0650d0
y.create.l HWIO_LPASS_LPM_XPU_ESYNR1_ADDR A:0xfe0650d4
y.create.l HWIO_LPASS_LPM_XPU_ESYNR2_ADDR A:0xfe0650d8
y.create.l HWIO_LPASS_LPM_XPU_UMR_RACR_ADDR A:0xfe0650e0
y.create.l HWIO_LPASS_LPM_XPU_UMR_WACR_ADDR A:0xfe0650e4
y.create.l HWIO_LPASS_LPM_XPU_IDR0_ADDR A:0xfe065074
y.create.l HWIO_LPASS_LPM_XPU_IDR1_ADDR A:0xfe065078
y.create.l HWIO_LPASS_LPM_XPU_REV_ADDR A:0xfe06507c
y.create.l HWIO_LPASS_LPM_XPU_PRT0_RACR0_ADDR A:0xfe065200
y.create.l HWIO_LPASS_LPM_XPU_PRT1_RACR0_ADDR A:0xfe065280
y.create.l HWIO_LPASS_LPM_XPU_PRT2_RACR0_ADDR A:0xfe065300
y.create.l HWIO_LPASS_LPM_XPU_PRT3_RACR0_ADDR A:0xfe065380
y.create.l HWIO_LPASS_LPM_XPU_PRT4_RACR0_ADDR A:0xfe065400
y.create.l HWIO_LPASS_LPM_XPU_PRT5_RACR0_ADDR A:0xfe065480
y.create.l HWIO_LPASS_LPM_XPU_PRT6_RACR0_ADDR A:0xfe065500
y.create.l HWIO_LPASS_LPM_XPU_PRT7_RACR0_ADDR A:0xfe065580
y.create.l HWIO_LPASS_LPM_XPU_PRT8_RACR0_ADDR A:0xfe065600
y.create.l HWIO_LPASS_LPM_XPU_PRT9_RACR0_ADDR A:0xfe065680
y.create.l HWIO_LPASS_LPM_XPU_PRT0_WACR0_ADDR A:0xfe065220
y.create.l HWIO_LPASS_LPM_XPU_PRT1_WACR0_ADDR A:0xfe0652a0
y.create.l HWIO_LPASS_LPM_XPU_PRT2_WACR0_ADDR A:0xfe065320
y.create.l HWIO_LPASS_LPM_XPU_PRT3_WACR0_ADDR A:0xfe0653a0
y.create.l HWIO_LPASS_LPM_XPU_PRT4_WACR0_ADDR A:0xfe065420
y.create.l HWIO_LPASS_LPM_XPU_PRT5_WACR0_ADDR A:0xfe0654a0
y.create.l HWIO_LPASS_LPM_XPU_PRT6_WACR0_ADDR A:0xfe065520
y.create.l HWIO_LPASS_LPM_XPU_PRT7_WACR0_ADDR A:0xfe0655a0
y.create.l HWIO_LPASS_LPM_XPU_PRT8_WACR0_ADDR A:0xfe065620
y.create.l HWIO_LPASS_LPM_XPU_PRT9_WACR0_ADDR A:0xfe0656a0
y.create.l HWIO_LPASS_LPM_XPU_PRT0_START0_ADDR A:0xfe065240
y.create.l HWIO_LPASS_LPM_XPU_PRT1_START0_ADDR A:0xfe0652c0
y.create.l HWIO_LPASS_LPM_XPU_PRT2_START0_ADDR A:0xfe065340
y.create.l HWIO_LPASS_LPM_XPU_PRT3_START0_ADDR A:0xfe0653c0
y.create.l HWIO_LPASS_LPM_XPU_PRT4_START0_ADDR A:0xfe065440
y.create.l HWIO_LPASS_LPM_XPU_PRT5_START0_ADDR A:0xfe0654c0
y.create.l HWIO_LPASS_LPM_XPU_PRT6_START0_ADDR A:0xfe065540
y.create.l HWIO_LPASS_LPM_XPU_PRT7_START0_ADDR A:0xfe0655c0
y.create.l HWIO_LPASS_LPM_XPU_PRT8_START0_ADDR A:0xfe065640
y.create.l HWIO_LPASS_LPM_XPU_PRT9_START0_ADDR A:0xfe0656c0
y.create.l HWIO_LPASS_LPM_XPU_PRT0_END0_ADDR A:0xfe065248
y.create.l HWIO_LPASS_LPM_XPU_PRT1_END0_ADDR A:0xfe0652c8
y.create.l HWIO_LPASS_LPM_XPU_PRT2_END0_ADDR A:0xfe065348
y.create.l HWIO_LPASS_LPM_XPU_PRT3_END0_ADDR A:0xfe0653c8
y.create.l HWIO_LPASS_LPM_XPU_PRT4_END0_ADDR A:0xfe065448
y.create.l HWIO_LPASS_LPM_XPU_PRT5_END0_ADDR A:0xfe0654c8
y.create.l HWIO_LPASS_LPM_XPU_PRT6_END0_ADDR A:0xfe065548
y.create.l HWIO_LPASS_LPM_XPU_PRT7_END0_ADDR A:0xfe0655c8
y.create.l HWIO_LPASS_LPM_XPU_PRT8_END0_ADDR A:0xfe065648
y.create.l HWIO_LPASS_LPM_XPU_PRT9_END0_ADDR A:0xfe0656c8
y.create.l HWIO_LPASS_LPM_XPU_PRT0_SCR_ADDR A:0xfe065250
y.create.l HWIO_LPASS_LPM_XPU_PRT1_SCR_ADDR A:0xfe0652d0
y.create.l HWIO_LPASS_LPM_XPU_PRT2_SCR_ADDR A:0xfe065350
y.create.l HWIO_LPASS_LPM_XPU_PRT3_SCR_ADDR A:0xfe0653d0
y.create.l HWIO_LPASS_LPM_XPU_PRT4_SCR_ADDR A:0xfe065450
y.create.l HWIO_LPASS_LPM_XPU_PRT5_SCR_ADDR A:0xfe0654d0
y.create.l HWIO_LPASS_LPM_XPU_PRT6_SCR_ADDR A:0xfe065550
y.create.l HWIO_LPASS_LPM_XPU_PRT7_SCR_ADDR A:0xfe0655d0
y.create.l HWIO_LPASS_LPM_XPU_PRT8_SCR_ADDR A:0xfe065650
y.create.l HWIO_LPASS_LPM_XPU_PRT9_SCR_ADDR A:0xfe0656d0
y.create.l HWIO_LPASS_LPM_XPU_RG0_MCR_ADDR A:0xfe065254
y.create.l HWIO_LPASS_LPM_XPU_RG1_MCR_ADDR A:0xfe0652d4
y.create.l HWIO_LPASS_LPM_XPU_RG2_MCR_ADDR A:0xfe065354
y.create.l HWIO_LPASS_LPM_XPU_RG3_MCR_ADDR A:0xfe0653d4
y.create.l HWIO_LPASS_LPM_XPU_RG4_MCR_ADDR A:0xfe065454
y.create.l HWIO_LPASS_LPM_XPU_RG5_MCR_ADDR A:0xfe0654d4
y.create.l HWIO_LPASS_LPM_XPU_RG6_MCR_ADDR A:0xfe065554
y.create.l HWIO_LPASS_LPM_XPU_RG7_MCR_ADDR A:0xfe0655d4
y.create.l HWIO_LPASS_LPM_XPU_RG8_MCR_ADDR A:0xfe065654
y.create.l HWIO_LPASS_LPM_XPU_RG9_MCR_ADDR A:0xfe0656d4
y.create.l HWIO_LPASS_LPM_XPU_PRT0_CNTL0_ADDR A:0xfe065258
y.create.l HWIO_LPASS_LPM_XPU_PRT1_CNTL0_ADDR A:0xfe0652d8
y.create.l HWIO_LPASS_LPM_XPU_PRT2_CNTL0_ADDR A:0xfe065358
y.create.l HWIO_LPASS_LPM_XPU_PRT3_CNTL0_ADDR A:0xfe0653d8
y.create.l HWIO_LPASS_LPM_XPU_PRT4_CNTL0_ADDR A:0xfe065458
y.create.l HWIO_LPASS_LPM_XPU_PRT5_CNTL0_ADDR A:0xfe0654d8
y.create.l HWIO_LPASS_LPM_XPU_PRT6_CNTL0_ADDR A:0xfe065558
y.create.l HWIO_LPASS_LPM_XPU_PRT7_CNTL0_ADDR A:0xfe0655d8
y.create.l HWIO_LPASS_LPM_XPU_PRT8_CNTL0_ADDR A:0xfe065658
y.create.l HWIO_LPASS_LPM_XPU_PRT9_CNTL0_ADDR A:0xfe0656d8
y.create.l HWIO_LPASS_LPM_XPU_PRT0_CNTL1_ADDR A:0xfe06525c
y.create.l HWIO_LPASS_LPM_XPU_PRT1_CNTL1_ADDR A:0xfe0652dc
y.create.l HWIO_LPASS_LPM_XPU_PRT2_CNTL1_ADDR A:0xfe06535c
y.create.l HWIO_LPASS_LPM_XPU_PRT3_CNTL1_ADDR A:0xfe0653dc
y.create.l HWIO_LPASS_LPM_XPU_PRT4_CNTL1_ADDR A:0xfe06545c
y.create.l HWIO_LPASS_LPM_XPU_PRT5_CNTL1_ADDR A:0xfe0654dc
y.create.l HWIO_LPASS_LPM_XPU_PRT6_CNTL1_ADDR A:0xfe06555c
y.create.l HWIO_LPASS_LPM_XPU_PRT7_CNTL1_ADDR A:0xfe0655dc
y.create.l HWIO_LPASS_LPM_XPU_PRT8_CNTL1_ADDR A:0xfe06565c
y.create.l HWIO_LPASS_LPM_XPU_PRT9_CNTL1_ADDR A:0xfe0656dc
y.create.l HWIO_LPASS_CSR_XPU_SCR_ADDR A:0xfe066000
y.create.l HWIO_LPASS_CSR_XPU_SWDR_ADDR A:0xfe066004
y.create.l HWIO_LPASS_CSR_XPU_SEAR0_ADDR A:0xfe066040
y.create.l HWIO_LPASS_CSR_XPU_SESR_ADDR A:0xfe066048
y.create.l HWIO_LPASS_CSR_XPU_SESRRESTORE_ADDR A:0xfe06604c
y.create.l HWIO_LPASS_CSR_XPU_SESYNR0_ADDR A:0xfe066050
y.create.l HWIO_LPASS_CSR_XPU_SESYNR1_ADDR A:0xfe066054
y.create.l HWIO_LPASS_CSR_XPU_SESYNR2_ADDR A:0xfe066058
y.create.l HWIO_LPASS_CSR_XPU_MCR_ADDR A:0xfe066100
y.create.l HWIO_LPASS_CSR_XPU_MEAR0_ADDR A:0xfe066140
y.create.l HWIO_LPASS_CSR_XPU_MESR_ADDR A:0xfe066148
y.create.l HWIO_LPASS_CSR_XPU_MESRRESTORE_ADDR A:0xfe06614c
y.create.l HWIO_LPASS_CSR_XPU_MESYNR0_ADDR A:0xfe066150
y.create.l HWIO_LPASS_CSR_XPU_MESYNR1_ADDR A:0xfe066154
y.create.l HWIO_LPASS_CSR_XPU_MESYNR2_ADDR A:0xfe066158
y.create.l HWIO_LPASS_CSR_XPU_CR_ADDR A:0xfe066080
y.create.l HWIO_LPASS_CSR_XPU_RPU_ACR0_ADDR A:0xfe0660a0
y.create.l HWIO_LPASS_CSR_XPU_EAR0_ADDR A:0xfe0660c0
y.create.l HWIO_LPASS_CSR_XPU_ESR_ADDR A:0xfe0660c8
y.create.l HWIO_LPASS_CSR_XPU_ESRRESTORE_ADDR A:0xfe0660cc
y.create.l HWIO_LPASS_CSR_XPU_ESYNR0_ADDR A:0xfe0660d0
y.create.l HWIO_LPASS_CSR_XPU_ESYNR1_ADDR A:0xfe0660d4
y.create.l HWIO_LPASS_CSR_XPU_ESYNR2_ADDR A:0xfe0660d8
y.create.l HWIO_LPASS_CSR_XPU_IDR0_ADDR A:0xfe066074
y.create.l HWIO_LPASS_CSR_XPU_IDR1_ADDR A:0xfe066078
y.create.l HWIO_LPASS_CSR_XPU_REV_ADDR A:0xfe06607c
y.create.l HWIO_LPASS_CSR_XPU_RG0_RACR0_ADDR A:0xfe066200
y.create.l HWIO_LPASS_CSR_XPU_RG1_RACR0_ADDR A:0xfe066280
y.create.l HWIO_LPASS_CSR_XPU_RG2_RACR0_ADDR A:0xfe066300
y.create.l HWIO_LPASS_CSR_XPU_RG3_RACR0_ADDR A:0xfe066380
y.create.l HWIO_LPASS_CSR_XPU_RG4_RACR0_ADDR A:0xfe066400
y.create.l HWIO_LPASS_CSR_XPU_RG5_RACR0_ADDR A:0xfe066480
y.create.l HWIO_LPASS_CSR_XPU_RG6_RACR0_ADDR A:0xfe066500
y.create.l HWIO_LPASS_CSR_XPU_RG0_WACR0_ADDR A:0xfe066220
y.create.l HWIO_LPASS_CSR_XPU_RG1_WACR0_ADDR A:0xfe0662a0
y.create.l HWIO_LPASS_CSR_XPU_RG2_WACR0_ADDR A:0xfe066320
y.create.l HWIO_LPASS_CSR_XPU_RG3_WACR0_ADDR A:0xfe0663a0
y.create.l HWIO_LPASS_CSR_XPU_RG4_WACR0_ADDR A:0xfe066420
y.create.l HWIO_LPASS_CSR_XPU_RG5_WACR0_ADDR A:0xfe0664a0
y.create.l HWIO_LPASS_CSR_XPU_RG6_WACR0_ADDR A:0xfe066520
y.create.l HWIO_LPASS_CSR_XPU_RG0_SCR_ADDR A:0xfe066250
y.create.l HWIO_LPASS_CSR_XPU_RG1_SCR_ADDR A:0xfe0662d0
y.create.l HWIO_LPASS_CSR_XPU_RG2_SCR_ADDR A:0xfe066350
y.create.l HWIO_LPASS_CSR_XPU_RG3_SCR_ADDR A:0xfe0663d0
y.create.l HWIO_LPASS_CSR_XPU_RG4_SCR_ADDR A:0xfe066450
y.create.l HWIO_LPASS_CSR_XPU_RG5_SCR_ADDR A:0xfe0664d0
y.create.l HWIO_LPASS_CSR_XPU_RG6_SCR_ADDR A:0xfe066550
y.create.l HWIO_LPASS_CSR_XPU_RG0_MCR_ADDR A:0xfe066254
y.create.l HWIO_LPASS_CSR_XPU_RG1_MCR_ADDR A:0xfe0662d4
y.create.l HWIO_LPASS_CSR_XPU_RG2_MCR_ADDR A:0xfe066354
y.create.l HWIO_LPASS_CSR_XPU_RG3_MCR_ADDR A:0xfe0663d4
y.create.l HWIO_LPASS_CSR_XPU_RG4_MCR_ADDR A:0xfe066454
y.create.l HWIO_LPASS_CSR_XPU_RG5_MCR_ADDR A:0xfe0664d4
y.create.l HWIO_LPASS_CSR_XPU_RG6_MCR_ADDR A:0xfe066554
y.create.l HWIO_LPASS_CMN_XPU_SCR_ADDR A:0xfe067000
y.create.l HWIO_LPASS_CMN_XPU_SWDR_ADDR A:0xfe067004
y.create.l HWIO_LPASS_CMN_XPU_SEAR0_ADDR A:0xfe067040
y.create.l HWIO_LPASS_CMN_XPU_SESR_ADDR A:0xfe067048
y.create.l HWIO_LPASS_CMN_XPU_SESRRESTORE_ADDR A:0xfe06704c
y.create.l HWIO_LPASS_CMN_XPU_SESYNR0_ADDR A:0xfe067050
y.create.l HWIO_LPASS_CMN_XPU_SESYNR1_ADDR A:0xfe067054
y.create.l HWIO_LPASS_CMN_XPU_SESYNR2_ADDR A:0xfe067058
y.create.l HWIO_LPASS_CMN_XPU_MCR_ADDR A:0xfe067100
y.create.l HWIO_LPASS_CMN_XPU_MEAR0_ADDR A:0xfe067140
y.create.l HWIO_LPASS_CMN_XPU_MESR_ADDR A:0xfe067148
y.create.l HWIO_LPASS_CMN_XPU_MESRRESTORE_ADDR A:0xfe06714c
y.create.l HWIO_LPASS_CMN_XPU_MESYNR0_ADDR A:0xfe067150
y.create.l HWIO_LPASS_CMN_XPU_MESYNR1_ADDR A:0xfe067154
y.create.l HWIO_LPASS_CMN_XPU_MESYNR2_ADDR A:0xfe067158
y.create.l HWIO_LPASS_CMN_XPU_CR_ADDR A:0xfe067080
y.create.l HWIO_LPASS_CMN_XPU_RPU_ACR0_ADDR A:0xfe0670a0
y.create.l HWIO_LPASS_CMN_XPU_EAR0_ADDR A:0xfe0670c0
y.create.l HWIO_LPASS_CMN_XPU_ESR_ADDR A:0xfe0670c8
y.create.l HWIO_LPASS_CMN_XPU_ESRRESTORE_ADDR A:0xfe0670cc
y.create.l HWIO_LPASS_CMN_XPU_ESYNR0_ADDR A:0xfe0670d0
y.create.l HWIO_LPASS_CMN_XPU_ESYNR1_ADDR A:0xfe0670d4
y.create.l HWIO_LPASS_CMN_XPU_ESYNR2_ADDR A:0xfe0670d8
y.create.l HWIO_LPASS_CMN_XPU_IDR0_ADDR A:0xfe067074
y.create.l HWIO_LPASS_CMN_XPU_IDR1_ADDR A:0xfe067078
y.create.l HWIO_LPASS_CMN_XPU_REV_ADDR A:0xfe06707c
y.create.l HWIO_LPASS_CMN_XPU_RG0_RACR0_ADDR A:0xfe067200
y.create.l HWIO_LPASS_CMN_XPU_RG1_RACR0_ADDR A:0xfe067280
y.create.l HWIO_LPASS_CMN_XPU_RG2_RACR0_ADDR A:0xfe067300
y.create.l HWIO_LPASS_CMN_XPU_RG3_RACR0_ADDR A:0xfe067380
y.create.l HWIO_LPASS_CMN_XPU_RG0_SCR_ADDR A:0xfe067250
y.create.l HWIO_LPASS_CMN_XPU_RG1_SCR_ADDR A:0xfe0672d0
y.create.l HWIO_LPASS_CMN_XPU_RG2_SCR_ADDR A:0xfe067350
y.create.l HWIO_LPASS_CMN_XPU_RG3_SCR_ADDR A:0xfe0673d0
y.create.l HWIO_LPASS_CMN_XPU_RG0_MCR_ADDR A:0xfe067254
y.create.l HWIO_LPASS_CMN_XPU_RG1_MCR_ADDR A:0xfe0672d4
y.create.l HWIO_LPASS_CMN_XPU_RG2_MCR_ADDR A:0xfe067354
y.create.l HWIO_LPASS_CMN_XPU_RG3_MCR_ADDR A:0xfe0673d4
y.create.l HWIO_LPASS_LPAIF_XPU_SCR_ADDR A:0xfe06a000
y.create.l HWIO_LPASS_LPAIF_XPU_SWDR_ADDR A:0xfe06a004
y.create.l HWIO_LPASS_LPAIF_XPU_SEAR0_ADDR A:0xfe06a040
y.create.l HWIO_LPASS_LPAIF_XPU_SESR_ADDR A:0xfe06a048
y.create.l HWIO_LPASS_LPAIF_XPU_SESRRESTORE_ADDR A:0xfe06a04c
y.create.l HWIO_LPASS_LPAIF_XPU_SESYNR0_ADDR A:0xfe06a050
y.create.l HWIO_LPASS_LPAIF_XPU_SESYNR1_ADDR A:0xfe06a054
y.create.l HWIO_LPASS_LPAIF_XPU_SESYNR2_ADDR A:0xfe06a058
y.create.l HWIO_LPASS_LPAIF_XPU_MCR_ADDR A:0xfe06a100
y.create.l HWIO_LPASS_LPAIF_XPU_MEAR0_ADDR A:0xfe06a140
y.create.l HWIO_LPASS_LPAIF_XPU_MESR_ADDR A:0xfe06a148
y.create.l HWIO_LPASS_LPAIF_XPU_MESRRESTORE_ADDR A:0xfe06a14c
y.create.l HWIO_LPASS_LPAIF_XPU_MESYNR0_ADDR A:0xfe06a150
y.create.l HWIO_LPASS_LPAIF_XPU_MESYNR1_ADDR A:0xfe06a154
y.create.l HWIO_LPASS_LPAIF_XPU_MESYNR2_ADDR A:0xfe06a158
y.create.l HWIO_LPASS_LPAIF_XPU_CR_ADDR A:0xfe06a080
y.create.l HWIO_LPASS_LPAIF_XPU_RPU_ACR0_ADDR A:0xfe06a0a0
y.create.l HWIO_LPASS_LPAIF_XPU_EAR0_ADDR A:0xfe06a0c0
y.create.l HWIO_LPASS_LPAIF_XPU_ESR_ADDR A:0xfe06a0c8
y.create.l HWIO_LPASS_LPAIF_XPU_ESRRESTORE_ADDR A:0xfe06a0cc
y.create.l HWIO_LPASS_LPAIF_XPU_ESYNR0_ADDR A:0xfe06a0d0
y.create.l HWIO_LPASS_LPAIF_XPU_ESYNR1_ADDR A:0xfe06a0d4
y.create.l HWIO_LPASS_LPAIF_XPU_ESYNR2_ADDR A:0xfe06a0d8
y.create.l HWIO_LPASS_LPAIF_XPU_IDR0_ADDR A:0xfe06a074
y.create.l HWIO_LPASS_LPAIF_XPU_IDR1_ADDR A:0xfe06a078
y.create.l HWIO_LPASS_LPAIF_XPU_REV_ADDR A:0xfe06a07c
y.create.l HWIO_LPASS_LPAIF_XPU_RG0_RACR0_ADDR A:0xfe06a200
y.create.l HWIO_LPASS_LPAIF_XPU_RG1_RACR0_ADDR A:0xfe06a280
y.create.l HWIO_LPASS_LPAIF_XPU_RG2_RACR0_ADDR A:0xfe06a300
y.create.l HWIO_LPASS_LPAIF_XPU_RG3_RACR0_ADDR A:0xfe06a380
y.create.l HWIO_LPASS_LPAIF_XPU_RG4_RACR0_ADDR A:0xfe06a400
y.create.l HWIO_LPASS_LPAIF_XPU_RG5_RACR0_ADDR A:0xfe06a480
y.create.l HWIO_LPASS_LPAIF_XPU_RG6_RACR0_ADDR A:0xfe06a500
y.create.l HWIO_LPASS_LPAIF_XPU_RG7_RACR0_ADDR A:0xfe06a580
y.create.l HWIO_LPASS_LPAIF_XPU_RG8_RACR0_ADDR A:0xfe06a600
y.create.l HWIO_LPASS_LPAIF_XPU_RG9_RACR0_ADDR A:0xfe06a680
y.create.l HWIO_LPASS_LPAIF_XPU_RG0_WACR0_ADDR A:0xfe06a220
y.create.l HWIO_LPASS_LPAIF_XPU_RG1_WACR0_ADDR A:0xfe06a2a0
y.create.l HWIO_LPASS_LPAIF_XPU_RG2_WACR0_ADDR A:0xfe06a320
y.create.l HWIO_LPASS_LPAIF_XPU_RG3_WACR0_ADDR A:0xfe06a3a0
y.create.l HWIO_LPASS_LPAIF_XPU_RG4_WACR0_ADDR A:0xfe06a420
y.create.l HWIO_LPASS_LPAIF_XPU_RG5_WACR0_ADDR A:0xfe06a4a0
y.create.l HWIO_LPASS_LPAIF_XPU_RG6_WACR0_ADDR A:0xfe06a520
y.create.l HWIO_LPASS_LPAIF_XPU_RG7_WACR0_ADDR A:0xfe06a5a0
y.create.l HWIO_LPASS_LPAIF_XPU_RG8_WACR0_ADDR A:0xfe06a620
y.create.l HWIO_LPASS_LPAIF_XPU_RG9_WACR0_ADDR A:0xfe06a6a0
y.create.l HWIO_LPASS_LPAIF_XPU_RG0_SCR_ADDR A:0xfe06a250
y.create.l HWIO_LPASS_LPAIF_XPU_RG1_SCR_ADDR A:0xfe06a2d0
y.create.l HWIO_LPASS_LPAIF_XPU_RG2_SCR_ADDR A:0xfe06a350
y.create.l HWIO_LPASS_LPAIF_XPU_RG3_SCR_ADDR A:0xfe06a3d0
y.create.l HWIO_LPASS_LPAIF_XPU_RG4_SCR_ADDR A:0xfe06a450
y.create.l HWIO_LPASS_LPAIF_XPU_RG5_SCR_ADDR A:0xfe06a4d0
y.create.l HWIO_LPASS_LPAIF_XPU_RG6_SCR_ADDR A:0xfe06a550
y.create.l HWIO_LPASS_LPAIF_XPU_RG7_SCR_ADDR A:0xfe06a5d0
y.create.l HWIO_LPASS_LPAIF_XPU_RG8_SCR_ADDR A:0xfe06a650
y.create.l HWIO_LPASS_LPAIF_XPU_RG9_SCR_ADDR A:0xfe06a6d0
y.create.l HWIO_LPASS_LPAIF_XPU_RG0_MCR_ADDR A:0xfe06a254
y.create.l HWIO_LPASS_LPAIF_XPU_RG1_MCR_ADDR A:0xfe06a2d4
y.create.l HWIO_LPASS_LPAIF_XPU_RG2_MCR_ADDR A:0xfe06a354
y.create.l HWIO_LPASS_LPAIF_XPU_RG3_MCR_ADDR A:0xfe06a3d4
y.create.l HWIO_LPASS_LPAIF_XPU_RG4_MCR_ADDR A:0xfe06a454
y.create.l HWIO_LPASS_LPAIF_XPU_RG5_MCR_ADDR A:0xfe06a4d4
y.create.l HWIO_LPASS_LPAIF_XPU_RG6_MCR_ADDR A:0xfe06a554
y.create.l HWIO_LPASS_LPAIF_XPU_RG7_MCR_ADDR A:0xfe06a5d4
y.create.l HWIO_LPASS_LPAIF_XPU_RG8_MCR_ADDR A:0xfe06a654
y.create.l HWIO_LPASS_LPAIF_XPU_RG9_MCR_ADDR A:0xfe06a6d4
y.create.l HWIO_LPASS_LPAIF_VERSION_ADDR A:0xfe0c0000
y.create.l HWIO_LPASS_LPAIF_PCM_CTL0_ADDR A:0xfe0c0010
y.create.l HWIO_LPASS_LPAIF_PCM_CTL1_ADDR A:0xfe0c1010
y.create.l HWIO_LPASS_LPAIF_PCM_SLOT_CTL0_ADDR A:0xfe0c0014
y.create.l HWIO_LPASS_LPAIF_PCM_SLOT_CTL1_ADDR A:0xfe0c1014
y.create.l HWIO_LPASS_LPAIF_I2S_CTL0_ADDR A:0xfe0c4000
y.create.l HWIO_LPASS_LPAIF_I2S_CTL1_ADDR A:0xfe0c5000
y.create.l HWIO_LPASS_LPAIF_DMIC_CTL_ADDR A:0xfe0cc000
y.create.l HWIO_LPASS_LPAIF_DMIC_VOL_CTL0_ADDR A:0xfe0cc010
y.create.l HWIO_LPASS_LPAIF_DMIC_VOL_CTL1_ADDR A:0xfe0cc014
y.create.l HWIO_LPASS_LPAIF_WRDMA_LPBK_MIX_ADDR A:0xfe0cd000
y.create.l HWIO_LPASS_LPAIF_MIXER_CTL_ADDR A:0xfe0ce000
y.create.l HWIO_LPASS_LPAIF_IRQ_EN0_ADDR A:0xfe0cf000
y.create.l HWIO_LPASS_LPAIF_IRQ_EN1_ADDR A:0xfe0d0000
y.create.l HWIO_LPASS_LPAIF_IRQ_EN2_ADDR A:0xfe0d1000
y.create.l HWIO_LPASS_LPAIF_IRQ_STAT0_ADDR A:0xfe0cf004
y.create.l HWIO_LPASS_LPAIF_IRQ_STAT1_ADDR A:0xfe0d0004
y.create.l HWIO_LPASS_LPAIF_IRQ_STAT2_ADDR A:0xfe0d1004
y.create.l HWIO_LPASS_LPAIF_IRQ_RAW_STAT0_ADDR A:0xfe0cf008
y.create.l HWIO_LPASS_LPAIF_IRQ_RAW_STAT1_ADDR A:0xfe0d0008
y.create.l HWIO_LPASS_LPAIF_IRQ_RAW_STAT2_ADDR A:0xfe0d1008
y.create.l HWIO_LPASS_LPAIF_IRQ_CLEAR0_ADDR A:0xfe0cf00c
y.create.l HWIO_LPASS_LPAIF_IRQ_CLEAR1_ADDR A:0xfe0d000c
y.create.l HWIO_LPASS_LPAIF_IRQ_CLEAR2_ADDR A:0xfe0d100c
y.create.l HWIO_LPASS_LPAIF_IRQ_FORCE0_ADDR A:0xfe0cf010
y.create.l HWIO_LPASS_LPAIF_IRQ_FORCE1_ADDR A:0xfe0d0010
y.create.l HWIO_LPASS_LPAIF_IRQ_FORCE2_ADDR A:0xfe0d1010
y.create.l HWIO_LPASS_LPAIF_RDDMA_CTL0_ADDR A:0xfe0d2000
y.create.l HWIO_LPASS_LPAIF_RDDMA_CTL1_ADDR A:0xfe0d3000
y.create.l HWIO_LPASS_LPAIF_RDDMA_BASE0_ADDR A:0xfe0d2004
y.create.l HWIO_LPASS_LPAIF_RDDMA_BASE1_ADDR A:0xfe0d3004
y.create.l HWIO_LPASS_LPAIF_RDDMA_BUFF_LEN0_ADDR A:0xfe0d2008
y.create.l HWIO_LPASS_LPAIF_RDDMA_BUFF_LEN1_ADDR A:0xfe0d3008
y.create.l HWIO_LPASS_LPAIF_RDDMA_CURR_ADDR0_ADDR A:0xfe0d200c
y.create.l HWIO_LPASS_LPAIF_RDDMA_CURR_ADDR1_ADDR A:0xfe0d300c
y.create.l HWIO_LPASS_LPAIF_RDDMA_PER_LEN0_ADDR A:0xfe0d2010
y.create.l HWIO_LPASS_LPAIF_RDDMA_PER_LEN1_ADDR A:0xfe0d3010
y.create.l HWIO_LPASS_LPAIF_RDDMA_PER_CNT0_ADDR A:0xfe0d2014
y.create.l HWIO_LPASS_LPAIF_RDDMA_PER_CNT1_ADDR A:0xfe0d3014
y.create.l HWIO_LPASS_LPAIF_RDDMA_FRM0_ADDR A:0xfe0d2018
y.create.l HWIO_LPASS_LPAIF_RDDMA_FRM1_ADDR A:0xfe0d3018
y.create.l HWIO_LPASS_LPAIF_RDDMA_FRMCLR0_ADDR A:0xfe0d201c
y.create.l HWIO_LPASS_LPAIF_RDDMA_FRMCLR1_ADDR A:0xfe0d301c
y.create.l HWIO_LPASS_LPAIF_RDDMA_SET_BUFF_CNT0_ADDR A:0xfe0d2020
y.create.l HWIO_LPASS_LPAIF_RDDMA_SET_BUFF_CNT1_ADDR A:0xfe0d3020
y.create.l HWIO_LPASS_LPAIF_RDDMA_SET_PER_CNT0_ADDR A:0xfe0d2024
y.create.l HWIO_LPASS_LPAIF_RDDMA_SET_PER_CNT1_ADDR A:0xfe0d3024
y.create.l HWIO_LPASS_LPAIF_WRDMA_CTL0_ADDR A:0xfe0d8000
y.create.l HWIO_LPASS_LPAIF_WRDMA_CTL1_ADDR A:0xfe0d9000
y.create.l HWIO_LPASS_LPAIF_WRDMA_BASE0_ADDR A:0xfe0d8004
y.create.l HWIO_LPASS_LPAIF_WRDMA_BASE1_ADDR A:0xfe0d9004
y.create.l HWIO_LPASS_LPAIF_WRDMA_BUFF_LEN0_ADDR A:0xfe0d8008
y.create.l HWIO_LPASS_LPAIF_WRDMA_BUFF_LEN1_ADDR A:0xfe0d9008
y.create.l HWIO_LPASS_LPAIF_WRDMA_CURR_ADDR0_ADDR A:0xfe0d800c
y.create.l HWIO_LPASS_LPAIF_WRDMA_CURR_ADDR1_ADDR A:0xfe0d900c
y.create.l HWIO_LPASS_LPAIF_WRDMA_PER_LEN0_ADDR A:0xfe0d8010
y.create.l HWIO_LPASS_LPAIF_WRDMA_PER_LEN1_ADDR A:0xfe0d9010
y.create.l HWIO_LPASS_LPAIF_WRDMA_PER_CNT0_ADDR A:0xfe0d8014
y.create.l HWIO_LPASS_LPAIF_WRDMA_PER_CNT1_ADDR A:0xfe0d9014
y.create.l HWIO_LPASS_LPAIF_WRDMA_FRM0_ADDR A:0xfe0d8018
y.create.l HWIO_LPASS_LPAIF_WRDMA_FRM1_ADDR A:0xfe0d9018
y.create.l HWIO_LPASS_LPAIF_WRDMA_FRMCLR0_ADDR A:0xfe0d801c
y.create.l HWIO_LPASS_LPAIF_WRDMA_FRMCLR1_ADDR A:0xfe0d901c
y.create.l HWIO_LPASS_LPAIF_WRDMA_SET_BUFF_CNT0_ADDR A:0xfe0d8020
y.create.l HWIO_LPASS_LPAIF_WRDMA_SET_BUFF_CNT1_ADDR A:0xfe0d9020
y.create.l HWIO_LPASS_LPAIF_WRDMA_SET_PER_CNT0_ADDR A:0xfe0d8024
y.create.l HWIO_LPASS_LPAIF_WRDMA_SET_PER_CNT1_ADDR A:0xfe0d9024
y.create.l HWIO_LPASS_LPAIF_EXT_VFR_ADDR A:0xfe0de000
y.create.l HWIO_LPASS_LPAIF_DEBUG_CTL_ADDR A:0xfe0de004
y.create.l HWIO_LPASS_LPAIF_SPARE_ADDR A:0xfe0de100
y.create.l HWIO_LPASS_SB_BAM_CTRL_ADDR A:0xfe104000
y.create.l HWIO_LPASS_SB_BAM_REVISION_ADDR A:0xfe104004
y.create.l HWIO_LPASS_SB_BAM_SW_VERSION_ADDR A:0xfe104080
y.create.l HWIO_LPASS_SB_BAM_NUM_PIPES_ADDR A:0xfe10403c
y.create.l HWIO_LPASS_SB_BAM_TIMER_ADDR A:0xfe104040
y.create.l HWIO_LPASS_SB_BAM_TIMER_CTRL_ADDR A:0xfe104044
y.create.l HWIO_LPASS_SB_BAM_DESC_CNT_TRSHLD_ADDR A:0xfe104008
y.create.l HWIO_LPASS_SB_BAM_IRQ_SRCS_ADDR A:0xfe10400c
y.create.l HWIO_LPASS_SB_BAM_IRQ_SRCS_MSK_ADDR A:0xfe104010
y.create.l HWIO_LPASS_SB_BAM_IRQ_SRCS_UNMASKED_ADDR A:0xfe104030
y.create.l HWIO_LPASS_SB_BAM_IRQ_STTS_ADDR A:0xfe104014
y.create.l HWIO_LPASS_SB_BAM_IRQ_CLR_ADDR A:0xfe104018
y.create.l HWIO_LPASS_SB_BAM_IRQ_EN_ADDR A:0xfe10401c
y.create.l HWIO_LPASS_SB_BAM_AHB_MASTER_ERR_CTRLS_ADDR A:0xfe104024
y.create.l HWIO_LPASS_SB_BAM_AHB_MASTER_ERR_ADDR_ADDR A:0xfe104028
y.create.l HWIO_LPASS_SB_BAM_AHB_MASTER_ERR_DATA_ADDR A:0xfe10402c
y.create.l HWIO_LPASS_SB_BAM_TRUST_REG_ADDR A:0xfe104070
y.create.l HWIO_LPASS_SB_BAM_TEST_BUS_SEL_ADDR A:0xfe104074
y.create.l HWIO_LPASS_SB_BAM_TEST_BUS_REG_ADDR A:0xfe104078
y.create.l HWIO_LPASS_SB_BAM_CNFG_BITS_ADDR A:0xfe10407c
y.create.l HWIO_LPASS_SB_BAM_IRQ_SRCS_EE0_ADDR A:0xfe104800
y.create.l HWIO_LPASS_SB_BAM_IRQ_SRCS_EE1_ADDR A:0xfe104880
y.create.l HWIO_LPASS_SB_BAM_IRQ_SRCS_EE2_ADDR A:0xfe104900
y.create.l HWIO_LPASS_SB_BAM_IRQ_SRCS_EE3_ADDR A:0xfe104980
y.create.l HWIO_LPASS_SB_BAM_IRQ_SRCS_EE4_ADDR A:0xfe104a00
y.create.l HWIO_LPASS_SB_BAM_IRQ_SRCS_EE5_ADDR A:0xfe104a80
y.create.l HWIO_LPASS_SB_BAM_IRQ_SRCS_EE6_ADDR A:0xfe104b00
y.create.l HWIO_LPASS_SB_BAM_IRQ_SRCS_EE7_ADDR A:0xfe104b80
y.create.l HWIO_LPASS_SB_BAM_IRQ_SRCS_MSK_EE0_ADDR A:0xfe104804
y.create.l HWIO_LPASS_SB_BAM_IRQ_SRCS_MSK_EE1_ADDR A:0xfe104884
y.create.l HWIO_LPASS_SB_BAM_IRQ_SRCS_MSK_EE2_ADDR A:0xfe104904
y.create.l HWIO_LPASS_SB_BAM_IRQ_SRCS_MSK_EE3_ADDR A:0xfe104984
y.create.l HWIO_LPASS_SB_BAM_IRQ_SRCS_MSK_EE4_ADDR A:0xfe104a04
y.create.l HWIO_LPASS_SB_BAM_IRQ_SRCS_MSK_EE5_ADDR A:0xfe104a84
y.create.l HWIO_LPASS_SB_BAM_IRQ_SRCS_MSK_EE6_ADDR A:0xfe104b04
y.create.l HWIO_LPASS_SB_BAM_IRQ_SRCS_MSK_EE7_ADDR A:0xfe104b84
y.create.l HWIO_LPASS_SB_BAM_IRQ_SRCS_UNMASKED_EE0_ADDR A:0xfe104808
y.create.l HWIO_LPASS_SB_BAM_IRQ_SRCS_UNMASKED_EE1_ADDR A:0xfe104888
y.create.l HWIO_LPASS_SB_BAM_IRQ_SRCS_UNMASKED_EE2_ADDR A:0xfe104908
y.create.l HWIO_LPASS_SB_BAM_IRQ_SRCS_UNMASKED_EE3_ADDR A:0xfe104988
y.create.l HWIO_LPASS_SB_BAM_IRQ_SRCS_UNMASKED_EE4_ADDR A:0xfe104a08
y.create.l HWIO_LPASS_SB_BAM_IRQ_SRCS_UNMASKED_EE5_ADDR A:0xfe104a88
y.create.l HWIO_LPASS_SB_BAM_IRQ_SRCS_UNMASKED_EE6_ADDR A:0xfe104b08
y.create.l HWIO_LPASS_SB_BAM_IRQ_SRCS_UNMASKED_EE7_ADDR A:0xfe104b88
y.create.l HWIO_LPASS_SB_BAM_P_CTRL0_ADDR A:0xfe105000
y.create.l HWIO_LPASS_SB_BAM_P_CTRL1_ADDR A:0xfe106000
y.create.l HWIO_LPASS_SB_BAM_P_CTRL2_ADDR A:0xfe107000
y.create.l HWIO_LPASS_SB_BAM_P_CTRL3_ADDR A:0xfe108000
y.create.l HWIO_LPASS_SB_BAM_P_CTRL4_ADDR A:0xfe109000
y.create.l HWIO_LPASS_SB_BAM_P_CTRL5_ADDR A:0xfe10a000
y.create.l HWIO_LPASS_SB_BAM_P_CTRL6_ADDR A:0xfe10b000
y.create.l HWIO_LPASS_SB_BAM_P_CTRL7_ADDR A:0xfe10c000
y.create.l HWIO_LPASS_SB_BAM_P_CTRL8_ADDR A:0xfe10d000
y.create.l HWIO_LPASS_SB_BAM_P_CTRL9_ADDR A:0xfe10e000
y.create.l HWIO_LPASS_SB_BAM_P_RST0_ADDR A:0xfe105004
y.create.l HWIO_LPASS_SB_BAM_P_RST1_ADDR A:0xfe106004
y.create.l HWIO_LPASS_SB_BAM_P_RST2_ADDR A:0xfe107004
y.create.l HWIO_LPASS_SB_BAM_P_RST3_ADDR A:0xfe108004
y.create.l HWIO_LPASS_SB_BAM_P_RST4_ADDR A:0xfe109004
y.create.l HWIO_LPASS_SB_BAM_P_RST5_ADDR A:0xfe10a004
y.create.l HWIO_LPASS_SB_BAM_P_RST6_ADDR A:0xfe10b004
y.create.l HWIO_LPASS_SB_BAM_P_RST7_ADDR A:0xfe10c004
y.create.l HWIO_LPASS_SB_BAM_P_RST8_ADDR A:0xfe10d004
y.create.l HWIO_LPASS_SB_BAM_P_RST9_ADDR A:0xfe10e004
y.create.l HWIO_LPASS_SB_BAM_P_HALT0_ADDR A:0xfe105008
y.create.l HWIO_LPASS_SB_BAM_P_HALT1_ADDR A:0xfe106008
y.create.l HWIO_LPASS_SB_BAM_P_HALT2_ADDR A:0xfe107008
y.create.l HWIO_LPASS_SB_BAM_P_HALT3_ADDR A:0xfe108008
y.create.l HWIO_LPASS_SB_BAM_P_HALT4_ADDR A:0xfe109008
y.create.l HWIO_LPASS_SB_BAM_P_HALT5_ADDR A:0xfe10a008
y.create.l HWIO_LPASS_SB_BAM_P_HALT6_ADDR A:0xfe10b008
y.create.l HWIO_LPASS_SB_BAM_P_HALT7_ADDR A:0xfe10c008
y.create.l HWIO_LPASS_SB_BAM_P_HALT8_ADDR A:0xfe10d008
y.create.l HWIO_LPASS_SB_BAM_P_HALT9_ADDR A:0xfe10e008
y.create.l HWIO_LPASS_SB_BAM_P_TRUST_REG0_ADDR A:0xfe105030
y.create.l HWIO_LPASS_SB_BAM_P_TRUST_REG1_ADDR A:0xfe106030
y.create.l HWIO_LPASS_SB_BAM_P_TRUST_REG2_ADDR A:0xfe107030
y.create.l HWIO_LPASS_SB_BAM_P_TRUST_REG3_ADDR A:0xfe108030
y.create.l HWIO_LPASS_SB_BAM_P_TRUST_REG4_ADDR A:0xfe109030
y.create.l HWIO_LPASS_SB_BAM_P_TRUST_REG5_ADDR A:0xfe10a030
y.create.l HWIO_LPASS_SB_BAM_P_TRUST_REG6_ADDR A:0xfe10b030
y.create.l HWIO_LPASS_SB_BAM_P_TRUST_REG7_ADDR A:0xfe10c030
y.create.l HWIO_LPASS_SB_BAM_P_TRUST_REG8_ADDR A:0xfe10d030
y.create.l HWIO_LPASS_SB_BAM_P_TRUST_REG9_ADDR A:0xfe10e030
y.create.l HWIO_LPASS_SB_BAM_P_IRQ_STTS0_ADDR A:0xfe105010
y.create.l HWIO_LPASS_SB_BAM_P_IRQ_STTS1_ADDR A:0xfe106010
y.create.l HWIO_LPASS_SB_BAM_P_IRQ_STTS2_ADDR A:0xfe107010
y.create.l HWIO_LPASS_SB_BAM_P_IRQ_STTS3_ADDR A:0xfe108010
y.create.l HWIO_LPASS_SB_BAM_P_IRQ_STTS4_ADDR A:0xfe109010
y.create.l HWIO_LPASS_SB_BAM_P_IRQ_STTS5_ADDR A:0xfe10a010
y.create.l HWIO_LPASS_SB_BAM_P_IRQ_STTS6_ADDR A:0xfe10b010
y.create.l HWIO_LPASS_SB_BAM_P_IRQ_STTS7_ADDR A:0xfe10c010
y.create.l HWIO_LPASS_SB_BAM_P_IRQ_STTS8_ADDR A:0xfe10d010
y.create.l HWIO_LPASS_SB_BAM_P_IRQ_STTS9_ADDR A:0xfe10e010
y.create.l HWIO_LPASS_SB_BAM_P_IRQ_CLR0_ADDR A:0xfe105014
y.create.l HWIO_LPASS_SB_BAM_P_IRQ_CLR1_ADDR A:0xfe106014
y.create.l HWIO_LPASS_SB_BAM_P_IRQ_CLR2_ADDR A:0xfe107014
y.create.l HWIO_LPASS_SB_BAM_P_IRQ_CLR3_ADDR A:0xfe108014
y.create.l HWIO_LPASS_SB_BAM_P_IRQ_CLR4_ADDR A:0xfe109014
y.create.l HWIO_LPASS_SB_BAM_P_IRQ_CLR5_ADDR A:0xfe10a014
y.create.l HWIO_LPASS_SB_BAM_P_IRQ_CLR6_ADDR A:0xfe10b014
y.create.l HWIO_LPASS_SB_BAM_P_IRQ_CLR7_ADDR A:0xfe10c014
y.create.l HWIO_LPASS_SB_BAM_P_IRQ_CLR8_ADDR A:0xfe10d014
y.create.l HWIO_LPASS_SB_BAM_P_IRQ_CLR9_ADDR A:0xfe10e014
y.create.l HWIO_LPASS_SB_BAM_P_IRQ_EN0_ADDR A:0xfe105018
y.create.l HWIO_LPASS_SB_BAM_P_IRQ_EN1_ADDR A:0xfe106018
y.create.l HWIO_LPASS_SB_BAM_P_IRQ_EN2_ADDR A:0xfe107018
y.create.l HWIO_LPASS_SB_BAM_P_IRQ_EN3_ADDR A:0xfe108018
y.create.l HWIO_LPASS_SB_BAM_P_IRQ_EN4_ADDR A:0xfe109018
y.create.l HWIO_LPASS_SB_BAM_P_IRQ_EN5_ADDR A:0xfe10a018
y.create.l HWIO_LPASS_SB_BAM_P_IRQ_EN6_ADDR A:0xfe10b018
y.create.l HWIO_LPASS_SB_BAM_P_IRQ_EN7_ADDR A:0xfe10c018
y.create.l HWIO_LPASS_SB_BAM_P_IRQ_EN8_ADDR A:0xfe10d018
y.create.l HWIO_LPASS_SB_BAM_P_IRQ_EN9_ADDR A:0xfe10e018
y.create.l HWIO_LPASS_SB_BAM_P_TIMER0_ADDR A:0xfe10501c
y.create.l HWIO_LPASS_SB_BAM_P_TIMER1_ADDR A:0xfe10601c
y.create.l HWIO_LPASS_SB_BAM_P_TIMER2_ADDR A:0xfe10701c
y.create.l HWIO_LPASS_SB_BAM_P_TIMER3_ADDR A:0xfe10801c
y.create.l HWIO_LPASS_SB_BAM_P_TIMER4_ADDR A:0xfe10901c
y.create.l HWIO_LPASS_SB_BAM_P_TIMER5_ADDR A:0xfe10a01c
y.create.l HWIO_LPASS_SB_BAM_P_TIMER6_ADDR A:0xfe10b01c
y.create.l HWIO_LPASS_SB_BAM_P_TIMER7_ADDR A:0xfe10c01c
y.create.l HWIO_LPASS_SB_BAM_P_TIMER8_ADDR A:0xfe10d01c
y.create.l HWIO_LPASS_SB_BAM_P_TIMER9_ADDR A:0xfe10e01c
y.create.l HWIO_LPASS_SB_BAM_P_TIMER_CTRL0_ADDR A:0xfe105020
y.create.l HWIO_LPASS_SB_BAM_P_TIMER_CTRL1_ADDR A:0xfe106020
y.create.l HWIO_LPASS_SB_BAM_P_TIMER_CTRL2_ADDR A:0xfe107020
y.create.l HWIO_LPASS_SB_BAM_P_TIMER_CTRL3_ADDR A:0xfe108020
y.create.l HWIO_LPASS_SB_BAM_P_TIMER_CTRL4_ADDR A:0xfe109020
y.create.l HWIO_LPASS_SB_BAM_P_TIMER_CTRL5_ADDR A:0xfe10a020
y.create.l HWIO_LPASS_SB_BAM_P_TIMER_CTRL6_ADDR A:0xfe10b020
y.create.l HWIO_LPASS_SB_BAM_P_TIMER_CTRL7_ADDR A:0xfe10c020
y.create.l HWIO_LPASS_SB_BAM_P_TIMER_CTRL8_ADDR A:0xfe10d020
y.create.l HWIO_LPASS_SB_BAM_P_TIMER_CTRL9_ADDR A:0xfe10e020
y.create.l HWIO_LPASS_SB_BAM_P_PRDCR_SDBND0_ADDR A:0xfe105024
y.create.l HWIO_LPASS_SB_BAM_P_PRDCR_SDBND1_ADDR A:0xfe106024
y.create.l HWIO_LPASS_SB_BAM_P_PRDCR_SDBND2_ADDR A:0xfe107024
y.create.l HWIO_LPASS_SB_BAM_P_PRDCR_SDBND3_ADDR A:0xfe108024
y.create.l HWIO_LPASS_SB_BAM_P_PRDCR_SDBND4_ADDR A:0xfe109024
y.create.l HWIO_LPASS_SB_BAM_P_PRDCR_SDBND5_ADDR A:0xfe10a024
y.create.l HWIO_LPASS_SB_BAM_P_PRDCR_SDBND6_ADDR A:0xfe10b024
y.create.l HWIO_LPASS_SB_BAM_P_PRDCR_SDBND7_ADDR A:0xfe10c024
y.create.l HWIO_LPASS_SB_BAM_P_PRDCR_SDBND8_ADDR A:0xfe10d024
y.create.l HWIO_LPASS_SB_BAM_P_PRDCR_SDBND9_ADDR A:0xfe10e024
y.create.l HWIO_LPASS_SB_BAM_P_CNSMR_SDBND0_ADDR A:0xfe105028
y.create.l HWIO_LPASS_SB_BAM_P_CNSMR_SDBND1_ADDR A:0xfe106028
y.create.l HWIO_LPASS_SB_BAM_P_CNSMR_SDBND2_ADDR A:0xfe107028
y.create.l HWIO_LPASS_SB_BAM_P_CNSMR_SDBND3_ADDR A:0xfe108028
y.create.l HWIO_LPASS_SB_BAM_P_CNSMR_SDBND4_ADDR A:0xfe109028
y.create.l HWIO_LPASS_SB_BAM_P_CNSMR_SDBND5_ADDR A:0xfe10a028
y.create.l HWIO_LPASS_SB_BAM_P_CNSMR_SDBND6_ADDR A:0xfe10b028
y.create.l HWIO_LPASS_SB_BAM_P_CNSMR_SDBND7_ADDR A:0xfe10c028
y.create.l HWIO_LPASS_SB_BAM_P_CNSMR_SDBND8_ADDR A:0xfe10d028
y.create.l HWIO_LPASS_SB_BAM_P_CNSMR_SDBND9_ADDR A:0xfe10e028
y.create.l HWIO_LPASS_SB_BAM_P_EVNT_DEST_ADDR0_ADDR A:0xfe10582c
y.create.l HWIO_LPASS_SB_BAM_P_EVNT_DEST_ADDR1_ADDR A:0xfe10682c
y.create.l HWIO_LPASS_SB_BAM_P_EVNT_DEST_ADDR2_ADDR A:0xfe10782c
y.create.l HWIO_LPASS_SB_BAM_P_EVNT_DEST_ADDR3_ADDR A:0xfe10882c
y.create.l HWIO_LPASS_SB_BAM_P_EVNT_DEST_ADDR4_ADDR A:0xfe10982c
y.create.l HWIO_LPASS_SB_BAM_P_EVNT_DEST_ADDR5_ADDR A:0xfe10a82c
y.create.l HWIO_LPASS_SB_BAM_P_EVNT_DEST_ADDR6_ADDR A:0xfe10b82c
y.create.l HWIO_LPASS_SB_BAM_P_EVNT_DEST_ADDR7_ADDR A:0xfe10c82c
y.create.l HWIO_LPASS_SB_BAM_P_EVNT_DEST_ADDR8_ADDR A:0xfe10d82c
y.create.l HWIO_LPASS_SB_BAM_P_EVNT_DEST_ADDR9_ADDR A:0xfe10e82c
y.create.l HWIO_LPASS_SB_BAM_P_EVNT_REG0_ADDR A:0xfe105818
y.create.l HWIO_LPASS_SB_BAM_P_EVNT_REG1_ADDR A:0xfe106818
y.create.l HWIO_LPASS_SB_BAM_P_EVNT_REG2_ADDR A:0xfe107818
y.create.l HWIO_LPASS_SB_BAM_P_EVNT_REG3_ADDR A:0xfe108818
y.create.l HWIO_LPASS_SB_BAM_P_EVNT_REG4_ADDR A:0xfe109818
y.create.l HWIO_LPASS_SB_BAM_P_EVNT_REG5_ADDR A:0xfe10a818
y.create.l HWIO_LPASS_SB_BAM_P_EVNT_REG6_ADDR A:0xfe10b818
y.create.l HWIO_LPASS_SB_BAM_P_EVNT_REG7_ADDR A:0xfe10c818
y.create.l HWIO_LPASS_SB_BAM_P_EVNT_REG8_ADDR A:0xfe10d818
y.create.l HWIO_LPASS_SB_BAM_P_EVNT_REG9_ADDR A:0xfe10e818
y.create.l HWIO_LPASS_SB_BAM_P_SW_OFSTS0_ADDR A:0xfe105800
y.create.l HWIO_LPASS_SB_BAM_P_SW_OFSTS1_ADDR A:0xfe106800
y.create.l HWIO_LPASS_SB_BAM_P_SW_OFSTS2_ADDR A:0xfe107800
y.create.l HWIO_LPASS_SB_BAM_P_SW_OFSTS3_ADDR A:0xfe108800
y.create.l HWIO_LPASS_SB_BAM_P_SW_OFSTS4_ADDR A:0xfe109800
y.create.l HWIO_LPASS_SB_BAM_P_SW_OFSTS5_ADDR A:0xfe10a800
y.create.l HWIO_LPASS_SB_BAM_P_SW_OFSTS6_ADDR A:0xfe10b800
y.create.l HWIO_LPASS_SB_BAM_P_SW_OFSTS7_ADDR A:0xfe10c800
y.create.l HWIO_LPASS_SB_BAM_P_SW_OFSTS8_ADDR A:0xfe10d800
y.create.l HWIO_LPASS_SB_BAM_P_SW_OFSTS9_ADDR A:0xfe10e800
y.create.l HWIO_LPASS_SB_BAM_P_DATA_FIFO_ADDR0_ADDR A:0xfe105824
y.create.l HWIO_LPASS_SB_BAM_P_DATA_FIFO_ADDR1_ADDR A:0xfe106824
y.create.l HWIO_LPASS_SB_BAM_P_DATA_FIFO_ADDR2_ADDR A:0xfe107824
y.create.l HWIO_LPASS_SB_BAM_P_DATA_FIFO_ADDR3_ADDR A:0xfe108824
y.create.l HWIO_LPASS_SB_BAM_P_DATA_FIFO_ADDR4_ADDR A:0xfe109824
y.create.l HWIO_LPASS_SB_BAM_P_DATA_FIFO_ADDR5_ADDR A:0xfe10a824
y.create.l HWIO_LPASS_SB_BAM_P_DATA_FIFO_ADDR6_ADDR A:0xfe10b824
y.create.l HWIO_LPASS_SB_BAM_P_DATA_FIFO_ADDR7_ADDR A:0xfe10c824
y.create.l HWIO_LPASS_SB_BAM_P_DATA_FIFO_ADDR8_ADDR A:0xfe10d824
y.create.l HWIO_LPASS_SB_BAM_P_DATA_FIFO_ADDR9_ADDR A:0xfe10e824
y.create.l HWIO_LPASS_SB_BAM_P_DESC_FIFO_ADDR0_ADDR A:0xfe10581c
y.create.l HWIO_LPASS_SB_BAM_P_DESC_FIFO_ADDR1_ADDR A:0xfe10681c
y.create.l HWIO_LPASS_SB_BAM_P_DESC_FIFO_ADDR2_ADDR A:0xfe10781c
y.create.l HWIO_LPASS_SB_BAM_P_DESC_FIFO_ADDR3_ADDR A:0xfe10881c
y.create.l HWIO_LPASS_SB_BAM_P_DESC_FIFO_ADDR4_ADDR A:0xfe10981c
y.create.l HWIO_LPASS_SB_BAM_P_DESC_FIFO_ADDR5_ADDR A:0xfe10a81c
y.create.l HWIO_LPASS_SB_BAM_P_DESC_FIFO_ADDR6_ADDR A:0xfe10b81c
y.create.l HWIO_LPASS_SB_BAM_P_DESC_FIFO_ADDR7_ADDR A:0xfe10c81c
y.create.l HWIO_LPASS_SB_BAM_P_DESC_FIFO_ADDR8_ADDR A:0xfe10d81c
y.create.l HWIO_LPASS_SB_BAM_P_DESC_FIFO_ADDR9_ADDR A:0xfe10e81c
y.create.l HWIO_LPASS_SB_BAM_P_EVNT_GEN_TRSHLD0_ADDR A:0xfe105828
y.create.l HWIO_LPASS_SB_BAM_P_EVNT_GEN_TRSHLD1_ADDR A:0xfe106828
y.create.l HWIO_LPASS_SB_BAM_P_EVNT_GEN_TRSHLD2_ADDR A:0xfe107828
y.create.l HWIO_LPASS_SB_BAM_P_EVNT_GEN_TRSHLD3_ADDR A:0xfe108828
y.create.l HWIO_LPASS_SB_BAM_P_EVNT_GEN_TRSHLD4_ADDR A:0xfe109828
y.create.l HWIO_LPASS_SB_BAM_P_EVNT_GEN_TRSHLD5_ADDR A:0xfe10a828
y.create.l HWIO_LPASS_SB_BAM_P_EVNT_GEN_TRSHLD6_ADDR A:0xfe10b828
y.create.l HWIO_LPASS_SB_BAM_P_EVNT_GEN_TRSHLD7_ADDR A:0xfe10c828
y.create.l HWIO_LPASS_SB_BAM_P_EVNT_GEN_TRSHLD8_ADDR A:0xfe10d828
y.create.l HWIO_LPASS_SB_BAM_P_EVNT_GEN_TRSHLD9_ADDR A:0xfe10e828
y.create.l HWIO_LPASS_SB_BAM_P_FIFO_SIZES0_ADDR A:0xfe105820
y.create.l HWIO_LPASS_SB_BAM_P_FIFO_SIZES1_ADDR A:0xfe106820
y.create.l HWIO_LPASS_SB_BAM_P_FIFO_SIZES2_ADDR A:0xfe107820
y.create.l HWIO_LPASS_SB_BAM_P_FIFO_SIZES3_ADDR A:0xfe108820
y.create.l HWIO_LPASS_SB_BAM_P_FIFO_SIZES4_ADDR A:0xfe109820
y.create.l HWIO_LPASS_SB_BAM_P_FIFO_SIZES5_ADDR A:0xfe10a820
y.create.l HWIO_LPASS_SB_BAM_P_FIFO_SIZES6_ADDR A:0xfe10b820
y.create.l HWIO_LPASS_SB_BAM_P_FIFO_SIZES7_ADDR A:0xfe10c820
y.create.l HWIO_LPASS_SB_BAM_P_FIFO_SIZES8_ADDR A:0xfe10d820
y.create.l HWIO_LPASS_SB_BAM_P_FIFO_SIZES9_ADDR A:0xfe10e820
y.create.l HWIO_LPASS_SB_BAM_P_RETR_CNTXT_0_ADDR A:0xfe105834
y.create.l HWIO_LPASS_SB_BAM_P_RETR_CNTXT_1_ADDR A:0xfe106834
y.create.l HWIO_LPASS_SB_BAM_P_RETR_CNTXT_2_ADDR A:0xfe107834
y.create.l HWIO_LPASS_SB_BAM_P_RETR_CNTXT_3_ADDR A:0xfe108834
y.create.l HWIO_LPASS_SB_BAM_P_RETR_CNTXT_4_ADDR A:0xfe109834
y.create.l HWIO_LPASS_SB_BAM_P_RETR_CNTXT_5_ADDR A:0xfe10a834
y.create.l HWIO_LPASS_SB_BAM_P_RETR_CNTXT_6_ADDR A:0xfe10b834
y.create.l HWIO_LPASS_SB_BAM_P_RETR_CNTXT_7_ADDR A:0xfe10c834
y.create.l HWIO_LPASS_SB_BAM_P_RETR_CNTXT_8_ADDR A:0xfe10d834
y.create.l HWIO_LPASS_SB_BAM_P_RETR_CNTXT_9_ADDR A:0xfe10e834
y.create.l HWIO_LPASS_SB_BAM_P_SI_CNTXT_0_ADDR A:0xfe105838
y.create.l HWIO_LPASS_SB_BAM_P_SI_CNTXT_1_ADDR A:0xfe106838
y.create.l HWIO_LPASS_SB_BAM_P_SI_CNTXT_2_ADDR A:0xfe107838
y.create.l HWIO_LPASS_SB_BAM_P_SI_CNTXT_3_ADDR A:0xfe108838
y.create.l HWIO_LPASS_SB_BAM_P_SI_CNTXT_4_ADDR A:0xfe109838
y.create.l HWIO_LPASS_SB_BAM_P_SI_CNTXT_5_ADDR A:0xfe10a838
y.create.l HWIO_LPASS_SB_BAM_P_SI_CNTXT_6_ADDR A:0xfe10b838
y.create.l HWIO_LPASS_SB_BAM_P_SI_CNTXT_7_ADDR A:0xfe10c838
y.create.l HWIO_LPASS_SB_BAM_P_SI_CNTXT_8_ADDR A:0xfe10d838
y.create.l HWIO_LPASS_SB_BAM_P_SI_CNTXT_9_ADDR A:0xfe10e838
y.create.l HWIO_LPASS_SB_BAM_P_DF_CNTXT_0_ADDR A:0xfe105830
y.create.l HWIO_LPASS_SB_BAM_P_DF_CNTXT_1_ADDR A:0xfe106830
y.create.l HWIO_LPASS_SB_BAM_P_DF_CNTXT_2_ADDR A:0xfe107830
y.create.l HWIO_LPASS_SB_BAM_P_DF_CNTXT_3_ADDR A:0xfe108830
y.create.l HWIO_LPASS_SB_BAM_P_DF_CNTXT_4_ADDR A:0xfe109830
y.create.l HWIO_LPASS_SB_BAM_P_DF_CNTXT_5_ADDR A:0xfe10a830
y.create.l HWIO_LPASS_SB_BAM_P_DF_CNTXT_6_ADDR A:0xfe10b830
y.create.l HWIO_LPASS_SB_BAM_P_DF_CNTXT_7_ADDR A:0xfe10c830
y.create.l HWIO_LPASS_SB_BAM_P_DF_CNTXT_8_ADDR A:0xfe10d830
y.create.l HWIO_LPASS_SB_BAM_P_DF_CNTXT_9_ADDR A:0xfe10e830
y.create.l HWIO_LPASS_SB_BAM_P_AU_PSM_CNTXT_1_0_ADDR A:0xfe105804
y.create.l HWIO_LPASS_SB_BAM_P_AU_PSM_CNTXT_1_1_ADDR A:0xfe106804
y.create.l HWIO_LPASS_SB_BAM_P_AU_PSM_CNTXT_1_2_ADDR A:0xfe107804
y.create.l HWIO_LPASS_SB_BAM_P_AU_PSM_CNTXT_1_3_ADDR A:0xfe108804
y.create.l HWIO_LPASS_SB_BAM_P_AU_PSM_CNTXT_1_4_ADDR A:0xfe109804
y.create.l HWIO_LPASS_SB_BAM_P_AU_PSM_CNTXT_1_5_ADDR A:0xfe10a804
y.create.l HWIO_LPASS_SB_BAM_P_AU_PSM_CNTXT_1_6_ADDR A:0xfe10b804
y.create.l HWIO_LPASS_SB_BAM_P_AU_PSM_CNTXT_1_7_ADDR A:0xfe10c804
y.create.l HWIO_LPASS_SB_BAM_P_AU_PSM_CNTXT_1_8_ADDR A:0xfe10d804
y.create.l HWIO_LPASS_SB_BAM_P_AU_PSM_CNTXT_1_9_ADDR A:0xfe10e804
y.create.l HWIO_LPASS_SB_BAM_P_PSM_CNTXT_2_0_ADDR A:0xfe105808
y.create.l HWIO_LPASS_SB_BAM_P_PSM_CNTXT_2_1_ADDR A:0xfe106808
y.create.l HWIO_LPASS_SB_BAM_P_PSM_CNTXT_2_2_ADDR A:0xfe107808
y.create.l HWIO_LPASS_SB_BAM_P_PSM_CNTXT_2_3_ADDR A:0xfe108808
y.create.l HWIO_LPASS_SB_BAM_P_PSM_CNTXT_2_4_ADDR A:0xfe109808
y.create.l HWIO_LPASS_SB_BAM_P_PSM_CNTXT_2_5_ADDR A:0xfe10a808
y.create.l HWIO_LPASS_SB_BAM_P_PSM_CNTXT_2_6_ADDR A:0xfe10b808
y.create.l HWIO_LPASS_SB_BAM_P_PSM_CNTXT_2_7_ADDR A:0xfe10c808
y.create.l HWIO_LPASS_SB_BAM_P_PSM_CNTXT_2_8_ADDR A:0xfe10d808
y.create.l HWIO_LPASS_SB_BAM_P_PSM_CNTXT_2_9_ADDR A:0xfe10e808
y.create.l HWIO_LPASS_SB_BAM_P_PSM_CNTXT_3_0_ADDR A:0xfe10580c
y.create.l HWIO_LPASS_SB_BAM_P_PSM_CNTXT_3_1_ADDR A:0xfe10680c
y.create.l HWIO_LPASS_SB_BAM_P_PSM_CNTXT_3_2_ADDR A:0xfe10780c
y.create.l HWIO_LPASS_SB_BAM_P_PSM_CNTXT_3_3_ADDR A:0xfe10880c
y.create.l HWIO_LPASS_SB_BAM_P_PSM_CNTXT_3_4_ADDR A:0xfe10980c
y.create.l HWIO_LPASS_SB_BAM_P_PSM_CNTXT_3_5_ADDR A:0xfe10a80c
y.create.l HWIO_LPASS_SB_BAM_P_PSM_CNTXT_3_6_ADDR A:0xfe10b80c
y.create.l HWIO_LPASS_SB_BAM_P_PSM_CNTXT_3_7_ADDR A:0xfe10c80c
y.create.l HWIO_LPASS_SB_BAM_P_PSM_CNTXT_3_8_ADDR A:0xfe10d80c
y.create.l HWIO_LPASS_SB_BAM_P_PSM_CNTXT_3_9_ADDR A:0xfe10e80c
y.create.l HWIO_LPASS_SB_BAM_P_PSM_CNTXT_4_0_ADDR A:0xfe105810
y.create.l HWIO_LPASS_SB_BAM_P_PSM_CNTXT_4_1_ADDR A:0xfe106810
y.create.l HWIO_LPASS_SB_BAM_P_PSM_CNTXT_4_2_ADDR A:0xfe107810
y.create.l HWIO_LPASS_SB_BAM_P_PSM_CNTXT_4_3_ADDR A:0xfe108810
y.create.l HWIO_LPASS_SB_BAM_P_PSM_CNTXT_4_4_ADDR A:0xfe109810
y.create.l HWIO_LPASS_SB_BAM_P_PSM_CNTXT_4_5_ADDR A:0xfe10a810
y.create.l HWIO_LPASS_SB_BAM_P_PSM_CNTXT_4_6_ADDR A:0xfe10b810
y.create.l HWIO_LPASS_SB_BAM_P_PSM_CNTXT_4_7_ADDR A:0xfe10c810
y.create.l HWIO_LPASS_SB_BAM_P_PSM_CNTXT_4_8_ADDR A:0xfe10d810
y.create.l HWIO_LPASS_SB_BAM_P_PSM_CNTXT_4_9_ADDR A:0xfe10e810
y.create.l HWIO_LPASS_SB_BAM_P_PSM_CNTXT_5_0_ADDR A:0xfe105814
y.create.l HWIO_LPASS_SB_BAM_P_PSM_CNTXT_5_1_ADDR A:0xfe106814
y.create.l HWIO_LPASS_SB_BAM_P_PSM_CNTXT_5_2_ADDR A:0xfe107814
y.create.l HWIO_LPASS_SB_BAM_P_PSM_CNTXT_5_3_ADDR A:0xfe108814
y.create.l HWIO_LPASS_SB_BAM_P_PSM_CNTXT_5_4_ADDR A:0xfe109814
y.create.l HWIO_LPASS_SB_BAM_P_PSM_CNTXT_5_5_ADDR A:0xfe10a814
y.create.l HWIO_LPASS_SB_BAM_P_PSM_CNTXT_5_6_ADDR A:0xfe10b814
y.create.l HWIO_LPASS_SB_BAM_P_PSM_CNTXT_5_7_ADDR A:0xfe10c814
y.create.l HWIO_LPASS_SB_BAM_P_PSM_CNTXT_5_8_ADDR A:0xfe10d814
y.create.l HWIO_LPASS_SB_BAM_P_PSM_CNTXT_5_9_ADDR A:0xfe10e814
y.create.l HWIO_LPASS_SB_XPU_SCR_ADDR A:0xfe102000
y.create.l HWIO_LPASS_SB_XPU_SWDR_ADDR A:0xfe102004
y.create.l HWIO_LPASS_SB_XPU_SEAR0_ADDR A:0xfe102040
y.create.l HWIO_LPASS_SB_XPU_SESR_ADDR A:0xfe102048
y.create.l HWIO_LPASS_SB_XPU_SESRRESTORE_ADDR A:0xfe10204c
y.create.l HWIO_LPASS_SB_XPU_SESYNR0_ADDR A:0xfe102050
y.create.l HWIO_LPASS_SB_XPU_SESYNR1_ADDR A:0xfe102054
y.create.l HWIO_LPASS_SB_XPU_SESYNR2_ADDR A:0xfe102058
y.create.l HWIO_LPASS_SB_XPU_MCR_ADDR A:0xfe102100
y.create.l HWIO_LPASS_SB_XPU_MEAR0_ADDR A:0xfe102140
y.create.l HWIO_LPASS_SB_XPU_MESR_ADDR A:0xfe102148
y.create.l HWIO_LPASS_SB_XPU_MESRRESTORE_ADDR A:0xfe10214c
y.create.l HWIO_LPASS_SB_XPU_MESYNR0_ADDR A:0xfe102150
y.create.l HWIO_LPASS_SB_XPU_MESYNR1_ADDR A:0xfe102154
y.create.l HWIO_LPASS_SB_XPU_MESYNR2_ADDR A:0xfe102158
y.create.l HWIO_LPASS_SB_XPU_CR_ADDR A:0xfe102080
y.create.l HWIO_LPASS_SB_XPU_RPU_ACR0_ADDR A:0xfe1020a0
y.create.l HWIO_LPASS_SB_XPU_EAR0_ADDR A:0xfe1020c0
y.create.l HWIO_LPASS_SB_XPU_ESR_ADDR A:0xfe1020c8
y.create.l HWIO_LPASS_SB_XPU_ESRRESTORE_ADDR A:0xfe1020cc
y.create.l HWIO_LPASS_SB_XPU_ESYNR0_ADDR A:0xfe1020d0
y.create.l HWIO_LPASS_SB_XPU_ESYNR1_ADDR A:0xfe1020d4
y.create.l HWIO_LPASS_SB_XPU_ESYNR2_ADDR A:0xfe1020d8
y.create.l HWIO_LPASS_SB_XPU_IDR0_ADDR A:0xfe102074
y.create.l HWIO_LPASS_SB_XPU_IDR1_ADDR A:0xfe102078
y.create.l HWIO_LPASS_SB_XPU_REV_ADDR A:0xfe10207c
y.create.l HWIO_LPASS_SB_XPU_RG0_RACR0_ADDR A:0xfe102200
y.create.l HWIO_LPASS_SB_XPU_RG1_RACR0_ADDR A:0xfe102280
y.create.l HWIO_LPASS_SB_XPU_RG2_RACR0_ADDR A:0xfe102300
y.create.l HWIO_LPASS_SB_XPU_RG3_RACR0_ADDR A:0xfe102380
y.create.l HWIO_LPASS_SB_XPU_RG4_RACR0_ADDR A:0xfe102400
y.create.l HWIO_LPASS_SB_XPU_RG5_RACR0_ADDR A:0xfe102480
y.create.l HWIO_LPASS_SB_XPU_RG6_RACR0_ADDR A:0xfe102500
y.create.l HWIO_LPASS_SB_XPU_RG7_RACR0_ADDR A:0xfe102580
y.create.l HWIO_LPASS_SB_XPU_RG8_RACR0_ADDR A:0xfe102600
y.create.l HWIO_LPASS_SB_XPU_RG9_RACR0_ADDR A:0xfe102680
y.create.l HWIO_LPASS_SB_XPU_RG0_SCR_ADDR A:0xfe102250
y.create.l HWIO_LPASS_SB_XPU_RG1_SCR_ADDR A:0xfe1022d0
y.create.l HWIO_LPASS_SB_XPU_RG2_SCR_ADDR A:0xfe102350
y.create.l HWIO_LPASS_SB_XPU_RG3_SCR_ADDR A:0xfe1023d0
y.create.l HWIO_LPASS_SB_XPU_RG4_SCR_ADDR A:0xfe102450
y.create.l HWIO_LPASS_SB_XPU_RG5_SCR_ADDR A:0xfe1024d0
y.create.l HWIO_LPASS_SB_XPU_RG6_SCR_ADDR A:0xfe102550
y.create.l HWIO_LPASS_SB_XPU_RG7_SCR_ADDR A:0xfe1025d0
y.create.l HWIO_LPASS_SB_XPU_RG8_SCR_ADDR A:0xfe102650
y.create.l HWIO_LPASS_SB_XPU_RG9_SCR_ADDR A:0xfe1026d0
y.create.l HWIO_LPASS_SB_XPU_RG0_MCR_ADDR A:0xfe102254
y.create.l HWIO_LPASS_SB_XPU_RG1_MCR_ADDR A:0xfe1022d4
y.create.l HWIO_LPASS_SB_XPU_RG2_MCR_ADDR A:0xfe102354
y.create.l HWIO_LPASS_SB_XPU_RG3_MCR_ADDR A:0xfe1023d4
y.create.l HWIO_LPASS_SB_XPU_RG4_MCR_ADDR A:0xfe102454
y.create.l HWIO_LPASS_SB_XPU_RG5_MCR_ADDR A:0xfe1024d4
y.create.l HWIO_LPASS_SB_XPU_RG6_MCR_ADDR A:0xfe102554
y.create.l HWIO_LPASS_SB_XPU_RG7_MCR_ADDR A:0xfe1025d4
y.create.l HWIO_LPASS_SB_XPU_RG8_MCR_ADDR A:0xfe102654
y.create.l HWIO_LPASS_SB_XPU_RG9_MCR_ADDR A:0xfe1026d4
y.create.l HWIO_LPASS_SB_VMIDMT_SCR0_ADDR A:0xfe100000
y.create.l HWIO_LPASS_SB_VMIDMT_SCR1_ADDR A:0xfe100004
y.create.l HWIO_LPASS_SB_VMIDMT_SCR2_ADDR A:0xfe100008
y.create.l HWIO_LPASS_SB_VMIDMT_SACR_ADDR A:0xfe100010
y.create.l HWIO_LPASS_SB_VMIDMT_SIDR0_ADDR A:0xfe100020
y.create.l HWIO_LPASS_SB_VMIDMT_SIDR1_ADDR A:0xfe100024
y.create.l HWIO_LPASS_SB_VMIDMT_SIDR2_ADDR A:0xfe100028
y.create.l HWIO_LPASS_SB_VMIDMT_SIDR4_ADDR A:0xfe100030
y.create.l HWIO_LPASS_SB_VMIDMT_SIDR5_ADDR A:0xfe100034
y.create.l HWIO_LPASS_SB_VMIDMT_SIDR7_ADDR A:0xfe10003c
y.create.l HWIO_LPASS_SB_VMIDMT_SGFAR0_ADDR A:0xfe100040
y.create.l HWIO_LPASS_SB_VMIDMT_SGFSR_ADDR A:0xfe100048
y.create.l HWIO_LPASS_SB_VMIDMT_SGFSRRESTORE_ADDR A:0xfe10004c
y.create.l HWIO_LPASS_SB_VMIDMT_SGFSYNDR0_ADDR A:0xfe100050
y.create.l HWIO_LPASS_SB_VMIDMT_SGFSYNDR1_ADDR A:0xfe100054
y.create.l HWIO_LPASS_SB_VMIDMT_SGFSYNDR2_ADDR A:0xfe100058
y.create.l HWIO_LPASS_SB_VMIDMT_VMIDMTSCR0_ADDR A:0xfe100090
y.create.l HWIO_LPASS_SB_VMIDMT_CR0_ADDR A:0xfe100000
y.create.l HWIO_LPASS_SB_VMIDMT_CR2_ADDR A:0xfe100008
y.create.l HWIO_LPASS_SB_VMIDMT_ACR_ADDR A:0xfe100010
y.create.l HWIO_LPASS_SB_VMIDMT_IDR0_ADDR A:0xfe100020
y.create.l HWIO_LPASS_SB_VMIDMT_IDR1_ADDR A:0xfe100024
y.create.l HWIO_LPASS_SB_VMIDMT_IDR2_ADDR A:0xfe100028
y.create.l HWIO_LPASS_SB_VMIDMT_IDR4_ADDR A:0xfe100030
y.create.l HWIO_LPASS_SB_VMIDMT_IDR5_ADDR A:0xfe100034
y.create.l HWIO_LPASS_SB_VMIDMT_IDR7_ADDR A:0xfe10003c
y.create.l HWIO_LPASS_SB_VMIDMT_GFAR0_ADDR A:0xfe100040
y.create.l HWIO_LPASS_SB_VMIDMT_GFSR_ADDR A:0xfe100048
y.create.l HWIO_LPASS_SB_VMIDMT_GFSRRESTORE_ADDR A:0xfe10004c
y.create.l HWIO_LPASS_SB_VMIDMT_GFSYNDR0_ADDR A:0xfe100050
y.create.l HWIO_LPASS_SB_VMIDMT_GFSYNDR1_ADDR A:0xfe100054
y.create.l HWIO_LPASS_SB_VMIDMT_GFSYNDR2_ADDR A:0xfe100058
y.create.l HWIO_LPASS_SB_VMIDMT_VMIDMTCR0_ADDR A:0xfe100090
y.create.l HWIO_LPASS_SB_VMIDMT_VMIDMTACR_ADDR A:0xfe10009c
y.create.l HWIO_LPASS_SB_VMIDMT_NSCR0_ADDR A:0xfe100400
y.create.l HWIO_LPASS_SB_VMIDMT_NSCR2_ADDR A:0xfe100408
y.create.l HWIO_LPASS_SB_VMIDMT_NSACR_ADDR A:0xfe100410
y.create.l HWIO_LPASS_SB_VMIDMT_NSGFAR0_ADDR A:0xfe100440
y.create.l HWIO_LPASS_SB_VMIDMT_NSGFSR_ADDR A:0xfe100448
y.create.l HWIO_LPASS_SB_VMIDMT_NSGFSRRESTORE_ADDR A:0xfe10044c
y.create.l HWIO_LPASS_SB_VMIDMT_NSGFSYNDR0_ADDR A:0xfe100450
y.create.l HWIO_LPASS_SB_VMIDMT_NSGFSYNDR1_ADDR A:0xfe100454
y.create.l HWIO_LPASS_SB_VMIDMT_NSGFSYNDR2_ADDR A:0xfe100458
y.create.l HWIO_LPASS_SB_VMIDMT_NSVMIDMTCR0_ADDR A:0xfe100490
y.create.l HWIO_LPASS_SB_VMIDMT_SSDR0_ADDR A:0xfe100080
y.create.l HWIO_LPASS_SB_VMIDMT_MSDR0_ADDR A:0xfe100480
y.create.l HWIO_LPASS_SB_VMIDMT_MCR_ADDR A:0xfe100494
y.create.l HWIO_LPASS_SB_VMIDMT_S2VR0_ADDR A:0xfe100c00
y.create.l HWIO_LPASS_SB_VMIDMT_S2VR1_ADDR A:0xfe100c04
y.create.l HWIO_LPASS_SB_VMIDMT_S2VR2_ADDR A:0xfe100c08
y.create.l HWIO_LPASS_SB_VMIDMT_S2VR3_ADDR A:0xfe100c0c
y.create.l HWIO_LPASS_SB_VMIDMT_S2VR4_ADDR A:0xfe100c10
y.create.l HWIO_LPASS_SB_VMIDMT_S2VR5_ADDR A:0xfe100c14
y.create.l HWIO_LPASS_SB_VMIDMT_S2VR6_ADDR A:0xfe100c18
y.create.l HWIO_LPASS_SB_VMIDMT_S2VR7_ADDR A:0xfe100c1c
y.create.l HWIO_LPASS_SB_VMIDMT_S2VR8_ADDR A:0xfe100c20
y.create.l HWIO_LPASS_SB_VMIDMT_S2VR9_ADDR A:0xfe100c24
y.create.l HWIO_LPASS_SB_VMIDMT_AS2VR0_ADDR A:0xfe100e00
y.create.l HWIO_LPASS_SB_VMIDMT_AS2VR1_ADDR A:0xfe100e04
y.create.l HWIO_LPASS_SB_VMIDMT_AS2VR2_ADDR A:0xfe100e08
y.create.l HWIO_LPASS_SB_VMIDMT_AS2VR3_ADDR A:0xfe100e0c
y.create.l HWIO_LPASS_SB_VMIDMT_AS2VR4_ADDR A:0xfe100e10
y.create.l HWIO_LPASS_SB_VMIDMT_AS2VR5_ADDR A:0xfe100e14
y.create.l HWIO_LPASS_SB_VMIDMT_AS2VR6_ADDR A:0xfe100e18
y.create.l HWIO_LPASS_SB_VMIDMT_AS2VR7_ADDR A:0xfe100e1c
y.create.l HWIO_LPASS_SB_VMIDMT_AS2VR8_ADDR A:0xfe100e20
y.create.l HWIO_LPASS_SB_VMIDMT_AS2VR9_ADDR A:0xfe100e24
y.create.l HWIO_LPASS_SB_VMIDMT_SMR0_ADDR A:0xfe100800
y.create.l HWIO_LPASS_SB_VMIDMT_SMR1_ADDR A:0xfe100804
y.create.l HWIO_LPASS_SB_VMIDMT_SMR2_ADDR A:0xfe100808
y.create.l HWIO_LPASS_SB_VMIDMT_SMR3_ADDR A:0xfe10080c
y.create.l HWIO_LPASS_SB_VMIDMT_SMR4_ADDR A:0xfe100810
y.create.l HWIO_LPASS_SB_VMIDMT_SMR5_ADDR A:0xfe100814
y.create.l HWIO_LPASS_SB_VMIDMT_SMR6_ADDR A:0xfe100818
y.create.l HWIO_LPASS_SB_VMIDMT_SMR7_ADDR A:0xfe10081c
y.create.l HWIO_LPASS_SB_VMIDMT_SMR8_ADDR A:0xfe100820
y.create.l HWIO_LPASS_SB_VMIDMT_SMR9_ADDR A:0xfe100824
y.create.l HWIO_LPASS_SB_COMP_HW_VERSION_ADDR A:0xfe12f000
y.create.l HWIO_LPASS_SB_COMP_CFG_ADDR A:0xfe12f004
y.create.l HWIO_LPASS_SB_SW_RESET_ADDR A:0xfe12f008
y.create.l HWIO_LPASS_SB_COMP_STATUS_ADDR A:0xfe12f020
y.create.l HWIO_LPASS_SB_COMP_PARAMS_ADDR A:0xfe12f024
y.create.l HWIO_LPASS_SB_COMP_CHAR_CFG_ADDR A:0xfe12f028
y.create.l HWIO_LPASS_SB_COMP_CHAR_DATA_0_ADDR A:0xfe12f02c
y.create.l HWIO_LPASS_SB_COMP_CHAR_DATA_1_ADDR A:0xfe12f030
y.create.l HWIO_LPASS_SB_MGR_CFG_ADDR A:0xfe12f200
y.create.l HWIO_LPASS_SB_MGR_STATUS_ADDR A:0xfe12f204
y.create.l HWIO_LPASS_SB_MGR_RX_MSGQ_CFG_ADDR A:0xfe12f208
y.create.l HWIO_LPASS_SB_MGR_INT_EN_ADDR A:0xfe12f210
y.create.l HWIO_LPASS_SB_MGR_INT_STATUS_ADDR A:0xfe12f214
y.create.l HWIO_LPASS_SB_MGR_INT_CLR_ADDR A:0xfe12f218
y.create.l HWIO_LPASS_SB_MGR_TX_MSG0_ADDR A:0xfe12f230
y.create.l HWIO_LPASS_SB_MGR_TX_MSG1_ADDR A:0xfe12f234
y.create.l HWIO_LPASS_SB_MGR_TX_MSG2_ADDR A:0xfe12f238
y.create.l HWIO_LPASS_SB_MGR_TX_MSG3_ADDR A:0xfe12f23c
y.create.l HWIO_LPASS_SB_MGR_TX_MSG4_ADDR A:0xfe12f240
y.create.l HWIO_LPASS_SB_MGR_TX_MSG5_ADDR A:0xfe12f244
y.create.l HWIO_LPASS_SB_MGR_TX_MSG6_ADDR A:0xfe12f248
y.create.l HWIO_LPASS_SB_MGR_TX_MSG7_ADDR A:0xfe12f24c
y.create.l HWIO_LPASS_SB_MGR_TX_MSG8_ADDR A:0xfe12f250
y.create.l HWIO_LPASS_SB_MGR_TX_MSG9_ADDR A:0xfe12f254
y.create.l HWIO_LPASS_SB_MGR_RX_MSG0_ADDR A:0xfe12f270
y.create.l HWIO_LPASS_SB_MGR_RX_MSG1_ADDR A:0xfe12f274
y.create.l HWIO_LPASS_SB_MGR_RX_MSG2_ADDR A:0xfe12f278
y.create.l HWIO_LPASS_SB_MGR_RX_MSG3_ADDR A:0xfe12f27c
y.create.l HWIO_LPASS_SB_MGR_RX_MSG4_ADDR A:0xfe12f280
y.create.l HWIO_LPASS_SB_MGR_RX_MSG5_ADDR A:0xfe12f284
y.create.l HWIO_LPASS_SB_MGR_RX_MSG6_ADDR A:0xfe12f288
y.create.l HWIO_LPASS_SB_MGR_RX_MSG7_ADDR A:0xfe12f28c
y.create.l HWIO_LPASS_SB_MGR_RX_MSG8_ADDR A:0xfe12f290
y.create.l HWIO_LPASS_SB_MGR_RX_MSG9_ADDR A:0xfe12f294
y.create.l HWIO_LPASS_SB_MGR_IE_STATUS_ADDR A:0xfe12f2f0
y.create.l HWIO_LPASS_SB_MGR_VE_STATUS_ADDR A:0xfe12f300
y.create.l HWIO_LPASS_SB_FRM_CFG_ADDR A:0xfe12f400
y.create.l HWIO_LPASS_SB_FRM_STATUS_ADDR A:0xfe12f404
y.create.l HWIO_LPASS_SB_FRM_INT_EN_ADDR A:0xfe12f410
y.create.l HWIO_LPASS_SB_FRM_INT_STATUS_ADDR A:0xfe12f414
y.create.l HWIO_LPASS_SB_FRM_INT_CLR_ADDR A:0xfe12f418
y.create.l HWIO_LPASS_SB_FRM_WAKEUP_ADDR A:0xfe12f41c
y.create.l HWIO_LPASS_SB_FRM_CLKCTL_DONE_ADDR A:0xfe12f420
y.create.l HWIO_LPASS_SB_FRM_IE_STATUS_ADDR A:0xfe12f430
y.create.l HWIO_LPASS_SB_FRM_VE_STATUS_ADDR A:0xfe12f440
y.create.l HWIO_LPASS_SB_INTF_CFG_ADDR A:0xfe12f600
y.create.l HWIO_LPASS_SB_INTF_STATUS_ADDR A:0xfe12f604
y.create.l HWIO_LPASS_SB_INTF_INT_EN_ADDR A:0xfe12f610
y.create.l HWIO_LPASS_SB_INTF_INT_STATUS_ADDR A:0xfe12f614
y.create.l HWIO_LPASS_SB_INTF_INT_CLR_ADDR A:0xfe12f618
y.create.l HWIO_LPASS_SB_INTF_IE_STATUS_ADDR A:0xfe12f630
y.create.l HWIO_LPASS_SB_INTF_VE_STATUS_ADDR A:0xfe12f640
y.create.l HWIO_LPASS_SB_NGD1_CFG_ADDR A:0xfe130000
y.create.l HWIO_LPASS_SB_NGD1_STATUS_ADDR A:0xfe130004
y.create.l HWIO_LPASS_SB_NGD1_RX_MSGQ_CFG_ADDR A:0xfe130008
y.create.l HWIO_LPASS_SB_NGD1_INT_EN_ADDR A:0xfe130010
y.create.l HWIO_LPASS_SB_NGD1_INT_STATUS_ADDR A:0xfe130014
y.create.l HWIO_LPASS_SB_NGD1_INT_CLR_ADDR A:0xfe130018
y.create.l HWIO_LPASS_SB_NGD1_TX_MSG0_ADDR A:0xfe130030
y.create.l HWIO_LPASS_SB_NGD1_TX_MSG1_ADDR A:0xfe130034
y.create.l HWIO_LPASS_SB_NGD1_TX_MSG2_ADDR A:0xfe130038
y.create.l HWIO_LPASS_SB_NGD1_TX_MSG3_ADDR A:0xfe13003c
y.create.l HWIO_LPASS_SB_NGD1_TX_MSG4_ADDR A:0xfe130040
y.create.l HWIO_LPASS_SB_NGD1_TX_MSG5_ADDR A:0xfe130044
y.create.l HWIO_LPASS_SB_NGD1_TX_MSG6_ADDR A:0xfe130048
y.create.l HWIO_LPASS_SB_NGD1_TX_MSG7_ADDR A:0xfe13004c
y.create.l HWIO_LPASS_SB_NGD1_TX_MSG8_ADDR A:0xfe130050
y.create.l HWIO_LPASS_SB_NGD1_TX_MSG9_ADDR A:0xfe130054
y.create.l HWIO_LPASS_SB_NGD1_RX_MSG0_ADDR A:0xfe130070
y.create.l HWIO_LPASS_SB_NGD1_RX_MSG1_ADDR A:0xfe130074
y.create.l HWIO_LPASS_SB_NGD1_RX_MSG2_ADDR A:0xfe130078
y.create.l HWIO_LPASS_SB_NGD1_RX_MSG3_ADDR A:0xfe13007c
y.create.l HWIO_LPASS_SB_NGD1_RX_MSG4_ADDR A:0xfe130080
y.create.l HWIO_LPASS_SB_NGD1_RX_MSG5_ADDR A:0xfe130084
y.create.l HWIO_LPASS_SB_NGD1_RX_MSG6_ADDR A:0xfe130088
y.create.l HWIO_LPASS_SB_NGD1_RX_MSG7_ADDR A:0xfe13008c
y.create.l HWIO_LPASS_SB_NGD1_RX_MSG8_ADDR A:0xfe130090
y.create.l HWIO_LPASS_SB_NGD1_RX_MSG9_ADDR A:0xfe130094
y.create.l HWIO_LPASS_SB_NGD1_IE_STATUS_ADDR A:0xfe1300f0
y.create.l HWIO_LPASS_SB_NGD1_VE_STATUS_ADDR A:0xfe130100
y.create.l HWIO_LPASS_SB_NGD2_CFG_ADDR A:0xfe131000
y.create.l HWIO_LPASS_SB_NGD2_STATUS_ADDR A:0xfe131004
y.create.l HWIO_LPASS_SB_NGD2_RX_MSGQ_CFG_ADDR A:0xfe131008
y.create.l HWIO_LPASS_SB_NGD2_INT_EN_ADDR A:0xfe131010
y.create.l HWIO_LPASS_SB_NGD2_INT_STATUS_ADDR A:0xfe131014
y.create.l HWIO_LPASS_SB_NGD2_INT_CLR_ADDR A:0xfe131018
y.create.l HWIO_LPASS_SB_NGD2_TX_MSG0_ADDR A:0xfe131030
y.create.l HWIO_LPASS_SB_NGD2_TX_MSG1_ADDR A:0xfe131034
y.create.l HWIO_LPASS_SB_NGD2_TX_MSG2_ADDR A:0xfe131038
y.create.l HWIO_LPASS_SB_NGD2_TX_MSG3_ADDR A:0xfe13103c
y.create.l HWIO_LPASS_SB_NGD2_TX_MSG4_ADDR A:0xfe131040
y.create.l HWIO_LPASS_SB_NGD2_TX_MSG5_ADDR A:0xfe131044
y.create.l HWIO_LPASS_SB_NGD2_TX_MSG6_ADDR A:0xfe131048
y.create.l HWIO_LPASS_SB_NGD2_TX_MSG7_ADDR A:0xfe13104c
y.create.l HWIO_LPASS_SB_NGD2_TX_MSG8_ADDR A:0xfe131050
y.create.l HWIO_LPASS_SB_NGD2_TX_MSG9_ADDR A:0xfe131054
y.create.l HWIO_LPASS_SB_NGD2_RX_MSG0_ADDR A:0xfe131070
y.create.l HWIO_LPASS_SB_NGD2_RX_MSG1_ADDR A:0xfe131074
y.create.l HWIO_LPASS_SB_NGD2_RX_MSG2_ADDR A:0xfe131078
y.create.l HWIO_LPASS_SB_NGD2_RX_MSG3_ADDR A:0xfe13107c
y.create.l HWIO_LPASS_SB_NGD2_RX_MSG4_ADDR A:0xfe131080
y.create.l HWIO_LPASS_SB_NGD2_RX_MSG5_ADDR A:0xfe131084
y.create.l HWIO_LPASS_SB_NGD2_RX_MSG6_ADDR A:0xfe131088
y.create.l HWIO_LPASS_SB_NGD2_RX_MSG7_ADDR A:0xfe13108c
y.create.l HWIO_LPASS_SB_NGD2_RX_MSG8_ADDR A:0xfe131090
y.create.l HWIO_LPASS_SB_NGD2_RX_MSG9_ADDR A:0xfe131094
y.create.l HWIO_LPASS_SB_NGD2_IE_STATUS_ADDR A:0xfe1310f0
y.create.l HWIO_LPASS_SB_NGD2_VE_STATUS_ADDR A:0xfe131100
y.create.l HWIO_LPASS_SB_PGD_CFG_ADDR A:0xfe12f800
y.create.l HWIO_LPASS_SB_PGD_STATUS_ADDR A:0xfe12f804
y.create.l HWIO_LPASS_SB_PGD_DEV_INT_EN_ADDR A:0xfe12f810
y.create.l HWIO_LPASS_SB_PGD_DEV_INT_STATUS_ADDR A:0xfe12f814
y.create.l HWIO_LPASS_SB_PGD_DEV_INT_CLR_ADDR A:0xfe12f818
y.create.l HWIO_LPASS_SB_COMP_TRUST_CFG_ADDR A:0xfe132000
y.create.l HWIO_LPASS_SB_COMP_TRUST_DEV1_ADDR A:0xfe132004
y.create.l HWIO_LPASS_SB_COMP_TRUST_DEV2_ADDR A:0xfe132008
y.create.l HWIO_LPASS_SB_PGD_TRUST_OWN_EE0_ADDR A:0xfe13200c
y.create.l HWIO_LPASS_SB_PGD_TRUST_OWN_EE1_ADDR A:0xfe132010
y.create.l HWIO_LPASS_SB_PGD_TRUST_OWN_EE2_ADDR A:0xfe132014
y.create.l HWIO_LPASS_SB_COMP_TEST_ADDR A:0xfe133000
y.create.l HWIO_LPASS_SB_COMP_DEBUG_ADDR A:0xfe133004
y.create.l HWIO_LPASS_SB_PGD_PORT_INT_EN_EE0_ADDR A:0xfe134000
y.create.l HWIO_LPASS_SB_PGD_PORT_INT_EN_EE1_ADDR A:0xfe135000
y.create.l HWIO_LPASS_SB_PGD_PORT_INT_EN_EE2_ADDR A:0xfe136000
y.create.l HWIO_LPASS_SB_PGD_PORT_INT_STATUS_EE0_ADDR A:0xfe134004
y.create.l HWIO_LPASS_SB_PGD_PORT_INT_STATUS_EE1_ADDR A:0xfe135004
y.create.l HWIO_LPASS_SB_PGD_PORT_INT_STATUS_EE2_ADDR A:0xfe136004
y.create.l HWIO_LPASS_SB_PGD_PORT_INT_CLR_EE0_ADDR A:0xfe134008
y.create.l HWIO_LPASS_SB_PGD_PORT_INT_CLR_EE1_ADDR A:0xfe135008
y.create.l HWIO_LPASS_SB_PGD_PORT_INT_CLR_EE2_ADDR A:0xfe136008
y.create.l HWIO_LPASS_SB_PGD_PORT_CFG0_ADDR A:0xfe143000
y.create.l HWIO_LPASS_SB_PGD_PORT_CFG1_ADDR A:0xfe144000
y.create.l HWIO_LPASS_SB_PGD_PORT_CFG2_ADDR A:0xfe145000
y.create.l HWIO_LPASS_SB_PGD_PORT_CFG3_ADDR A:0xfe146000
y.create.l HWIO_LPASS_SB_PGD_PORT_CFG4_ADDR A:0xfe147000
y.create.l HWIO_LPASS_SB_PGD_PORT_CFG5_ADDR A:0xfe148000
y.create.l HWIO_LPASS_SB_PGD_PORT_CFG6_ADDR A:0xfe149000
y.create.l HWIO_LPASS_SB_PGD_PORT_CFG7_ADDR A:0xfe14a000
y.create.l HWIO_LPASS_SB_PGD_PORT_CFG8_ADDR A:0xfe14b000
y.create.l HWIO_LPASS_SB_PGD_PORT_CFG9_ADDR A:0xfe14c000
y.create.l HWIO_LPASS_SB_PGD_PORT_STATUS0_ADDR A:0xfe143004
y.create.l HWIO_LPASS_SB_PGD_PORT_STATUS1_ADDR A:0xfe144004
y.create.l HWIO_LPASS_SB_PGD_PORT_STATUS2_ADDR A:0xfe145004
y.create.l HWIO_LPASS_SB_PGD_PORT_STATUS3_ADDR A:0xfe146004
y.create.l HWIO_LPASS_SB_PGD_PORT_STATUS4_ADDR A:0xfe147004
y.create.l HWIO_LPASS_SB_PGD_PORT_STATUS5_ADDR A:0xfe148004
y.create.l HWIO_LPASS_SB_PGD_PORT_STATUS6_ADDR A:0xfe149004
y.create.l HWIO_LPASS_SB_PGD_PORT_STATUS7_ADDR A:0xfe14a004
y.create.l HWIO_LPASS_SB_PGD_PORT_STATUS8_ADDR A:0xfe14b004
y.create.l HWIO_LPASS_SB_PGD_PORT_STATUS9_ADDR A:0xfe14c004
y.create.l HWIO_LPASS_SB_PGD_PORT_PARAM0_ADDR A:0xfe143008
y.create.l HWIO_LPASS_SB_PGD_PORT_PARAM1_ADDR A:0xfe144008
y.create.l HWIO_LPASS_SB_PGD_PORT_PARAM2_ADDR A:0xfe145008
y.create.l HWIO_LPASS_SB_PGD_PORT_PARAM3_ADDR A:0xfe146008
y.create.l HWIO_LPASS_SB_PGD_PORT_PARAM4_ADDR A:0xfe147008
y.create.l HWIO_LPASS_SB_PGD_PORT_PARAM5_ADDR A:0xfe148008
y.create.l HWIO_LPASS_SB_PGD_PORT_PARAM6_ADDR A:0xfe149008
y.create.l HWIO_LPASS_SB_PGD_PORT_PARAM7_ADDR A:0xfe14a008
y.create.l HWIO_LPASS_SB_PGD_PORT_PARAM8_ADDR A:0xfe14b008
y.create.l HWIO_LPASS_SB_PGD_PORT_PARAM9_ADDR A:0xfe14c008
y.create.l HWIO_LPASS_SB_PGD_PORT_BLK_SIZE0_ADDR A:0xfe14300c
y.create.l HWIO_LPASS_SB_PGD_PORT_BLK_SIZE1_ADDR A:0xfe14400c
y.create.l HWIO_LPASS_SB_PGD_PORT_BLK_SIZE2_ADDR A:0xfe14500c
y.create.l HWIO_LPASS_SB_PGD_PORT_BLK_SIZE3_ADDR A:0xfe14600c
y.create.l HWIO_LPASS_SB_PGD_PORT_BLK_SIZE4_ADDR A:0xfe14700c
y.create.l HWIO_LPASS_SB_PGD_PORT_BLK_SIZE5_ADDR A:0xfe14800c
y.create.l HWIO_LPASS_SB_PGD_PORT_BLK_SIZE6_ADDR A:0xfe14900c
y.create.l HWIO_LPASS_SB_PGD_PORT_BLK_SIZE7_ADDR A:0xfe14a00c
y.create.l HWIO_LPASS_SB_PGD_PORT_BLK_SIZE8_ADDR A:0xfe14b00c
y.create.l HWIO_LPASS_SB_PGD_PORT_BLK_SIZE9_ADDR A:0xfe14c00c
y.create.l HWIO_LPASS_SB_PGD_PORT_TRANS_SIZE0_ADDR A:0xfe143010
y.create.l HWIO_LPASS_SB_PGD_PORT_TRANS_SIZE1_ADDR A:0xfe144010
y.create.l HWIO_LPASS_SB_PGD_PORT_TRANS_SIZE2_ADDR A:0xfe145010
y.create.l HWIO_LPASS_SB_PGD_PORT_TRANS_SIZE3_ADDR A:0xfe146010
y.create.l HWIO_LPASS_SB_PGD_PORT_TRANS_SIZE4_ADDR A:0xfe147010
y.create.l HWIO_LPASS_SB_PGD_PORT_TRANS_SIZE5_ADDR A:0xfe148010
y.create.l HWIO_LPASS_SB_PGD_PORT_TRANS_SIZE6_ADDR A:0xfe149010
y.create.l HWIO_LPASS_SB_PGD_PORT_TRANS_SIZE7_ADDR A:0xfe14a010
y.create.l HWIO_LPASS_SB_PGD_PORT_TRANS_SIZE8_ADDR A:0xfe14b010
y.create.l HWIO_LPASS_SB_PGD_PORT_TRANS_SIZE9_ADDR A:0xfe14c010
y.create.l HWIO_LPASS_SB_PGD_PORT_MULTI_CHNL0_ADDR A:0xfe143014
y.create.l HWIO_LPASS_SB_PGD_PORT_MULTI_CHNL1_ADDR A:0xfe144014
y.create.l HWIO_LPASS_SB_PGD_PORT_MULTI_CHNL2_ADDR A:0xfe145014
y.create.l HWIO_LPASS_SB_PGD_PORT_MULTI_CHNL3_ADDR A:0xfe146014
y.create.l HWIO_LPASS_SB_PGD_PORT_MULTI_CHNL4_ADDR A:0xfe147014
y.create.l HWIO_LPASS_SB_PGD_PORT_MULTI_CHNL5_ADDR A:0xfe148014
y.create.l HWIO_LPASS_SB_PGD_PORT_MULTI_CHNL6_ADDR A:0xfe149014
y.create.l HWIO_LPASS_SB_PGD_PORT_MULTI_CHNL7_ADDR A:0xfe14a014
y.create.l HWIO_LPASS_SB_PGD_PORT_MULTI_CHNL8_ADDR A:0xfe14b014
y.create.l HWIO_LPASS_SB_PGD_PORT_MULTI_CHNL9_ADDR A:0xfe14c014
y.create.l HWIO_LPASS_SB_PGD_PORT_PUSHPULL0_ADDR A:0xfe143018
y.create.l HWIO_LPASS_SB_PGD_PORT_PUSHPULL1_ADDR A:0xfe144018
y.create.l HWIO_LPASS_SB_PGD_PORT_PUSHPULL2_ADDR A:0xfe145018
y.create.l HWIO_LPASS_SB_PGD_PORT_PUSHPULL3_ADDR A:0xfe146018
y.create.l HWIO_LPASS_SB_PGD_PORT_PUSHPULL4_ADDR A:0xfe147018
y.create.l HWIO_LPASS_SB_PGD_PORT_PUSHPULL5_ADDR A:0xfe148018
y.create.l HWIO_LPASS_SB_PGD_PORT_PUSHPULL6_ADDR A:0xfe149018
y.create.l HWIO_LPASS_SB_PGD_PORT_PUSHPULL7_ADDR A:0xfe14a018
y.create.l HWIO_LPASS_SB_PGD_PORT_PUSHPULL8_ADDR A:0xfe14b018
y.create.l HWIO_LPASS_SB_PGD_PORT_PUSHPULL9_ADDR A:0xfe14c018
y.create.l HWIO_LPASS_SB_PGD_IE_STATUS_ADDR A:0xfe12f820
y.create.l HWIO_LPASS_SB_PGD_VE_STATUS_ADDR A:0xfe12f830
y.create.l HWIO_LPASS_SB_PGD_PC_CFG0_ADDR A:0xfe137000
y.create.l HWIO_LPASS_SB_PGD_PC_CFG1_ADDR A:0xfe138000
y.create.l HWIO_LPASS_SB_PGD_PC_CFG2_ADDR A:0xfe139000
y.create.l HWIO_LPASS_SB_PGD_PC_CFG3_ADDR A:0xfe13a000
y.create.l HWIO_LPASS_SB_PGD_PC_CFG4_ADDR A:0xfe13b000
y.create.l HWIO_LPASS_SB_PGD_PC_CFG5_ADDR A:0xfe13c000
y.create.l HWIO_LPASS_SB_PGD_PC_CFG6_ADDR A:0xfe13d000
y.create.l HWIO_LPASS_SB_PGD_PC_CFG7_ADDR A:0xfe13e000
y.create.l HWIO_LPASS_SB_PGD_PC_CFG8_ADDR A:0xfe13f000
y.create.l HWIO_LPASS_SB_PGD_PC_CFG9_ADDR A:0xfe140000
y.create.l HWIO_LPASS_SB_PGD_PC_VAL0_ADDR A:0xfe137004
y.create.l HWIO_LPASS_SB_PGD_PC_VAL1_ADDR A:0xfe138004
y.create.l HWIO_LPASS_SB_PGD_PC_VAL2_ADDR A:0xfe139004
y.create.l HWIO_LPASS_SB_PGD_PC_VAL3_ADDR A:0xfe13a004
y.create.l HWIO_LPASS_SB_PGD_PC_VAL4_ADDR A:0xfe13b004
y.create.l HWIO_LPASS_SB_PGD_PC_VAL5_ADDR A:0xfe13c004
y.create.l HWIO_LPASS_SB_PGD_PC_VAL6_ADDR A:0xfe13d004
y.create.l HWIO_LPASS_SB_PGD_PC_VAL7_ADDR A:0xfe13e004
y.create.l HWIO_LPASS_SB_PGD_PC_VAL8_ADDR A:0xfe13f004
y.create.l HWIO_LPASS_SB_PGD_PC_VAL9_ADDR A:0xfe140004
y.create.l HWIO_LPASS_SB_PGD_PC_VFR_TS0_ADDR A:0xfe137008
y.create.l HWIO_LPASS_SB_PGD_PC_VFR_TS1_ADDR A:0xfe138008
y.create.l HWIO_LPASS_SB_PGD_PC_VFR_TS2_ADDR A:0xfe139008
y.create.l HWIO_LPASS_SB_PGD_PC_VFR_TS3_ADDR A:0xfe13a008
y.create.l HWIO_LPASS_SB_PGD_PC_VFR_TS4_ADDR A:0xfe13b008
y.create.l HWIO_LPASS_SB_PGD_PC_VFR_TS5_ADDR A:0xfe13c008
y.create.l HWIO_LPASS_SB_PGD_PC_VFR_TS6_ADDR A:0xfe13d008
y.create.l HWIO_LPASS_SB_PGD_PC_VFR_TS7_ADDR A:0xfe13e008
y.create.l HWIO_LPASS_SB_PGD_PC_VFR_TS8_ADDR A:0xfe13f008
y.create.l HWIO_LPASS_SB_PGD_PC_VFR_TS9_ADDR A:0xfe140008
y.create.l HWIO_LPASS_SB_PGD_PC_VFR_TS_STATUS0_ADDR A:0xfe13700c
y.create.l HWIO_LPASS_SB_PGD_PC_VFR_TS_STATUS1_ADDR A:0xfe13800c
y.create.l HWIO_LPASS_SB_PGD_PC_VFR_TS_STATUS2_ADDR A:0xfe13900c
y.create.l HWIO_LPASS_SB_PGD_PC_VFR_TS_STATUS3_ADDR A:0xfe13a00c
y.create.l HWIO_LPASS_SB_PGD_PC_VFR_TS_STATUS4_ADDR A:0xfe13b00c
y.create.l HWIO_LPASS_SB_PGD_PC_VFR_TS_STATUS5_ADDR A:0xfe13c00c
y.create.l HWIO_LPASS_SB_PGD_PC_VFR_TS_STATUS6_ADDR A:0xfe13d00c
y.create.l HWIO_LPASS_SB_PGD_PC_VFR_TS_STATUS7_ADDR A:0xfe13e00c
y.create.l HWIO_LPASS_SB_PGD_PC_VFR_TS_STATUS8_ADDR A:0xfe13f00c
y.create.l HWIO_LPASS_SB_PGD_PC_VFR_TS_STATUS9_ADDR A:0xfe14000c
y.create.l HWIO_LPASS_SB_PGD_PC_VFR_TS_CLR0_ADDR A:0xfe137010
y.create.l HWIO_LPASS_SB_PGD_PC_VFR_TS_CLR1_ADDR A:0xfe138010
y.create.l HWIO_LPASS_SB_PGD_PC_VFR_TS_CLR2_ADDR A:0xfe139010
y.create.l HWIO_LPASS_SB_PGD_PC_VFR_TS_CLR3_ADDR A:0xfe13a010
y.create.l HWIO_LPASS_SB_PGD_PC_VFR_TS_CLR4_ADDR A:0xfe13b010
y.create.l HWIO_LPASS_SB_PGD_PC_VFR_TS_CLR5_ADDR A:0xfe13c010
y.create.l HWIO_LPASS_SB_PGD_PC_VFR_TS_CLR6_ADDR A:0xfe13d010
y.create.l HWIO_LPASS_SB_PGD_PC_VFR_TS_CLR7_ADDR A:0xfe13e010
y.create.l HWIO_LPASS_SB_PGD_PC_VFR_TS_CLR8_ADDR A:0xfe13f010
y.create.l HWIO_LPASS_SB_PGD_PC_VFR_TS_CLR9_ADDR A:0xfe140010
y.create.l HWIO_LPASS_QDSP6SS_VERSION_ADDR A:0xfe200000
y.create.l HWIO_LPASS_QDSP6SS_RST_EVB_ADDR A:0xfe200010
y.create.l HWIO_LPASS_QDSP6SS_RESET_ADDR A:0xfe200014
y.create.l HWIO_LPASS_QDSP6SS_DBG_CFG_ADDR A:0xfe200018
y.create.l HWIO_LPASS_QDSP6SS_GFMUX_CTL_ADDR A:0xfe200020
y.create.l HWIO_LPASS_QDSP6SS_GFMUX_STATUS_ADDR A:0xfe200024
y.create.l HWIO_LPASS_QDSP6SS_PWR_CTL_ADDR A:0xfe200030
y.create.l HWIO_LPASS_QDSP6SS_CGC_OVERRIDE_ADDR A:0xfe200034
y.create.l HWIO_LPASS_QDSP6SS_NMI_ADDR A:0xfe200040
y.create.l HWIO_LPASS_QDSP6SS_NMI_STATUS_ADDR A:0xfe200044
y.create.l HWIO_LPASS_QDSP6SS_LDO_CFG0_ADDR A:0xfe200050
y.create.l HWIO_LPASS_QDSP6SS_LDO_CFG1_ADDR A:0xfe200054
y.create.l HWIO_LPASS_QDSP6SS_LDO_CFG2_ADDR A:0xfe200058
y.create.l HWIO_LPASS_QDSP6SS_LDO_VREF_SET_ADDR A:0xfe20005c
y.create.l HWIO_LPASS_QDSP6SS_STRAP_TCM_ADDR A:0xfe200100
y.create.l HWIO_LPASS_QDSP6SS_STRAP_AHBUPPER_ADDR A:0xfe200104
y.create.l HWIO_LPASS_QDSP6SS_STRAP_AHBLOWER_ADDR A:0xfe200108
y.create.l HWIO_LPASS_QDSP6SS_STRAP_ACC_ADDR A:0xfe200110
y.create.l HWIO_LPASS_QDSP6SS_DCC_CTRL_ADDR A:0xfe200114
y.create.l HWIO_LPASS_QDSP6SS_EXT_WAKEUP_ADDR A:0xfe201000
y.create.l HWIO_LPASS_QDSP6SS_EXT_PD_ADDR A:0xfe201004
y.create.l HWIO_LPASS_QDSP6SS_FLL_CTL_ADDR A:0xfe201010
y.create.l HWIO_LPASS_QDSP6SS_FLL_STATUS_ADDR A:0xfe201014
y.create.l HWIO_LPASS_QDSP6SS_TEST_BUS_CTL_ADDR A:0xfe202000
y.create.l HWIO_LPASS_QDSP6SS_TEST_BUS_VALUE_ADDR A:0xfe202004
y.create.l HWIO_LPASS_QDSP6SS_TEST_BUS_WDATA_ADDR A:0xfe202008
y.create.l HWIO_LPASS_QDSP6SS_PWRDBG_CTL_ADDR A:0xfe20200c
y.create.l HWIO_LPASS_QDSP6SS_TEST_CLK_CTL_ADDR A:0xfe202010
y.create.l HWIO_LPASS_QDSP6SS_PWRDBG_STATUS_ADDR A:0xfe202014
y.create.l HWIO_LPASS_QDSP6SS_LDO_ATEST_ADDR A:0xfe202018
y.create.l HWIO_LPASS_QDSP6SS_LDO_DAC_STATUS_ADDR A:0xfe20201c
y.create.l HWIO_LPASS_QDSP6SS_ZMEAS_CONFIG_ADDR A:0xfe202020
y.create.l HWIO_LPASS_QDSP6SS_XPU_SCR_ADDR A:0xfe270000
y.create.l HWIO_LPASS_QDSP6SS_XPU_SWDR_ADDR A:0xfe270004
y.create.l HWIO_LPASS_QDSP6SS_XPU_SEAR0_ADDR A:0xfe270040
y.create.l HWIO_LPASS_QDSP6SS_XPU_SESR_ADDR A:0xfe270048
y.create.l HWIO_LPASS_QDSP6SS_XPU_SESRRESTORE_ADDR A:0xfe27004c
y.create.l HWIO_LPASS_QDSP6SS_XPU_SESYNR0_ADDR A:0xfe270050
y.create.l HWIO_LPASS_QDSP6SS_XPU_SESYNR1_ADDR A:0xfe270054
y.create.l HWIO_LPASS_QDSP6SS_XPU_SESYNR2_ADDR A:0xfe270058
y.create.l HWIO_LPASS_QDSP6SS_XPU_MCR_ADDR A:0xfe270100
y.create.l HWIO_LPASS_QDSP6SS_XPU_MEAR0_ADDR A:0xfe270140
y.create.l HWIO_LPASS_QDSP6SS_XPU_MESR_ADDR A:0xfe270148
y.create.l HWIO_LPASS_QDSP6SS_XPU_MESRRESTORE_ADDR A:0xfe27014c
y.create.l HWIO_LPASS_QDSP6SS_XPU_MESYNR0_ADDR A:0xfe270150
y.create.l HWIO_LPASS_QDSP6SS_XPU_MESYNR1_ADDR A:0xfe270154
y.create.l HWIO_LPASS_QDSP6SS_XPU_MESYNR2_ADDR A:0xfe270158
y.create.l HWIO_LPASS_QDSP6SS_XPU_CR_ADDR A:0xfe270080
y.create.l HWIO_LPASS_QDSP6SS_XPU_RPU_ACR0_ADDR A:0xfe2700a0
y.create.l HWIO_LPASS_QDSP6SS_XPU_EAR0_ADDR A:0xfe2700c0
y.create.l HWIO_LPASS_QDSP6SS_XPU_ESR_ADDR A:0xfe2700c8
y.create.l HWIO_LPASS_QDSP6SS_XPU_ESRRESTORE_ADDR A:0xfe2700cc
y.create.l HWIO_LPASS_QDSP6SS_XPU_ESYNR0_ADDR A:0xfe2700d0
y.create.l HWIO_LPASS_QDSP6SS_XPU_ESYNR1_ADDR A:0xfe2700d4
y.create.l HWIO_LPASS_QDSP6SS_XPU_ESYNR2_ADDR A:0xfe2700d8
y.create.l HWIO_LPASS_QDSP6SS_XPU_IDR0_ADDR A:0xfe270074
y.create.l HWIO_LPASS_QDSP6SS_XPU_IDR1_ADDR A:0xfe270078
y.create.l HWIO_LPASS_QDSP6SS_XPU_REV_ADDR A:0xfe27007c
y.create.l HWIO_LPASS_QDSP6SS_XPU_RG0_RACR0_ADDR A:0xfe270200
y.create.l HWIO_LPASS_QDSP6SS_XPU_RG1_RACR0_ADDR A:0xfe270280
y.create.l HWIO_LPASS_QDSP6SS_XPU_RG0_SCR_ADDR A:0xfe270250
y.create.l HWIO_LPASS_QDSP6SS_XPU_RG1_SCR_ADDR A:0xfe2702d0
y.create.l HWIO_LPASS_QDSP6SS_XPU_RG0_MCR_ADDR A:0xfe270254
y.create.l HWIO_LPASS_QDSP6SS_XPU_RG1_MCR_ADDR A:0xfe2702d4
y.create.l HWIO_LPASS_QDSP6SS_INSTANCE_ID_ADDR A:0xfe280000
y.create.l HWIO_LPASS_QDSP6SS_IDLT_MATCH_VAL_ADDR A:0xfe281000
y.create.l HWIO_LPASS_QDSP6SS_IDLT_COUNT_VAL_ADDR A:0xfe281004
y.create.l HWIO_LPASS_QDSP6SS_IDLT_ENABLE_ADDR A:0xfe281008
y.create.l HWIO_LPASS_QDSP6SS_IDLT_SYNC_STATUS_ADDR A:0xfe28100c
y.create.l HWIO_LPASS_QDSP6SS_WDOG_RESET_ADDR A:0xfe282000
y.create.l HWIO_LPASS_QDSP6SS_WDOG_CTL_ADDR A:0xfe282004
y.create.l HWIO_LPASS_QDSP6SS_WDOG_STATUS_ADDR A:0xfe282008
y.create.l HWIO_LPASS_QDSP6SS_WDOG_BARK_TIME_ADDR A:0xfe28200c
y.create.l HWIO_LPASS_QDSP6SS_WDOG_BITE_TIME_ADDR A:0xfe282010
y.create.l HWIO_LPASS_QDSP6SS_WDOG_NMI_TIME_ADDR A:0xfe282014
y.create.l HWIO_LPASS_QDSP6SS_WDOG_TEST_LOAD_ADDR A:0xfe282018
y.create.l HWIO_LPASS_QDSP6SS_WDOG_TEST_ADDR A:0xfe28201c
y.create.l HWIO_LPASS_QDSP6SS_IPC_ADDR A:0xfe285000
y.create.l HWIO_LPASS_QDSP6SS_L1_IRQ_BACKUP_EN_ADDR A:0xfe285010
y.create.l HWIO_LPASS_QDSP6SS_PD_HS_START_ADDR A:0xfe28700c
y.create.l HWIO_LPASS_QDSP6SS_PD_HS_DONE_ADDR A:0xfe287010
y.create.l HWIO_LPASS_QDSP6SS_PU_HS_START_ADDR A:0xfe287014
y.create.l HWIO_LPASS_QDSP6SS_SLPC_CFG_ADDR A:0xfe28701c
y.create.l HWIO_LPASS_QDSP6SS_SLPC_STATUS_ADDR A:0xfe287020
y.create.l HWIO_LPASS_QDSP6SS_SPMCTL_EN_ARES_ADDR A:0xfe287024
y.create.l HWIO_LPASS_QDSP6SS_SPMCTL_EN_CLAMP_ADDR A:0xfe287028
y.create.l HWIO_LPASS_QDSP6SS_SPMCTL_EN_CLK_ADDR A:0xfe28702c
y.create.l HWIO_LPASS_QDSP6SS_SPMCTL_EN_MEM_ADDR A:0xfe287030
y.create.l HWIO_LPASS_QDSP6SS_SPMCTL_EN_BHS_ADDR A:0xfe287034
y.create.l HWIO_LPASS_QDSP6SS_SPMCTL_EN_LDO_ADDR A:0xfe287038
y.create.l HWIO_LPASS_QDSP6SS_SPMCTL_EN_EXT_ADDR A:0xfe28703c
y.create.l HWIO_LPASS_QDSP6SS_L2VIC_VID_ADDR A:0xfe290000
y.create.l HWIO_LPASS_QDSP6SS_L2VIC_INT_ENABLE0_ADDR A:0xfe290100
y.create.l HWIO_LPASS_QDSP6SS_L2VIC_INT_ENABLE1_ADDR A:0xfe290104
y.create.l HWIO_LPASS_QDSP6SS_L2VIC_INT_ENABLE2_ADDR A:0xfe290108
y.create.l HWIO_LPASS_QDSP6SS_L2VIC_INT_ENABLE3_ADDR A:0xfe29010c
y.create.l HWIO_LPASS_QDSP6SS_L2VIC_INT_ENABLE4_ADDR A:0xfe290110
y.create.l HWIO_LPASS_QDSP6SS_L2VIC_INT_ENABLE5_ADDR A:0xfe290114
y.create.l HWIO_LPASS_QDSP6SS_L2VIC_INT_ENABLE6_ADDR A:0xfe290118
y.create.l HWIO_LPASS_QDSP6SS_L2VIC_INT_ENABLE7_ADDR A:0xfe29011c
y.create.l HWIO_LPASS_QDSP6SS_L2VIC_INT_ENABLE8_ADDR A:0xfe290120
y.create.l HWIO_LPASS_QDSP6SS_L2VIC_INT_ENABLE9_ADDR A:0xfe290124
y.create.l HWIO_LPASS_QDSP6SS_L2VIC_INT_ENABLE_CLEAR0_ADDR A:0xfe290180
y.create.l HWIO_LPASS_QDSP6SS_L2VIC_INT_ENABLE_CLEAR1_ADDR A:0xfe290184
y.create.l HWIO_LPASS_QDSP6SS_L2VIC_INT_ENABLE_CLEAR2_ADDR A:0xfe290188
y.create.l HWIO_LPASS_QDSP6SS_L2VIC_INT_ENABLE_CLEAR3_ADDR A:0xfe29018c
y.create.l HWIO_LPASS_QDSP6SS_L2VIC_INT_ENABLE_CLEAR4_ADDR A:0xfe290190
y.create.l HWIO_LPASS_QDSP6SS_L2VIC_INT_ENABLE_CLEAR5_ADDR A:0xfe290194
y.create.l HWIO_LPASS_QDSP6SS_L2VIC_INT_ENABLE_CLEAR6_ADDR A:0xfe290198
y.create.l HWIO_LPASS_QDSP6SS_L2VIC_INT_ENABLE_CLEAR7_ADDR A:0xfe29019c
y.create.l HWIO_LPASS_QDSP6SS_L2VIC_INT_ENABLE_CLEAR8_ADDR A:0xfe2901a0
y.create.l HWIO_LPASS_QDSP6SS_L2VIC_INT_ENABLE_CLEAR9_ADDR A:0xfe2901a4
y.create.l HWIO_LPASS_QDSP6SS_L2VIC_INT_ENABLE_SET0_ADDR A:0xfe290200
y.create.l HWIO_LPASS_QDSP6SS_L2VIC_INT_ENABLE_SET1_ADDR A:0xfe290204
y.create.l HWIO_LPASS_QDSP6SS_L2VIC_INT_ENABLE_SET2_ADDR A:0xfe290208
y.create.l HWIO_LPASS_QDSP6SS_L2VIC_INT_ENABLE_SET3_ADDR A:0xfe29020c
y.create.l HWIO_LPASS_QDSP6SS_L2VIC_INT_ENABLE_SET4_ADDR A:0xfe290210
y.create.l HWIO_LPASS_QDSP6SS_L2VIC_INT_ENABLE_SET5_ADDR A:0xfe290214
y.create.l HWIO_LPASS_QDSP6SS_L2VIC_INT_ENABLE_SET6_ADDR A:0xfe290218
y.create.l HWIO_LPASS_QDSP6SS_L2VIC_INT_ENABLE_SET7_ADDR A:0xfe29021c
y.create.l HWIO_LPASS_QDSP6SS_L2VIC_INT_ENABLE_SET8_ADDR A:0xfe290220
y.create.l HWIO_LPASS_QDSP6SS_L2VIC_INT_ENABLE_SET9_ADDR A:0xfe290224
y.create.l HWIO_LPASS_QDSP6SS_L2VIC_INT_TYPE0_ADDR A:0xfe290280
y.create.l HWIO_LPASS_QDSP6SS_L2VIC_INT_TYPE1_ADDR A:0xfe290284
y.create.l HWIO_LPASS_QDSP6SS_L2VIC_INT_TYPE2_ADDR A:0xfe290288
y.create.l HWIO_LPASS_QDSP6SS_L2VIC_INT_TYPE3_ADDR A:0xfe29028c
y.create.l HWIO_LPASS_QDSP6SS_L2VIC_INT_TYPE4_ADDR A:0xfe290290
y.create.l HWIO_LPASS_QDSP6SS_L2VIC_INT_TYPE5_ADDR A:0xfe290294
y.create.l HWIO_LPASS_QDSP6SS_L2VIC_INT_TYPE6_ADDR A:0xfe290298
y.create.l HWIO_LPASS_QDSP6SS_L2VIC_INT_TYPE7_ADDR A:0xfe29029c
y.create.l HWIO_LPASS_QDSP6SS_L2VIC_INT_TYPE8_ADDR A:0xfe2902a0
y.create.l HWIO_LPASS_QDSP6SS_L2VIC_INT_TYPE9_ADDR A:0xfe2902a4
y.create.l HWIO_LPASS_QDSP6SS_L2VIC_INT_STATUS0_ADDR A:0xfe290380
y.create.l HWIO_LPASS_QDSP6SS_L2VIC_INT_STATUS1_ADDR A:0xfe290384
y.create.l HWIO_LPASS_QDSP6SS_L2VIC_INT_STATUS2_ADDR A:0xfe290388
y.create.l HWIO_LPASS_QDSP6SS_L2VIC_INT_STATUS3_ADDR A:0xfe29038c
y.create.l HWIO_LPASS_QDSP6SS_L2VIC_INT_STATUS4_ADDR A:0xfe290390
y.create.l HWIO_LPASS_QDSP6SS_L2VIC_INT_STATUS5_ADDR A:0xfe290394
y.create.l HWIO_LPASS_QDSP6SS_L2VIC_INT_STATUS6_ADDR A:0xfe290398
y.create.l HWIO_LPASS_QDSP6SS_L2VIC_INT_STATUS7_ADDR A:0xfe29039c
y.create.l HWIO_LPASS_QDSP6SS_L2VIC_INT_STATUS8_ADDR A:0xfe2903a0
y.create.l HWIO_LPASS_QDSP6SS_L2VIC_INT_STATUS9_ADDR A:0xfe2903a4
y.create.l HWIO_LPASS_QDSP6SS_L2VIC_INT_CLEAR0_ADDR A:0xfe290400
y.create.l HWIO_LPASS_QDSP6SS_L2VIC_INT_CLEAR1_ADDR A:0xfe290404
y.create.l HWIO_LPASS_QDSP6SS_L2VIC_INT_CLEAR2_ADDR A:0xfe290408
y.create.l HWIO_LPASS_QDSP6SS_L2VIC_INT_CLEAR3_ADDR A:0xfe29040c
y.create.l HWIO_LPASS_QDSP6SS_L2VIC_INT_CLEAR4_ADDR A:0xfe290410
y.create.l HWIO_LPASS_QDSP6SS_L2VIC_INT_CLEAR5_ADDR A:0xfe290414
y.create.l HWIO_LPASS_QDSP6SS_L2VIC_INT_CLEAR6_ADDR A:0xfe290418
y.create.l HWIO_LPASS_QDSP6SS_L2VIC_INT_CLEAR7_ADDR A:0xfe29041c
y.create.l HWIO_LPASS_QDSP6SS_L2VIC_INT_CLEAR8_ADDR A:0xfe290420
y.create.l HWIO_LPASS_QDSP6SS_L2VIC_INT_CLEAR9_ADDR A:0xfe290424
y.create.l HWIO_LPASS_QDSP6SS_L2VIC_SOFT_INT0_ADDR A:0xfe290480
y.create.l HWIO_LPASS_QDSP6SS_L2VIC_SOFT_INT1_ADDR A:0xfe290484
y.create.l HWIO_LPASS_QDSP6SS_L2VIC_SOFT_INT2_ADDR A:0xfe290488
y.create.l HWIO_LPASS_QDSP6SS_L2VIC_SOFT_INT3_ADDR A:0xfe29048c
y.create.l HWIO_LPASS_QDSP6SS_L2VIC_SOFT_INT4_ADDR A:0xfe290490
y.create.l HWIO_LPASS_QDSP6SS_L2VIC_SOFT_INT5_ADDR A:0xfe290494
y.create.l HWIO_LPASS_QDSP6SS_L2VIC_SOFT_INT6_ADDR A:0xfe290498
y.create.l HWIO_LPASS_QDSP6SS_L2VIC_SOFT_INT7_ADDR A:0xfe29049c
y.create.l HWIO_LPASS_QDSP6SS_L2VIC_SOFT_INT8_ADDR A:0xfe2904a0
y.create.l HWIO_LPASS_QDSP6SS_L2VIC_SOFT_INT9_ADDR A:0xfe2904a4
y.create.l HWIO_LPASS_QDSP6SS_L2VIC_INT_PENDING0_ADDR A:0xfe290500
y.create.l HWIO_LPASS_QDSP6SS_L2VIC_INT_PENDING1_ADDR A:0xfe290504
y.create.l HWIO_LPASS_QDSP6SS_L2VIC_INT_PENDING2_ADDR A:0xfe290508
y.create.l HWIO_LPASS_QDSP6SS_L2VIC_INT_PENDING3_ADDR A:0xfe29050c
y.create.l HWIO_LPASS_QDSP6SS_L2VIC_INT_PENDING4_ADDR A:0xfe290510
y.create.l HWIO_LPASS_QDSP6SS_L2VIC_INT_PENDING5_ADDR A:0xfe290514
y.create.l HWIO_LPASS_QDSP6SS_L2VIC_INT_PENDING6_ADDR A:0xfe290518
y.create.l HWIO_LPASS_QDSP6SS_L2VIC_INT_PENDING7_ADDR A:0xfe29051c
y.create.l HWIO_LPASS_QDSP6SS_L2VIC_INT_PENDING8_ADDR A:0xfe290520
y.create.l HWIO_LPASS_QDSP6SS_L2VIC_INT_PENDING9_ADDR A:0xfe290524
y.create.l HWIO_LPASS_QDSP6SS_QTMR_AC_CNTFRQ_ADDR A:0xfe2a0000
y.create.l HWIO_LPASS_QDSP6SS_QTMR_AC_CNTSR_ADDR A:0xfe2a0004
y.create.l HWIO_LPASS_QDSP6SS_QTMR_AC_CNTTID_ADDR A:0xfe2a0008
y.create.l HWIO_LPASS_QDSP6SS_QTMR_AC_CNTACR_0_ADDR A:0xfe2a0040
y.create.l HWIO_LPASS_QDSP6SS_QTMR_AC_CNTACR_1_ADDR A:0xfe2a0044
y.create.l HWIO_LPASS_QDSP6SS_QTMR_AC_CNTACR_2_ADDR A:0xfe2a0048
y.create.l HWIO_LPASS_QDSP6SS_QTMR_AC_CNTVOFF_LO_0_ADDR A:0xfe2a0080
y.create.l HWIO_LPASS_QDSP6SS_QTMR_AC_CNTVOFF_LO_1_ADDR A:0xfe2a0088
y.create.l HWIO_LPASS_QDSP6SS_QTMR_AC_CNTVOFF_LO_2_ADDR A:0xfe2a0090
y.create.l HWIO_LPASS_QDSP6SS_QTMR_AC_CNTVOFF_HI_0_ADDR A:0xfe2a0084
y.create.l HWIO_LPASS_QDSP6SS_QTMR_AC_CNTVOFF_HI_1_ADDR A:0xfe2a008c
y.create.l HWIO_LPASS_QDSP6SS_QTMR_AC_CNTVOFF_HI_2_ADDR A:0xfe2a0094
y.create.l HWIO_LPASS_QDSP6SS_QTMR_AC_VERSION_ADDR A:0xfe2a0fd0
y.create.l HWIO_LPASS_QDSP6SS_QTMR_V1_CNTPCT_LO_0_ADDR A:0xfe2a1000
y.create.l HWIO_LPASS_QDSP6SS_QTMR_V1_CNTPCT_HI_0_ADDR A:0xfe2a1004
y.create.l HWIO_LPASS_QDSP6SS_QTMR_V1_CNTVCT_LO_0_ADDR A:0xfe2a1008
y.create.l HWIO_LPASS_QDSP6SS_QTMR_V1_CNTVCT_HI_0_ADDR A:0xfe2a100c
y.create.l HWIO_LPASS_QDSP6SS_QTMR_V1_CNTFRQ_0_ADDR A:0xfe2a1010
y.create.l HWIO_LPASS_QDSP6SS_QTMR_V1_CNTPL0ACR_0_ADDR A:0xfe2a1014
y.create.l HWIO_LPASS_QDSP6SS_QTMR_V1_CNTVOFF_LO_0_ADDR A:0xfe2a1018
y.create.l HWIO_LPASS_QDSP6SS_QTMR_V1_CNTVOFF_HI_0_ADDR A:0xfe2a101c
y.create.l HWIO_LPASS_QDSP6SS_QTMR_V1_CNTP_CVAL_LO_0_ADDR A:0xfe2a1020
y.create.l HWIO_LPASS_QDSP6SS_QTMR_V1_CNTP_CVAL_HI_0_ADDR A:0xfe2a1024
y.create.l HWIO_LPASS_QDSP6SS_QTMR_V1_CNTP_TVAL_0_ADDR A:0xfe2a1028
y.create.l HWIO_LPASS_QDSP6SS_QTMR_V1_CNTP_CTL_0_ADDR A:0xfe2a102c
y.create.l HWIO_LPASS_QDSP6SS_QTMR_V1_CNTV_CVAL_LO_0_ADDR A:0xfe2a1030
y.create.l HWIO_LPASS_QDSP6SS_QTMR_V1_CNTV_CVAL_HI_0_ADDR A:0xfe2a1034
y.create.l HWIO_LPASS_QDSP6SS_QTMR_V1_CNTV_TVAL_0_ADDR A:0xfe2a1038
y.create.l HWIO_LPASS_QDSP6SS_QTMR_V1_CNTV_CTL_0_ADDR A:0xfe2a103c
y.create.l HWIO_LPASS_QDSP6SS_QTMR_V1_VERSION_0_ADDR A:0xfe2a1fd0
y.create.l HWIO_LPASS_QDSP6SS_QTMR_V1_CNTPCT_LO_1_ADDR A:0xfe2a2000
y.create.l HWIO_LPASS_QDSP6SS_QTMR_V1_CNTPCT_HI_1_ADDR A:0xfe2a2004
y.create.l HWIO_LPASS_QDSP6SS_QTMR_V1_CNTVCT_LO_1_ADDR A:0xfe2a2008
y.create.l HWIO_LPASS_QDSP6SS_QTMR_V1_CNTVCT_HI_1_ADDR A:0xfe2a200c
y.create.l HWIO_LPASS_QDSP6SS_QTMR_V1_CNTFRQ_1_ADDR A:0xfe2a2010
y.create.l HWIO_LPASS_QDSP6SS_QTMR_V1_CNTPL0ACR_1_ADDR A:0xfe2a2014
y.create.l HWIO_LPASS_QDSP6SS_QTMR_V1_CNTVOFF_LO_1_ADDR A:0xfe2a2018
y.create.l HWIO_LPASS_QDSP6SS_QTMR_V1_CNTVOFF_HI_1_ADDR A:0xfe2a201c
y.create.l HWIO_LPASS_QDSP6SS_QTMR_V1_CNTP_CVAL_LO_1_ADDR A:0xfe2a2020
y.create.l HWIO_LPASS_QDSP6SS_QTMR_V1_CNTP_CVAL_HI_1_ADDR A:0xfe2a2024
y.create.l HWIO_LPASS_QDSP6SS_QTMR_V1_CNTP_TVAL_1_ADDR A:0xfe2a2028
y.create.l HWIO_LPASS_QDSP6SS_QTMR_V1_CNTP_CTL_1_ADDR A:0xfe2a202c
y.create.l HWIO_LPASS_QDSP6SS_QTMR_V1_CNTV_CVAL_LO_1_ADDR A:0xfe2a2030
y.create.l HWIO_LPASS_QDSP6SS_QTMR_V1_CNTV_CVAL_HI_1_ADDR A:0xfe2a2034
y.create.l HWIO_LPASS_QDSP6SS_QTMR_V1_CNTV_TVAL_1_ADDR A:0xfe2a2038
y.create.l HWIO_LPASS_QDSP6SS_QTMR_V1_CNTV_CTL_1_ADDR A:0xfe2a203c
y.create.l HWIO_LPASS_QDSP6SS_QTMR_V1_VERSION_1_ADDR A:0xfe2a2fd0
y.create.l HWIO_LPASS_QDSP6SS_QTMR_V1_CNTPCT_LO_2_ADDR A:0xfe2a3000
y.create.l HWIO_LPASS_QDSP6SS_QTMR_V1_CNTPCT_HI_2_ADDR A:0xfe2a3004
y.create.l HWIO_LPASS_QDSP6SS_QTMR_V1_CNTVCT_LO_2_ADDR A:0xfe2a3008
y.create.l HWIO_LPASS_QDSP6SS_QTMR_V1_CNTVCT_HI_2_ADDR A:0xfe2a300c
y.create.l HWIO_LPASS_QDSP6SS_QTMR_V1_CNTFRQ_2_ADDR A:0xfe2a3010
y.create.l HWIO_LPASS_QDSP6SS_QTMR_V1_CNTPL0ACR_2_ADDR A:0xfe2a3014
y.create.l HWIO_LPASS_QDSP6SS_QTMR_V1_CNTVOFF_LO_2_ADDR A:0xfe2a3018
y.create.l HWIO_LPASS_QDSP6SS_QTMR_V1_CNTVOFF_HI_2_ADDR A:0xfe2a301c
y.create.l HWIO_LPASS_QDSP6SS_QTMR_V1_CNTP_CVAL_LO_2_ADDR A:0xfe2a3020
y.create.l HWIO_LPASS_QDSP6SS_QTMR_V1_CNTP_CVAL_HI_2_ADDR A:0xfe2a3024
y.create.l HWIO_LPASS_QDSP6SS_QTMR_V1_CNTP_TVAL_2_ADDR A:0xfe2a3028
y.create.l HWIO_LPASS_QDSP6SS_QTMR_V1_CNTP_CTL_2_ADDR A:0xfe2a302c
y.create.l HWIO_LPASS_QDSP6SS_QTMR_V1_CNTV_CVAL_LO_2_ADDR A:0xfe2a3030
y.create.l HWIO_LPASS_QDSP6SS_QTMR_V1_CNTV_CVAL_HI_2_ADDR A:0xfe2a3034
y.create.l HWIO_LPASS_QDSP6SS_QTMR_V1_CNTV_TVAL_2_ADDR A:0xfe2a3038
y.create.l HWIO_LPASS_QDSP6SS_QTMR_V1_CNTV_CTL_2_ADDR A:0xfe2a303c
y.create.l HWIO_LPASS_QDSP6SS_QTMR_V1_VERSION_2_ADDR A:0xfe2a3fd0
y.create.l HWIO_LPASS_QDSP6SS_SAW2_SECURE_ADDR A:0xfe2b0000
y.create.l HWIO_LPASS_QDSP6SS_SAW2_ID_ADDR A:0xfe2b0004
y.create.l HWIO_LPASS_QDSP6SS_SAW2_CFG_ADDR A:0xfe2b0008
y.create.l HWIO_LPASS_QDSP6SS_SAW2_SPM_STS_ADDR A:0xfe2b000c
y.create.l HWIO_LPASS_QDSP6SS_SAW2_AVS_STS_ADDR A:0xfe2b0010
y.create.l HWIO_LPASS_QDSP6SS_SAW2_PMIC_STS_ADDR A:0xfe2b0014
y.create.l HWIO_LPASS_QDSP6SS_SAW2_RST_ADDR A:0xfe2b0018
y.create.l HWIO_LPASS_QDSP6SS_SAW2_VCTL_ADDR A:0xfe2b001c
y.create.l HWIO_LPASS_QDSP6SS_SAW2_AVS_CTL_ADDR A:0xfe2b0020
y.create.l HWIO_LPASS_QDSP6SS_SAW2_AVS_LIMIT_ADDR A:0xfe2b0024
y.create.l HWIO_LPASS_QDSP6SS_SAW2_AVS_DLY_ADDR A:0xfe2b0028
y.create.l HWIO_LPASS_QDSP6SS_SAW2_AVS_HYSTERESIS_ADDR A:0xfe2b002c
y.create.l HWIO_LPASS_QDSP6SS_SAW2_SPM_CTL_ADDR A:0xfe2b0030
y.create.l HWIO_LPASS_QDSP6SS_SAW2_SPM_DLY_ADDR A:0xfe2b0034
y.create.l HWIO_LPASS_QDSP6SS_SAW2_SPM_SLP_SEQ_ENTRY_0_ADDR A:0xfe2b0080
y.create.l HWIO_LPASS_QDSP6SS_SAW2_SPM_SLP_SEQ_ENTRY_1_ADDR A:0xfe2b0084
y.create.l HWIO_LPASS_QDSP6SS_SAW2_SPM_SLP_SEQ_ENTRY_2_ADDR A:0xfe2b0088
y.create.l HWIO_LPASS_QDSP6SS_SAW2_SPM_SLP_SEQ_ENTRY_3_ADDR A:0xfe2b008c
y.create.l HWIO_LPASS_QDSP6SS_SAW2_SPM_SLP_SEQ_ENTRY_4_ADDR A:0xfe2b0090
y.create.l HWIO_LPASS_QDSP6SS_SAW2_SPM_SLP_SEQ_ENTRY_5_ADDR A:0xfe2b0094
y.create.l HWIO_LPASS_QDSP6SS_SAW2_SPM_SLP_SEQ_ENTRY_6_ADDR A:0xfe2b0098
y.create.l HWIO_LPASS_QDSP6SS_SAW2_SPM_SLP_SEQ_ENTRY_7_ADDR A:0xfe2b009c
y.create.l HWIO_LPASS_QDSP6SS_SAW2_SPM_SLP_SEQ_ENTRY_8_ADDR A:0xfe2b00a0
y.create.l HWIO_LPASS_QDSP6SS_SAW2_SPM_SLP_SEQ_ENTRY_9_ADDR A:0xfe2b00a4
y.create.l HWIO_LPASS_QDSP6SS_SAW2_SPM_PMIC_DATA_0_ADDR A:0xfe2b0040
y.create.l HWIO_LPASS_QDSP6SS_SAW2_SPM_PMIC_DATA_1_ADDR A:0xfe2b0044
y.create.l HWIO_LPASS_QDSP6SS_SAW2_SPM_PMIC_DATA_2_ADDR A:0xfe2b0048
y.create.l HWIO_LPASS_QDSP6SS_SAW2_VERSION_ADDR A:0xfe2b0fd0
y.create.l HWIO_MPM2_MPM_PMIC_VDD_ON_CFG_1_ADDR A:0xfc4a0000
y.create.l HWIO_MPM2_MPM_PMIC_VDD_ON_CFG_2_ADDR A:0xfc4a0004
y.create.l HWIO_MPM2_MPM_PMIC_VDD_ON_CFG_3_ADDR A:0xfc4a0008
y.create.l HWIO_MPM2_MPM_PMIC_VDD_ON_CFG_4_ADDR A:0xfc4a000c
y.create.l HWIO_MPM2_MPM_PMIC_VDD_ON_CFG_5_ADDR A:0xfc4a0010
y.create.l HWIO_MPM2_MPM_PMIC_VDD_ON_CFG_6_ADDR A:0xfc4a0014
y.create.l HWIO_MPM2_MPM_PMIC_VDD_ON_CFG_7_ADDR A:0xfc4a0018
y.create.l HWIO_MPM2_MPM_PMIC_VDD_ON_CFG_8_ADDR A:0xfc4a001c
y.create.l HWIO_MPM2_MPM_PMIC_VDD_ON_CFG_9_ADDR A:0xfc4a0020
y.create.l HWIO_MPM2_MPM_PMIC_VDD_ON_CFG_10_ADDR A:0xfc4a0024
y.create.l HWIO_MPM2_MPM_PMIC_VDD_ON_CFG_11_ADDR A:0xfc4a0028
y.create.l HWIO_MPM2_MPM_PMIC_VDD_ON_CFG_12_ADDR A:0xfc4a002c
y.create.l HWIO_MPM2_MPM_PMIC_VDD_OFF_CFG_1_ADDR A:0xfc4a0030
y.create.l HWIO_MPM2_MPM_PMIC_VDD_OFF_CFG_2_ADDR A:0xfc4a0034
y.create.l HWIO_MPM2_MPM_PMIC_VDD_OFF_CFG_3_ADDR A:0xfc4a0038
y.create.l HWIO_MPM2_MPM_PMIC_VDD_OFF_CFG_4_ADDR A:0xfc4a003c
y.create.l HWIO_MPM2_MPM_PMIC_VDD_OFF_CFG_5_ADDR A:0xfc4a0040
y.create.l HWIO_MPM2_MPM_PMIC_VDD_OFF_CFG_6_ADDR A:0xfc4a0044
y.create.l HWIO_MPM2_MPM_PMIC_VDD_OFF_CFG_7_ADDR A:0xfc4a0048
y.create.l HWIO_MPM2_MPM_PMIC_VDD_OFF_CFG_8_ADDR A:0xfc4a004c
y.create.l HWIO_MPM2_MPM_PMIC_VDD_OFF_CFG_9_ADDR A:0xfc4a0050
y.create.l HWIO_MPM2_MPM_PMIC_VDD_OFF_CFG_10_ADDR A:0xfc4a0054
y.create.l HWIO_MPM2_MPM_PMIC_VDD_OFF_CFG_11_ADDR A:0xfc4a0058
y.create.l HWIO_MPM2_MPM_PMIC_VDD_OFF_CFG_12_ADDR A:0xfc4a005c
y.create.l HWIO_MPM2_MPM_SPMI_CMD_CFG_ADDR A:0xfc4a0060
y.create.l HWIO_MPM2_MPM_SPMI_CDIV_CNTRL_ADDR A:0xfc4a0064
y.create.l HWIO_MPM2_MPM_CXO_CTRL_ADDR A:0xfc4a0068
y.create.l HWIO_MPM2_MPM_PXO_OSC_CTRL_ADDR A:0xfc4a006c
y.create.l HWIO_MPM2_MPM_LOW_POWER_CFG_ADDR A:0xfc4a0070
y.create.l HWIO_MPM2_MPM_LOW_POWER_STATUS_ADDR A:0xfc4a0074
y.create.l HWIO_MPM2_MPM_CXO_POWER_RAMPUP_TIME_ADDR A:0xfc4a0078
y.create.l HWIO_MPM2_MPM_PXO_WARMUP_TIME_ADDR A:0xfc4a007c
y.create.l HWIO_MPM2_MPM_HARDWARE_RESTORED_ADDR A:0xfc4a0080
y.create.l HWIO_MPM2_MPM_INT_CLEAR_1_ADDR A:0xfc4a0084
y.create.l HWIO_MPM2_MPM_INT_CLEAR_2_ADDR A:0xfc4a0088
y.create.l HWIO_MPM2_MPM_INT_EN_1_ADDR A:0xfc4a008c
y.create.l HWIO_MPM2_MPM_INT_EN_2_ADDR A:0xfc4a0090
y.create.l HWIO_MPM2_MPM_INT_POLARITY_1_ADDR A:0xfc4a0094
y.create.l HWIO_MPM2_MPM_INT_POLARITY_2_ADDR A:0xfc4a0098
y.create.l HWIO_MPM2_MPM_DETECT_CTL_1_ADDR A:0xfc4a009c
y.create.l HWIO_MPM2_MPM_DETECT_CTL_2_ADDR A:0xfc4a00a0
y.create.l HWIO_MPM2_MPM_DETECT_CTL_3_ADDR A:0xfc4a00a4
y.create.l HWIO_MPM2_MPM_DETECT_CTL_4_ADDR A:0xfc4a00a8
y.create.l HWIO_MPM2_MPM_INT_STATUS_1_ADDR A:0xfc4a00ac
y.create.l HWIO_MPM2_MPM_INT_STATUS_2_ADDR A:0xfc4a00b0
y.create.l HWIO_MPM2_MPM_INT_WKUP_CLK_SEL_1_ADDR A:0xfc4a00b4
y.create.l HWIO_MPM2_MPM_INT_WKUP_CLK_SEL_2_ADDR A:0xfc4a00b8
y.create.l HWIO_MPM2_MPM_DEBUG_BUS_EN_ADDR A:0xfc4a00bc
y.create.l HWIO_MPM2_MPM_PEN_DEBOUNCE_CTL_ADDR A:0xfc4a00c0
y.create.l HWIO_MPM2_MPM_WARM_BOOT_CFG_ADDR A:0xfc4a00c4
y.create.l HWIO_MPM2_MPM_REG0_FILE_ADDR A:0xfc4a00c8
y.create.l HWIO_MPM2_MPM_REG1_FILE_ADDR A:0xfc4a00cc
y.create.l HWIO_MPM2_MPM_REG2_FILE_ADDR A:0xfc4a00d0
y.create.l HWIO_MPM2_MPM_REG3_FILE_ADDR A:0xfc4a00d4
y.create.l HWIO_MPM2_MPM_REG4_FILE_ADDR A:0xfc4a00d8
y.create.l HWIO_MPM2_MPM_REG5_FILE_ADDR A:0xfc4a00dc
y.create.l HWIO_MPM2_MPM_REG6_FILE_ADDR A:0xfc4a00e0
y.create.l HWIO_MPM2_MPM_REG7_FILE_ADDR A:0xfc4a00e4
y.create.l HWIO_MPM2_MPM_REG8_FILE_ADDR A:0xfc4a00e8
y.create.l HWIO_MPM2_MPM_CNTR_CLK_CONTROL_ADDR A:0xfc4a00ec
y.create.l HWIO_MPM2_MPM_CNTR_FRAC_ADDR A:0xfc4a00f0
y.create.l HWIO_MPM2_MPM_CNTR_INCR_DATA_ADDR A:0xfc4a00f4
y.create.l HWIO_MPM2_MPM_HW_ID_ADDR A:0xfc4a00f8
y.create.l HWIO_MPM2_MPM_CONTROL_CNTCR_ADDR A:0xfc4a1000
y.create.l HWIO_MPM2_MPM_CONTROL_CNTSR_ADDR A:0xfc4a1004
y.create.l HWIO_MPM2_MPM_CONTROL_CNTCV_LO_ADDR A:0xfc4a1008
y.create.l HWIO_MPM2_MPM_CONTROL_CNTCV_HI_ADDR A:0xfc4a100c
y.create.l HWIO_MPM2_MPM_CONTROL_CNTFID0_ADDR A:0xfc4a1020
y.create.l HWIO_MPM2_MPM_CONTROL_ID_ADDR A:0xfc4a1fd0
y.create.l HWIO_MPM2_MPM_READ_CNTCV_LO_ADDR A:0xfc4a2000
y.create.l HWIO_MPM2_MPM_READ_CNTCV_HI_ADDR A:0xfc4a2004
y.create.l HWIO_MPM2_MPM_READ_ID_ADDR A:0xfc4a2fd0
y.create.l HWIO_MPM2_MPM_SLEEP_TIMETICK_COUNT_VAL_ADDR A:0xfc4a3000
y.create.l HWIO_MPM2_QTMR_AC_CNTFRQ_ADDR A:0xfc4a4000
y.create.l HWIO_MPM2_QTMR_AC_CNTSR_ADDR A:0xfc4a4004
y.create.l HWIO_MPM2_QTMR_AC_CNTTID_ADDR A:0xfc4a4008
y.create.l HWIO_MPM2_QTMR_AC_CNTACR_0_ADDR A:0xfc4a4040
y.create.l HWIO_MPM2_QTMR_AC_CNTVOFF_LO_0_ADDR A:0xfc4a4080
y.create.l HWIO_MPM2_QTMR_AC_CNTVOFF_HI_0_ADDR A:0xfc4a4084
y.create.l HWIO_MPM2_QTMR_AC_VERSION_ADDR A:0xfc4a4fd0
y.create.l HWIO_MPM2_QTMR_V1_CNTPCT_LO_ADDR A:0xfc4a5000
y.create.l HWIO_MPM2_QTMR_V1_CNTPCT_HI_ADDR A:0xfc4a5004
y.create.l HWIO_MPM2_QTMR_V1_CNTVCT_LO_ADDR A:0xfc4a5008
y.create.l HWIO_MPM2_QTMR_V1_CNTVCT_HI_ADDR A:0xfc4a500c
y.create.l HWIO_MPM2_QTMR_V1_CNTFRQ_ADDR A:0xfc4a5010
y.create.l HWIO_MPM2_QTMR_V1_CNTPL0ACR_ADDR A:0xfc4a5014
y.create.l HWIO_MPM2_QTMR_V1_CNTVOFF_LO_ADDR A:0xfc4a5018
y.create.l HWIO_MPM2_QTMR_V1_CNTVOFF_HI_ADDR A:0xfc4a501c
y.create.l HWIO_MPM2_QTMR_V1_CNTP_CVAL_LO_ADDR A:0xfc4a5020
y.create.l HWIO_MPM2_QTMR_V1_CNTP_CVAL_HI_ADDR A:0xfc4a5024
y.create.l HWIO_MPM2_QTMR_V1_CNTP_TVAL_ADDR A:0xfc4a5028
y.create.l HWIO_MPM2_QTMR_V1_CNTP_CTL_ADDR A:0xfc4a502c
y.create.l HWIO_MPM2_QTMR_V1_CNTV_CVAL_LO_ADDR A:0xfc4a5030
y.create.l HWIO_MPM2_QTMR_V1_CNTV_CVAL_HI_ADDR A:0xfc4a5034
y.create.l HWIO_MPM2_QTMR_V1_CNTV_TVAL_ADDR A:0xfc4a5038
y.create.l HWIO_MPM2_QTMR_V1_CNTV_CTL_ADDR A:0xfc4a503c
y.create.l HWIO_MPM2_QTMR_V1_VERSION_ADDR A:0xfc4a5fd0
y.create.l HWIO_MPM2_MPM_TSYNC_CTL_ADDR A:0xfc4a6000
y.create.l HWIO_MPM2_MPM_TSYNC_CMD_ADDR A:0xfc4a6004
y.create.l HWIO_MPM2_MPM_TSYNC_START_ADDR A:0xfc4a6008
y.create.l HWIO_MPM2_MPM_TSYNC_START_PHASE_ADDR A:0xfc4a600c
y.create.l HWIO_MPM2_MPM_TSYNC_PERIOD_ADDR A:0xfc4a6010
y.create.l HWIO_MPM2_MPM_TSYNC_PERIOD_PHASE_ADDR A:0xfc4a6014
y.create.l HWIO_MPM2_MPM_TSYNC_STATUS_TIME_ADDR A:0xfc4a6018
y.create.l HWIO_MPM2_MPM_TSYNC_STATUS_PHASE_ADDR A:0xfc4a601c
y.create.l HWIO_MPM2_MPM_GRFC_CXO_EN_ADDR A:0xfc4a6020
y.create.l HWIO_MPM2_XPU_SCR_ADDR A:0xfc4a7000
y.create.l HWIO_MPM2_XPU_SWDR_ADDR A:0xfc4a7004
y.create.l HWIO_MPM2_XPU_SEAR0_ADDR A:0xfc4a7040
y.create.l HWIO_MPM2_XPU_SESR_ADDR A:0xfc4a7048
y.create.l HWIO_MPM2_XPU_SESRRESTORE_ADDR A:0xfc4a704c
y.create.l HWIO_MPM2_XPU_SESYNR0_ADDR A:0xfc4a7050
y.create.l HWIO_MPM2_XPU_SESYNR1_ADDR A:0xfc4a7054
y.create.l HWIO_MPM2_XPU_SESYNR2_ADDR A:0xfc4a7058
y.create.l HWIO_MPM2_XPU_MCR_ADDR A:0xfc4a7100
y.create.l HWIO_MPM2_XPU_MEAR0_ADDR A:0xfc4a7140
y.create.l HWIO_MPM2_XPU_MESR_ADDR A:0xfc4a7148
y.create.l HWIO_MPM2_XPU_MESRRESTORE_ADDR A:0xfc4a714c
y.create.l HWIO_MPM2_XPU_MESYNR0_ADDR A:0xfc4a7150
y.create.l HWIO_MPM2_XPU_MESYNR1_ADDR A:0xfc4a7154
y.create.l HWIO_MPM2_XPU_MESYNR2_ADDR A:0xfc4a7158
y.create.l HWIO_MPM2_XPU_CR_ADDR A:0xfc4a7080
y.create.l HWIO_MPM2_XPU_RPU_ACR0_ADDR A:0xfc4a70a0
y.create.l HWIO_MPM2_XPU_EAR0_ADDR A:0xfc4a70c0
y.create.l HWIO_MPM2_XPU_ESR_ADDR A:0xfc4a70c8
y.create.l HWIO_MPM2_XPU_ESRRESTORE_ADDR A:0xfc4a70cc
y.create.l HWIO_MPM2_XPU_ESYNR0_ADDR A:0xfc4a70d0
y.create.l HWIO_MPM2_XPU_ESYNR1_ADDR A:0xfc4a70d4
y.create.l HWIO_MPM2_XPU_ESYNR2_ADDR A:0xfc4a70d8
y.create.l HWIO_MPM2_XPU_IDR0_ADDR A:0xfc4a7074
y.create.l HWIO_MPM2_XPU_IDR1_ADDR A:0xfc4a7078
y.create.l HWIO_MPM2_XPU_REV_ADDR A:0xfc4a707c
y.create.l HWIO_MPM2_XPU_RG0_RACR0_ADDR A:0xfc4a7200
y.create.l HWIO_MPM2_XPU_RG1_RACR0_ADDR A:0xfc4a7280
y.create.l HWIO_MPM2_XPU_RG2_RACR0_ADDR A:0xfc4a7300
y.create.l HWIO_MPM2_XPU_RG3_RACR0_ADDR A:0xfc4a7380
y.create.l HWIO_MPM2_XPU_RG4_RACR0_ADDR A:0xfc4a7400
y.create.l HWIO_MPM2_XPU_RG5_RACR0_ADDR A:0xfc4a7480
y.create.l HWIO_MPM2_XPU_RG6_RACR0_ADDR A:0xfc4a7500
y.create.l HWIO_MPM2_XPU_RG7_RACR0_ADDR A:0xfc4a7580
y.create.l HWIO_MPM2_XPU_RG8_RACR0_ADDR A:0xfc4a7600
y.create.l HWIO_MPM2_XPU_RG9_RACR0_ADDR A:0xfc4a7680
y.create.l HWIO_MPM2_XPU_RG0_SCR_ADDR A:0xfc4a7250
y.create.l HWIO_MPM2_XPU_RG1_SCR_ADDR A:0xfc4a72d0
y.create.l HWIO_MPM2_XPU_RG2_SCR_ADDR A:0xfc4a7350
y.create.l HWIO_MPM2_XPU_RG3_SCR_ADDR A:0xfc4a73d0
y.create.l HWIO_MPM2_XPU_RG4_SCR_ADDR A:0xfc4a7450
y.create.l HWIO_MPM2_XPU_RG5_SCR_ADDR A:0xfc4a74d0
y.create.l HWIO_MPM2_XPU_RG6_SCR_ADDR A:0xfc4a7550
y.create.l HWIO_MPM2_XPU_RG7_SCR_ADDR A:0xfc4a75d0
y.create.l HWIO_MPM2_XPU_RG8_SCR_ADDR A:0xfc4a7650
y.create.l HWIO_MPM2_XPU_RG9_SCR_ADDR A:0xfc4a76d0
y.create.l HWIO_MPM2_XPU_RG0_MCR_ADDR A:0xfc4a7254
y.create.l HWIO_MPM2_XPU_RG1_MCR_ADDR A:0xfc4a72d4
y.create.l HWIO_MPM2_XPU_RG2_MCR_ADDR A:0xfc4a7354
y.create.l HWIO_MPM2_XPU_RG3_MCR_ADDR A:0xfc4a73d4
y.create.l HWIO_MPM2_XPU_RG4_MCR_ADDR A:0xfc4a7454
y.create.l HWIO_MPM2_XPU_RG5_MCR_ADDR A:0xfc4a74d4
y.create.l HWIO_MPM2_XPU_RG6_MCR_ADDR A:0xfc4a7554
y.create.l HWIO_MPM2_XPU_RG7_MCR_ADDR A:0xfc4a75d4
y.create.l HWIO_MPM2_XPU_RG8_MCR_ADDR A:0xfc4a7654
y.create.l HWIO_MPM2_XPU_RG9_MCR_ADDR A:0xfc4a76d4
y.create.l HWIO_MPM2_TSENS_CTRL_ADDR A:0xfc4a8000
y.create.l HWIO_MPM2_TSENS_TEST_CTRL_ADDR A:0xfc4a8004
y.create.l HWIO_MPM2_TSENS_S0_MIN_MAX_STATUS_CTRL_ADDR A:0xfc4a8008
y.create.l HWIO_MPM2_TSENS_S1_MIN_MAX_STATUS_CTRL_ADDR A:0xfc4a800c
y.create.l HWIO_MPM2_TSENS_S2_MIN_MAX_STATUS_CTRL_ADDR A:0xfc4a8010
y.create.l HWIO_MPM2_TSENS_S3_MIN_MAX_STATUS_CTRL_ADDR A:0xfc4a8014
y.create.l HWIO_MPM2_TSENS_S4_MIN_MAX_STATUS_CTRL_ADDR A:0xfc4a8018
y.create.l HWIO_MPM2_TSENS_S5_MIN_MAX_STATUS_CTRL_ADDR A:0xfc4a801c
y.create.l HWIO_MPM2_TSENS_S6_MIN_MAX_STATUS_CTRL_ADDR A:0xfc4a8020
y.create.l HWIO_MPM2_TSENS_S7_MIN_MAX_STATUS_CTRL_ADDR A:0xfc4a8024
y.create.l HWIO_MPM2_TSENS_S8_MIN_MAX_STATUS_CTRL_ADDR A:0xfc4a8028
y.create.l HWIO_MPM2_TSENS_S9_MIN_MAX_STATUS_CTRL_ADDR A:0xfc4a802c
y.create.l HWIO_MPM2_TSENS_GLOBAL_CONFIG_ADDR A:0xfc4a8034
y.create.l HWIO_MPM2_TSENS_S0_MAIN_CONFIG_ADDR A:0xfc4a8038
y.create.l HWIO_MPM2_TSENS_S1_REMOTE_CONFIG_ADDR A:0xfc4a8040
y.create.l HWIO_MPM2_TSENS_S2_REMOTE_CONFIG_ADDR A:0xfc4a8044
y.create.l HWIO_MPM2_TSENS_S3_REMOTE_CONFIG_ADDR A:0xfc4a8048
y.create.l HWIO_MPM2_TSENS_S4_REMOTE_CONFIG_ADDR A:0xfc4a804c
y.create.l HWIO_MPM2_TSENS_S5_REMOTE_CONFIG_ADDR A:0xfc4a8050
y.create.l HWIO_MPM2_TSENS_S6_REMOTE_CONFIG_ADDR A:0xfc4a8054
y.create.l HWIO_MPM2_TSENS_S7_REMOTE_CONFIG_ADDR A:0xfc4a8058
y.create.l HWIO_MPM2_TSENS_S8_REMOTE_CONFIG_ADDR A:0xfc4a805c
y.create.l HWIO_MPM2_TSENS_S9_REMOTE_CONFIG_ADDR A:0xfc4a8060
y.create.l HWIO_MPM2_TSENS_S10_REMOTE_CONFIG_ADDR A:0xfc4a8064
y.create.l HWIO_MPM2_TSENS_UPPER_LOWER_INTERRUPT_CTRL_ADDR A:0xfc4a9000
y.create.l HWIO_MPM2_TSENS_S0_UPPER_LOWER_STATUS_CTRL_ADDR A:0xfc4a9004
y.create.l HWIO_MPM2_TSENS_S1_UPPER_LOWER_STATUS_CTRL_ADDR A:0xfc4a9008
y.create.l HWIO_MPM2_TSENS_S2_UPPER_LOWER_STATUS_CTRL_ADDR A:0xfc4a900c
y.create.l HWIO_MPM2_TSENS_S3_UPPER_LOWER_STATUS_CTRL_ADDR A:0xfc4a9010
y.create.l HWIO_MPM2_TSENS_S4_UPPER_LOWER_STATUS_CTRL_ADDR A:0xfc4a9014
y.create.l HWIO_MPM2_TSENS_S5_UPPER_LOWER_STATUS_CTRL_ADDR A:0xfc4a9018
y.create.l HWIO_MPM2_TSENS_S6_UPPER_LOWER_STATUS_CTRL_ADDR A:0xfc4a901c
y.create.l HWIO_MPM2_TSENS_S7_UPPER_LOWER_STATUS_CTRL_ADDR A:0xfc4a9020
y.create.l HWIO_MPM2_TSENS_S8_UPPER_LOWER_STATUS_CTRL_ADDR A:0xfc4a9024
y.create.l HWIO_MPM2_TSENS_S9_UPPER_LOWER_STATUS_CTRL_ADDR A:0xfc4a9028
y.create.l HWIO_MPM2_TSENS_S0_STATUS_ADDR A:0xfc4a9030
y.create.l HWIO_MPM2_TSENS_S1_STATUS_ADDR A:0xfc4a9034
y.create.l HWIO_MPM2_TSENS_S2_STATUS_ADDR A:0xfc4a9038
y.create.l HWIO_MPM2_TSENS_S3_STATUS_ADDR A:0xfc4a903c
y.create.l HWIO_MPM2_TSENS_S4_STATUS_ADDR A:0xfc4a9040
y.create.l HWIO_MPM2_TSENS_S5_STATUS_ADDR A:0xfc4a9044
y.create.l HWIO_MPM2_TSENS_S6_STATUS_ADDR A:0xfc4a9048
y.create.l HWIO_MPM2_TSENS_S7_STATUS_ADDR A:0xfc4a904c
y.create.l HWIO_MPM2_TSENS_S8_STATUS_ADDR A:0xfc4a9050
y.create.l HWIO_MPM2_TSENS_S9_STATUS_ADDR A:0xfc4a9054
y.create.l HWIO_MPM2_TSENS_TRDY_ADDR A:0xfc4a905c
y.create.l HWIO_MPM2_WDOG_RESET_REG_ADDR A:0xfc4aa000
y.create.l HWIO_MPM2_WDOG_CTL_REG_ADDR A:0xfc4aa004
y.create.l HWIO_MPM2_WDOG_STATUS_REG_ADDR A:0xfc4aa008
y.create.l HWIO_MPM2_WDOG_BARK_VAL_REG_ADDR A:0xfc4aa00c
y.create.l HWIO_MPM2_WDOG_BITE_VAL_REG_ADDR A:0xfc4aa010
y.create.l HWIO_MPM2_MPM_PS_HOLD_ADDR A:0xfc4ab000
y.create.l HWIO_MSS_XPU_SCR_ADDR A:0xfc800000
y.create.l HWIO_MSS_XPU_SWDR_ADDR A:0xfc800004
y.create.l HWIO_MSS_XPU_SEAR0_ADDR A:0xfc800040
y.create.l HWIO_MSS_XPU_SESR_ADDR A:0xfc800048
y.create.l HWIO_MSS_XPU_SESRRESTORE_ADDR A:0xfc80004c
y.create.l HWIO_MSS_XPU_SESYNR0_ADDR A:0xfc800050
y.create.l HWIO_MSS_XPU_SESYNR1_ADDR A:0xfc800054
y.create.l HWIO_MSS_XPU_SESYNR2_ADDR A:0xfc800058
y.create.l HWIO_MSS_XPU_MCR_ADDR A:0xfc800100
y.create.l HWIO_MSS_XPU_MEAR0_ADDR A:0xfc800140
y.create.l HWIO_MSS_XPU_MESR_ADDR A:0xfc800148
y.create.l HWIO_MSS_XPU_MESRRESTORE_ADDR A:0xfc80014c
y.create.l HWIO_MSS_XPU_MESYNR0_ADDR A:0xfc800150
y.create.l HWIO_MSS_XPU_MESYNR1_ADDR A:0xfc800154
y.create.l HWIO_MSS_XPU_MESYNR2_ADDR A:0xfc800158
y.create.l HWIO_MSS_XPU_CR_ADDR A:0xfc800080
y.create.l HWIO_MSS_XPU_RPU_ACR0_ADDR A:0xfc8000a0
y.create.l HWIO_MSS_XPU_EAR0_ADDR A:0xfc8000c0
y.create.l HWIO_MSS_XPU_ESR_ADDR A:0xfc8000c8
y.create.l HWIO_MSS_XPU_ESRRESTORE_ADDR A:0xfc8000cc
y.create.l HWIO_MSS_XPU_ESYNR0_ADDR A:0xfc8000d0
y.create.l HWIO_MSS_XPU_ESYNR1_ADDR A:0xfc8000d4
y.create.l HWIO_MSS_XPU_ESYNR2_ADDR A:0xfc8000d8
y.create.l HWIO_MSS_XPU_IDR0_ADDR A:0xfc800074
y.create.l HWIO_MSS_XPU_IDR1_ADDR A:0xfc800078
y.create.l HWIO_MSS_XPU_REV_ADDR A:0xfc80007c
y.create.l HWIO_MSS_XPU_RG0_RACR0_ADDR A:0xfc800200
y.create.l HWIO_MSS_XPU_RG1_RACR0_ADDR A:0xfc800280
y.create.l HWIO_MSS_XPU_RG2_RACR0_ADDR A:0xfc800300
y.create.l HWIO_MSS_XPU_RG3_RACR0_ADDR A:0xfc800380
y.create.l HWIO_MSS_XPU_RG4_RACR0_ADDR A:0xfc800400
y.create.l HWIO_MSS_XPU_RG0_SCR_ADDR A:0xfc800250
y.create.l HWIO_MSS_XPU_RG1_SCR_ADDR A:0xfc8002d0
y.create.l HWIO_MSS_XPU_RG2_SCR_ADDR A:0xfc800350
y.create.l HWIO_MSS_XPU_RG3_SCR_ADDR A:0xfc8003d0
y.create.l HWIO_MSS_XPU_RG4_SCR_ADDR A:0xfc800450
y.create.l HWIO_MSS_XPU_RG0_MCR_ADDR A:0xfc800254
y.create.l HWIO_MSS_XPU_RG1_MCR_ADDR A:0xfc8002d4
y.create.l HWIO_MSS_XPU_RG2_MCR_ADDR A:0xfc800354
y.create.l HWIO_MSS_XPU_RG3_MCR_ADDR A:0xfc8003d4
y.create.l HWIO_MSS_XPU_RG4_MCR_ADDR A:0xfc800454
y.create.l HWIO_MSS_MODEM_VMIDMT_SCR0_ADDR A:0xfc808000
y.create.l HWIO_MSS_MODEM_VMIDMT_SCR1_ADDR A:0xfc808004
y.create.l HWIO_MSS_MODEM_VMIDMT_SCR2_ADDR A:0xfc808008
y.create.l HWIO_MSS_MODEM_VMIDMT_SACR_ADDR A:0xfc808010
y.create.l HWIO_MSS_MODEM_VMIDMT_SIDR0_ADDR A:0xfc808020
y.create.l HWIO_MSS_MODEM_VMIDMT_SIDR1_ADDR A:0xfc808024
y.create.l HWIO_MSS_MODEM_VMIDMT_SIDR2_ADDR A:0xfc808028
y.create.l HWIO_MSS_MODEM_VMIDMT_SIDR4_ADDR A:0xfc808030
y.create.l HWIO_MSS_MODEM_VMIDMT_SIDR5_ADDR A:0xfc808034
y.create.l HWIO_MSS_MODEM_VMIDMT_SIDR7_ADDR A:0xfc80803c
y.create.l HWIO_MSS_MODEM_VMIDMT_SGFAR0_ADDR A:0xfc808040
y.create.l HWIO_MSS_MODEM_VMIDMT_SGFSR_ADDR A:0xfc808048
y.create.l HWIO_MSS_MODEM_VMIDMT_SGFSRRESTORE_ADDR A:0xfc80804c
y.create.l HWIO_MSS_MODEM_VMIDMT_SGFSYNDR0_ADDR A:0xfc808050
y.create.l HWIO_MSS_MODEM_VMIDMT_SGFSYNDR1_ADDR A:0xfc808054
y.create.l HWIO_MSS_MODEM_VMIDMT_SGFSYNDR2_ADDR A:0xfc808058
y.create.l HWIO_MSS_MODEM_VMIDMT_VMIDMTSCR0_ADDR A:0xfc808090
y.create.l HWIO_MSS_MODEM_VMIDMT_CR0_ADDR A:0xfc808000
y.create.l HWIO_MSS_MODEM_VMIDMT_CR2_ADDR A:0xfc808008
y.create.l HWIO_MSS_MODEM_VMIDMT_ACR_ADDR A:0xfc808010
y.create.l HWIO_MSS_MODEM_VMIDMT_IDR0_ADDR A:0xfc808020
y.create.l HWIO_MSS_MODEM_VMIDMT_IDR1_ADDR A:0xfc808024
y.create.l HWIO_MSS_MODEM_VMIDMT_IDR2_ADDR A:0xfc808028
y.create.l HWIO_MSS_MODEM_VMIDMT_IDR4_ADDR A:0xfc808030
y.create.l HWIO_MSS_MODEM_VMIDMT_IDR5_ADDR A:0xfc808034
y.create.l HWIO_MSS_MODEM_VMIDMT_IDR7_ADDR A:0xfc80803c
y.create.l HWIO_MSS_MODEM_VMIDMT_GFAR0_ADDR A:0xfc808040
y.create.l HWIO_MSS_MODEM_VMIDMT_GFSR_ADDR A:0xfc808048
y.create.l HWIO_MSS_MODEM_VMIDMT_GFSRRESTORE_ADDR A:0xfc80804c
y.create.l HWIO_MSS_MODEM_VMIDMT_GFSYNDR0_ADDR A:0xfc808050
y.create.l HWIO_MSS_MODEM_VMIDMT_GFSYNDR1_ADDR A:0xfc808054
y.create.l HWIO_MSS_MODEM_VMIDMT_GFSYNDR2_ADDR A:0xfc808058
y.create.l HWIO_MSS_MODEM_VMIDMT_VMIDMTCR0_ADDR A:0xfc808090
y.create.l HWIO_MSS_MODEM_VMIDMT_VMIDMTACR_ADDR A:0xfc80809c
y.create.l HWIO_MSS_MODEM_VMIDMT_NSCR0_ADDR A:0xfc808400
y.create.l HWIO_MSS_MODEM_VMIDMT_NSCR2_ADDR A:0xfc808408
y.create.l HWIO_MSS_MODEM_VMIDMT_NSACR_ADDR A:0xfc808410
y.create.l HWIO_MSS_MODEM_VMIDMT_NSGFAR0_ADDR A:0xfc808440
y.create.l HWIO_MSS_MODEM_VMIDMT_NSGFSR_ADDR A:0xfc808448
y.create.l HWIO_MSS_MODEM_VMIDMT_NSGFSRRESTORE_ADDR A:0xfc80844c
y.create.l HWIO_MSS_MODEM_VMIDMT_NSGFSYNDR0_ADDR A:0xfc808450
y.create.l HWIO_MSS_MODEM_VMIDMT_NSGFSYNDR1_ADDR A:0xfc808454
y.create.l HWIO_MSS_MODEM_VMIDMT_NSGFSYNDR2_ADDR A:0xfc808458
y.create.l HWIO_MSS_MODEM_VMIDMT_NSVMIDMTCR0_ADDR A:0xfc808490
y.create.l HWIO_MSS_MODEM_VMIDMT_SSDR0_ADDR A:0xfc808080
y.create.l HWIO_MSS_MODEM_VMIDMT_S2VR0_ADDR A:0xfc808c00
y.create.l HWIO_MSS_MODEM_VMIDMT_S2VR1_ADDR A:0xfc808c04
y.create.l HWIO_MSS_MODEM_VMIDMT_AS2VR0_ADDR A:0xfc808e00
y.create.l HWIO_MSS_MODEM_VMIDMT_AS2VR1_ADDR A:0xfc808e04
y.create.l HWIO_MSS_NAV_VMIDMT_SCR0_ADDR A:0xfc810000
y.create.l HWIO_MSS_NAV_VMIDMT_SCR1_ADDR A:0xfc810004
y.create.l HWIO_MSS_NAV_VMIDMT_SCR2_ADDR A:0xfc810008
y.create.l HWIO_MSS_NAV_VMIDMT_SACR_ADDR A:0xfc810010
y.create.l HWIO_MSS_NAV_VMIDMT_SIDR0_ADDR A:0xfc810020
y.create.l HWIO_MSS_NAV_VMIDMT_SIDR1_ADDR A:0xfc810024
y.create.l HWIO_MSS_NAV_VMIDMT_SIDR2_ADDR A:0xfc810028
y.create.l HWIO_MSS_NAV_VMIDMT_SIDR4_ADDR A:0xfc810030
y.create.l HWIO_MSS_NAV_VMIDMT_SIDR5_ADDR A:0xfc810034
y.create.l HWIO_MSS_NAV_VMIDMT_SIDR7_ADDR A:0xfc81003c
y.create.l HWIO_MSS_NAV_VMIDMT_SGFAR0_ADDR A:0xfc810040
y.create.l HWIO_MSS_NAV_VMIDMT_SGFSR_ADDR A:0xfc810048
y.create.l HWIO_MSS_NAV_VMIDMT_SGFSRRESTORE_ADDR A:0xfc81004c
y.create.l HWIO_MSS_NAV_VMIDMT_SGFSYNDR0_ADDR A:0xfc810050
y.create.l HWIO_MSS_NAV_VMIDMT_SGFSYNDR1_ADDR A:0xfc810054
y.create.l HWIO_MSS_NAV_VMIDMT_SGFSYNDR2_ADDR A:0xfc810058
y.create.l HWIO_MSS_NAV_VMIDMT_VMIDMTSCR0_ADDR A:0xfc810090
y.create.l HWIO_MSS_NAV_VMIDMT_CR0_ADDR A:0xfc810000
y.create.l HWIO_MSS_NAV_VMIDMT_CR2_ADDR A:0xfc810008
y.create.l HWIO_MSS_NAV_VMIDMT_ACR_ADDR A:0xfc810010
y.create.l HWIO_MSS_NAV_VMIDMT_IDR0_ADDR A:0xfc810020
y.create.l HWIO_MSS_NAV_VMIDMT_IDR1_ADDR A:0xfc810024
y.create.l HWIO_MSS_NAV_VMIDMT_IDR2_ADDR A:0xfc810028
y.create.l HWIO_MSS_NAV_VMIDMT_IDR4_ADDR A:0xfc810030
y.create.l HWIO_MSS_NAV_VMIDMT_IDR5_ADDR A:0xfc810034
y.create.l HWIO_MSS_NAV_VMIDMT_IDR7_ADDR A:0xfc81003c
y.create.l HWIO_MSS_NAV_VMIDMT_GFAR0_ADDR A:0xfc810040
y.create.l HWIO_MSS_NAV_VMIDMT_GFSR_ADDR A:0xfc810048
y.create.l HWIO_MSS_NAV_VMIDMT_GFSRRESTORE_ADDR A:0xfc81004c
y.create.l HWIO_MSS_NAV_VMIDMT_GFSYNDR0_ADDR A:0xfc810050
y.create.l HWIO_MSS_NAV_VMIDMT_GFSYNDR1_ADDR A:0xfc810054
y.create.l HWIO_MSS_NAV_VMIDMT_GFSYNDR2_ADDR A:0xfc810058
y.create.l HWIO_MSS_NAV_VMIDMT_VMIDMTCR0_ADDR A:0xfc810090
y.create.l HWIO_MSS_NAV_VMIDMT_VMIDMTACR_ADDR A:0xfc81009c
y.create.l HWIO_MSS_NAV_VMIDMT_NSCR0_ADDR A:0xfc810400
y.create.l HWIO_MSS_NAV_VMIDMT_NSCR2_ADDR A:0xfc810408
y.create.l HWIO_MSS_NAV_VMIDMT_NSACR_ADDR A:0xfc810410
y.create.l HWIO_MSS_NAV_VMIDMT_NSGFAR0_ADDR A:0xfc810440
y.create.l HWIO_MSS_NAV_VMIDMT_NSGFSR_ADDR A:0xfc810448
y.create.l HWIO_MSS_NAV_VMIDMT_NSGFSRRESTORE_ADDR A:0xfc81044c
y.create.l HWIO_MSS_NAV_VMIDMT_NSGFSYNDR0_ADDR A:0xfc810450
y.create.l HWIO_MSS_NAV_VMIDMT_NSGFSYNDR1_ADDR A:0xfc810454
y.create.l HWIO_MSS_NAV_VMIDMT_NSGFSYNDR2_ADDR A:0xfc810458
y.create.l HWIO_MSS_NAV_VMIDMT_NSVMIDMTCR0_ADDR A:0xfc810490
y.create.l HWIO_MSS_NAV_VMIDMT_SSDR0_ADDR A:0xfc810080
y.create.l HWIO_MSS_NAV_VMIDMT_S2VR0_ADDR A:0xfc810c00
y.create.l HWIO_MSS_NAV_VMIDMT_AS2VR0_ADDR A:0xfc810e00
y.create.l HWIO_MSS_Q6_VMIDMT_SCR0_ADDR A:0xfc818000
y.create.l HWIO_MSS_Q6_VMIDMT_SCR1_ADDR A:0xfc818004
y.create.l HWIO_MSS_Q6_VMIDMT_SCR2_ADDR A:0xfc818008
y.create.l HWIO_MSS_Q6_VMIDMT_SACR_ADDR A:0xfc818010
y.create.l HWIO_MSS_Q6_VMIDMT_SIDR0_ADDR A:0xfc818020
y.create.l HWIO_MSS_Q6_VMIDMT_SIDR1_ADDR A:0xfc818024
y.create.l HWIO_MSS_Q6_VMIDMT_SIDR2_ADDR A:0xfc818028
y.create.l HWIO_MSS_Q6_VMIDMT_SIDR4_ADDR A:0xfc818030
y.create.l HWIO_MSS_Q6_VMIDMT_SIDR5_ADDR A:0xfc818034
y.create.l HWIO_MSS_Q6_VMIDMT_SIDR7_ADDR A:0xfc81803c
y.create.l HWIO_MSS_Q6_VMIDMT_SGFAR0_ADDR A:0xfc818040
y.create.l HWIO_MSS_Q6_VMIDMT_SGFSR_ADDR A:0xfc818048
y.create.l HWIO_MSS_Q6_VMIDMT_SGFSRRESTORE_ADDR A:0xfc81804c
y.create.l HWIO_MSS_Q6_VMIDMT_SGFSYNDR0_ADDR A:0xfc818050
y.create.l HWIO_MSS_Q6_VMIDMT_SGFSYNDR1_ADDR A:0xfc818054
y.create.l HWIO_MSS_Q6_VMIDMT_SGFSYNDR2_ADDR A:0xfc818058
y.create.l HWIO_MSS_Q6_VMIDMT_VMIDMTSCR0_ADDR A:0xfc818090
y.create.l HWIO_MSS_Q6_VMIDMT_CR0_ADDR A:0xfc818000
y.create.l HWIO_MSS_Q6_VMIDMT_CR2_ADDR A:0xfc818008
y.create.l HWIO_MSS_Q6_VMIDMT_ACR_ADDR A:0xfc818010
y.create.l HWIO_MSS_Q6_VMIDMT_IDR0_ADDR A:0xfc818020
y.create.l HWIO_MSS_Q6_VMIDMT_IDR1_ADDR A:0xfc818024
y.create.l HWIO_MSS_Q6_VMIDMT_IDR2_ADDR A:0xfc818028
y.create.l HWIO_MSS_Q6_VMIDMT_IDR4_ADDR A:0xfc818030
y.create.l HWIO_MSS_Q6_VMIDMT_IDR5_ADDR A:0xfc818034
y.create.l HWIO_MSS_Q6_VMIDMT_IDR7_ADDR A:0xfc81803c
y.create.l HWIO_MSS_Q6_VMIDMT_GFAR0_ADDR A:0xfc818040
y.create.l HWIO_MSS_Q6_VMIDMT_GFSR_ADDR A:0xfc818048
y.create.l HWIO_MSS_Q6_VMIDMT_GFSRRESTORE_ADDR A:0xfc81804c
y.create.l HWIO_MSS_Q6_VMIDMT_GFSYNDR0_ADDR A:0xfc818050
y.create.l HWIO_MSS_Q6_VMIDMT_GFSYNDR1_ADDR A:0xfc818054
y.create.l HWIO_MSS_Q6_VMIDMT_GFSYNDR2_ADDR A:0xfc818058
y.create.l HWIO_MSS_Q6_VMIDMT_VMIDMTCR0_ADDR A:0xfc818090
y.create.l HWIO_MSS_Q6_VMIDMT_VMIDMTACR_ADDR A:0xfc81809c
y.create.l HWIO_MSS_Q6_VMIDMT_NSCR0_ADDR A:0xfc818400
y.create.l HWIO_MSS_Q6_VMIDMT_NSCR2_ADDR A:0xfc818408
y.create.l HWIO_MSS_Q6_VMIDMT_NSACR_ADDR A:0xfc818410
y.create.l HWIO_MSS_Q6_VMIDMT_NSGFAR0_ADDR A:0xfc818440
y.create.l HWIO_MSS_Q6_VMIDMT_NSGFSR_ADDR A:0xfc818448
y.create.l HWIO_MSS_Q6_VMIDMT_NSGFSRRESTORE_ADDR A:0xfc81844c
y.create.l HWIO_MSS_Q6_VMIDMT_NSGFSYNDR0_ADDR A:0xfc818450
y.create.l HWIO_MSS_Q6_VMIDMT_NSGFSYNDR1_ADDR A:0xfc818454
y.create.l HWIO_MSS_Q6_VMIDMT_NSGFSYNDR2_ADDR A:0xfc818458
y.create.l HWIO_MSS_Q6_VMIDMT_NSVMIDMTCR0_ADDR A:0xfc818490
y.create.l HWIO_MSS_Q6_VMIDMT_SSDR0_ADDR A:0xfc818080
y.create.l HWIO_MSS_Q6_VMIDMT_S2VR0_ADDR A:0xfc818c00
y.create.l HWIO_MSS_Q6_VMIDMT_AS2VR0_ADDR A:0xfc818e00
y.create.l HWIO_MSS_RELAY_MSG_BUFFER_00_ADDR A:0xfc820000
y.create.l HWIO_MSS_RELAY_MSG_BUFFER_01_ADDR A:0xfc820004
y.create.l HWIO_MSS_RELAY_MSG_BUFFER_02_ADDR A:0xfc820008
y.create.l HWIO_MSS_RELAY_MSG_BUFFER_03_ADDR A:0xfc82000c
y.create.l HWIO_MSS_RELAY_MSG_BUFFER_04_ADDR A:0xfc820010
y.create.l HWIO_MSS_RELAY_MSG_BUFFER_05_ADDR A:0xfc820014
y.create.l HWIO_MSS_RELAY_MSG_BUFFER_06_ADDR A:0xfc820018
y.create.l HWIO_MSS_RELAY_MSG_BUFFER_07_ADDR A:0xfc82001c
y.create.l HWIO_MSS_RELAY_MSG_BUFFER_08_ADDR A:0xfc820020
y.create.l HWIO_MSS_BAM_CTRL_ADDR A:0xfc834000
y.create.l HWIO_MSS_BAM_REVISION_ADDR A:0xfc834004
y.create.l HWIO_MSS_BAM_SW_VERSION_ADDR A:0xfc834080
y.create.l HWIO_MSS_BAM_NUM_PIPES_ADDR A:0xfc83403c
y.create.l HWIO_MSS_BAM_TIMER_ADDR A:0xfc834040
y.create.l HWIO_MSS_BAM_TIMER_CTRL_ADDR A:0xfc834044
y.create.l HWIO_MSS_BAM_DESC_CNT_TRSHLD_ADDR A:0xfc834008
y.create.l HWIO_MSS_BAM_IRQ_SRCS_ADDR A:0xfc83400c
y.create.l HWIO_MSS_BAM_IRQ_SRCS_MSK_ADDR A:0xfc834010
y.create.l HWIO_MSS_BAM_IRQ_SRCS_UNMASKED_ADDR A:0xfc834030
y.create.l HWIO_MSS_BAM_IRQ_STTS_ADDR A:0xfc834014
y.create.l HWIO_MSS_BAM_IRQ_CLR_ADDR A:0xfc834018
y.create.l HWIO_MSS_BAM_IRQ_EN_ADDR A:0xfc83401c
y.create.l HWIO_MSS_BAM_AHB_MASTER_ERR_CTRLS_ADDR A:0xfc834024
y.create.l HWIO_MSS_BAM_AHB_MASTER_ERR_ADDR_ADDR A:0xfc834028
y.create.l HWIO_MSS_BAM_AHB_MASTER_ERR_DATA_ADDR A:0xfc83402c
y.create.l HWIO_MSS_BAM_TRUST_REG_ADDR A:0xfc834070
y.create.l HWIO_MSS_BAM_TEST_BUS_SEL_ADDR A:0xfc834074
y.create.l HWIO_MSS_BAM_TEST_BUS_REG_ADDR A:0xfc834078
y.create.l HWIO_MSS_BAM_CNFG_BITS_ADDR A:0xfc83407c
y.create.l HWIO_MSS_BAM_IRQ_SRCS_EE0_ADDR A:0xfc834800
y.create.l HWIO_MSS_BAM_IRQ_SRCS_EE1_ADDR A:0xfc834880
y.create.l HWIO_MSS_BAM_IRQ_SRCS_EE2_ADDR A:0xfc834900
y.create.l HWIO_MSS_BAM_IRQ_SRCS_EE3_ADDR A:0xfc834980
y.create.l HWIO_MSS_BAM_IRQ_SRCS_EE4_ADDR A:0xfc834a00
y.create.l HWIO_MSS_BAM_IRQ_SRCS_EE5_ADDR A:0xfc834a80
y.create.l HWIO_MSS_BAM_IRQ_SRCS_EE6_ADDR A:0xfc834b00
y.create.l HWIO_MSS_BAM_IRQ_SRCS_EE7_ADDR A:0xfc834b80
y.create.l HWIO_MSS_BAM_IRQ_SRCS_MSK_EE0_ADDR A:0xfc834804
y.create.l HWIO_MSS_BAM_IRQ_SRCS_MSK_EE1_ADDR A:0xfc834884
y.create.l HWIO_MSS_BAM_IRQ_SRCS_MSK_EE2_ADDR A:0xfc834904
y.create.l HWIO_MSS_BAM_IRQ_SRCS_MSK_EE3_ADDR A:0xfc834984
y.create.l HWIO_MSS_BAM_IRQ_SRCS_MSK_EE4_ADDR A:0xfc834a04
y.create.l HWIO_MSS_BAM_IRQ_SRCS_MSK_EE5_ADDR A:0xfc834a84
y.create.l HWIO_MSS_BAM_IRQ_SRCS_MSK_EE6_ADDR A:0xfc834b04
y.create.l HWIO_MSS_BAM_IRQ_SRCS_MSK_EE7_ADDR A:0xfc834b84
y.create.l HWIO_MSS_BAM_IRQ_SRCS_UNMASKED_EE0_ADDR A:0xfc834808
y.create.l HWIO_MSS_BAM_IRQ_SRCS_UNMASKED_EE1_ADDR A:0xfc834888
y.create.l HWIO_MSS_BAM_IRQ_SRCS_UNMASKED_EE2_ADDR A:0xfc834908
y.create.l HWIO_MSS_BAM_IRQ_SRCS_UNMASKED_EE3_ADDR A:0xfc834988
y.create.l HWIO_MSS_BAM_IRQ_SRCS_UNMASKED_EE4_ADDR A:0xfc834a08
y.create.l HWIO_MSS_BAM_IRQ_SRCS_UNMASKED_EE5_ADDR A:0xfc834a88
y.create.l HWIO_MSS_BAM_IRQ_SRCS_UNMASKED_EE6_ADDR A:0xfc834b08
y.create.l HWIO_MSS_BAM_IRQ_SRCS_UNMASKED_EE7_ADDR A:0xfc834b88
y.create.l HWIO_MSS_BAM_P_CTRL0_ADDR A:0xfc835000
y.create.l HWIO_MSS_BAM_P_CTRL1_ADDR A:0xfc836000
y.create.l HWIO_MSS_BAM_P_CTRL2_ADDR A:0xfc837000
y.create.l HWIO_MSS_BAM_P_CTRL3_ADDR A:0xfc838000
y.create.l HWIO_MSS_BAM_P_CTRL4_ADDR A:0xfc839000
y.create.l HWIO_MSS_BAM_P_CTRL5_ADDR A:0xfc83a000
y.create.l HWIO_MSS_BAM_P_RST0_ADDR A:0xfc835004
y.create.l HWIO_MSS_BAM_P_RST1_ADDR A:0xfc836004
y.create.l HWIO_MSS_BAM_P_RST2_ADDR A:0xfc837004
y.create.l HWIO_MSS_BAM_P_RST3_ADDR A:0xfc838004
y.create.l HWIO_MSS_BAM_P_RST4_ADDR A:0xfc839004
y.create.l HWIO_MSS_BAM_P_RST5_ADDR A:0xfc83a004
y.create.l HWIO_MSS_BAM_P_HALT0_ADDR A:0xfc835008
y.create.l HWIO_MSS_BAM_P_HALT1_ADDR A:0xfc836008
y.create.l HWIO_MSS_BAM_P_HALT2_ADDR A:0xfc837008
y.create.l HWIO_MSS_BAM_P_HALT3_ADDR A:0xfc838008
y.create.l HWIO_MSS_BAM_P_HALT4_ADDR A:0xfc839008
y.create.l HWIO_MSS_BAM_P_HALT5_ADDR A:0xfc83a008
y.create.l HWIO_MSS_BAM_P_TRUST_REG0_ADDR A:0xfc835030
y.create.l HWIO_MSS_BAM_P_TRUST_REG1_ADDR A:0xfc836030
y.create.l HWIO_MSS_BAM_P_TRUST_REG2_ADDR A:0xfc837030
y.create.l HWIO_MSS_BAM_P_TRUST_REG3_ADDR A:0xfc838030
y.create.l HWIO_MSS_BAM_P_TRUST_REG4_ADDR A:0xfc839030
y.create.l HWIO_MSS_BAM_P_TRUST_REG5_ADDR A:0xfc83a030
y.create.l HWIO_MSS_BAM_P_IRQ_STTS0_ADDR A:0xfc835010
y.create.l HWIO_MSS_BAM_P_IRQ_STTS1_ADDR A:0xfc836010
y.create.l HWIO_MSS_BAM_P_IRQ_STTS2_ADDR A:0xfc837010
y.create.l HWIO_MSS_BAM_P_IRQ_STTS3_ADDR A:0xfc838010
y.create.l HWIO_MSS_BAM_P_IRQ_STTS4_ADDR A:0xfc839010
y.create.l HWIO_MSS_BAM_P_IRQ_STTS5_ADDR A:0xfc83a010
y.create.l HWIO_MSS_BAM_P_IRQ_CLR0_ADDR A:0xfc835014
y.create.l HWIO_MSS_BAM_P_IRQ_CLR1_ADDR A:0xfc836014
y.create.l HWIO_MSS_BAM_P_IRQ_CLR2_ADDR A:0xfc837014
y.create.l HWIO_MSS_BAM_P_IRQ_CLR3_ADDR A:0xfc838014
y.create.l HWIO_MSS_BAM_P_IRQ_CLR4_ADDR A:0xfc839014
y.create.l HWIO_MSS_BAM_P_IRQ_CLR5_ADDR A:0xfc83a014
y.create.l HWIO_MSS_BAM_P_IRQ_EN0_ADDR A:0xfc835018
y.create.l HWIO_MSS_BAM_P_IRQ_EN1_ADDR A:0xfc836018
y.create.l HWIO_MSS_BAM_P_IRQ_EN2_ADDR A:0xfc837018
y.create.l HWIO_MSS_BAM_P_IRQ_EN3_ADDR A:0xfc838018
y.create.l HWIO_MSS_BAM_P_IRQ_EN4_ADDR A:0xfc839018
y.create.l HWIO_MSS_BAM_P_IRQ_EN5_ADDR A:0xfc83a018
y.create.l HWIO_MSS_BAM_P_TIMER0_ADDR A:0xfc83501c
y.create.l HWIO_MSS_BAM_P_TIMER1_ADDR A:0xfc83601c
y.create.l HWIO_MSS_BAM_P_TIMER2_ADDR A:0xfc83701c
y.create.l HWIO_MSS_BAM_P_TIMER3_ADDR A:0xfc83801c
y.create.l HWIO_MSS_BAM_P_TIMER4_ADDR A:0xfc83901c
y.create.l HWIO_MSS_BAM_P_TIMER5_ADDR A:0xfc83a01c
y.create.l HWIO_MSS_BAM_P_TIMER_CTRL0_ADDR A:0xfc835020
y.create.l HWIO_MSS_BAM_P_TIMER_CTRL1_ADDR A:0xfc836020
y.create.l HWIO_MSS_BAM_P_TIMER_CTRL2_ADDR A:0xfc837020
y.create.l HWIO_MSS_BAM_P_TIMER_CTRL3_ADDR A:0xfc838020
y.create.l HWIO_MSS_BAM_P_TIMER_CTRL4_ADDR A:0xfc839020
y.create.l HWIO_MSS_BAM_P_TIMER_CTRL5_ADDR A:0xfc83a020
y.create.l HWIO_MSS_BAM_P_PRDCR_SDBND0_ADDR A:0xfc835024
y.create.l HWIO_MSS_BAM_P_PRDCR_SDBND1_ADDR A:0xfc836024
y.create.l HWIO_MSS_BAM_P_PRDCR_SDBND2_ADDR A:0xfc837024
y.create.l HWIO_MSS_BAM_P_PRDCR_SDBND3_ADDR A:0xfc838024
y.create.l HWIO_MSS_BAM_P_PRDCR_SDBND4_ADDR A:0xfc839024
y.create.l HWIO_MSS_BAM_P_PRDCR_SDBND5_ADDR A:0xfc83a024
y.create.l HWIO_MSS_BAM_P_CNSMR_SDBND0_ADDR A:0xfc835028
y.create.l HWIO_MSS_BAM_P_CNSMR_SDBND1_ADDR A:0xfc836028
y.create.l HWIO_MSS_BAM_P_CNSMR_SDBND2_ADDR A:0xfc837028
y.create.l HWIO_MSS_BAM_P_CNSMR_SDBND3_ADDR A:0xfc838028
y.create.l HWIO_MSS_BAM_P_CNSMR_SDBND4_ADDR A:0xfc839028
y.create.l HWIO_MSS_BAM_P_CNSMR_SDBND5_ADDR A:0xfc83a028
y.create.l HWIO_MSS_BAM_P_EVNT_DEST_ADDR0_ADDR A:0xfc83582c
y.create.l HWIO_MSS_BAM_P_EVNT_DEST_ADDR1_ADDR A:0xfc83682c
y.create.l HWIO_MSS_BAM_P_EVNT_DEST_ADDR2_ADDR A:0xfc83782c
y.create.l HWIO_MSS_BAM_P_EVNT_DEST_ADDR3_ADDR A:0xfc83882c
y.create.l HWIO_MSS_BAM_P_EVNT_DEST_ADDR4_ADDR A:0xfc83982c
y.create.l HWIO_MSS_BAM_P_EVNT_DEST_ADDR5_ADDR A:0xfc83a82c
y.create.l HWIO_MSS_BAM_P_EVNT_REG0_ADDR A:0xfc835818
y.create.l HWIO_MSS_BAM_P_EVNT_REG1_ADDR A:0xfc836818
y.create.l HWIO_MSS_BAM_P_EVNT_REG2_ADDR A:0xfc837818
y.create.l HWIO_MSS_BAM_P_EVNT_REG3_ADDR A:0xfc838818
y.create.l HWIO_MSS_BAM_P_EVNT_REG4_ADDR A:0xfc839818
y.create.l HWIO_MSS_BAM_P_EVNT_REG5_ADDR A:0xfc83a818
y.create.l HWIO_MSS_BAM_P_SW_OFSTS0_ADDR A:0xfc835800
y.create.l HWIO_MSS_BAM_P_SW_OFSTS1_ADDR A:0xfc836800
y.create.l HWIO_MSS_BAM_P_SW_OFSTS2_ADDR A:0xfc837800
y.create.l HWIO_MSS_BAM_P_SW_OFSTS3_ADDR A:0xfc838800
y.create.l HWIO_MSS_BAM_P_SW_OFSTS4_ADDR A:0xfc839800
y.create.l HWIO_MSS_BAM_P_SW_OFSTS5_ADDR A:0xfc83a800
y.create.l HWIO_MSS_BAM_P_DATA_FIFO_ADDR0_ADDR A:0xfc835824
y.create.l HWIO_MSS_BAM_P_DATA_FIFO_ADDR1_ADDR A:0xfc836824
y.create.l HWIO_MSS_BAM_P_DATA_FIFO_ADDR2_ADDR A:0xfc837824
y.create.l HWIO_MSS_BAM_P_DATA_FIFO_ADDR3_ADDR A:0xfc838824
y.create.l HWIO_MSS_BAM_P_DATA_FIFO_ADDR4_ADDR A:0xfc839824
y.create.l HWIO_MSS_BAM_P_DATA_FIFO_ADDR5_ADDR A:0xfc83a824
y.create.l HWIO_MSS_BAM_P_DESC_FIFO_ADDR0_ADDR A:0xfc83581c
y.create.l HWIO_MSS_BAM_P_DESC_FIFO_ADDR1_ADDR A:0xfc83681c
y.create.l HWIO_MSS_BAM_P_DESC_FIFO_ADDR2_ADDR A:0xfc83781c
y.create.l HWIO_MSS_BAM_P_DESC_FIFO_ADDR3_ADDR A:0xfc83881c
y.create.l HWIO_MSS_BAM_P_DESC_FIFO_ADDR4_ADDR A:0xfc83981c
y.create.l HWIO_MSS_BAM_P_DESC_FIFO_ADDR5_ADDR A:0xfc83a81c
y.create.l HWIO_MSS_BAM_P_EVNT_GEN_TRSHLD0_ADDR A:0xfc835828
y.create.l HWIO_MSS_BAM_P_EVNT_GEN_TRSHLD1_ADDR A:0xfc836828
y.create.l HWIO_MSS_BAM_P_EVNT_GEN_TRSHLD2_ADDR A:0xfc837828
y.create.l HWIO_MSS_BAM_P_EVNT_GEN_TRSHLD3_ADDR A:0xfc838828
y.create.l HWIO_MSS_BAM_P_EVNT_GEN_TRSHLD4_ADDR A:0xfc839828
y.create.l HWIO_MSS_BAM_P_EVNT_GEN_TRSHLD5_ADDR A:0xfc83a828
y.create.l HWIO_MSS_BAM_P_FIFO_SIZES0_ADDR A:0xfc835820
y.create.l HWIO_MSS_BAM_P_FIFO_SIZES1_ADDR A:0xfc836820
y.create.l HWIO_MSS_BAM_P_FIFO_SIZES2_ADDR A:0xfc837820
y.create.l HWIO_MSS_BAM_P_FIFO_SIZES3_ADDR A:0xfc838820
y.create.l HWIO_MSS_BAM_P_FIFO_SIZES4_ADDR A:0xfc839820
y.create.l HWIO_MSS_BAM_P_FIFO_SIZES5_ADDR A:0xfc83a820
y.create.l HWIO_MSS_BAM_P_RETR_CNTXT_0_ADDR A:0xfc835834
y.create.l HWIO_MSS_BAM_P_RETR_CNTXT_1_ADDR A:0xfc836834
y.create.l HWIO_MSS_BAM_P_RETR_CNTXT_2_ADDR A:0xfc837834
y.create.l HWIO_MSS_BAM_P_RETR_CNTXT_3_ADDR A:0xfc838834
y.create.l HWIO_MSS_BAM_P_RETR_CNTXT_4_ADDR A:0xfc839834
y.create.l HWIO_MSS_BAM_P_RETR_CNTXT_5_ADDR A:0xfc83a834
y.create.l HWIO_MSS_BAM_P_SI_CNTXT_0_ADDR A:0xfc835838
y.create.l HWIO_MSS_BAM_P_SI_CNTXT_1_ADDR A:0xfc836838
y.create.l HWIO_MSS_BAM_P_SI_CNTXT_2_ADDR A:0xfc837838
y.create.l HWIO_MSS_BAM_P_SI_CNTXT_3_ADDR A:0xfc838838
y.create.l HWIO_MSS_BAM_P_SI_CNTXT_4_ADDR A:0xfc839838
y.create.l HWIO_MSS_BAM_P_SI_CNTXT_5_ADDR A:0xfc83a838
y.create.l HWIO_MSS_BAM_P_DF_CNTXT_0_ADDR A:0xfc835830
y.create.l HWIO_MSS_BAM_P_DF_CNTXT_1_ADDR A:0xfc836830
y.create.l HWIO_MSS_BAM_P_DF_CNTXT_2_ADDR A:0xfc837830
y.create.l HWIO_MSS_BAM_P_DF_CNTXT_3_ADDR A:0xfc838830
y.create.l HWIO_MSS_BAM_P_DF_CNTXT_4_ADDR A:0xfc839830
y.create.l HWIO_MSS_BAM_P_DF_CNTXT_5_ADDR A:0xfc83a830
y.create.l HWIO_MSS_BAM_P_AU_PSM_CNTXT_1_0_ADDR A:0xfc835804
y.create.l HWIO_MSS_BAM_P_AU_PSM_CNTXT_1_1_ADDR A:0xfc836804
y.create.l HWIO_MSS_BAM_P_AU_PSM_CNTXT_1_2_ADDR A:0xfc837804
y.create.l HWIO_MSS_BAM_P_AU_PSM_CNTXT_1_3_ADDR A:0xfc838804
y.create.l HWIO_MSS_BAM_P_AU_PSM_CNTXT_1_4_ADDR A:0xfc839804
y.create.l HWIO_MSS_BAM_P_AU_PSM_CNTXT_1_5_ADDR A:0xfc83a804
y.create.l HWIO_MSS_BAM_P_PSM_CNTXT_2_0_ADDR A:0xfc835808
y.create.l HWIO_MSS_BAM_P_PSM_CNTXT_2_1_ADDR A:0xfc836808
y.create.l HWIO_MSS_BAM_P_PSM_CNTXT_2_2_ADDR A:0xfc837808
y.create.l HWIO_MSS_BAM_P_PSM_CNTXT_2_3_ADDR A:0xfc838808
y.create.l HWIO_MSS_BAM_P_PSM_CNTXT_2_4_ADDR A:0xfc839808
y.create.l HWIO_MSS_BAM_P_PSM_CNTXT_2_5_ADDR A:0xfc83a808
y.create.l HWIO_MSS_BAM_P_PSM_CNTXT_3_0_ADDR A:0xfc83580c
y.create.l HWIO_MSS_BAM_P_PSM_CNTXT_3_1_ADDR A:0xfc83680c
y.create.l HWIO_MSS_BAM_P_PSM_CNTXT_3_2_ADDR A:0xfc83780c
y.create.l HWIO_MSS_BAM_P_PSM_CNTXT_3_3_ADDR A:0xfc83880c
y.create.l HWIO_MSS_BAM_P_PSM_CNTXT_3_4_ADDR A:0xfc83980c
y.create.l HWIO_MSS_BAM_P_PSM_CNTXT_3_5_ADDR A:0xfc83a80c
y.create.l HWIO_MSS_BAM_P_PSM_CNTXT_4_0_ADDR A:0xfc835810
y.create.l HWIO_MSS_BAM_P_PSM_CNTXT_4_1_ADDR A:0xfc836810
y.create.l HWIO_MSS_BAM_P_PSM_CNTXT_4_2_ADDR A:0xfc837810
y.create.l HWIO_MSS_BAM_P_PSM_CNTXT_4_3_ADDR A:0xfc838810
y.create.l HWIO_MSS_BAM_P_PSM_CNTXT_4_4_ADDR A:0xfc839810
y.create.l HWIO_MSS_BAM_P_PSM_CNTXT_4_5_ADDR A:0xfc83a810
y.create.l HWIO_MSS_BAM_P_PSM_CNTXT_5_0_ADDR A:0xfc835814
y.create.l HWIO_MSS_BAM_P_PSM_CNTXT_5_1_ADDR A:0xfc836814
y.create.l HWIO_MSS_BAM_P_PSM_CNTXT_5_2_ADDR A:0xfc837814
y.create.l HWIO_MSS_BAM_P_PSM_CNTXT_5_3_ADDR A:0xfc838814
y.create.l HWIO_MSS_BAM_P_PSM_CNTXT_5_4_ADDR A:0xfc839814
y.create.l HWIO_MSS_BAM_P_PSM_CNTXT_5_5_ADDR A:0xfc83a814
y.create.l HWIO_MSS_QDSP6SS_VERSION_ADDR A:0xfc880000
y.create.l HWIO_MSS_QDSP6SS_RST_EVB_ADDR A:0xfc880010
y.create.l HWIO_MSS_QDSP6SS_RESET_ADDR A:0xfc880014
y.create.l HWIO_MSS_QDSP6SS_DBG_CFG_ADDR A:0xfc880018
y.create.l HWIO_MSS_QDSP6SS_GFMUX_CTL_ADDR A:0xfc880020
y.create.l HWIO_MSS_QDSP6SS_GFMUX_STATUS_ADDR A:0xfc880024
y.create.l HWIO_MSS_QDSP6SS_PWR_CTL_ADDR A:0xfc880030
y.create.l HWIO_MSS_QDSP6SS_CGC_OVERRIDE_ADDR A:0xfc880034
y.create.l HWIO_MSS_QDSP6SS_NMI_ADDR A:0xfc880040
y.create.l HWIO_MSS_QDSP6SS_NMI_STATUS_ADDR A:0xfc880044
y.create.l HWIO_MSS_QDSP6SS_LDO_CFG0_ADDR A:0xfc880050
y.create.l HWIO_MSS_QDSP6SS_LDO_CFG1_ADDR A:0xfc880054
y.create.l HWIO_MSS_QDSP6SS_LDO_CFG2_ADDR A:0xfc880058
y.create.l HWIO_MSS_QDSP6SS_LDO_VREF_SET_ADDR A:0xfc88005c
y.create.l HWIO_MSS_QDSP6SS_STRAP_TCM_ADDR A:0xfc880100
y.create.l HWIO_MSS_QDSP6SS_STRAP_AHBUPPER_ADDR A:0xfc880104
y.create.l HWIO_MSS_QDSP6SS_STRAP_AHBLOWER_ADDR A:0xfc880108
y.create.l HWIO_MSS_QDSP6SS_STRAP_ACC_ADDR A:0xfc880110
y.create.l HWIO_MSS_QDSP6SS_DCC_CTRL_ADDR A:0xfc880114
y.create.l HWIO_MSS_QDSP6SS_EXT_WAKEUP_ADDR A:0xfc881000
y.create.l HWIO_MSS_QDSP6SS_EXT_PD_ADDR A:0xfc881004
y.create.l HWIO_MSS_QDSP6SS_FLL_CTL_ADDR A:0xfc881010
y.create.l HWIO_MSS_QDSP6SS_FLL_STATUS_ADDR A:0xfc881014
y.create.l HWIO_MSS_QDSP6SS_TEST_BUS_CTL_ADDR A:0xfc882000
y.create.l HWIO_MSS_QDSP6SS_TEST_BUS_VALUE_ADDR A:0xfc882004
y.create.l HWIO_MSS_QDSP6SS_TEST_BUS_WDATA_ADDR A:0xfc882008
y.create.l HWIO_MSS_QDSP6SS_PWRDBG_CTL_ADDR A:0xfc88200c
y.create.l HWIO_MSS_QDSP6SS_TEST_CLK_CTL_ADDR A:0xfc882010
y.create.l HWIO_MSS_QDSP6SS_PWRDBG_STATUS_ADDR A:0xfc882014
y.create.l HWIO_MSS_QDSP6SS_LDO_ATEST_ADDR A:0xfc882018
y.create.l HWIO_MSS_QDSP6SS_LDO_DAC_STATUS_ADDR A:0xfc88201c
y.create.l HWIO_MSS_QDSP6SS_ZMEAS_CONFIG_ADDR A:0xfc882020
y.create.l HWIO_QDSP6SS_INSTANCE_ID_ADDR A:0xfc900000
y.create.l HWIO_QDSP6SS_IDLT_MATCH_VAL_ADDR A:0xfc901000
y.create.l HWIO_QDSP6SS_IDLT_COUNT_VAL_ADDR A:0xfc901004
y.create.l HWIO_QDSP6SS_IDLT_ENABLE_ADDR A:0xfc901008
y.create.l HWIO_QDSP6SS_IDLT_SYNC_STATUS_ADDR A:0xfc90100c
y.create.l HWIO_QDSP6SS_WDOG_RESET_ADDR A:0xfc902000
y.create.l HWIO_QDSP6SS_WDOG_CTL_ADDR A:0xfc902004
y.create.l HWIO_QDSP6SS_WDOG_STATUS_ADDR A:0xfc902008
y.create.l HWIO_QDSP6SS_WDOG_BARK_TIME_ADDR A:0xfc90200c
y.create.l HWIO_QDSP6SS_WDOG_BITE_TIME_ADDR A:0xfc902010
y.create.l HWIO_QDSP6SS_WDOG_NMI_TIME_ADDR A:0xfc902014
y.create.l HWIO_QDSP6SS_WDOG_TEST_LOAD_ADDR A:0xfc902018
y.create.l HWIO_QDSP6SS_WDOG_TEST_ADDR A:0xfc90201c
y.create.l HWIO_QDSP6SS_IPC_ADDR A:0xfc905000
y.create.l HWIO_QDSP6SS_L1_IRQ_BACKUP_EN_ADDR A:0xfc905010
y.create.l HWIO_QDSP6SS_PD_HS_START_ADDR A:0xfc90700c
y.create.l HWIO_QDSP6SS_PD_HS_DONE_ADDR A:0xfc907010
y.create.l HWIO_QDSP6SS_PU_HS_START_ADDR A:0xfc907014
y.create.l HWIO_QDSP6SS_SLPC_CFG_ADDR A:0xfc90701c
y.create.l HWIO_QDSP6SS_SLPC_STATUS_ADDR A:0xfc907020
y.create.l HWIO_QDSP6SS_SPMCTL_EN_ARES_ADDR A:0xfc907024
y.create.l HWIO_QDSP6SS_SPMCTL_EN_CLAMP_ADDR A:0xfc907028
y.create.l HWIO_QDSP6SS_SPMCTL_EN_CLK_ADDR A:0xfc90702c
y.create.l HWIO_QDSP6SS_SPMCTL_EN_MEM_ADDR A:0xfc907030
y.create.l HWIO_QDSP6SS_SPMCTL_EN_BHS_ADDR A:0xfc907034
y.create.l HWIO_QDSP6SS_SPMCTL_EN_LDO_ADDR A:0xfc907038
y.create.l HWIO_QDSP6SS_SPMCTL_EN_EXT_ADDR A:0xfc90703c
y.create.l HWIO_QDSP6SS_L2VIC_VID_ADDR A:0xfc910000
y.create.l HWIO_QDSP6SS_L2VIC_INT_ENABLE0_ADDR A:0xfc910100
y.create.l HWIO_QDSP6SS_L2VIC_INT_ENABLE1_ADDR A:0xfc910104
y.create.l HWIO_QDSP6SS_L2VIC_INT_ENABLE2_ADDR A:0xfc910108
y.create.l HWIO_QDSP6SS_L2VIC_INT_ENABLE3_ADDR A:0xfc91010c
y.create.l HWIO_QDSP6SS_L2VIC_INT_ENABLE4_ADDR A:0xfc910110
y.create.l HWIO_QDSP6SS_L2VIC_INT_ENABLE5_ADDR A:0xfc910114
y.create.l HWIO_QDSP6SS_L2VIC_INT_ENABLE6_ADDR A:0xfc910118
y.create.l HWIO_QDSP6SS_L2VIC_INT_ENABLE7_ADDR A:0xfc91011c
y.create.l HWIO_QDSP6SS_L2VIC_INT_ENABLE8_ADDR A:0xfc910120
y.create.l HWIO_QDSP6SS_L2VIC_INT_ENABLE9_ADDR A:0xfc910124
y.create.l HWIO_QDSP6SS_L2VIC_INT_ENABLE_CLEAR0_ADDR A:0xfc910180
y.create.l HWIO_QDSP6SS_L2VIC_INT_ENABLE_CLEAR1_ADDR A:0xfc910184
y.create.l HWIO_QDSP6SS_L2VIC_INT_ENABLE_CLEAR2_ADDR A:0xfc910188
y.create.l HWIO_QDSP6SS_L2VIC_INT_ENABLE_CLEAR3_ADDR A:0xfc91018c
y.create.l HWIO_QDSP6SS_L2VIC_INT_ENABLE_CLEAR4_ADDR A:0xfc910190
y.create.l HWIO_QDSP6SS_L2VIC_INT_ENABLE_CLEAR5_ADDR A:0xfc910194
y.create.l HWIO_QDSP6SS_L2VIC_INT_ENABLE_CLEAR6_ADDR A:0xfc910198
y.create.l HWIO_QDSP6SS_L2VIC_INT_ENABLE_CLEAR7_ADDR A:0xfc91019c
y.create.l HWIO_QDSP6SS_L2VIC_INT_ENABLE_CLEAR8_ADDR A:0xfc9101a0
y.create.l HWIO_QDSP6SS_L2VIC_INT_ENABLE_CLEAR9_ADDR A:0xfc9101a4
y.create.l HWIO_QDSP6SS_L2VIC_INT_ENABLE_SET0_ADDR A:0xfc910200
y.create.l HWIO_QDSP6SS_L2VIC_INT_ENABLE_SET1_ADDR A:0xfc910204
y.create.l HWIO_QDSP6SS_L2VIC_INT_ENABLE_SET2_ADDR A:0xfc910208
y.create.l HWIO_QDSP6SS_L2VIC_INT_ENABLE_SET3_ADDR A:0xfc91020c
y.create.l HWIO_QDSP6SS_L2VIC_INT_ENABLE_SET4_ADDR A:0xfc910210
y.create.l HWIO_QDSP6SS_L2VIC_INT_ENABLE_SET5_ADDR A:0xfc910214
y.create.l HWIO_QDSP6SS_L2VIC_INT_ENABLE_SET6_ADDR A:0xfc910218
y.create.l HWIO_QDSP6SS_L2VIC_INT_ENABLE_SET7_ADDR A:0xfc91021c
y.create.l HWIO_QDSP6SS_L2VIC_INT_ENABLE_SET8_ADDR A:0xfc910220
y.create.l HWIO_QDSP6SS_L2VIC_INT_ENABLE_SET9_ADDR A:0xfc910224
y.create.l HWIO_QDSP6SS_L2VIC_INT_TYPE0_ADDR A:0xfc910280
y.create.l HWIO_QDSP6SS_L2VIC_INT_TYPE1_ADDR A:0xfc910284
y.create.l HWIO_QDSP6SS_L2VIC_INT_TYPE2_ADDR A:0xfc910288
y.create.l HWIO_QDSP6SS_L2VIC_INT_TYPE3_ADDR A:0xfc91028c
y.create.l HWIO_QDSP6SS_L2VIC_INT_TYPE4_ADDR A:0xfc910290
y.create.l HWIO_QDSP6SS_L2VIC_INT_TYPE5_ADDR A:0xfc910294
y.create.l HWIO_QDSP6SS_L2VIC_INT_TYPE6_ADDR A:0xfc910298
y.create.l HWIO_QDSP6SS_L2VIC_INT_TYPE7_ADDR A:0xfc91029c
y.create.l HWIO_QDSP6SS_L2VIC_INT_TYPE8_ADDR A:0xfc9102a0
y.create.l HWIO_QDSP6SS_L2VIC_INT_TYPE9_ADDR A:0xfc9102a4
y.create.l HWIO_QDSP6SS_L2VIC_INT_STATUS0_ADDR A:0xfc910380
y.create.l HWIO_QDSP6SS_L2VIC_INT_STATUS1_ADDR A:0xfc910384
y.create.l HWIO_QDSP6SS_L2VIC_INT_STATUS2_ADDR A:0xfc910388
y.create.l HWIO_QDSP6SS_L2VIC_INT_STATUS3_ADDR A:0xfc91038c
y.create.l HWIO_QDSP6SS_L2VIC_INT_STATUS4_ADDR A:0xfc910390
y.create.l HWIO_QDSP6SS_L2VIC_INT_STATUS5_ADDR A:0xfc910394
y.create.l HWIO_QDSP6SS_L2VIC_INT_STATUS6_ADDR A:0xfc910398
y.create.l HWIO_QDSP6SS_L2VIC_INT_STATUS7_ADDR A:0xfc91039c
y.create.l HWIO_QDSP6SS_L2VIC_INT_STATUS8_ADDR A:0xfc9103a0
y.create.l HWIO_QDSP6SS_L2VIC_INT_STATUS9_ADDR A:0xfc9103a4
y.create.l HWIO_QDSP6SS_L2VIC_INT_CLEAR0_ADDR A:0xfc910400
y.create.l HWIO_QDSP6SS_L2VIC_INT_CLEAR1_ADDR A:0xfc910404
y.create.l HWIO_QDSP6SS_L2VIC_INT_CLEAR2_ADDR A:0xfc910408
y.create.l HWIO_QDSP6SS_L2VIC_INT_CLEAR3_ADDR A:0xfc91040c
y.create.l HWIO_QDSP6SS_L2VIC_INT_CLEAR4_ADDR A:0xfc910410
y.create.l HWIO_QDSP6SS_L2VIC_INT_CLEAR5_ADDR A:0xfc910414
y.create.l HWIO_QDSP6SS_L2VIC_INT_CLEAR6_ADDR A:0xfc910418
y.create.l HWIO_QDSP6SS_L2VIC_INT_CLEAR7_ADDR A:0xfc91041c
y.create.l HWIO_QDSP6SS_L2VIC_INT_CLEAR8_ADDR A:0xfc910420
y.create.l HWIO_QDSP6SS_L2VIC_INT_CLEAR9_ADDR A:0xfc910424
y.create.l HWIO_QDSP6SS_L2VIC_SOFT_INT0_ADDR A:0xfc910480
y.create.l HWIO_QDSP6SS_L2VIC_SOFT_INT1_ADDR A:0xfc910484
y.create.l HWIO_QDSP6SS_L2VIC_SOFT_INT2_ADDR A:0xfc910488
y.create.l HWIO_QDSP6SS_L2VIC_SOFT_INT3_ADDR A:0xfc91048c
y.create.l HWIO_QDSP6SS_L2VIC_SOFT_INT4_ADDR A:0xfc910490
y.create.l HWIO_QDSP6SS_L2VIC_SOFT_INT5_ADDR A:0xfc910494
y.create.l HWIO_QDSP6SS_L2VIC_SOFT_INT6_ADDR A:0xfc910498
y.create.l HWIO_QDSP6SS_L2VIC_SOFT_INT7_ADDR A:0xfc91049c
y.create.l HWIO_QDSP6SS_L2VIC_SOFT_INT8_ADDR A:0xfc9104a0
y.create.l HWIO_QDSP6SS_L2VIC_SOFT_INT9_ADDR A:0xfc9104a4
y.create.l HWIO_QDSP6SS_L2VIC_INT_PENDING0_ADDR A:0xfc910500
y.create.l HWIO_QDSP6SS_L2VIC_INT_PENDING1_ADDR A:0xfc910504
y.create.l HWIO_QDSP6SS_L2VIC_INT_PENDING2_ADDR A:0xfc910508
y.create.l HWIO_QDSP6SS_L2VIC_INT_PENDING3_ADDR A:0xfc91050c
y.create.l HWIO_QDSP6SS_L2VIC_INT_PENDING4_ADDR A:0xfc910510
y.create.l HWIO_QDSP6SS_L2VIC_INT_PENDING5_ADDR A:0xfc910514
y.create.l HWIO_QDSP6SS_L2VIC_INT_PENDING6_ADDR A:0xfc910518
y.create.l HWIO_QDSP6SS_L2VIC_INT_PENDING7_ADDR A:0xfc91051c
y.create.l HWIO_QDSP6SS_L2VIC_INT_PENDING8_ADDR A:0xfc910520
y.create.l HWIO_QDSP6SS_L2VIC_INT_PENDING9_ADDR A:0xfc910524
y.create.l HWIO_QDSP6SS_QTMR_AC_CNTFRQ_ADDR A:0xfc920000
y.create.l HWIO_QDSP6SS_QTMR_AC_CNTSR_ADDR A:0xfc920004
y.create.l HWIO_QDSP6SS_QTMR_AC_CNTTID_ADDR A:0xfc920008
y.create.l HWIO_QDSP6SS_QTMR_AC_CNTACR_0_ADDR A:0xfc920040
y.create.l HWIO_QDSP6SS_QTMR_AC_CNTACR_1_ADDR A:0xfc920044
y.create.l HWIO_QDSP6SS_QTMR_AC_CNTACR_2_ADDR A:0xfc920048
y.create.l HWIO_QDSP6SS_QTMR_AC_CNTVOFF_LO_0_ADDR A:0xfc920080
y.create.l HWIO_QDSP6SS_QTMR_AC_CNTVOFF_LO_1_ADDR A:0xfc920088
y.create.l HWIO_QDSP6SS_QTMR_AC_CNTVOFF_LO_2_ADDR A:0xfc920090
y.create.l HWIO_QDSP6SS_QTMR_AC_CNTVOFF_HI_0_ADDR A:0xfc920084
y.create.l HWIO_QDSP6SS_QTMR_AC_CNTVOFF_HI_1_ADDR A:0xfc92008c
y.create.l HWIO_QDSP6SS_QTMR_AC_CNTVOFF_HI_2_ADDR A:0xfc920094
y.create.l HWIO_QDSP6SS_QTMR_AC_VERSION_ADDR A:0xfc920fd0
y.create.l HWIO_QDSP6SS_QTMR_V1_CNTPCT_LO_0_ADDR A:0xfc921000
y.create.l HWIO_QDSP6SS_QTMR_V1_CNTPCT_HI_0_ADDR A:0xfc921004
y.create.l HWIO_QDSP6SS_QTMR_V1_CNTVCT_LO_0_ADDR A:0xfc921008
y.create.l HWIO_QDSP6SS_QTMR_V1_CNTVCT_HI_0_ADDR A:0xfc92100c
y.create.l HWIO_QDSP6SS_QTMR_V1_CNTFRQ_0_ADDR A:0xfc921010
y.create.l HWIO_QDSP6SS_QTMR_V1_CNTPL0ACR_0_ADDR A:0xfc921014
y.create.l HWIO_QDSP6SS_QTMR_V1_CNTVOFF_LO_0_ADDR A:0xfc921018
y.create.l HWIO_QDSP6SS_QTMR_V1_CNTVOFF_HI_0_ADDR A:0xfc92101c
y.create.l HWIO_QDSP6SS_QTMR_V1_CNTP_CVAL_LO_0_ADDR A:0xfc921020
y.create.l HWIO_QDSP6SS_QTMR_V1_CNTP_CVAL_HI_0_ADDR A:0xfc921024
y.create.l HWIO_QDSP6SS_QTMR_V1_CNTP_TVAL_0_ADDR A:0xfc921028
y.create.l HWIO_QDSP6SS_QTMR_V1_CNTP_CTL_0_ADDR A:0xfc92102c
y.create.l HWIO_QDSP6SS_QTMR_V1_CNTV_CVAL_LO_0_ADDR A:0xfc921030
y.create.l HWIO_QDSP6SS_QTMR_V1_CNTV_CVAL_HI_0_ADDR A:0xfc921034
y.create.l HWIO_QDSP6SS_QTMR_V1_CNTV_TVAL_0_ADDR A:0xfc921038
y.create.l HWIO_QDSP6SS_QTMR_V1_CNTV_CTL_0_ADDR A:0xfc92103c
y.create.l HWIO_QDSP6SS_QTMR_V1_VERSION_0_ADDR A:0xfc921fd0
y.create.l HWIO_QDSP6SS_QTMR_V1_CNTPCT_LO_1_ADDR A:0xfc922000
y.create.l HWIO_QDSP6SS_QTMR_V1_CNTPCT_HI_1_ADDR A:0xfc922004
y.create.l HWIO_QDSP6SS_QTMR_V1_CNTVCT_LO_1_ADDR A:0xfc922008
y.create.l HWIO_QDSP6SS_QTMR_V1_CNTVCT_HI_1_ADDR A:0xfc92200c
y.create.l HWIO_QDSP6SS_QTMR_V1_CNTFRQ_1_ADDR A:0xfc922010
y.create.l HWIO_QDSP6SS_QTMR_V1_CNTPL0ACR_1_ADDR A:0xfc922014
y.create.l HWIO_QDSP6SS_QTMR_V1_CNTVOFF_LO_1_ADDR A:0xfc922018
y.create.l HWIO_QDSP6SS_QTMR_V1_CNTVOFF_HI_1_ADDR A:0xfc92201c
y.create.l HWIO_QDSP6SS_QTMR_V1_CNTP_CVAL_LO_1_ADDR A:0xfc922020
y.create.l HWIO_QDSP6SS_QTMR_V1_CNTP_CVAL_HI_1_ADDR A:0xfc922024
y.create.l HWIO_QDSP6SS_QTMR_V1_CNTP_TVAL_1_ADDR A:0xfc922028
y.create.l HWIO_QDSP6SS_QTMR_V1_CNTP_CTL_1_ADDR A:0xfc92202c
y.create.l HWIO_QDSP6SS_QTMR_V1_CNTV_CVAL_LO_1_ADDR A:0xfc922030
y.create.l HWIO_QDSP6SS_QTMR_V1_CNTV_CVAL_HI_1_ADDR A:0xfc922034
y.create.l HWIO_QDSP6SS_QTMR_V1_CNTV_TVAL_1_ADDR A:0xfc922038
y.create.l HWIO_QDSP6SS_QTMR_V1_CNTV_CTL_1_ADDR A:0xfc92203c
y.create.l HWIO_QDSP6SS_QTMR_V1_VERSION_1_ADDR A:0xfc922fd0
y.create.l HWIO_QDSP6SS_QTMR_V1_CNTPCT_LO_2_ADDR A:0xfc923000
y.create.l HWIO_QDSP6SS_QTMR_V1_CNTPCT_HI_2_ADDR A:0xfc923004
y.create.l HWIO_QDSP6SS_QTMR_V1_CNTVCT_LO_2_ADDR A:0xfc923008
y.create.l HWIO_QDSP6SS_QTMR_V1_CNTVCT_HI_2_ADDR A:0xfc92300c
y.create.l HWIO_QDSP6SS_QTMR_V1_CNTFRQ_2_ADDR A:0xfc923010
y.create.l HWIO_QDSP6SS_QTMR_V1_CNTPL0ACR_2_ADDR A:0xfc923014
y.create.l HWIO_QDSP6SS_QTMR_V1_CNTVOFF_LO_2_ADDR A:0xfc923018
y.create.l HWIO_QDSP6SS_QTMR_V1_CNTVOFF_HI_2_ADDR A:0xfc92301c
y.create.l HWIO_QDSP6SS_QTMR_V1_CNTP_CVAL_LO_2_ADDR A:0xfc923020
y.create.l HWIO_QDSP6SS_QTMR_V1_CNTP_CVAL_HI_2_ADDR A:0xfc923024
y.create.l HWIO_QDSP6SS_QTMR_V1_CNTP_TVAL_2_ADDR A:0xfc923028
y.create.l HWIO_QDSP6SS_QTMR_V1_CNTP_CTL_2_ADDR A:0xfc92302c
y.create.l HWIO_QDSP6SS_QTMR_V1_CNTV_CVAL_LO_2_ADDR A:0xfc923030
y.create.l HWIO_QDSP6SS_QTMR_V1_CNTV_CVAL_HI_2_ADDR A:0xfc923034
y.create.l HWIO_QDSP6SS_QTMR_V1_CNTV_TVAL_2_ADDR A:0xfc923038
y.create.l HWIO_QDSP6SS_QTMR_V1_CNTV_CTL_2_ADDR A:0xfc92303c
y.create.l HWIO_QDSP6SS_QTMR_V1_VERSION_2_ADDR A:0xfc923fd0
y.create.l HWIO_QDSP6SS_SAW2_SECURE_ADDR A:0xfc930000
y.create.l HWIO_QDSP6SS_SAW2_ID_ADDR A:0xfc930004
y.create.l HWIO_QDSP6SS_SAW2_CFG_ADDR A:0xfc930008
y.create.l HWIO_QDSP6SS_SAW2_SPM_STS_ADDR A:0xfc93000c
y.create.l HWIO_QDSP6SS_SAW2_AVS_STS_ADDR A:0xfc930010
y.create.l HWIO_QDSP6SS_SAW2_PMIC_STS_ADDR A:0xfc930014
y.create.l HWIO_QDSP6SS_SAW2_RST_ADDR A:0xfc930018
y.create.l HWIO_QDSP6SS_SAW2_VCTL_ADDR A:0xfc93001c
y.create.l HWIO_QDSP6SS_SAW2_AVS_CTL_ADDR A:0xfc930020
y.create.l HWIO_QDSP6SS_SAW2_AVS_LIMIT_ADDR A:0xfc930024
y.create.l HWIO_QDSP6SS_SAW2_AVS_DLY_ADDR A:0xfc930028
y.create.l HWIO_QDSP6SS_SAW2_AVS_HYSTERESIS_ADDR A:0xfc93002c
y.create.l HWIO_QDSP6SS_SAW2_SPM_CTL_ADDR A:0xfc930030
y.create.l HWIO_QDSP6SS_SAW2_SPM_DLY_ADDR A:0xfc930034
y.create.l HWIO_QDSP6SS_SAW2_SPM_SLP_SEQ_ENTRY_0_ADDR A:0xfc930080
y.create.l HWIO_QDSP6SS_SAW2_SPM_SLP_SEQ_ENTRY_1_ADDR A:0xfc930084
y.create.l HWIO_QDSP6SS_SAW2_SPM_SLP_SEQ_ENTRY_2_ADDR A:0xfc930088
y.create.l HWIO_QDSP6SS_SAW2_SPM_SLP_SEQ_ENTRY_3_ADDR A:0xfc93008c
y.create.l HWIO_QDSP6SS_SAW2_SPM_SLP_SEQ_ENTRY_4_ADDR A:0xfc930090
y.create.l HWIO_QDSP6SS_SAW2_SPM_SLP_SEQ_ENTRY_5_ADDR A:0xfc930094
y.create.l HWIO_QDSP6SS_SAW2_SPM_SLP_SEQ_ENTRY_6_ADDR A:0xfc930098
y.create.l HWIO_QDSP6SS_SAW2_SPM_SLP_SEQ_ENTRY_7_ADDR A:0xfc93009c
y.create.l HWIO_QDSP6SS_SAW2_SPM_SLP_SEQ_ENTRY_8_ADDR A:0xfc9300a0
y.create.l HWIO_QDSP6SS_SAW2_SPM_SLP_SEQ_ENTRY_9_ADDR A:0xfc9300a4
y.create.l HWIO_QDSP6SS_SAW2_SPM_PMIC_DATA_0_ADDR A:0xfc930040
y.create.l HWIO_QDSP6SS_SAW2_SPM_PMIC_DATA_1_ADDR A:0xfc930044
y.create.l HWIO_QDSP6SS_SAW2_SPM_PMIC_DATA_2_ADDR A:0xfc930048
y.create.l HWIO_QDSP6SS_SAW2_VERSION_ADDR A:0xfc930fd0
y.create.l HWIO_MSS_ENABLE_ADDR A:0xfc980000
y.create.l HWIO_MSS_CLAMP_MEM_ADDR A:0xfc980004
y.create.l HWIO_MSS_CLAMP_IO_ADDR A:0xfc980008
y.create.l HWIO_MSS_BUS_AHB2AHB_CFG_ADDR A:0xfc98000c
y.create.l HWIO_MSS_BUS_MAXI2AXI_CFG_ADDR A:0xfc980010
y.create.l HWIO_MSS_CUSTOM_MEM_ARRSTBYN_ADDR A:0xfc980014
y.create.l HWIO_MSS_ANALOG_IP_TEST_CTL_ADDR A:0xfc980018
y.create.l HWIO_MSS_ATB_ID_ADDR A:0xfc98001c
y.create.l HWIO_MSS_DBG_BUS_CTL_ADDR A:0xfc980020
y.create.l HWIO_MSS_AHB_ACCESS_ERR_IRQ_EN_ADDR A:0xfc980024
y.create.l HWIO_MSS_AHB_ACCESS_ERR_IRQ_STATUS_ADDR A:0xfc980028
y.create.l HWIO_MSS_AHB_ACCESS_ERR_IRQ_CLR_ADDR A:0xfc98002c
y.create.l HWIO_MSS_BUS_CTL_CFG_ADDR A:0xfc980030
y.create.l HWIO_MSS_RELAY_MSG_SHADOW0_ADDR A:0xfc980034
y.create.l HWIO_MSS_RELAY_MSG_SHADOW1_ADDR A:0xfc980038
y.create.l HWIO_MSS_RELAY_MSG_SHADOW2_ADDR A:0xfc98003c
y.create.l HWIO_MSS_RELAY_MSG_SHADOW3_ADDR A:0xfc980040
y.create.l HWIO_MSS_RELAY_MSG_SHADOW4_ADDR A:0xfc980044
y.create.l HWIO_MSS_RELAY_MSG_SHADOW5_ADDR A:0xfc980048
y.create.l HWIO_MSS_RELAY_MSG_SHADOW6_ADDR A:0xfc98004c
y.create.l HWIO_MSS_RELAY_MSG_SHADOW7_ADDR A:0xfc980050
y.create.l HWIO_MSS_RELAY_MSG_SHADOW8_ADDR A:0xfc980054
y.create.l HWIO_MSS_MSA_ADDR A:0xfc980058
y.create.l HWIO_MSS_HW_VERSION_ADDR A:0xfc98005c
y.create.l HWIO_MSS_DIME_MEM_SLP_CNTL_ADDR A:0xfc980060
y.create.l HWIO_MSS_CLOCK_SPDM_MON_ADDR A:0xfc980064
y.create.l HWIO_MSS_BBRX0_MUX_SEL_ADDR A:0xfc980068
y.create.l HWIO_MSS_BBRX1_MUX_SEL_ADDR A:0xfc98006c
y.create.l HWIO_MSS_BBRX2_MUX_SEL_ADDR A:0xfc980070
y.create.l HWIO_MSS_BBRX3_MUX_SEL_ADDR A:0xfc980074
y.create.l HWIO_MSS_DEBUG_CLOCK_CTL_ADDR A:0xfc980078
y.create.l HWIO_MSS_BBRX_EXT_CLOCK_MUX_SEL_ADDR A:0xfc98007c
y.create.l HWIO_MSS_DSM_PHASE_HIGHZ_ENABLE_ADDR A:0xfc980080
y.create.l HWIO_MSS_GNSSADC_BIST_CONFIG_ADDR A:0xfc980084
y.create.l HWIO_MSS_GNSSADC_BIST_STATUS_1_ADDR A:0xfc980088
y.create.l HWIO_MSS_GNSSADC_BIST_STATUS_2_ADDR A:0xfc98008c
y.create.l HWIO_MSS_GNSSADC_BIST_STATUS_3_ADDR A:0xfc980090
y.create.l HWIO_MSS_BBRX_CTL_ADDR A:0xfc980094
y.create.l HWIO_MSS_DEBUG_CTL_ADDR A:0xfc980098
y.create.l HWIO_MSS_MPLL0_MODE_ADDR A:0xfc981000
y.create.l HWIO_MSS_MPLL0_L_VAL_ADDR A:0xfc981004
y.create.l HWIO_MSS_MPLL0_M_VAL_ADDR A:0xfc981008
y.create.l HWIO_MSS_MPLL0_N_VAL_ADDR A:0xfc98100c
y.create.l HWIO_MSS_MPLL0_USER_CTL_ADDR A:0xfc981010
y.create.l HWIO_MSS_MPLL0_CONFIG_CTL_ADDR A:0xfc981014
y.create.l HWIO_MSS_MPLL0_TEST_CTL_ADDR A:0xfc981018
y.create.l HWIO_MSS_MPLL0_STATUS_ADDR A:0xfc98101c
y.create.l HWIO_MSS_MPLL1_MODE_ADDR A:0xfc981020
y.create.l HWIO_MSS_MPLL1_L_VAL_ADDR A:0xfc981024
y.create.l HWIO_MSS_MPLL1_M_VAL_ADDR A:0xfc981028
y.create.l HWIO_MSS_MPLL1_N_VAL_ADDR A:0xfc98102c
y.create.l HWIO_MSS_MPLL1_USER_CTL_ADDR A:0xfc981030
y.create.l HWIO_MSS_MPLL1_CONFIG_CTL_ADDR A:0xfc981034
y.create.l HWIO_MSS_MPLL1_TEST_CTL_ADDR A:0xfc981038
y.create.l HWIO_MSS_MPLL1_STATUS_ADDR A:0xfc98103c
y.create.l HWIO_MSS_MPLL2_MODE_ADDR A:0xfc981040
y.create.l HWIO_MSS_MPLL2_L_VAL_ADDR A:0xfc981044
y.create.l HWIO_MSS_MPLL2_M_VAL_ADDR A:0xfc981048
y.create.l HWIO_MSS_MPLL2_N_VAL_ADDR A:0xfc98104c
y.create.l HWIO_MSS_MPLL2_USER_CTL_ADDR A:0xfc981050
y.create.l HWIO_MSS_MPLL2_CONFIG_CTL_ADDR A:0xfc981054
y.create.l HWIO_MSS_MPLL2_TEST_CTL_ADDR A:0xfc981058
y.create.l HWIO_MSS_MPLL2_STATUS_ADDR A:0xfc98105c
y.create.l HWIO_MSS_UIM0_BCR_ADDR A:0xfc981060
y.create.l HWIO_MSS_UIM1_BCR_ADDR A:0xfc981064
y.create.l HWIO_MSS_Q6SS_BCR_ADDR A:0xfc981068
y.create.l HWIO_MSS_NC_HM_BCR_ADDR A:0xfc98106c
y.create.l HWIO_MSS_RBCPR_BCR_ADDR A:0xfc981070
y.create.l HWIO_MSS_COXM_BCR_ADDR A:0xfc981074
y.create.l HWIO_MSS_UIM0_CBCR_ADDR A:0xfc981078
y.create.l HWIO_MSS_UIM1_CBCR_ADDR A:0xfc98107c
y.create.l HWIO_MSS_XO_UIM0_CBCR_ADDR A:0xfc981080
y.create.l HWIO_MSS_XO_UIM1_CBCR_ADDR A:0xfc981084
y.create.l HWIO_MSS_XO_MODEM_CX_TO_LS_CBCR_ADDR A:0xfc981088
y.create.l HWIO_MSS_XO_Q6_CBCR_ADDR A:0xfc98108c
y.create.l HWIO_MSS_BUS_UIM0_CBCR_ADDR A:0xfc981090
y.create.l HWIO_MSS_BUS_UIM1_CBCR_ADDR A:0xfc981094
y.create.l HWIO_MSS_BUS_CSR_CBCR_ADDR A:0xfc981098
y.create.l HWIO_MSS_BUS_BRIDGE_CBCR_ADDR A:0xfc98109c
y.create.l HWIO_MSS_BUS_MODEM_CX_TO_LS_CBCR_ADDR A:0xfc9810a0
y.create.l HWIO_MSS_BUS_Q6_CBCR_ADDR A:0xfc9810a4
y.create.l HWIO_MSS_BUS_NC_HM_BRIDGE_CBCR_ADDR A:0xfc9810a8
y.create.l HWIO_MSS_BUS_CRYPTO_CBCR_ADDR A:0xfc9810ac
y.create.l HWIO_MSS_BUS_NAV_CBCR_ADDR A:0xfc9810b0
y.create.l HWIO_MSS_BUS_NC_HM_BRIDGE_CX_CBCR_ADDR A:0xfc9810b4
y.create.l HWIO_MSS_BUS_ATB_CBCR_ADDR A:0xfc9810b8
y.create.l HWIO_MSS_BUS_COXM_CBCR_ADDR A:0xfc9810bc
y.create.l HWIO_MSS_BUS_MODEM_BRIDGE_CX_CBCR_ADDR A:0xfc9810c0
y.create.l HWIO_MSS_BUS_SLAVE_TIMEOUT_CBCR_ADDR A:0xfc9810c4
y.create.l HWIO_MSS_BUS_RBCPR_CBCR_ADDR A:0xfc9810c8
y.create.l HWIO_MSS_BUS_COMBODAC_COMP_CBCR_ADDR A:0xfc9810cc
y.create.l HWIO_MSS_BUS_RBCPR_REF_CBCR_ADDR A:0xfc9810d0
y.create.l HWIO_MSS_MODEM_CFG_AHB_CBCR_ADDR A:0xfc9810d4
y.create.l HWIO_MSS_MODEM_SNOC_AXI_CBCR_ADDR A:0xfc9810d8
y.create.l HWIO_MSS_NAV_SNOC_AXI_CBCR_ADDR A:0xfc9810dc
y.create.l HWIO_MSS_VMIDMT_SNOC_AXI_CBCR_ADDR A:0xfc9810e0
y.create.l HWIO_MSS_MPLL0_MAIN_MODEM_CX_TO_LS_CBCR_ADDR A:0xfc9810e4
y.create.l HWIO_MSS_MPLL1_MAIN_CBCR_ADDR A:0xfc9810e8
y.create.l HWIO_MSS_MPLL1_MAIN_BUS_CBCR_ADDR A:0xfc9810ec
y.create.l HWIO_MSS_MPLL1_EARLY_DIV5_CBCR_ADDR A:0xfc9810f0
y.create.l HWIO_MSS_MPLL1_EARLY_DIV3_CBCR_ADDR A:0xfc9810f4
y.create.l HWIO_MSS_BIT_COXM_CBCR_ADDR A:0xfc9810f8
y.create.l HWIO_MSS_SLEEP_Q6_CBCR_ADDR A:0xfc9810fc
y.create.l HWIO_MSS_MPLL1_OUT_EARLY_DIV3_CBCR_ADDR A:0xfc981100
y.create.l HWIO_MSS_MPLL1_OUT_EARLY_DIV5_CBCR_ADDR A:0xfc981104
y.create.l HWIO_MSS_BUS_CMD_RCGR_ADDR A:0xfc981108
y.create.l HWIO_MSS_BUS_CFG_RCGR_ADDR A:0xfc98110c
y.create.l HWIO_MSS_Q6_CMD_RCGR_ADDR A:0xfc981110
y.create.l HWIO_MSS_Q6_CFG_RCGR_ADDR A:0xfc981114
y.create.l HWIO_MSS_UIM_CMD_RCGR_ADDR A:0xfc981118
y.create.l HWIO_MSS_UIM_CFG_RCGR_ADDR A:0xfc98111c
y.create.l HWIO_MSS_BBRX0_ACGC_ADDR A:0xfc981120
y.create.l HWIO_MSS_BBRX1_ACGC_ADDR A:0xfc981124
y.create.l HWIO_MSS_BBRX2_ACGC_ADDR A:0xfc981128
y.create.l HWIO_MSS_BBRX3_ACGC_ADDR A:0xfc98112c
y.create.l HWIO_MSS_RESERVE_01_ADDR A:0xfc981130
y.create.l HWIO_MSS_RESERVE_02_ADDR A:0xfc981134
y.create.l HWIO_MSS_BBRX0_MISC_ADDR A:0xfc981138
y.create.l HWIO_MSS_BBRX1_MISC_ADDR A:0xfc98113c
y.create.l HWIO_MSS_BBRX2_MISC_ADDR A:0xfc981140
y.create.l HWIO_MSS_BBRX3_MISC_ADDR A:0xfc981144
y.create.l HWIO_MSS_BIT_COXM_DIV_MISC_ADDR A:0xfc981148
y.create.l HWIO_MSS_BUS_RBCPR_REF_DIV_MISC_ADDR A:0xfc98114c
y.create.l HWIO_MSS_UIM0_MND_CMD_RCGR_ADDR A:0xfc981150
y.create.l HWIO_MSS_UIM0_MND_CFG_RCGR_ADDR A:0xfc981154
y.create.l HWIO_MSS_UIM0_MND_M_ADDR A:0xfc981158
y.create.l HWIO_MSS_UIM0_MND_N_ADDR A:0xfc98115c
y.create.l HWIO_MSS_UIM0_MND_D_ADDR A:0xfc981160
y.create.l HWIO_MSS_UIM1_MND_CMD_RCGR_ADDR A:0xfc981164
y.create.l HWIO_MSS_UIM1_MND_CFG_RCGR_ADDR A:0xfc981168
y.create.l HWIO_MSS_UIM1_MND_M_ADDR A:0xfc98116c
y.create.l HWIO_MSS_UIM1_MND_N_ADDR A:0xfc981170
y.create.l HWIO_MSS_UIM1_MND_D_ADDR A:0xfc981174
y.create.l HWIO_MSS_TCSR_ACC_SEL_ADDR A:0xfc98f000
y.create.l HWIO_MSS_UIM0_UART_DM_MR1_ADDR A:0xfc990000
y.create.l HWIO_MSS_UIM0_UART_DM_MR2_ADDR A:0xfc990004
y.create.l HWIO_MSS_UIM0_UART_DM_CSR_SR_DEPRECATED_ADDR A:0xfc990008
y.create.l HWIO_MSS_UIM0_UART_DM_CR_MISR_DEPRECATED_ADDR A:0xfc990010
y.create.l HWIO_MSS_UIM0_UART_DM_IMR_ISR_DEPRECATED_ADDR A:0xfc990014
y.create.l HWIO_MSS_UIM0_UART_DM_IPR_ADDR A:0xfc990018
y.create.l HWIO_MSS_UIM0_UART_DM_TFWR_ADDR A:0xfc99001c
y.create.l HWIO_MSS_UIM0_UART_DM_RFWR_ADDR A:0xfc990020
y.create.l HWIO_MSS_UIM0_UART_DM_HCR_ADDR A:0xfc990024
y.create.l HWIO_MSS_UIM0_UART_DM_DMRX_ADDR A:0xfc990034
y.create.l HWIO_MSS_UIM0_UART_DM_IRDA_RX_TOTAL_SNAP_DEPRECATED_ADDR A:0xfc990038
y.create.l HWIO_MSS_UIM0_UART_DM_DMEN_ADDR A:0xfc99003c
y.create.l HWIO_MSS_UIM0_UART_DM_NO_CHARS_FOR_TX_ADDR A:0xfc990040
y.create.l HWIO_MSS_UIM0_UART_DM_BADR_ADDR A:0xfc990044
y.create.l HWIO_MSS_UIM0_UART_DM_TESTSL_ADDR A:0xfc990048
y.create.l HWIO_MSS_UIM0_UART_DM_TXFS_ADDR A:0xfc99004c
y.create.l HWIO_MSS_UIM0_UART_DM_RXFS_ADDR A:0xfc990050
y.create.l HWIO_MSS_UIM0_UART_DM_MISR_MODE_ADDR A:0xfc990060
y.create.l HWIO_MSS_UIM0_UART_DM_MISR_RESET_ADDR A:0xfc990064
y.create.l HWIO_MSS_UIM0_UART_DM_MISR_EXPORT_ADDR A:0xfc990068
y.create.l HWIO_MSS_UIM0_UART_DM_MISR_VAL_ADDR A:0xfc99006c
y.create.l HWIO_MSS_UIM0_UART_DM_TF_RF_DEPRECATED_ADDR A:0xfc990070
y.create.l HWIO_MSS_UIM0_UART_DM_TF_RF_2_DEPRECATED_ADDR A:0xfc990074
y.create.l HWIO_MSS_UIM0_UART_DM_TF_RF_3_DEPRECATED_ADDR A:0xfc990078
y.create.l HWIO_MSS_UIM0_UART_DM_TF_RF_4_DEPRECATED_ADDR A:0xfc99007c
y.create.l HWIO_MSS_UIM0_UART_DM_SIM_CFG_ADDR A:0xfc990080
y.create.l HWIO_MSS_UIM0_UART_DM_TEST_WR_ADDR_ADDR A:0xfc990084
y.create.l HWIO_MSS_UIM0_UART_DM_TEST_WR_DATA_ADDR A:0xfc990088
y.create.l HWIO_MSS_UIM0_UART_DM_TEST_RD_ADDR_ADDR A:0xfc99008c
y.create.l HWIO_MSS_UIM0_UART_DM_TEST_RD_DATA_ADDR A:0xfc990090
y.create.l HWIO_MSS_UIM0_UART_DM_CSR_ADDR A:0xfc9900a0
y.create.l HWIO_MSS_UIM0_UART_DM_SR_ADDR A:0xfc9900a4
y.create.l HWIO_MSS_UIM0_UART_DM_CR_ADDR A:0xfc9900a8
y.create.l HWIO_MSS_UIM0_UART_DM_MISR_ADDR A:0xfc9900ac
y.create.l HWIO_MSS_UIM0_UART_DM_IMR_ADDR A:0xfc9900b0
y.create.l HWIO_MSS_UIM0_UART_DM_ISR_ADDR A:0xfc9900b4
y.create.l HWIO_MSS_UIM0_UART_DM_IRDA_ADDR A:0xfc9900b8
y.create.l HWIO_MSS_UIM0_UART_DM_RX_TOTAL_SNAP_ADDR A:0xfc9900bc
y.create.l HWIO_MSS_UIM0_UART_DM_WWT_TIMEOUT_ADDR A:0xfc9900c0
y.create.l HWIO_MSS_UIM0_UART_DM_CLK_CTRL_ADDR A:0xfc9900c4
y.create.l HWIO_MSS_UIM0_UART_DM_BCR_ADDR A:0xfc9900c8
y.create.l HWIO_MSS_UIM0_UART_DM_RX_TRANS_CTRL_ADDR A:0xfc9900cc
y.create.l HWIO_MSS_UIM0_UART_DM_DMRX_DBG_ADDR A:0xfc9900d0
y.create.l HWIO_MSS_UIM0_UART_DM_FSM_STATUS_ADDR A:0xfc9900d4
y.create.l HWIO_MSS_UIM0_UART_DM_HW_VERSION_ADDR A:0xfc9900d8
y.create.l HWIO_MSS_UIM0_UART_DM_GENERICS_ADDR A:0xfc9900dc
y.create.l HWIO_MSS_UIM0_UART_DM_TF_ADDR A:0xfc990100
y.create.l HWIO_MSS_UIM0_UART_DM_TF_2_ADDR A:0xfc990104
y.create.l HWIO_MSS_UIM0_UART_DM_TF_3_ADDR A:0xfc990108
y.create.l HWIO_MSS_UIM0_UART_DM_TF_4_ADDR A:0xfc99010c
y.create.l HWIO_MSS_UIM0_UART_DM_TF_5_ADDR A:0xfc990110
y.create.l HWIO_MSS_UIM0_UART_DM_TF_6_ADDR A:0xfc990114
y.create.l HWIO_MSS_UIM0_UART_DM_TF_7_ADDR A:0xfc990118
y.create.l HWIO_MSS_UIM0_UART_DM_TF_8_ADDR A:0xfc99011c
y.create.l HWIO_MSS_UIM0_UART_DM_TF_9_ADDR A:0xfc990120
y.create.l HWIO_MSS_UIM0_UART_DM_TF_10_ADDR A:0xfc990124
y.create.l HWIO_MSS_UIM0_UART_DM_TF_11_ADDR A:0xfc990128
y.create.l HWIO_MSS_UIM0_UART_DM_TF_12_ADDR A:0xfc99012c
y.create.l HWIO_MSS_UIM0_UART_DM_TF_13_ADDR A:0xfc990130
y.create.l HWIO_MSS_UIM0_UART_DM_TF_14_ADDR A:0xfc990134
y.create.l HWIO_MSS_UIM0_UART_DM_TF_15_ADDR A:0xfc990138
y.create.l HWIO_MSS_UIM0_UART_DM_TF_16_ADDR A:0xfc99013c
y.create.l HWIO_MSS_UIM0_UART_DM_RF_ADDR A:0xfc990140
y.create.l HWIO_MSS_UIM0_UART_DM_RF_2_ADDR A:0xfc990144
y.create.l HWIO_MSS_UIM0_UART_DM_RF_3_ADDR A:0xfc990148
y.create.l HWIO_MSS_UIM0_UART_DM_RF_4_ADDR A:0xfc99014c
y.create.l HWIO_MSS_UIM0_UART_DM_RF_5_ADDR A:0xfc990150
y.create.l HWIO_MSS_UIM0_UART_DM_RF_6_ADDR A:0xfc990154
y.create.l HWIO_MSS_UIM0_UART_DM_RF_7_ADDR A:0xfc990158
y.create.l HWIO_MSS_UIM0_UART_DM_RF_8_ADDR A:0xfc99015c
y.create.l HWIO_MSS_UIM0_UART_DM_RF_9_ADDR A:0xfc990160
y.create.l HWIO_MSS_UIM0_UART_DM_RF_10_ADDR A:0xfc990164
y.create.l HWIO_MSS_UIM0_UART_DM_RF_11_ADDR A:0xfc990168
y.create.l HWIO_MSS_UIM0_UART_DM_RF_12_ADDR A:0xfc99016c
y.create.l HWIO_MSS_UIM0_UART_DM_RF_13_ADDR A:0xfc990170
y.create.l HWIO_MSS_UIM0_UART_DM_RF_14_ADDR A:0xfc990174
y.create.l HWIO_MSS_UIM0_UART_DM_RF_15_ADDR A:0xfc990178
y.create.l HWIO_MSS_UIM0_UART_DM_RF_16_ADDR A:0xfc99017c
y.create.l HWIO_MSS_UIM0_UART_DM_UIM_CFG_ADDR A:0xfc990180
y.create.l HWIO_MSS_UIM0_UART_DM_UIM_CMD_ADDR A:0xfc990184
y.create.l HWIO_MSS_UIM0_UART_DM_UIM_IO_STATUS_ADDR A:0xfc990188
y.create.l HWIO_MSS_UIM0_UART_DM_UIM_IRQ_ISR_ADDR A:0xfc99018c
y.create.l HWIO_MSS_UIM0_UART_DM_UIM_IRQ_MISR_ADDR A:0xfc990190
y.create.l HWIO_MSS_UIM0_UART_DM_UIM_IRQ_CLR_ADDR A:0xfc990194
y.create.l HWIO_MSS_UIM0_UART_DM_UIM_IRQ_IMR_ADDR A:0xfc990198
y.create.l HWIO_MSS_UIM0_UART_DM_UIM_IRQ_IMR_SET_ADDR A:0xfc99019c
y.create.l HWIO_MSS_UIM0_UART_DM_UIM_IRQ_IMR_CLR_ADDR A:0xfc9901a0
y.create.l HWIO_MSS_UIM1_UART_DM_MR1_ADDR A:0xfc998000
y.create.l HWIO_MSS_UIM1_UART_DM_MR2_ADDR A:0xfc998004
y.create.l HWIO_MSS_UIM1_UART_DM_CSR_SR_DEPRECATED_ADDR A:0xfc998008
y.create.l HWIO_MSS_UIM1_UART_DM_CR_MISR_DEPRECATED_ADDR A:0xfc998010
y.create.l HWIO_MSS_UIM1_UART_DM_IMR_ISR_DEPRECATED_ADDR A:0xfc998014
y.create.l HWIO_MSS_UIM1_UART_DM_IPR_ADDR A:0xfc998018
y.create.l HWIO_MSS_UIM1_UART_DM_TFWR_ADDR A:0xfc99801c
y.create.l HWIO_MSS_UIM1_UART_DM_RFWR_ADDR A:0xfc998020
y.create.l HWIO_MSS_UIM1_UART_DM_HCR_ADDR A:0xfc998024
y.create.l HWIO_MSS_UIM1_UART_DM_DMRX_ADDR A:0xfc998034
y.create.l HWIO_MSS_UIM1_UART_DM_IRDA_RX_TOTAL_SNAP_DEPRECATED_ADDR A:0xfc998038
y.create.l HWIO_MSS_UIM1_UART_DM_DMEN_ADDR A:0xfc99803c
y.create.l HWIO_MSS_UIM1_UART_DM_NO_CHARS_FOR_TX_ADDR A:0xfc998040
y.create.l HWIO_MSS_UIM1_UART_DM_BADR_ADDR A:0xfc998044
y.create.l HWIO_MSS_UIM1_UART_DM_TESTSL_ADDR A:0xfc998048
y.create.l HWIO_MSS_UIM1_UART_DM_TXFS_ADDR A:0xfc99804c
y.create.l HWIO_MSS_UIM1_UART_DM_RXFS_ADDR A:0xfc998050
y.create.l HWIO_MSS_UIM1_UART_DM_MISR_MODE_ADDR A:0xfc998060
y.create.l HWIO_MSS_UIM1_UART_DM_MISR_RESET_ADDR A:0xfc998064
y.create.l HWIO_MSS_UIM1_UART_DM_MISR_EXPORT_ADDR A:0xfc998068
y.create.l HWIO_MSS_UIM1_UART_DM_MISR_VAL_ADDR A:0xfc99806c
y.create.l HWIO_MSS_UIM1_UART_DM_TF_RF_DEPRECATED_ADDR A:0xfc998070
y.create.l HWIO_MSS_UIM1_UART_DM_TF_RF_2_DEPRECATED_ADDR A:0xfc998074
y.create.l HWIO_MSS_UIM1_UART_DM_TF_RF_3_DEPRECATED_ADDR A:0xfc998078
y.create.l HWIO_MSS_UIM1_UART_DM_TF_RF_4_DEPRECATED_ADDR A:0xfc99807c
y.create.l HWIO_MSS_UIM1_UART_DM_SIM_CFG_ADDR A:0xfc998080
y.create.l HWIO_MSS_UIM1_UART_DM_TEST_WR_ADDR_ADDR A:0xfc998084
y.create.l HWIO_MSS_UIM1_UART_DM_TEST_WR_DATA_ADDR A:0xfc998088
y.create.l HWIO_MSS_UIM1_UART_DM_TEST_RD_ADDR_ADDR A:0xfc99808c
y.create.l HWIO_MSS_UIM1_UART_DM_TEST_RD_DATA_ADDR A:0xfc998090
y.create.l HWIO_MSS_UIM1_UART_DM_CSR_ADDR A:0xfc9980a0
y.create.l HWIO_MSS_UIM1_UART_DM_SR_ADDR A:0xfc9980a4
y.create.l HWIO_MSS_UIM1_UART_DM_CR_ADDR A:0xfc9980a8
y.create.l HWIO_MSS_UIM1_UART_DM_MISR_ADDR A:0xfc9980ac
y.create.l HWIO_MSS_UIM1_UART_DM_IMR_ADDR A:0xfc9980b0
y.create.l HWIO_MSS_UIM1_UART_DM_ISR_ADDR A:0xfc9980b4
y.create.l HWIO_MSS_UIM1_UART_DM_IRDA_ADDR A:0xfc9980b8
y.create.l HWIO_MSS_UIM1_UART_DM_RX_TOTAL_SNAP_ADDR A:0xfc9980bc
y.create.l HWIO_MSS_UIM1_UART_DM_WWT_TIMEOUT_ADDR A:0xfc9980c0
y.create.l HWIO_MSS_UIM1_UART_DM_CLK_CTRL_ADDR A:0xfc9980c4
y.create.l HWIO_MSS_UIM1_UART_DM_BCR_ADDR A:0xfc9980c8
y.create.l HWIO_MSS_UIM1_UART_DM_RX_TRANS_CTRL_ADDR A:0xfc9980cc
y.create.l HWIO_MSS_UIM1_UART_DM_DMRX_DBG_ADDR A:0xfc9980d0
y.create.l HWIO_MSS_UIM1_UART_DM_FSM_STATUS_ADDR A:0xfc9980d4
y.create.l HWIO_MSS_UIM1_UART_DM_HW_VERSION_ADDR A:0xfc9980d8
y.create.l HWIO_MSS_UIM1_UART_DM_GENERICS_ADDR A:0xfc9980dc
y.create.l HWIO_MSS_UIM1_UART_DM_TF_ADDR A:0xfc998100
y.create.l HWIO_MSS_UIM1_UART_DM_TF_2_ADDR A:0xfc998104
y.create.l HWIO_MSS_UIM1_UART_DM_TF_3_ADDR A:0xfc998108
y.create.l HWIO_MSS_UIM1_UART_DM_TF_4_ADDR A:0xfc99810c
y.create.l HWIO_MSS_UIM1_UART_DM_TF_5_ADDR A:0xfc998110
y.create.l HWIO_MSS_UIM1_UART_DM_TF_6_ADDR A:0xfc998114
y.create.l HWIO_MSS_UIM1_UART_DM_TF_7_ADDR A:0xfc998118
y.create.l HWIO_MSS_UIM1_UART_DM_TF_8_ADDR A:0xfc99811c
y.create.l HWIO_MSS_UIM1_UART_DM_TF_9_ADDR A:0xfc998120
y.create.l HWIO_MSS_UIM1_UART_DM_TF_10_ADDR A:0xfc998124
y.create.l HWIO_MSS_UIM1_UART_DM_TF_11_ADDR A:0xfc998128
y.create.l HWIO_MSS_UIM1_UART_DM_TF_12_ADDR A:0xfc99812c
y.create.l HWIO_MSS_UIM1_UART_DM_TF_13_ADDR A:0xfc998130
y.create.l HWIO_MSS_UIM1_UART_DM_TF_14_ADDR A:0xfc998134
y.create.l HWIO_MSS_UIM1_UART_DM_TF_15_ADDR A:0xfc998138
y.create.l HWIO_MSS_UIM1_UART_DM_TF_16_ADDR A:0xfc99813c
y.create.l HWIO_MSS_UIM1_UART_DM_RF_ADDR A:0xfc998140
y.create.l HWIO_MSS_UIM1_UART_DM_RF_2_ADDR A:0xfc998144
y.create.l HWIO_MSS_UIM1_UART_DM_RF_3_ADDR A:0xfc998148
y.create.l HWIO_MSS_UIM1_UART_DM_RF_4_ADDR A:0xfc99814c
y.create.l HWIO_MSS_UIM1_UART_DM_RF_5_ADDR A:0xfc998150
y.create.l HWIO_MSS_UIM1_UART_DM_RF_6_ADDR A:0xfc998154
y.create.l HWIO_MSS_UIM1_UART_DM_RF_7_ADDR A:0xfc998158
y.create.l HWIO_MSS_UIM1_UART_DM_RF_8_ADDR A:0xfc99815c
y.create.l HWIO_MSS_UIM1_UART_DM_RF_9_ADDR A:0xfc998160
y.create.l HWIO_MSS_UIM1_UART_DM_RF_10_ADDR A:0xfc998164
y.create.l HWIO_MSS_UIM1_UART_DM_RF_11_ADDR A:0xfc998168
y.create.l HWIO_MSS_UIM1_UART_DM_RF_12_ADDR A:0xfc99816c
y.create.l HWIO_MSS_UIM1_UART_DM_RF_13_ADDR A:0xfc998170
y.create.l HWIO_MSS_UIM1_UART_DM_RF_14_ADDR A:0xfc998174
y.create.l HWIO_MSS_UIM1_UART_DM_RF_15_ADDR A:0xfc998178
y.create.l HWIO_MSS_UIM1_UART_DM_RF_16_ADDR A:0xfc99817c
y.create.l HWIO_MSS_UIM1_UART_DM_UIM_CFG_ADDR A:0xfc998180
y.create.l HWIO_MSS_UIM1_UART_DM_UIM_CMD_ADDR A:0xfc998184
y.create.l HWIO_MSS_UIM1_UART_DM_UIM_IO_STATUS_ADDR A:0xfc998188
y.create.l HWIO_MSS_UIM1_UART_DM_UIM_IRQ_ISR_ADDR A:0xfc99818c
y.create.l HWIO_MSS_UIM1_UART_DM_UIM_IRQ_MISR_ADDR A:0xfc998190
y.create.l HWIO_MSS_UIM1_UART_DM_UIM_IRQ_CLR_ADDR A:0xfc998194
y.create.l HWIO_MSS_UIM1_UART_DM_UIM_IRQ_IMR_ADDR A:0xfc998198
y.create.l HWIO_MSS_UIM1_UART_DM_UIM_IRQ_IMR_SET_ADDR A:0xfc99819c
y.create.l HWIO_MSS_UIM1_UART_DM_UIM_IRQ_IMR_CLR_ADDR A:0xfc9981a0
y.create.l HWIO_MSS_CXM_UART_DM_MR1_ADDR A:0xfc9a0000
y.create.l HWIO_MSS_CXM_UART_DM_MR2_ADDR A:0xfc9a0004
y.create.l HWIO_MSS_CXM_UART_DM_CSR_SR_DEPRECATED_ADDR A:0xfc9a0008
y.create.l HWIO_MSS_CXM_UART_DM_CR_MISR_DEPRECATED_ADDR A:0xfc9a0010
y.create.l HWIO_MSS_CXM_UART_DM_IMR_ISR_DEPRECATED_ADDR A:0xfc9a0014
y.create.l HWIO_MSS_CXM_UART_DM_IPR_ADDR A:0xfc9a0018
y.create.l HWIO_MSS_CXM_UART_DM_TFWR_ADDR A:0xfc9a001c
y.create.l HWIO_MSS_CXM_UART_DM_RFWR_ADDR A:0xfc9a0020
y.create.l HWIO_MSS_CXM_UART_DM_HCR_ADDR A:0xfc9a0024
y.create.l HWIO_MSS_CXM_UART_DM_DMRX_ADDR A:0xfc9a0034
y.create.l HWIO_MSS_CXM_UART_DM_IRDA_RX_TOTAL_SNAP_DEPRECATED_ADDR A:0xfc9a0038
y.create.l HWIO_MSS_CXM_UART_DM_DMEN_ADDR A:0xfc9a003c
y.create.l HWIO_MSS_CXM_UART_DM_NO_CHARS_FOR_TX_ADDR A:0xfc9a0040
y.create.l HWIO_MSS_CXM_UART_DM_BADR_ADDR A:0xfc9a0044
y.create.l HWIO_MSS_CXM_UART_DM_TESTSL_ADDR A:0xfc9a0048
y.create.l HWIO_MSS_CXM_UART_DM_TXFS_ADDR A:0xfc9a004c
y.create.l HWIO_MSS_CXM_UART_DM_RXFS_ADDR A:0xfc9a0050
y.create.l HWIO_MSS_CXM_UART_DM_MISR_MODE_ADDR A:0xfc9a0060
y.create.l HWIO_MSS_CXM_UART_DM_MISR_RESET_ADDR A:0xfc9a0064
y.create.l HWIO_MSS_CXM_UART_DM_MISR_EXPORT_ADDR A:0xfc9a0068
y.create.l HWIO_MSS_CXM_UART_DM_MISR_VAL_ADDR A:0xfc9a006c
y.create.l HWIO_MSS_CXM_UART_DM_TF_RF_DEPRECATED_ADDR A:0xfc9a0070
y.create.l HWIO_MSS_CXM_UART_DM_TF_RF_2_DEPRECATED_ADDR A:0xfc9a0074
y.create.l HWIO_MSS_CXM_UART_DM_TF_RF_3_DEPRECATED_ADDR A:0xfc9a0078
y.create.l HWIO_MSS_CXM_UART_DM_TF_RF_4_DEPRECATED_ADDR A:0xfc9a007c
y.create.l HWIO_MSS_CXM_UART_DM_SIM_CFG_ADDR A:0xfc9a0080
y.create.l HWIO_MSS_CXM_UART_DM_TEST_WR_ADDR_ADDR A:0xfc9a0084
y.create.l HWIO_MSS_CXM_UART_DM_TEST_WR_DATA_ADDR A:0xfc9a0088
y.create.l HWIO_MSS_CXM_UART_DM_TEST_RD_ADDR_ADDR A:0xfc9a008c
y.create.l HWIO_MSS_CXM_UART_DM_TEST_RD_DATA_ADDR A:0xfc9a0090
y.create.l HWIO_MSS_CXM_UART_DM_CSR_ADDR A:0xfc9a00a0
y.create.l HWIO_MSS_CXM_UART_DM_SR_ADDR A:0xfc9a00a4
y.create.l HWIO_MSS_CXM_UART_DM_CR_ADDR A:0xfc9a00a8
y.create.l HWIO_MSS_CXM_UART_DM_MISR_ADDR A:0xfc9a00ac
y.create.l HWIO_MSS_CXM_UART_DM_IMR_ADDR A:0xfc9a00b0
y.create.l HWIO_MSS_CXM_UART_DM_ISR_ADDR A:0xfc9a00b4
y.create.l HWIO_MSS_CXM_UART_DM_IRDA_ADDR A:0xfc9a00b8
y.create.l HWIO_MSS_CXM_UART_DM_RX_TOTAL_SNAP_ADDR A:0xfc9a00bc
y.create.l HWIO_MSS_CXM_UART_DM_WWT_TIMEOUT_ADDR A:0xfc9a00c0
y.create.l HWIO_MSS_CXM_UART_DM_CLK_CTRL_ADDR A:0xfc9a00c4
y.create.l HWIO_MSS_CXM_UART_DM_BCR_ADDR A:0xfc9a00c8
y.create.l HWIO_MSS_CXM_UART_DM_RX_TRANS_CTRL_ADDR A:0xfc9a00cc
y.create.l HWIO_MSS_CXM_UART_DM_DMRX_DBG_ADDR A:0xfc9a00d0
y.create.l HWIO_MSS_CXM_UART_DM_FSM_STATUS_ADDR A:0xfc9a00d4
y.create.l HWIO_MSS_CXM_UART_DM_HW_VERSION_ADDR A:0xfc9a00d8
y.create.l HWIO_MSS_CXM_UART_DM_GENERICS_ADDR A:0xfc9a00dc
y.create.l HWIO_MSS_CXM_UART_DM_TF_ADDR A:0xfc9a0100
y.create.l HWIO_MSS_CXM_UART_DM_TF_2_ADDR A:0xfc9a0104
y.create.l HWIO_MSS_CXM_UART_DM_TF_3_ADDR A:0xfc9a0108
y.create.l HWIO_MSS_CXM_UART_DM_TF_4_ADDR A:0xfc9a010c
y.create.l HWIO_MSS_CXM_UART_DM_TF_5_ADDR A:0xfc9a0110
y.create.l HWIO_MSS_CXM_UART_DM_TF_6_ADDR A:0xfc9a0114
y.create.l HWIO_MSS_CXM_UART_DM_TF_7_ADDR A:0xfc9a0118
y.create.l HWIO_MSS_CXM_UART_DM_TF_8_ADDR A:0xfc9a011c
y.create.l HWIO_MSS_CXM_UART_DM_TF_9_ADDR A:0xfc9a0120
y.create.l HWIO_MSS_CXM_UART_DM_TF_10_ADDR A:0xfc9a0124
y.create.l HWIO_MSS_CXM_UART_DM_TF_11_ADDR A:0xfc9a0128
y.create.l HWIO_MSS_CXM_UART_DM_TF_12_ADDR A:0xfc9a012c
y.create.l HWIO_MSS_CXM_UART_DM_TF_13_ADDR A:0xfc9a0130
y.create.l HWIO_MSS_CXM_UART_DM_TF_14_ADDR A:0xfc9a0134
y.create.l HWIO_MSS_CXM_UART_DM_TF_15_ADDR A:0xfc9a0138
y.create.l HWIO_MSS_CXM_UART_DM_TF_16_ADDR A:0xfc9a013c
y.create.l HWIO_MSS_CXM_UART_DM_RF_ADDR A:0xfc9a0140
y.create.l HWIO_MSS_CXM_UART_DM_RF_2_ADDR A:0xfc9a0144
y.create.l HWIO_MSS_CXM_UART_DM_RF_3_ADDR A:0xfc9a0148
y.create.l HWIO_MSS_CXM_UART_DM_RF_4_ADDR A:0xfc9a014c
y.create.l HWIO_MSS_CXM_UART_DM_RF_5_ADDR A:0xfc9a0150
y.create.l HWIO_MSS_CXM_UART_DM_RF_6_ADDR A:0xfc9a0154
y.create.l HWIO_MSS_CXM_UART_DM_RF_7_ADDR A:0xfc9a0158
y.create.l HWIO_MSS_CXM_UART_DM_RF_8_ADDR A:0xfc9a015c
y.create.l HWIO_MSS_CXM_UART_DM_RF_9_ADDR A:0xfc9a0160
y.create.l HWIO_MSS_CXM_UART_DM_RF_10_ADDR A:0xfc9a0164
y.create.l HWIO_MSS_CXM_UART_DM_RF_11_ADDR A:0xfc9a0168
y.create.l HWIO_MSS_CXM_UART_DM_RF_12_ADDR A:0xfc9a016c
y.create.l HWIO_MSS_CXM_UART_DM_RF_13_ADDR A:0xfc9a0170
y.create.l HWIO_MSS_CXM_UART_DM_RF_14_ADDR A:0xfc9a0174
y.create.l HWIO_MSS_CXM_UART_DM_RF_15_ADDR A:0xfc9a0178
y.create.l HWIO_MSS_CXM_UART_DM_RF_16_ADDR A:0xfc9a017c
y.create.l HWIO_MSS_CXM_UART_DM_UIM_CFG_ADDR A:0xfc9a0180
y.create.l HWIO_MSS_CXM_UART_DM_UIM_CMD_ADDR A:0xfc9a0184
y.create.l HWIO_MSS_CXM_UART_DM_UIM_IO_STATUS_ADDR A:0xfc9a0188
y.create.l HWIO_MSS_CXM_UART_DM_UIM_IRQ_ISR_ADDR A:0xfc9a018c
y.create.l HWIO_MSS_CXM_UART_DM_UIM_IRQ_MISR_ADDR A:0xfc9a0190
y.create.l HWIO_MSS_CXM_UART_DM_UIM_IRQ_CLR_ADDR A:0xfc9a0194
y.create.l HWIO_MSS_CXM_UART_DM_UIM_IRQ_IMR_ADDR A:0xfc9a0198
y.create.l HWIO_MSS_CXM_UART_DM_UIM_IRQ_IMR_SET_ADDR A:0xfc9a019c
y.create.l HWIO_MSS_CXM_UART_DM_UIM_IRQ_IMR_CLR_ADDR A:0xfc9a01a0
y.create.l HWIO_MSS_CXM_CONFIG_ADDR A:0xfc9a01a4
y.create.l HWIO_MSS_CXM_TX_CONFIG_ADDR A:0xfc9a01a8
y.create.l HWIO_MSS_CXM_RX_STAT_ADDR A:0xfc9a01ac
y.create.l HWIO_MSS_CONF_ABT_HW_VERSION_ADDR A:0xfc9b0000
y.create.l HWIO_MSS_CONF_ABT_INST_ID_ADDR A:0xfc9b0004
y.create.l HWIO_MSS_CONF_ABT_NUM_SLAVES_ADDR A:0xfc9b0008
y.create.l HWIO_MSS_CONF_ABT_TIMER_LOADVAL_ADDR A:0xfc9b000c
y.create.l HWIO_MSS_CONF_ABT_TIMER_MODE_ADDR A:0xfc9b0010
y.create.l HWIO_MSS_CONF_ABT_INTR_STATUS_ADDR A:0xfc9b0014
y.create.l HWIO_MSS_CONF_ABT_INTR_CLEAR_ADDR A:0xfc9b0018
y.create.l HWIO_MSS_CONF_ABT_INTR_ENABLE_ADDR A:0xfc9b001c
y.create.l HWIO_MSS_CONF_ABT_SYND_VALID_ADDR A:0xfc9b0020
y.create.l HWIO_MSS_CONF_ABT_SYND_CLEAR_ADDR A:0xfc9b0024
y.create.l HWIO_MSS_CONF_ABT_SYND_ID_ADDR A:0xfc9b0028
y.create.l HWIO_MSS_CONF_ABT_SYND_ADDR0_ADDR A:0xfc9b002c
y.create.l HWIO_MSS_CONF_ABT_SYND_ADDR1_ADDR A:0xfc9b0030
y.create.l HWIO_MSS_CONF_ABT_SYND_HREADY_ADDR A:0xfc9b0034
y.create.l HWIO_MSS_RBCPR_VERSION_ADDR A:0xfc9b1000
y.create.l HWIO_MSS_RBCPR_SENSOR_MASK0_ADDR A:0xfc9b1020
y.create.l HWIO_MSS_RBCPR_SENSOR_MASK1_ADDR A:0xfc9b1024
y.create.l HWIO_MSS_RBCPR_SENSOR_MASK2_ADDR A:0xfc9b1028
y.create.l HWIO_MSS_RBCPR_SENSOR_MASK3_ADDR A:0xfc9b102c
y.create.l HWIO_MSS_RBCPR_SENSOR_BYPASS0_ADDR A:0xfc9b1030
y.create.l HWIO_MSS_RBCPR_SENSOR_BYPASS1_ADDR A:0xfc9b1034
y.create.l HWIO_MSS_RBCPR_SENSOR_BYPASS2_ADDR A:0xfc9b1038
y.create.l HWIO_MSS_RBCPR_SENSOR_BYPASS3_ADDR A:0xfc9b103c
y.create.l HWIO_MSS_RBIF_PMIC_ADDR_ADDR A:0xfc9b1040
y.create.l HWIO_MSS_RBCPR_TIMER_INTERVAL_ADDR A:0xfc9b1044
y.create.l HWIO_MSS_RBIF_LIMIT_ADDR A:0xfc9b1048
y.create.l HWIO_MSS_RBIF_TIMER_ADJUST_ADDR A:0xfc9b104c
y.create.l HWIO_MSS_RBCPR_GCNT_TARGET0_ADDR A:0xfc9b1060
y.create.l HWIO_MSS_RBCPR_GCNT_TARGET1_ADDR A:0xfc9b1064
y.create.l HWIO_MSS_RBCPR_GCNT_TARGET2_ADDR A:0xfc9b1068
y.create.l HWIO_MSS_RBCPR_GCNT_TARGET3_ADDR A:0xfc9b106c
y.create.l HWIO_MSS_RBCPR_GCNT_TARGET4_ADDR A:0xfc9b1070
y.create.l HWIO_MSS_RBCPR_GCNT_TARGET5_ADDR A:0xfc9b1074
y.create.l HWIO_MSS_RBCPR_GCNT_TARGET6_ADDR A:0xfc9b1078
y.create.l HWIO_MSS_RBCPR_GCNT_TARGET7_ADDR A:0xfc9b107c
y.create.l HWIO_MSS_RBCPR_STEP_QUOT_ADDR A:0xfc9b1080
y.create.l HWIO_MSS_RBCPR_CTL_ADDR A:0xfc9b1090
y.create.l HWIO_MSS_RBIF_SW_VLEVEL_ADDR A:0xfc9b1094
y.create.l HWIO_MSS_RBIF_CONT_ACK_CMD_ADDR A:0xfc9b1098
y.create.l HWIO_MSS_RBIF_CONT_NACK_CMD_ADDR A:0xfc9b109c
y.create.l HWIO_MSS_RBCPR_RESULT_0_ADDR A:0xfc9b10a0
y.create.l HWIO_MSS_RBCPR_RESULT_1_ADDR A:0xfc9b10a4
y.create.l HWIO_MSS_RBIF_IRQ_EN_0_ADDR A:0xfc9b1100
y.create.l HWIO_MSS_RBIF_IRQ_EN_1_ADDR A:0xfc9b1104
y.create.l HWIO_MSS_RBIF_IRQ_EN_2_ADDR A:0xfc9b1108
y.create.l HWIO_MSS_RBIF_IRQ_CLEAR_ADDR A:0xfc9b1110
y.create.l HWIO_MSS_RBIF_IRQ_STATUS_ADDR A:0xfc9b1114
y.create.l HWIO_MSS_RBCPR_QUOT_AVG_ADDR A:0xfc9b1118
y.create.l HWIO_MSS_RBCPR_DEBUG0_ADDR A:0xfc9b111c
y.create.l HWIO_MSS_RBCPR_DEBUG1_ADDR A:0xfc9b1120
y.create.l HWIO_MSS_RBCPR_DEBUG2_ADDR A:0xfc9b1124
y.create.l HWIO_MSS_RBCPR_BIST_MINMAX_ADDR A:0xfc9b1128
y.create.l HWIO_MSS_RBCPR_BIST_RESULT_ADDR A:0xfc9b112c
y.create.l HWIO_MSS_RBCPR_BIST_FAIL_MAP0_ADDR A:0xfc9b1130
y.create.l HWIO_MSS_RBCPR_BIST_FAIL_MAP1_ADDR A:0xfc9b1134
y.create.l HWIO_MSS_RBCPR_BIST_FAIL_MAP2_ADDR A:0xfc9b1138
y.create.l HWIO_MSS_RBCPR_BIST_FAIL_MAP3_ADDR A:0xfc9b113c
y.create.l HWIO_MSS_RBCPR_LOG_0_ADDR A:0xfc9b1140
y.create.l HWIO_MSS_RBCPR_LOG_1_ADDR A:0xfc9b1144
y.create.l HWIO_MSS_RBCPR_LOG_2_ADDR A:0xfc9b1148
y.create.l HWIO_MSS_RBCPR_LOG_3_ADDR A:0xfc9b114c
y.create.l HWIO_MSS_RBCPR_LOG_4_ADDR A:0xfc9b1150
y.create.l HWIO_MSS_RBCPR_LOG_5_ADDR A:0xfc9b1154
y.create.l HWIO_MSS_RBCPR_LOG_6_ADDR A:0xfc9b1158
y.create.l HWIO_MSS_RBCPR_LOG_7_ADDR A:0xfc9b115c
y.create.l HWIO_COMBODAC_CFG0_0_ADDR A:0xfc9b2000
y.create.l HWIO_COMBODAC_CFG0_1_ADDR A:0xfc9b2004
y.create.l HWIO_COMBODAC_CFG1_0_ADDR A:0xfc9b2008
y.create.l HWIO_COMBODAC_CFG1_1_ADDR A:0xfc9b200c
y.create.l HWIO_COMBODAC_CTRL_0_ADDR A:0xfc9b2010
y.create.l HWIO_COMBODAC_CTRL_1_ADDR A:0xfc9b2014
y.create.l HWIO_COMBODAC_STATUS_0_ADDR A:0xfc9b2018
y.create.l HWIO_COMBODAC_STATUS_1_ADDR A:0xfc9b201c
y.create.l HWIO_COMBODAC_MSBCAL_ADDR A:0xfc9b2020
y.create.l HWIO_COMBODAC_DCCAL_ADDR A:0xfc9b2024
y.create.l HWIO_COMBODAC_MSBCAL_STATUS_ADDR A:0xfc9b2028
y.create.l HWIO_COMBODAC_DCCAL_STATUS_ADDR A:0xfc9b202c
y.create.l HWIO_COMBODAC_READ_MSBCAL_CODES_ADDR A:0xfc9b2030
y.create.l HWIO_COMBODAC_READ_MSBCAL_STATUS_ADDR A:0xfc9b2034
y.create.l HWIO_COMBODAC_READ_DCCAL_CODES_ADDR A:0xfc9b2038
y.create.l HWIO_COMBODAC_READ_DCCAL_STATUS_ADDR A:0xfc9b203c
y.create.l HWIO_COMBODAC_WRITE_MSBCAL_CODES_ADDR A:0xfc9b2040
y.create.l HWIO_COMBODAC_WRITE_MSBCAL_STATUS_ADDR A:0xfc9b2044
y.create.l HWIO_COMBODAC_WRITE_DCCAL_CODES_ADDR A:0xfc9b2048
y.create.l HWIO_COMBODAC_WRITE_DCCAL_STATUS_ADDR A:0xfc9b204c
y.create.l HWIO_COMBODAC_BIST_CFG1_ADDR A:0xfc9b2050
y.create.l HWIO_COMBODAC0_CLK_CFG_ADDR A:0xfc9b2054
y.create.l HWIO_COMBODAC1_CLK_CFG_ADDR A:0xfc9b2058
y.create.l HWIO_COMBODAC_CLK_SRC_CFG_ADDR A:0xfc9b205c
y.create.l HWIO_COMBODAC_REGARRAY0_ADDR A:0xfc9b2800
y.create.l HWIO_COMBODAC_REGARRAY1_ADDR A:0xfc9b2804
y.create.l HWIO_COMBODAC_REGARRAY2_ADDR A:0xfc9b2808
y.create.l HWIO_COMBODAC_REGARRAY3_ADDR A:0xfc9b280c
y.create.l HWIO_COMBODAC_REGARRAY4_ADDR A:0xfc9b2810
y.create.l HWIO_COMBODAC_REGARRAY5_ADDR A:0xfc9b2814
y.create.l HWIO_COMBODAC_REGARRAY6_ADDR A:0xfc9b2818
y.create.l HWIO_COMBODAC_REGARRAY7_ADDR A:0xfc9b281c
y.create.l HWIO_COMBODAC_REGARRAY8_ADDR A:0xfc9b2820
y.create.l HWIO_COMBODAC_REGARRAY9_ADDR A:0xfc9b2824
y.create.l HWIO_MSS_CRYPTO_VERSION_ADDR A:0xfc9da000
y.create.l HWIO_MSS_CRYPTO_DATA_IN0_ADDR A:0xfc9da010
y.create.l HWIO_MSS_CRYPTO_DATA_IN1_ADDR A:0xfc9da014
y.create.l HWIO_MSS_CRYPTO_DATA_IN2_ADDR A:0xfc9da018
y.create.l HWIO_MSS_CRYPTO_DATA_IN3_ADDR A:0xfc9da01c
y.create.l HWIO_MSS_CRYPTO_DATA_OUT0_ADDR A:0xfc9da020
y.create.l HWIO_MSS_CRYPTO_DATA_OUT1_ADDR A:0xfc9da024
y.create.l HWIO_MSS_CRYPTO_DATA_OUT2_ADDR A:0xfc9da028
y.create.l HWIO_MSS_CRYPTO_DATA_OUT3_ADDR A:0xfc9da02c
y.create.l HWIO_MSS_CRYPTO_STATUS_ADDR A:0xfc9da100
y.create.l HWIO_MSS_CRYPTO_STATUS2_ADDR A:0xfc9da104
y.create.l HWIO_MSS_CRYPTO_ENGINES_AVAIL_ADDR A:0xfc9da108
y.create.l HWIO_MSS_CRYPTO_FIFO_SIZES_ADDR A:0xfc9da10c
y.create.l HWIO_MSS_CRYPTO_SEG_SIZE_ADDR A:0xfc9da110
y.create.l HWIO_MSS_CRYPTO_GOPROC_ADDR A:0xfc9da120
y.create.l HWIO_MSS_CRYPTO_GOPROC_QC_KEY_ADDR A:0xfc9db000
y.create.l HWIO_MSS_CRYPTO_GOPROC_OEM_KEY_ADDR A:0xfc9dc000
y.create.l HWIO_MSS_CRYPTO_ENCR_SEG_CFG_ADDR A:0xfc9da200
y.create.l HWIO_MSS_CRYPTO_ENCR_SEG_SIZE_ADDR A:0xfc9da204
y.create.l HWIO_MSS_CRYPTO_ENCR_SEG_START_ADDR A:0xfc9da208
y.create.l HWIO_MSS_CRYPTO_ENCR_KEY0_ADDR A:0xfc9dd000
y.create.l HWIO_MSS_CRYPTO_ENCR_KEY1_ADDR A:0xfc9dd004
y.create.l HWIO_MSS_CRYPTO_ENCR_KEY2_ADDR A:0xfc9dd008
y.create.l HWIO_MSS_CRYPTO_ENCR_KEY3_ADDR A:0xfc9dd00c
y.create.l HWIO_MSS_CRYPTO_ENCR_KEY4_ADDR A:0xfc9dd010
y.create.l HWIO_MSS_CRYPTO_ENCR_KEY5_ADDR A:0xfc9dd014
y.create.l HWIO_MSS_CRYPTO_ENCR_KEY6_ADDR A:0xfc9dd018
y.create.l HWIO_MSS_CRYPTO_ENCR_KEY7_ADDR A:0xfc9dd01c
y.create.l HWIO_MSS_CRYPTO_ENCR_XTS_KEY0_ADDR A:0xfc9dd020
y.create.l HWIO_MSS_CRYPTO_ENCR_XTS_KEY1_ADDR A:0xfc9dd024
y.create.l HWIO_MSS_CRYPTO_ENCR_XTS_KEY2_ADDR A:0xfc9dd028
y.create.l HWIO_MSS_CRYPTO_ENCR_XTS_KEY3_ADDR A:0xfc9dd02c
y.create.l HWIO_MSS_CRYPTO_ENCR_XTS_KEY4_ADDR A:0xfc9dd030
y.create.l HWIO_MSS_CRYPTO_ENCR_XTS_KEY5_ADDR A:0xfc9dd034
y.create.l HWIO_MSS_CRYPTO_ENCR_XTS_KEY6_ADDR A:0xfc9dd038
y.create.l HWIO_MSS_CRYPTO_ENCR_XTS_KEY7_ADDR A:0xfc9dd03c
y.create.l HWIO_MSS_CRYPTO_ENCR_CNTR0_IV0_ADDR A:0xfc9da20c
y.create.l HWIO_MSS_CRYPTO_ENCR_CNTR1_IV1_ADDR A:0xfc9da210
y.create.l HWIO_MSS_CRYPTO_ENCR_CNTR2_IV2_ADDR A:0xfc9da214
y.create.l HWIO_MSS_CRYPTO_ENCR_CNTR3_IV3_ADDR A:0xfc9da218
y.create.l HWIO_MSS_CRYPTO_ENCR_CNTR_MASK_ADDR A:0xfc9da21c
y.create.l HWIO_MSS_CRYPTO_ENCR_CCM_INIT_CNTR0_ADDR A:0xfc9da220
y.create.l HWIO_MSS_CRYPTO_ENCR_CCM_INIT_CNTR1_ADDR A:0xfc9da224
y.create.l HWIO_MSS_CRYPTO_ENCR_CCM_INIT_CNTR2_ADDR A:0xfc9da228
y.create.l HWIO_MSS_CRYPTO_ENCR_CCM_INIT_CNTR3_ADDR A:0xfc9da22c
y.create.l HWIO_MSS_CRYPTO_ENCR_XTS_DU_SIZE_ADDR A:0xfc9da230
y.create.l HWIO_MSS_CRYPTO_AUTH_SEG_CFG_ADDR A:0xfc9da300
y.create.l HWIO_MSS_CRYPTO_AUTH_SEG_SIZE_ADDR A:0xfc9da304
y.create.l HWIO_MSS_CRYPTO_AUTH_SEG_START_ADDR A:0xfc9da308
y.create.l HWIO_MSS_CRYPTO_AUTH_KEY0_ADDR A:0xfc9dd040
y.create.l HWIO_MSS_CRYPTO_AUTH_KEY1_ADDR A:0xfc9dd044
y.create.l HWIO_MSS_CRYPTO_AUTH_KEY2_ADDR A:0xfc9dd048
y.create.l HWIO_MSS_CRYPTO_AUTH_KEY3_ADDR A:0xfc9dd04c
y.create.l HWIO_MSS_CRYPTO_AUTH_KEY4_ADDR A:0xfc9dd050
y.create.l HWIO_MSS_CRYPTO_AUTH_KEY5_ADDR A:0xfc9dd054
y.create.l HWIO_MSS_CRYPTO_AUTH_KEY6_ADDR A:0xfc9dd058
y.create.l HWIO_MSS_CRYPTO_AUTH_KEY7_ADDR A:0xfc9dd05c
y.create.l HWIO_MSS_CRYPTO_AUTH_KEY8_ADDR A:0xfc9dd060
y.create.l HWIO_MSS_CRYPTO_AUTH_KEY9_ADDR A:0xfc9dd064
y.create.l HWIO_MSS_CRYPTO_AUTH_IV0_ADDR A:0xfc9da310
y.create.l HWIO_MSS_CRYPTO_AUTH_IV1_ADDR A:0xfc9da314
y.create.l HWIO_MSS_CRYPTO_AUTH_IV2_ADDR A:0xfc9da318
y.create.l HWIO_MSS_CRYPTO_AUTH_IV3_ADDR A:0xfc9da31c
y.create.l HWIO_MSS_CRYPTO_AUTH_IV4_ADDR A:0xfc9da320
y.create.l HWIO_MSS_CRYPTO_AUTH_IV5_ADDR A:0xfc9da324
y.create.l HWIO_MSS_CRYPTO_AUTH_IV6_ADDR A:0xfc9da328
y.create.l HWIO_MSS_CRYPTO_AUTH_IV7_ADDR A:0xfc9da32c
y.create.l HWIO_MSS_CRYPTO_AUTH_INFO_NONCE0_ADDR A:0xfc9da350
y.create.l HWIO_MSS_CRYPTO_AUTH_INFO_NONCE1_ADDR A:0xfc9da354
y.create.l HWIO_MSS_CRYPTO_AUTH_INFO_NONCE2_ADDR A:0xfc9da358
y.create.l HWIO_MSS_CRYPTO_AUTH_INFO_NONCE3_ADDR A:0xfc9da35c
y.create.l HWIO_MSS_CRYPTO_AUTH_BYTECNT0_ADDR A:0xfc9da390
y.create.l HWIO_MSS_CRYPTO_AUTH_BYTECNT1_ADDR A:0xfc9da394
y.create.l HWIO_MSS_CRYPTO_AUTH_EXP_MAC0_ADDR A:0xfc9da3a0
y.create.l HWIO_MSS_CRYPTO_AUTH_EXP_MAC1_ADDR A:0xfc9da3a4
y.create.l HWIO_MSS_CRYPTO_AUTH_EXP_MAC2_ADDR A:0xfc9da3a8
y.create.l HWIO_MSS_CRYPTO_AUTH_EXP_MAC3_ADDR A:0xfc9da3ac
y.create.l HWIO_MSS_CRYPTO_AUTH_EXP_MAC4_ADDR A:0xfc9da3b0
y.create.l HWIO_MSS_CRYPTO_AUTH_EXP_MAC5_ADDR A:0xfc9da3b4
y.create.l HWIO_MSS_CRYPTO_AUTH_EXP_MAC6_ADDR A:0xfc9da3b8
y.create.l HWIO_MSS_CRYPTO_AUTH_EXP_MAC7_ADDR A:0xfc9da3bc
y.create.l HWIO_MSS_CRYPTO_CONFIG_ADDR A:0xfc9da400
y.create.l HWIO_MSS_CRYPTO_DEBUG_ENABLE_ADDR A:0xfc9df000
y.create.l HWIO_MSS_CRYPTO_DEBUG_ADDR A:0xfc9df004
y.create.l HWIO_MSS_CRYPTO_PWR_CTRL_ADDR A:0xfc9df008
y.create.l HWIO_MSS_CRYPTO_BAM_CTRL_ADDR A:0xfc9c4000
y.create.l HWIO_MSS_CRYPTO_BAM_REVISION_ADDR A:0xfc9c4004
y.create.l HWIO_MSS_CRYPTO_BAM_SW_VERSION_ADDR A:0xfc9c4080
y.create.l HWIO_MSS_CRYPTO_BAM_NUM_PIPES_ADDR A:0xfc9c403c
y.create.l HWIO_MSS_CRYPTO_BAM_TIMER_ADDR A:0xfc9c4040
y.create.l HWIO_MSS_CRYPTO_BAM_TIMER_CTRL_ADDR A:0xfc9c4044
y.create.l HWIO_MSS_CRYPTO_BAM_DESC_CNT_TRSHLD_ADDR A:0xfc9c4008
y.create.l HWIO_MSS_CRYPTO_BAM_IRQ_SRCS_ADDR A:0xfc9c400c
y.create.l HWIO_MSS_CRYPTO_BAM_IRQ_SRCS_MSK_ADDR A:0xfc9c4010
y.create.l HWIO_MSS_CRYPTO_BAM_IRQ_SRCS_UNMASKED_ADDR A:0xfc9c4030
y.create.l HWIO_MSS_CRYPTO_BAM_IRQ_STTS_ADDR A:0xfc9c4014
y.create.l HWIO_MSS_CRYPTO_BAM_IRQ_CLR_ADDR A:0xfc9c4018
y.create.l HWIO_MSS_CRYPTO_BAM_IRQ_EN_ADDR A:0xfc9c401c
y.create.l HWIO_MSS_CRYPTO_BAM_AHB_MASTER_ERR_CTRLS_ADDR A:0xfc9c4024
y.create.l HWIO_MSS_CRYPTO_BAM_AHB_MASTER_ERR_ADDR_ADDR A:0xfc9c4028
y.create.l HWIO_MSS_CRYPTO_BAM_AHB_MASTER_ERR_DATA_ADDR A:0xfc9c402c
y.create.l HWIO_MSS_CRYPTO_BAM_TRUST_REG_ADDR A:0xfc9c4070
y.create.l HWIO_MSS_CRYPTO_BAM_TEST_BUS_SEL_ADDR A:0xfc9c4074
y.create.l HWIO_MSS_CRYPTO_BAM_TEST_BUS_REG_ADDR A:0xfc9c4078
y.create.l HWIO_MSS_CRYPTO_BAM_CNFG_BITS_ADDR A:0xfc9c407c
y.create.l HWIO_MSS_CRYPTO_BAM_IRQ_SRCS_EE0_ADDR A:0xfc9c4800
y.create.l HWIO_MSS_CRYPTO_BAM_IRQ_SRCS_EE1_ADDR A:0xfc9c4880
y.create.l HWIO_MSS_CRYPTO_BAM_IRQ_SRCS_EE2_ADDR A:0xfc9c4900
y.create.l HWIO_MSS_CRYPTO_BAM_IRQ_SRCS_EE3_ADDR A:0xfc9c4980
y.create.l HWIO_MSS_CRYPTO_BAM_IRQ_SRCS_EE4_ADDR A:0xfc9c4a00
y.create.l HWIO_MSS_CRYPTO_BAM_IRQ_SRCS_EE5_ADDR A:0xfc9c4a80
y.create.l HWIO_MSS_CRYPTO_BAM_IRQ_SRCS_EE6_ADDR A:0xfc9c4b00
y.create.l HWIO_MSS_CRYPTO_BAM_IRQ_SRCS_EE7_ADDR A:0xfc9c4b80
y.create.l HWIO_MSS_CRYPTO_BAM_IRQ_SRCS_MSK_EE0_ADDR A:0xfc9c4804
y.create.l HWIO_MSS_CRYPTO_BAM_IRQ_SRCS_MSK_EE1_ADDR A:0xfc9c4884
y.create.l HWIO_MSS_CRYPTO_BAM_IRQ_SRCS_MSK_EE2_ADDR A:0xfc9c4904
y.create.l HWIO_MSS_CRYPTO_BAM_IRQ_SRCS_MSK_EE3_ADDR A:0xfc9c4984
y.create.l HWIO_MSS_CRYPTO_BAM_IRQ_SRCS_MSK_EE4_ADDR A:0xfc9c4a04
y.create.l HWIO_MSS_CRYPTO_BAM_IRQ_SRCS_MSK_EE5_ADDR A:0xfc9c4a84
y.create.l HWIO_MSS_CRYPTO_BAM_IRQ_SRCS_MSK_EE6_ADDR A:0xfc9c4b04
y.create.l HWIO_MSS_CRYPTO_BAM_IRQ_SRCS_MSK_EE7_ADDR A:0xfc9c4b84
y.create.l HWIO_MSS_CRYPTO_BAM_IRQ_SRCS_UNMASKED_EE0_ADDR A:0xfc9c4808
y.create.l HWIO_MSS_CRYPTO_BAM_IRQ_SRCS_UNMASKED_EE1_ADDR A:0xfc9c4888
y.create.l HWIO_MSS_CRYPTO_BAM_IRQ_SRCS_UNMASKED_EE2_ADDR A:0xfc9c4908
y.create.l HWIO_MSS_CRYPTO_BAM_IRQ_SRCS_UNMASKED_EE3_ADDR A:0xfc9c4988
y.create.l HWIO_MSS_CRYPTO_BAM_IRQ_SRCS_UNMASKED_EE4_ADDR A:0xfc9c4a08
y.create.l HWIO_MSS_CRYPTO_BAM_IRQ_SRCS_UNMASKED_EE5_ADDR A:0xfc9c4a88
y.create.l HWIO_MSS_CRYPTO_BAM_IRQ_SRCS_UNMASKED_EE6_ADDR A:0xfc9c4b08
y.create.l HWIO_MSS_CRYPTO_BAM_IRQ_SRCS_UNMASKED_EE7_ADDR A:0xfc9c4b88
y.create.l HWIO_MSS_CRYPTO_BAM_P_CTRL0_ADDR A:0xfc9c5000
y.create.l HWIO_MSS_CRYPTO_BAM_P_CTRL1_ADDR A:0xfc9c6000
y.create.l HWIO_MSS_CRYPTO_BAM_P_RST0_ADDR A:0xfc9c5004
y.create.l HWIO_MSS_CRYPTO_BAM_P_RST1_ADDR A:0xfc9c6004
y.create.l HWIO_MSS_CRYPTO_BAM_P_HALT0_ADDR A:0xfc9c5008
y.create.l HWIO_MSS_CRYPTO_BAM_P_HALT1_ADDR A:0xfc9c6008
y.create.l HWIO_MSS_CRYPTO_BAM_P_TRUST_REG0_ADDR A:0xfc9c5030
y.create.l HWIO_MSS_CRYPTO_BAM_P_TRUST_REG1_ADDR A:0xfc9c6030
y.create.l HWIO_MSS_CRYPTO_BAM_P_IRQ_STTS0_ADDR A:0xfc9c5010
y.create.l HWIO_MSS_CRYPTO_BAM_P_IRQ_STTS1_ADDR A:0xfc9c6010
y.create.l HWIO_MSS_CRYPTO_BAM_P_IRQ_CLR0_ADDR A:0xfc9c5014
y.create.l HWIO_MSS_CRYPTO_BAM_P_IRQ_CLR1_ADDR A:0xfc9c6014
y.create.l HWIO_MSS_CRYPTO_BAM_P_IRQ_EN0_ADDR A:0xfc9c5018
y.create.l HWIO_MSS_CRYPTO_BAM_P_IRQ_EN1_ADDR A:0xfc9c6018
y.create.l HWIO_MSS_CRYPTO_BAM_P_TIMER0_ADDR A:0xfc9c501c
y.create.l HWIO_MSS_CRYPTO_BAM_P_TIMER1_ADDR A:0xfc9c601c
y.create.l HWIO_MSS_CRYPTO_BAM_P_TIMER_CTRL0_ADDR A:0xfc9c5020
y.create.l HWIO_MSS_CRYPTO_BAM_P_TIMER_CTRL1_ADDR A:0xfc9c6020
y.create.l HWIO_MSS_CRYPTO_BAM_P_PRDCR_SDBND0_ADDR A:0xfc9c5024
y.create.l HWIO_MSS_CRYPTO_BAM_P_PRDCR_SDBND1_ADDR A:0xfc9c6024
y.create.l HWIO_MSS_CRYPTO_BAM_P_CNSMR_SDBND0_ADDR A:0xfc9c5028
y.create.l HWIO_MSS_CRYPTO_BAM_P_CNSMR_SDBND1_ADDR A:0xfc9c6028
y.create.l HWIO_MSS_CRYPTO_BAM_P_EVNT_DEST_ADDR0_ADDR A:0xfc9c582c
y.create.l HWIO_MSS_CRYPTO_BAM_P_EVNT_DEST_ADDR1_ADDR A:0xfc9c682c
y.create.l HWIO_MSS_CRYPTO_BAM_P_EVNT_REG0_ADDR A:0xfc9c5818
y.create.l HWIO_MSS_CRYPTO_BAM_P_EVNT_REG1_ADDR A:0xfc9c6818
y.create.l HWIO_MSS_CRYPTO_BAM_P_SW_OFSTS0_ADDR A:0xfc9c5800
y.create.l HWIO_MSS_CRYPTO_BAM_P_SW_OFSTS1_ADDR A:0xfc9c6800
y.create.l HWIO_MSS_CRYPTO_BAM_P_DATA_FIFO_ADDR0_ADDR A:0xfc9c5824
y.create.l HWIO_MSS_CRYPTO_BAM_P_DATA_FIFO_ADDR1_ADDR A:0xfc9c6824
y.create.l HWIO_MSS_CRYPTO_BAM_P_DESC_FIFO_ADDR0_ADDR A:0xfc9c581c
y.create.l HWIO_MSS_CRYPTO_BAM_P_DESC_FIFO_ADDR1_ADDR A:0xfc9c681c
y.create.l HWIO_MSS_CRYPTO_BAM_P_EVNT_GEN_TRSHLD0_ADDR A:0xfc9c5828
y.create.l HWIO_MSS_CRYPTO_BAM_P_EVNT_GEN_TRSHLD1_ADDR A:0xfc9c6828
y.create.l HWIO_MSS_CRYPTO_BAM_P_FIFO_SIZES0_ADDR A:0xfc9c5820
y.create.l HWIO_MSS_CRYPTO_BAM_P_FIFO_SIZES1_ADDR A:0xfc9c6820
y.create.l HWIO_MSS_CRYPTO_BAM_P_RETR_CNTXT_0_ADDR A:0xfc9c5834
y.create.l HWIO_MSS_CRYPTO_BAM_P_RETR_CNTXT_1_ADDR A:0xfc9c6834
y.create.l HWIO_MSS_CRYPTO_BAM_P_SI_CNTXT_0_ADDR A:0xfc9c5838
y.create.l HWIO_MSS_CRYPTO_BAM_P_SI_CNTXT_1_ADDR A:0xfc9c6838
y.create.l HWIO_MSS_CRYPTO_BAM_P_DF_CNTXT_0_ADDR A:0xfc9c5830
y.create.l HWIO_MSS_CRYPTO_BAM_P_DF_CNTXT_1_ADDR A:0xfc9c6830
y.create.l HWIO_MSS_CRYPTO_BAM_P_AU_PSM_CNTXT_1_0_ADDR A:0xfc9c5804
y.create.l HWIO_MSS_CRYPTO_BAM_P_AU_PSM_CNTXT_1_1_ADDR A:0xfc9c6804
y.create.l HWIO_MSS_CRYPTO_BAM_P_PSM_CNTXT_2_0_ADDR A:0xfc9c5808
y.create.l HWIO_MSS_CRYPTO_BAM_P_PSM_CNTXT_2_1_ADDR A:0xfc9c6808
y.create.l HWIO_MSS_CRYPTO_BAM_P_PSM_CNTXT_3_0_ADDR A:0xfc9c580c
y.create.l HWIO_MSS_CRYPTO_BAM_P_PSM_CNTXT_3_1_ADDR A:0xfc9c680c
y.create.l HWIO_MSS_CRYPTO_BAM_P_PSM_CNTXT_4_0_ADDR A:0xfc9c5810
y.create.l HWIO_MSS_CRYPTO_BAM_P_PSM_CNTXT_4_1_ADDR A:0xfc9c6810
y.create.l HWIO_MSS_CRYPTO_BAM_P_PSM_CNTXT_5_0_ADDR A:0xfc9c5814
y.create.l HWIO_MSS_CRYPTO_BAM_P_PSM_CNTXT_5_1_ADDR A:0xfc9c6814
y.create.l HWIO_MSS_RC_CONTROL_ADDR A:0xfca00000
y.create.l HWIO_MSS_RC_CONFIG_ADDR A:0xfca00004
y.create.l HWIO_MSS_RC_LPM_RTC_CONTROL_ADDR A:0xfca00008
y.create.l HWIO_MSS_RC_PPSO_ASSERT_ADDR A:0xfca0000c
y.create.l HWIO_MSS_RC_PPSO_DEASSERT_ADDR A:0xfca00010
y.create.l HWIO_MSS_RC_GPS_ON_ADDR A:0xfca00014
y.create.l HWIO_MSS_RC_TIME_TRANSFER_ADDR A:0xfca00018
y.create.l HWIO_MSS_RC_GNSS_RTC_STATUS_ADDR A:0xfca0001c
y.create.l HWIO_MSS_RC_BP1_COUNT_STATUS_ADDR A:0xfca00020
y.create.l HWIO_MSS_RC_BP1_PHASE_STATUS_ADDR A:0xfca00024
y.create.l HWIO_MSS_RC_BP2_COUNT_STATUS_ADDR A:0xfca00028
y.create.l HWIO_MSS_RC_BP2_PHASE_STATUS_ADDR A:0xfca0002c
y.create.l HWIO_MSS_RC_BP3_COUNT_STATUS_ADDR A:0xfca00030
y.create.l HWIO_MSS_RC_BP3_PHASE_STATUS_ADDR A:0xfca00034
y.create.l HWIO_MSS_RC_BP4_COUNT_STATUS_ADDR A:0xfca00038
y.create.l HWIO_MSS_RC_BP4_PHASE_STATUS_ADDR A:0xfca0003c
y.create.l HWIO_MSS_RC_TT_STATUS_ADDR A:0xfca00040
y.create.l HWIO_MSS_RC_IRQ_STATUS_ADDR A:0xfca00044
y.create.l HWIO_MSS_RC_PPSI_RTC_ADDR A:0xfca00048
y.create.l HWIO_MSS_RC_NAV_TT_RTC_ADDR A:0xfca0004c
y.create.l HWIO_MSS_RC_CDMA_TT_RTC_ADDR A:0xfca00050
y.create.l HWIO_MSS_RC_GNSS_TT_CNT_ADDR A:0xfca00054
y.create.l HWIO_MSS_RC_NAV_TEST_BUS_ADDR A:0xfca00058
y.create.l HWIO_MSS_RC_B1_POLYNOMIAL_MASK_ADDR A:0xfca0005c
y.create.l HWIO_MSS_AD_MODE_ADDR A:0xfca00080
y.create.l HWIO_MSS_AD_RX1_CONFIG_ADDR A:0xfca00084
y.create.l HWIO_MSS_AD_RX2_CONFIG_ADDR A:0xfca00088
y.create.l HWIO_MSS_AD_RX1_QUANTMAP_ADDR A:0xfca0008c
y.create.l HWIO_MSS_AD_RX2_QUANTMAP_ADDR A:0xfca00090
y.create.l HWIO_MSS_AD_MEAS_STATUS_ADDR A:0xfca00094
y.create.l HWIO_MSS_AD_RX1_MEAN_MON_ADDR A:0xfca00098
y.create.l HWIO_MSS_AD_RX2_MEAN_MON_ADDR A:0xfca0009c
y.create.l HWIO_MSS_AD_RX1_BLANK_MONITOR_ADDR A:0xfca000a0
y.create.l HWIO_MSS_AD_RX2_BLANK_MONITOR_ADDR A:0xfca000a4
y.create.l HWIO_MSS_AD_SL_INDEX_ADDR A:0xfca000a8
y.create.l HWIO_MSS_AD_RX1_AMPL_MON_ADDR A:0xfca000ac
y.create.l HWIO_MSS_AD_RX2_AMPL_MON_ADDR A:0xfca000b0
y.create.l HWIO_MSS_AD_SPEC_ANALYZER_CMD_ADDR A:0xfca000b4
y.create.l HWIO_MSS_AD_SPEC_ANALYZER_STATUS_ADDR A:0xfca000b8
y.create.l HWIO_MSS_BP1_CONFIG_ADDR A:0xfca00200
y.create.l HWIO_MSS_BP1_IF_FREQ_ADDR A:0xfca00204
y.create.l HWIO_MSS_BP1_RS_RATE_ADDR A:0xfca00208
y.create.l HWIO_MSS_BP1_OFFSET_ADDR A:0xfca0020c
y.create.l HWIO_MSS_BP1_NOTCH1_ADDR A:0xfca00210
y.create.l HWIO_MSS_BP1_NOTCH2_ADDR A:0xfca00214
y.create.l HWIO_MSS_BP1_NOTCH3_ADDR A:0xfca00218
y.create.l HWIO_MSS_BP1_NOTCH4_ADDR A:0xfca0021c
y.create.l HWIO_MSS_BP1_NOTCH5_ADDR A:0xfca00220
y.create.l HWIO_MSS_BP1_NOTCH6_ADDR A:0xfca00224
y.create.l HWIO_MSS_BP1_EQ_COEF_REAL_ADDR A:0xfca00228
y.create.l HWIO_MSS_BP1_EQ_COEF_IMAG_ADDR A:0xfca0022c
y.create.l HWIO_MSS_BP1_FREQ_ADDR A:0xfca00230
y.create.l HWIO_MSS_BP1_THRESH_ADDR A:0xfca00234
y.create.l HWIO_MSS_BP1_PRE_NOTCH_ADDR A:0xfca00238
y.create.l HWIO_MSS_BP1_RS_PHASE_ADDR A:0xfca0023c
y.create.l HWIO_MSS_BP1_PRE_AMPL_MON_ADDR A:0xfca00240
y.create.l HWIO_MSS_BP1_MEAN_MON_ADDR A:0xfca00244
y.create.l HWIO_MSS_BP1_SCH2_AMPL_MON_ADDR A:0xfca00248
y.create.l HWIO_MSS_BP1_SCH3_AMPL_MON_ADDR A:0xfca0024c
y.create.l HWIO_MSS_BP2_CONFIG_ADDR A:0xfca00300
y.create.l HWIO_MSS_BP2_IF_FREQ_ADDR A:0xfca00304
y.create.l HWIO_MSS_BP2_RS_RATE_ADDR A:0xfca00308
y.create.l HWIO_MSS_BP2_OFFSET_ADDR A:0xfca0030c
y.create.l HWIO_MSS_BP2_NOTCH1_ADDR A:0xfca00310
y.create.l HWIO_MSS_BP2_NOTCH2_ADDR A:0xfca00314
y.create.l HWIO_MSS_BP2_NOTCH3_ADDR A:0xfca00318
y.create.l HWIO_MSS_BP2_NOTCH4_ADDR A:0xfca0031c
y.create.l HWIO_MSS_BP2_NOTCH5_ADDR A:0xfca00320
y.create.l HWIO_MSS_BP2_NOTCH6_ADDR A:0xfca00324
y.create.l HWIO_MSS_BP2_EQ_COEF_REAL_ADDR A:0xfca00328
y.create.l HWIO_MSS_BP2_EQ_COEF_IMAG_ADDR A:0xfca0032c
y.create.l HWIO_MSS_BP2_FREQ_ADDR A:0xfca00330
y.create.l HWIO_MSS_BP2_THRESH_ADDR A:0xfca00334
y.create.l HWIO_MSS_BP2_PRE_NOTCH_ADDR A:0xfca00338
y.create.l HWIO_MSS_BP2_RS_PHASE_ADDR A:0xfca0033c
y.create.l HWIO_MSS_BP2_PRE_AMPL_MON_ADDR A:0xfca00340
y.create.l HWIO_MSS_BP2_MEAN_MON_ADDR A:0xfca00344
y.create.l HWIO_MSS_BP2_SCH2_AMPL_MON_ADDR A:0xfca00348
y.create.l HWIO_MSS_BP2_SCH3_AMPL_MON_ADDR A:0xfca0034c
y.create.l HWIO_MSS_BP3_CONFIG_ADDR A:0xfca00400
y.create.l HWIO_MSS_BP3_IF_FREQ_ADDR A:0xfca00404
y.create.l HWIO_MSS_BP3_RS_RATE_ADDR A:0xfca00408
y.create.l HWIO_MSS_BP3_OFFSET_ADDR A:0xfca0040c
y.create.l HWIO_MSS_BP3_NOTCH1_ADDR A:0xfca00410
y.create.l HWIO_MSS_BP3_NOTCH2_ADDR A:0xfca00414
y.create.l HWIO_MSS_BP3_NOTCH3_ADDR A:0xfca00418
y.create.l HWIO_MSS_BP3_NOTCH4_ADDR A:0xfca0041c
y.create.l HWIO_MSS_BP3_NOTCH5_ADDR A:0xfca00420
y.create.l HWIO_MSS_BP3_NOTCH6_ADDR A:0xfca00424
y.create.l HWIO_MSS_BP3_EQ_COEF_REAL_ADDR A:0xfca00428
y.create.l HWIO_MSS_BP3_EQ_COEF_IMAG_ADDR A:0xfca0042c
y.create.l HWIO_MSS_BP3_RS_PHASE_ADDR A:0xfca00430
y.create.l HWIO_MSS_BP3_SCH1_FREQ_ADDR A:0xfca00434
y.create.l HWIO_MSS_BP3_SCH2_FREQ_ADDR A:0xfca00438
y.create.l HWIO_MSS_BP3_SCH3_FREQ_ADDR A:0xfca0043c
y.create.l HWIO_MSS_BP3_SCH4_FREQ_ADDR A:0xfca00440
y.create.l HWIO_MSS_BP3_SCH5_FREQ_ADDR A:0xfca00444
y.create.l HWIO_MSS_BP3_SCH6_FREQ_ADDR A:0xfca00448
y.create.l HWIO_MSS_BP3_SCH7_FREQ_ADDR A:0xfca0044c
y.create.l HWIO_MSS_BP3_SCH8_FREQ_ADDR A:0xfca00450
y.create.l HWIO_MSS_BP3_SCH9_FREQ_ADDR A:0xfca00454
y.create.l HWIO_MSS_BP3_SCH10_FREQ_ADDR A:0xfca00458
y.create.l HWIO_MSS_BP3_SCH11_FREQ_ADDR A:0xfca0045c
y.create.l HWIO_MSS_BP3_SCH12_FREQ_ADDR A:0xfca00460
y.create.l HWIO_MSS_BP3_THRESH_A_ADDR A:0xfca00464
y.create.l HWIO_MSS_BP3_THRESH_B_ADDR A:0xfca00468
y.create.l HWIO_MSS_BP3_THRESH_C_ADDR A:0xfca0046c
y.create.l HWIO_MSS_BP3_THRESH_D_ADDR A:0xfca00470
y.create.l HWIO_MSS_BP3_THRESH_E_ADDR A:0xfca00474
y.create.l HWIO_MSS_BP3_THRESH_F_ADDR A:0xfca00478
y.create.l HWIO_MSS_BP3_PRE_AMPL_MON_ADDR A:0xfca0047c
y.create.l HWIO_MSS_BP3_MEAN_MON_ADDR A:0xfca00480
y.create.l HWIO_MSS_BP3_SCH1_AMPL_MON_ADDR A:0xfca00484
y.create.l HWIO_MSS_BP3_SCH2_AMPL_MON_ADDR A:0xfca00488
y.create.l HWIO_MSS_BP3_SCH3_AMPL_MON_ADDR A:0xfca0048c
y.create.l HWIO_MSS_BP3_SCH4_AMPL_MON_ADDR A:0xfca00490
y.create.l HWIO_MSS_BP3_SCH5_AMPL_MON_ADDR A:0xfca00494
y.create.l HWIO_MSS_BP3_SCH6_AMPL_MON_ADDR A:0xfca00498
y.create.l HWIO_MSS_BP3_SCH7_AMPL_MON_ADDR A:0xfca0049c
y.create.l HWIO_MSS_BP3_SCH8_AMPL_MON_ADDR A:0xfca004a0
y.create.l HWIO_MSS_BP3_SCH9_AMPL_MON_ADDR A:0xfca004a4
y.create.l HWIO_MSS_BP3_SCH10_AMPL_MON_ADDR A:0xfca004a8
y.create.l HWIO_MSS_BP3_SCH11_AMPL_MON_ADDR A:0xfca004ac
y.create.l HWIO_MSS_BP3_SCH12_AMPL_MON_ADDR A:0xfca004b0
y.create.l HWIO_MSS_BP3_SCH_MODE_ADDR A:0xfca004b4
y.create.l HWIO_MSS_BP3_PRE_NOTCH_ADDR A:0xfca004b8
y.create.l HWIO_MSS_BP4_CONFIG_ADDR A:0xfca00500
y.create.l HWIO_MSS_BP4_IF_FREQ_ADDR A:0xfca00504
y.create.l HWIO_MSS_BP4_RS_RATE_ADDR A:0xfca00508
y.create.l HWIO_MSS_BP4_OFFSET_ADDR A:0xfca0050c
y.create.l HWIO_MSS_BP4_NOTCH1_ADDR A:0xfca00510
y.create.l HWIO_MSS_BP4_NOTCH2_ADDR A:0xfca00514
y.create.l HWIO_MSS_BP4_NOTCH3_ADDR A:0xfca00518
y.create.l HWIO_MSS_BP4_NOTCH4_ADDR A:0xfca0051c
y.create.l HWIO_MSS_BP4_NOTCH5_ADDR A:0xfca00520
y.create.l HWIO_MSS_BP4_NOTCH6_ADDR A:0xfca00524
y.create.l HWIO_MSS_BP4_EQ_COEF_REAL_ADDR A:0xfca00528
y.create.l HWIO_MSS_BP4_EQ_COEF_IMAG_ADDR A:0xfca0052c
y.create.l HWIO_MSS_BP4_FREQ_ADDR A:0xfca00530
y.create.l HWIO_MSS_BP4_THRESH_ADDR A:0xfca00534
y.create.l HWIO_MSS_BP4_RS_PHASE_ADDR A:0xfca00538
y.create.l HWIO_MSS_BP4_PRE_AMPL_MON_ADDR A:0xfca0053c
y.create.l HWIO_MSS_BP4_MEAN_MON_ADDR A:0xfca00540
y.create.l HWIO_MSS_BP4_AMPL_MON_ADDR A:0xfca00544
y.create.l HWIO_MSS_BP4_PRE_NOTCH_ADDR A:0xfca00548
y.create.l HWIO_MSS_TSG_CMD0_ADDR A:0xfca00100
y.create.l HWIO_MSS_TSG_CH1_CONFIG_ADDR A:0xfca00104
y.create.l HWIO_MSS_TSG_CH1_RS_RATE_ADDR A:0xfca00108
y.create.l HWIO_MSS_TSG_CH1_INIT_COUNT_ADDR A:0xfca0010c
y.create.l HWIO_MSS_TSG_CH1_FREQ_ADDR A:0xfca00110
y.create.l HWIO_MSS_TSG_CH1_DATA_SEED_ADDR A:0xfca00114
y.create.l HWIO_MSS_TSG_CH1_PILOT_SEED_ADDR A:0xfca00118
y.create.l HWIO_MSS_TSG_CH2_CONFIG_ADDR A:0xfca0011c
y.create.l HWIO_MSS_TSG_CH2_RS_RATE_ADDR A:0xfca00120
y.create.l HWIO_MSS_TSG_CH2_INIT_COUNT_ADDR A:0xfca00124
y.create.l HWIO_MSS_TSG_CH2_FREQ_ADDR A:0xfca00128
y.create.l HWIO_MSS_TSG_CH2_DATA_SEED_ADDR A:0xfca0012c
y.create.l HWIO_MSS_TSG_CH2_PILOT_SEED_ADDR A:0xfca00130
y.create.l HWIO_MSS_TSG_RX1_CONFIG_ADDR A:0xfca00134
y.create.l HWIO_MSS_TSG_RX1_OFFSET_ADDR A:0xfca00138
y.create.l HWIO_MSS_TSG_RX2_CONFIG_ADDR A:0xfca0013c
y.create.l HWIO_MSS_TSG_RX2_OFFSET_ADDR A:0xfca00140
y.create.l HWIO_MSS_TSG_FIRST_CODE_ADDR A:0xfca00144
y.create.l HWIO_MSS_TSG_CH1_COUNT_STATUS_ADDR A:0xfca00148
y.create.l HWIO_MSS_TSG_CH2_COUNT_STATUS_ADDR A:0xfca0014c
y.create.l HWIO_MSS_SMI_MODE_ADDR A:0xfca00600
y.create.l HWIO_MSS_SMI_BASEADDR1_ADDR A:0xfca00604
y.create.l HWIO_MSS_SMI_BASEADDR2_ADDR A:0xfca00608
y.create.l HWIO_MSS_SMI_BASEADDR3A_ADDR A:0xfca0060c
y.create.l HWIO_MSS_SMI_BASEADDR3B_ADDR A:0xfca00610
y.create.l HWIO_MSS_SMI_BASEADDR3C_ADDR A:0xfca00614
y.create.l HWIO_MSS_SMI_BASEADDR4_ADDR A:0xfca00618
y.create.l HWIO_MSS_CP_START_ADDR A:0xfca00700
y.create.l HWIO_MSS_CP_CONFIG1_ADDR A:0xfca00704
y.create.l HWIO_MSS_CP_CONFIG2_ADDR A:0xfca00708
y.create.l HWIO_MSS_CP_SAMPLE_INDEX_ADDR A:0xfca0070c
y.create.l HWIO_MSS_CP_PHASE_ADDR A:0xfca00710
y.create.l HWIO_MSS_CP_FREQ_ADDR A:0xfca00714
y.create.l HWIO_MSS_CP_DATA_SEED_ADDR A:0xfca00718
y.create.l HWIO_MSS_CP_PILOT_SEED_ADDR A:0xfca0071c
y.create.l HWIO_MSS_CP_CODE_INDEX_ADDR A:0xfca00720
y.create.l HWIO_MSS_CP_COEF1_ADDR A:0xfca00724
y.create.l HWIO_MSS_CP_COEF2_ADDR A:0xfca00728
y.create.l HWIO_MSS_CP_COEF3_ADDR A:0xfca0072c
y.create.l HWIO_MSS_CP_COEF4_ADDR A:0xfca00730
y.create.l HWIO_MSS_CP_COEF5_ADDR A:0xfca00734
y.create.l HWIO_MSS_CP_COEF6_ADDR A:0xfca00738
y.create.l HWIO_MSS_CP_STATUS_ADDR A:0xfca0073c
y.create.l HWIO_MSS_CCP_BREAKPOINT_ADDR A:0xfca00800
y.create.l HWIO_MSS_CCP_BREAK_STATE_ADDR A:0xfca00804
y.create.l HWIO_MSS_CCP_PROG_STATUS_ADDR A:0xfca00808
y.create.l HWIO_MSS_CCP_G10_STATUS_ADDR A:0xfca0080c
y.create.l HWIO_MSS_CCP_G32_STATUS_ADDR A:0xfca00810
y.create.l HWIO_MSS_CCP_G54_STATUS_ADDR A:0xfca00814
y.create.l HWIO_MSS_CCP_G76_STATUS_ADDR A:0xfca00818
y.create.l HWIO_MSS_CCP_P10_STATUS_ADDR A:0xfca0081c
y.create.l HWIO_MSS_CCP_P2_STATUS_ADDR A:0xfca00820
y.create.l HWIO_MSS_SM_ADDR_BEGIN_ADDR A:0xfca40000
y.create.l HWIO_MSS_SM_ADDR_END_ADDR A:0xfca64ffc
y.create.l HWIO_MSS_GPM_ADDR_BEGIN_ADDR A:0xfca04000
y.create.l HWIO_MSS_GPM_ADDR_END_ADDR A:0xfca041fc
y.create.l HWIO_MSS_GDM_ADDR_BEGIN_ADDR A:0xfca08000
y.create.l HWIO_MSS_GDM_ADDR_END_ADDR A:0xfca081fc
y.create.l HWIO_MSS_CMA_ADDR_BEGIN_ADDR A:0xfca0c000
y.create.l HWIO_MSS_CMA_ADDR_END_ADDR A:0xfca0edfc
y.create.l HWIO_MSS_CMB_ADDR_BEGIN_ADDR A:0xfca10000
y.create.l HWIO_MSS_CMB_ADDR_END_ADDR A:0xfca12dfc
y.create.l HWIO_MSS_CCM_ADDR_BEGIN_ADDR A:0xfca14000
y.create.l HWIO_MSS_CCM_ADDR_END_ADDR A:0xfca147fc
y.create.l HWIO_MSS_VM_ADDR_BEGIN_ADDR A:0xfca18000
y.create.l HWIO_MSS_VM_ADDR_END_ADDR A:0xfca18ffc
y.create.l HWIO_MSS_PM_ADDR_BEGIN_ADDR A:0xfca1c000
y.create.l HWIO_MSS_PM_ADDR_END_ADDR A:0xfca1cffc
y.create.l HWIO_MSS_CCM_START_CMD_ADDR A:0xfca15000
y.create.l HWIO_MSS_CCM_WORD1_CMD_ADDR A:0xfca15004
y.create.l HWIO_MSS_CCM_WORD2_CMD_ADDR A:0xfca15008
y.create.l HWIO_MSS_CCM_WORD3_CMD_ADDR A:0xfca1500c
y.create.l HWIO_MSS_CCM_WORD4_CMD_ADDR A:0xfca15010
y.create.l HWIO_MSS_CCM_WORD5_CMD_ADDR A:0xfca15014
y.create.l HWIO_MSS_CCM_WORD6_CMD_ADDR A:0xfca15018
y.create.l HWIO_MSS_CCM_WORD7_CMD_ADDR A:0xfca1501c
y.create.l HWIO_MSS_CCM_END_CMD_ADDR A:0xfca15020
y.create.l HWIO_MSS_CCM_STOP_CMD_ADDR A:0xfca157dc
y.create.l HWIO_MSS_CCM_LOAD_CMD_ADDR A:0xfca157e0
y.create.l HWIO_MSS_CCM_ERROR_CLEAR_CMD_ADDR A:0xfca157e4
y.create.l HWIO_MSS_CCM_TIME_MARGIN_CMD_ADDR A:0xfca157e8
y.create.l HWIO_MSS_CCM_LATE_TASK_ERROR_STATUS_ADDR A:0xfca157ec
y.create.l HWIO_MSS_CCM_OVERRUN_ERROR_STATUS_ADDR A:0xfca157f0
y.create.l HWIO_MSS_CCM_SEQ_NUMBER_STATUS_ADDR A:0xfca157f4
y.create.l HWIO_MSS_CCM_DONE_RTC_STATUS_ADDR A:0xfca157f8
y.create.l HWIO_MSS_CCM_STALL_COUNT_STATUS_ADDR A:0xfca157fc
y.create.l HWIO_MSS_TPM_ADDR_BEGIN_ADDR A:0xfca20000
y.create.l HWIO_MSS_TPM_ADDR_END_ADDR A:0xfca201fc
y.create.l HWIO_MSS_TDM_ADDR_BEGIN_ADDR A:0xfca24000
y.create.l HWIO_MSS_TDM_ADDR_END_ADDR A:0xfca241fc
y.create.l HWIO_MSS_GTM_ADDR_BEGIN_ADDR A:0xfca80000
y.create.l HWIO_MSS_GTM_ADDR_END_ADDR A:0xfca9fffc
y.create.l HWIO_MSS_GACC_CLK_CTL_ADDR A:0xfca00a00
y.create.l HWIO_MSS_GACC_RTC_WAIT_ADDR A:0xfca00a04
y.create.l HWIO_MSS_GACC_START_ADDR_ADDR A:0xfca00a08
y.create.l HWIO_MSS_GACC_COUNT_ADDR A:0xfca00a0c
y.create.l HWIO_MSS_GACC_INCR_ADDR A:0xfca00a10
y.create.l HWIO_MSS_GACC_FREQ_ADDR A:0xfca00a14
y.create.l HWIO_MSS_GACC_CONFIG_ADDR A:0xfca00a18
y.create.l HWIO_MSS_GACC_PEAK_ADDR A:0xfca00a1c
y.create.l HWIO_MSS_GACC_DONE_ADDR A:0xfca00a20
y.create.l HWIO_MSS_GACC_RTC_ADDR A:0xfca00a24
y.create.l HWIO_MSS_GACC_TEST_BUS_OUT_ADDR A:0xfca00a28
y.create.l HWIO_MSS_GACC_SAMPLE_MEM_START_ADDR_ADDR A:0xfca28000
y.create.l HWIO_MSS_GACC_SAMPLE_MEM_END_ADDR_ADDR A:0xfca289fc
y.create.l HWIO_MSS_GACC_ENERGY_MEM_START_ADDR_ADDR A:0xfca2c000
y.create.l HWIO_MSS_GACC_ENERGY_MEM_END_ADDR_ADDR A:0xfca2c9fc
y.create.l HWIO_MSS_HI0_CH0_CMD_PTR_SD0_ADDR A:0xfca00b00
y.create.l HWIO_MSS_HI0_CH0_CMD_PTR_SD1_ADDR A:0xfca00f00
y.create.l HWIO_MSS_HI0_CH0_CMD_PTR_SD2_ADDR A:0xfca01300
y.create.l HWIO_MSS_HI0_CH0_CMD_PTR_SD3_ADDR A:0xfca01700
y.create.l HWIO_MSS_HI0_CH1_CMD_PTR_SD0_ADDR A:0xfca00b04
y.create.l HWIO_MSS_HI0_CH1_CMD_PTR_SD1_ADDR A:0xfca00f04
y.create.l HWIO_MSS_HI0_CH1_CMD_PTR_SD2_ADDR A:0xfca01304
y.create.l HWIO_MSS_HI0_CH1_CMD_PTR_SD3_ADDR A:0xfca01704
y.create.l HWIO_MSS_HI0_CH2_CMD_PTR_SD0_ADDR A:0xfca00b08
y.create.l HWIO_MSS_HI0_CH2_CMD_PTR_SD1_ADDR A:0xfca00f08
y.create.l HWIO_MSS_HI0_CH2_CMD_PTR_SD2_ADDR A:0xfca01308
y.create.l HWIO_MSS_HI0_CH2_CMD_PTR_SD3_ADDR A:0xfca01708
y.create.l HWIO_MSS_HI0_CH3_CMD_PTR_SD0_ADDR A:0xfca00b0c
y.create.l HWIO_MSS_HI0_CH3_CMD_PTR_SD1_ADDR A:0xfca00f0c
y.create.l HWIO_MSS_HI0_CH3_CMD_PTR_SD2_ADDR A:0xfca0130c
y.create.l HWIO_MSS_HI0_CH3_CMD_PTR_SD3_ADDR A:0xfca0170c
y.create.l HWIO_MSS_HI0_CH4_CMD_PTR_SD0_ADDR A:0xfca00b10
y.create.l HWIO_MSS_HI0_CH4_CMD_PTR_SD1_ADDR A:0xfca00f10
y.create.l HWIO_MSS_HI0_CH4_CMD_PTR_SD2_ADDR A:0xfca01310
y.create.l HWIO_MSS_HI0_CH4_CMD_PTR_SD3_ADDR A:0xfca01710
y.create.l HWIO_MSS_HI0_CH5_CMD_PTR_SD0_ADDR A:0xfca00b14
y.create.l HWIO_MSS_HI0_CH5_CMD_PTR_SD1_ADDR A:0xfca00f14
y.create.l HWIO_MSS_HI0_CH5_CMD_PTR_SD2_ADDR A:0xfca01314
y.create.l HWIO_MSS_HI0_CH5_CMD_PTR_SD3_ADDR A:0xfca01714
y.create.l HWIO_MSS_HI0_CH6_CMD_PTR_SD0_ADDR A:0xfca00b18
y.create.l HWIO_MSS_HI0_CH6_CMD_PTR_SD1_ADDR A:0xfca00f18
y.create.l HWIO_MSS_HI0_CH6_CMD_PTR_SD2_ADDR A:0xfca01318
y.create.l HWIO_MSS_HI0_CH6_CMD_PTR_SD3_ADDR A:0xfca01718
y.create.l HWIO_MSS_HI0_CH7_CMD_PTR_SD0_ADDR A:0xfca00b1c
y.create.l HWIO_MSS_HI0_CH7_CMD_PTR_SD1_ADDR A:0xfca00f1c
y.create.l HWIO_MSS_HI0_CH7_CMD_PTR_SD2_ADDR A:0xfca0131c
y.create.l HWIO_MSS_HI0_CH7_CMD_PTR_SD3_ADDR A:0xfca0171c
y.create.l HWIO_MSS_HI0_CH0_RSLT_SD0_ADDR A:0xfca00b40
y.create.l HWIO_MSS_HI0_CH0_RSLT_SD1_ADDR A:0xfca00f40
y.create.l HWIO_MSS_HI0_CH0_RSLT_SD2_ADDR A:0xfca01340
y.create.l HWIO_MSS_HI0_CH0_RSLT_SD3_ADDR A:0xfca01740
y.create.l HWIO_MSS_HI0_CH1_RSLT_SD0_ADDR A:0xfca00b44
y.create.l HWIO_MSS_HI0_CH1_RSLT_SD1_ADDR A:0xfca00f44
y.create.l HWIO_MSS_HI0_CH1_RSLT_SD2_ADDR A:0xfca01344
y.create.l HWIO_MSS_HI0_CH1_RSLT_SD3_ADDR A:0xfca01744
y.create.l HWIO_MSS_HI0_CH2_RSLT_SD0_ADDR A:0xfca00b48
y.create.l HWIO_MSS_HI0_CH2_RSLT_SD1_ADDR A:0xfca00f48
y.create.l HWIO_MSS_HI0_CH2_RSLT_SD2_ADDR A:0xfca01348
y.create.l HWIO_MSS_HI0_CH2_RSLT_SD3_ADDR A:0xfca01748
y.create.l HWIO_MSS_HI0_CH3_RSLT_SD0_ADDR A:0xfca00b4c
y.create.l HWIO_MSS_HI0_CH3_RSLT_SD1_ADDR A:0xfca00f4c
y.create.l HWIO_MSS_HI0_CH3_RSLT_SD2_ADDR A:0xfca0134c
y.create.l HWIO_MSS_HI0_CH3_RSLT_SD3_ADDR A:0xfca0174c
y.create.l HWIO_MSS_HI0_CH4_RSLT_SD0_ADDR A:0xfca00b50
y.create.l HWIO_MSS_HI0_CH4_RSLT_SD1_ADDR A:0xfca00f50
y.create.l HWIO_MSS_HI0_CH4_RSLT_SD2_ADDR A:0xfca01350
y.create.l HWIO_MSS_HI0_CH4_RSLT_SD3_ADDR A:0xfca01750
y.create.l HWIO_MSS_HI0_CH5_RSLT_SD0_ADDR A:0xfca00b54
y.create.l HWIO_MSS_HI0_CH5_RSLT_SD1_ADDR A:0xfca00f54
y.create.l HWIO_MSS_HI0_CH5_RSLT_SD2_ADDR A:0xfca01354
y.create.l HWIO_MSS_HI0_CH5_RSLT_SD3_ADDR A:0xfca01754
y.create.l HWIO_MSS_HI0_CH6_RSLT_SD0_ADDR A:0xfca00b58
y.create.l HWIO_MSS_HI0_CH6_RSLT_SD1_ADDR A:0xfca00f58
y.create.l HWIO_MSS_HI0_CH6_RSLT_SD2_ADDR A:0xfca01358
y.create.l HWIO_MSS_HI0_CH6_RSLT_SD3_ADDR A:0xfca01758
y.create.l HWIO_MSS_HI0_CH7_RSLT_SD0_ADDR A:0xfca00b5c
y.create.l HWIO_MSS_HI0_CH7_RSLT_SD1_ADDR A:0xfca00f5c
y.create.l HWIO_MSS_HI0_CH7_RSLT_SD2_ADDR A:0xfca0135c
y.create.l HWIO_MSS_HI0_CH7_RSLT_SD3_ADDR A:0xfca0175c
y.create.l HWIO_MSS_HI0_CH0_FLUSH_STATE0_SD0_ADDR A:0xfca00b80
y.create.l HWIO_MSS_HI0_CH0_FLUSH_STATE0_SD1_ADDR A:0xfca00f80
y.create.l HWIO_MSS_HI0_CH0_FLUSH_STATE0_SD2_ADDR A:0xfca01380
y.create.l HWIO_MSS_HI0_CH0_FLUSH_STATE0_SD3_ADDR A:0xfca01780
y.create.l HWIO_MSS_HI0_CH1_FLUSH_STATE0_SD0_ADDR A:0xfca00b84
y.create.l HWIO_MSS_HI0_CH1_FLUSH_STATE0_SD1_ADDR A:0xfca00f84
y.create.l HWIO_MSS_HI0_CH1_FLUSH_STATE0_SD2_ADDR A:0xfca01384
y.create.l HWIO_MSS_HI0_CH1_FLUSH_STATE0_SD3_ADDR A:0xfca01784
y.create.l HWIO_MSS_HI0_CH2_FLUSH_STATE0_SD0_ADDR A:0xfca00b88
y.create.l HWIO_MSS_HI0_CH2_FLUSH_STATE0_SD1_ADDR A:0xfca00f88
y.create.l HWIO_MSS_HI0_CH2_FLUSH_STATE0_SD2_ADDR A:0xfca01388
y.create.l HWIO_MSS_HI0_CH2_FLUSH_STATE0_SD3_ADDR A:0xfca01788
y.create.l HWIO_MSS_HI0_CH3_FLUSH_STATE0_SD0_ADDR A:0xfca00b8c
y.create.l HWIO_MSS_HI0_CH3_FLUSH_STATE0_SD1_ADDR A:0xfca00f8c
y.create.l HWIO_MSS_HI0_CH3_FLUSH_STATE0_SD2_ADDR A:0xfca0138c
y.create.l HWIO_MSS_HI0_CH3_FLUSH_STATE0_SD3_ADDR A:0xfca0178c
y.create.l HWIO_MSS_HI0_CH4_FLUSH_STATE0_SD0_ADDR A:0xfca00b90
y.create.l HWIO_MSS_HI0_CH4_FLUSH_STATE0_SD1_ADDR A:0xfca00f90
y.create.l HWIO_MSS_HI0_CH4_FLUSH_STATE0_SD2_ADDR A:0xfca01390
y.create.l HWIO_MSS_HI0_CH4_FLUSH_STATE0_SD3_ADDR A:0xfca01790
y.create.l HWIO_MSS_HI0_CH5_FLUSH_STATE0_SD0_ADDR A:0xfca00b94
y.create.l HWIO_MSS_HI0_CH5_FLUSH_STATE0_SD1_ADDR A:0xfca00f94
y.create.l HWIO_MSS_HI0_CH5_FLUSH_STATE0_SD2_ADDR A:0xfca01394
y.create.l HWIO_MSS_HI0_CH5_FLUSH_STATE0_SD3_ADDR A:0xfca01794
y.create.l HWIO_MSS_HI0_CH6_FLUSH_STATE0_SD0_ADDR A:0xfca00b98
y.create.l HWIO_MSS_HI0_CH6_FLUSH_STATE0_SD1_ADDR A:0xfca00f98
y.create.l HWIO_MSS_HI0_CH6_FLUSH_STATE0_SD2_ADDR A:0xfca01398
y.create.l HWIO_MSS_HI0_CH6_FLUSH_STATE0_SD3_ADDR A:0xfca01798
y.create.l HWIO_MSS_HI0_CH7_FLUSH_STATE0_SD0_ADDR A:0xfca00b9c
y.create.l HWIO_MSS_HI0_CH7_FLUSH_STATE0_SD1_ADDR A:0xfca00f9c
y.create.l HWIO_MSS_HI0_CH7_FLUSH_STATE0_SD2_ADDR A:0xfca0139c
y.create.l HWIO_MSS_HI0_CH7_FLUSH_STATE0_SD3_ADDR A:0xfca0179c
y.create.l HWIO_MSS_HI0_CH0_FLUSH_STATE1_SD0_ADDR A:0xfca00bc0
y.create.l HWIO_MSS_HI0_CH0_FLUSH_STATE1_SD1_ADDR A:0xfca00fc0
y.create.l HWIO_MSS_HI0_CH0_FLUSH_STATE1_SD2_ADDR A:0xfca013c0
y.create.l HWIO_MSS_HI0_CH0_FLUSH_STATE1_SD3_ADDR A:0xfca017c0
y.create.l HWIO_MSS_HI0_CH1_FLUSH_STATE1_SD0_ADDR A:0xfca00bc4
y.create.l HWIO_MSS_HI0_CH1_FLUSH_STATE1_SD1_ADDR A:0xfca00fc4
y.create.l HWIO_MSS_HI0_CH1_FLUSH_STATE1_SD2_ADDR A:0xfca013c4
y.create.l HWIO_MSS_HI0_CH1_FLUSH_STATE1_SD3_ADDR A:0xfca017c4
y.create.l HWIO_MSS_HI0_CH2_FLUSH_STATE1_SD0_ADDR A:0xfca00bc8
y.create.l HWIO_MSS_HI0_CH2_FLUSH_STATE1_SD1_ADDR A:0xfca00fc8
y.create.l HWIO_MSS_HI0_CH2_FLUSH_STATE1_SD2_ADDR A:0xfca013c8
y.create.l HWIO_MSS_HI0_CH2_FLUSH_STATE1_SD3_ADDR A:0xfca017c8
y.create.l HWIO_MSS_HI0_CH3_FLUSH_STATE1_SD0_ADDR A:0xfca00bcc
y.create.l HWIO_MSS_HI0_CH3_FLUSH_STATE1_SD1_ADDR A:0xfca00fcc
y.create.l HWIO_MSS_HI0_CH3_FLUSH_STATE1_SD2_ADDR A:0xfca013cc
y.create.l HWIO_MSS_HI0_CH3_FLUSH_STATE1_SD3_ADDR A:0xfca017cc
y.create.l HWIO_MSS_HI0_CH4_FLUSH_STATE1_SD0_ADDR A:0xfca00bd0
y.create.l HWIO_MSS_HI0_CH4_FLUSH_STATE1_SD1_ADDR A:0xfca00fd0
y.create.l HWIO_MSS_HI0_CH4_FLUSH_STATE1_SD2_ADDR A:0xfca013d0
y.create.l HWIO_MSS_HI0_CH4_FLUSH_STATE1_SD3_ADDR A:0xfca017d0
y.create.l HWIO_MSS_HI0_CH5_FLUSH_STATE1_SD0_ADDR A:0xfca00bd4
y.create.l HWIO_MSS_HI0_CH5_FLUSH_STATE1_SD1_ADDR A:0xfca00fd4
y.create.l HWIO_MSS_HI0_CH5_FLUSH_STATE1_SD2_ADDR A:0xfca013d4
y.create.l HWIO_MSS_HI0_CH5_FLUSH_STATE1_SD3_ADDR A:0xfca017d4
y.create.l HWIO_MSS_HI0_CH6_FLUSH_STATE1_SD0_ADDR A:0xfca00bd8
y.create.l HWIO_MSS_HI0_CH6_FLUSH_STATE1_SD1_ADDR A:0xfca00fd8
y.create.l HWIO_MSS_HI0_CH6_FLUSH_STATE1_SD2_ADDR A:0xfca013d8
y.create.l HWIO_MSS_HI0_CH6_FLUSH_STATE1_SD3_ADDR A:0xfca017d8
y.create.l HWIO_MSS_HI0_CH7_FLUSH_STATE1_SD0_ADDR A:0xfca00bdc
y.create.l HWIO_MSS_HI0_CH7_FLUSH_STATE1_SD1_ADDR A:0xfca00fdc
y.create.l HWIO_MSS_HI0_CH7_FLUSH_STATE1_SD2_ADDR A:0xfca013dc
y.create.l HWIO_MSS_HI0_CH7_FLUSH_STATE1_SD3_ADDR A:0xfca017dc
y.create.l HWIO_MSS_HI0_CH0_FLUSH_STATE3_SD0_ADDR A:0xfca00c40
y.create.l HWIO_MSS_HI0_CH0_FLUSH_STATE3_SD1_ADDR A:0xfca01040
y.create.l HWIO_MSS_HI0_CH0_FLUSH_STATE3_SD2_ADDR A:0xfca01440
y.create.l HWIO_MSS_HI0_CH0_FLUSH_STATE3_SD3_ADDR A:0xfca01840
y.create.l HWIO_MSS_HI0_CH1_FLUSH_STATE3_SD0_ADDR A:0xfca00c44
y.create.l HWIO_MSS_HI0_CH1_FLUSH_STATE3_SD1_ADDR A:0xfca01044
y.create.l HWIO_MSS_HI0_CH1_FLUSH_STATE3_SD2_ADDR A:0xfca01444
y.create.l HWIO_MSS_HI0_CH1_FLUSH_STATE3_SD3_ADDR A:0xfca01844
y.create.l HWIO_MSS_HI0_CH2_FLUSH_STATE3_SD0_ADDR A:0xfca00c48
y.create.l HWIO_MSS_HI0_CH2_FLUSH_STATE3_SD1_ADDR A:0xfca01048
y.create.l HWIO_MSS_HI0_CH2_FLUSH_STATE3_SD2_ADDR A:0xfca01448
y.create.l HWIO_MSS_HI0_CH2_FLUSH_STATE3_SD3_ADDR A:0xfca01848
y.create.l HWIO_MSS_HI0_CH3_FLUSH_STATE3_SD0_ADDR A:0xfca00c4c
y.create.l HWIO_MSS_HI0_CH3_FLUSH_STATE3_SD1_ADDR A:0xfca0104c
y.create.l HWIO_MSS_HI0_CH3_FLUSH_STATE3_SD2_ADDR A:0xfca0144c
y.create.l HWIO_MSS_HI0_CH3_FLUSH_STATE3_SD3_ADDR A:0xfca0184c
y.create.l HWIO_MSS_HI0_CH4_FLUSH_STATE3_SD0_ADDR A:0xfca00c50
y.create.l HWIO_MSS_HI0_CH4_FLUSH_STATE3_SD1_ADDR A:0xfca01050
y.create.l HWIO_MSS_HI0_CH4_FLUSH_STATE3_SD2_ADDR A:0xfca01450
y.create.l HWIO_MSS_HI0_CH4_FLUSH_STATE3_SD3_ADDR A:0xfca01850
y.create.l HWIO_MSS_HI0_CH5_FLUSH_STATE3_SD0_ADDR A:0xfca00c54
y.create.l HWIO_MSS_HI0_CH5_FLUSH_STATE3_SD1_ADDR A:0xfca01054
y.create.l HWIO_MSS_HI0_CH5_FLUSH_STATE3_SD2_ADDR A:0xfca01454
y.create.l HWIO_MSS_HI0_CH5_FLUSH_STATE3_SD3_ADDR A:0xfca01854
y.create.l HWIO_MSS_HI0_CH6_FLUSH_STATE3_SD0_ADDR A:0xfca00c58
y.create.l HWIO_MSS_HI0_CH6_FLUSH_STATE3_SD1_ADDR A:0xfca01058
y.create.l HWIO_MSS_HI0_CH6_FLUSH_STATE3_SD2_ADDR A:0xfca01458
y.create.l HWIO_MSS_HI0_CH6_FLUSH_STATE3_SD3_ADDR A:0xfca01858
y.create.l HWIO_MSS_HI0_CH7_FLUSH_STATE3_SD0_ADDR A:0xfca00c5c
y.create.l HWIO_MSS_HI0_CH7_FLUSH_STATE3_SD1_ADDR A:0xfca0105c
y.create.l HWIO_MSS_HI0_CH7_FLUSH_STATE3_SD2_ADDR A:0xfca0145c
y.create.l HWIO_MSS_HI0_CH7_FLUSH_STATE3_SD3_ADDR A:0xfca0185c
y.create.l HWIO_MSS_HI0_CH0_FLUSH_STATE4_SD0_ADDR A:0xfca00c80
y.create.l HWIO_MSS_HI0_CH0_FLUSH_STATE4_SD1_ADDR A:0xfca01080
y.create.l HWIO_MSS_HI0_CH0_FLUSH_STATE4_SD2_ADDR A:0xfca01480
y.create.l HWIO_MSS_HI0_CH0_FLUSH_STATE4_SD3_ADDR A:0xfca01880
y.create.l HWIO_MSS_HI0_CH1_FLUSH_STATE4_SD0_ADDR A:0xfca00c84
y.create.l HWIO_MSS_HI0_CH1_FLUSH_STATE4_SD1_ADDR A:0xfca01084
y.create.l HWIO_MSS_HI0_CH1_FLUSH_STATE4_SD2_ADDR A:0xfca01484
y.create.l HWIO_MSS_HI0_CH1_FLUSH_STATE4_SD3_ADDR A:0xfca01884
y.create.l HWIO_MSS_HI0_CH2_FLUSH_STATE4_SD0_ADDR A:0xfca00c88
y.create.l HWIO_MSS_HI0_CH2_FLUSH_STATE4_SD1_ADDR A:0xfca01088
y.create.l HWIO_MSS_HI0_CH2_FLUSH_STATE4_SD2_ADDR A:0xfca01488
y.create.l HWIO_MSS_HI0_CH2_FLUSH_STATE4_SD3_ADDR A:0xfca01888
y.create.l HWIO_MSS_HI0_CH3_FLUSH_STATE4_SD0_ADDR A:0xfca00c8c
y.create.l HWIO_MSS_HI0_CH3_FLUSH_STATE4_SD1_ADDR A:0xfca0108c
y.create.l HWIO_MSS_HI0_CH3_FLUSH_STATE4_SD2_ADDR A:0xfca0148c
y.create.l HWIO_MSS_HI0_CH3_FLUSH_STATE4_SD3_ADDR A:0xfca0188c
y.create.l HWIO_MSS_HI0_CH4_FLUSH_STATE4_SD0_ADDR A:0xfca00c90
y.create.l HWIO_MSS_HI0_CH4_FLUSH_STATE4_SD1_ADDR A:0xfca01090
y.create.l HWIO_MSS_HI0_CH4_FLUSH_STATE4_SD2_ADDR A:0xfca01490
y.create.l HWIO_MSS_HI0_CH4_FLUSH_STATE4_SD3_ADDR A:0xfca01890
y.create.l HWIO_MSS_HI0_CH5_FLUSH_STATE4_SD0_ADDR A:0xfca00c94
y.create.l HWIO_MSS_HI0_CH5_FLUSH_STATE4_SD1_ADDR A:0xfca01094
y.create.l HWIO_MSS_HI0_CH5_FLUSH_STATE4_SD2_ADDR A:0xfca01494
y.create.l HWIO_MSS_HI0_CH5_FLUSH_STATE4_SD3_ADDR A:0xfca01894
y.create.l HWIO_MSS_HI0_CH6_FLUSH_STATE4_SD0_ADDR A:0xfca00c98
y.create.l HWIO_MSS_HI0_CH6_FLUSH_STATE4_SD1_ADDR A:0xfca01098
y.create.l HWIO_MSS_HI0_CH6_FLUSH_STATE4_SD2_ADDR A:0xfca01498
y.create.l HWIO_MSS_HI0_CH6_FLUSH_STATE4_SD3_ADDR A:0xfca01898
y.create.l HWIO_MSS_HI0_CH7_FLUSH_STATE4_SD0_ADDR A:0xfca00c9c
y.create.l HWIO_MSS_HI0_CH7_FLUSH_STATE4_SD1_ADDR A:0xfca0109c
y.create.l HWIO_MSS_HI0_CH7_FLUSH_STATE4_SD2_ADDR A:0xfca0149c
y.create.l HWIO_MSS_HI0_CH7_FLUSH_STATE4_SD3_ADDR A:0xfca0189c
y.create.l HWIO_MSS_HI0_CH0_FLUSH_STATE5_SD0_ADDR A:0xfca00cc0
y.create.l HWIO_MSS_HI0_CH0_FLUSH_STATE5_SD1_ADDR A:0xfca010c0
y.create.l HWIO_MSS_HI0_CH0_FLUSH_STATE5_SD2_ADDR A:0xfca014c0
y.create.l HWIO_MSS_HI0_CH0_FLUSH_STATE5_SD3_ADDR A:0xfca018c0
y.create.l HWIO_MSS_HI0_CH1_FLUSH_STATE5_SD0_ADDR A:0xfca00cc4
y.create.l HWIO_MSS_HI0_CH1_FLUSH_STATE5_SD1_ADDR A:0xfca010c4
y.create.l HWIO_MSS_HI0_CH1_FLUSH_STATE5_SD2_ADDR A:0xfca014c4
y.create.l HWIO_MSS_HI0_CH1_FLUSH_STATE5_SD3_ADDR A:0xfca018c4
y.create.l HWIO_MSS_HI0_CH2_FLUSH_STATE5_SD0_ADDR A:0xfca00cc8
y.create.l HWIO_MSS_HI0_CH2_FLUSH_STATE5_SD1_ADDR A:0xfca010c8
y.create.l HWIO_MSS_HI0_CH2_FLUSH_STATE5_SD2_ADDR A:0xfca014c8
y.create.l HWIO_MSS_HI0_CH2_FLUSH_STATE5_SD3_ADDR A:0xfca018c8
y.create.l HWIO_MSS_HI0_CH3_FLUSH_STATE5_SD0_ADDR A:0xfca00ccc
y.create.l HWIO_MSS_HI0_CH3_FLUSH_STATE5_SD1_ADDR A:0xfca010cc
y.create.l HWIO_MSS_HI0_CH3_FLUSH_STATE5_SD2_ADDR A:0xfca014cc
y.create.l HWIO_MSS_HI0_CH3_FLUSH_STATE5_SD3_ADDR A:0xfca018cc
y.create.l HWIO_MSS_HI0_CH4_FLUSH_STATE5_SD0_ADDR A:0xfca00cd0
y.create.l HWIO_MSS_HI0_CH4_FLUSH_STATE5_SD1_ADDR A:0xfca010d0
y.create.l HWIO_MSS_HI0_CH4_FLUSH_STATE5_SD2_ADDR A:0xfca014d0
y.create.l HWIO_MSS_HI0_CH4_FLUSH_STATE5_SD3_ADDR A:0xfca018d0
y.create.l HWIO_MSS_HI0_CH5_FLUSH_STATE5_SD0_ADDR A:0xfca00cd4
y.create.l HWIO_MSS_HI0_CH5_FLUSH_STATE5_SD1_ADDR A:0xfca010d4
y.create.l HWIO_MSS_HI0_CH5_FLUSH_STATE5_SD2_ADDR A:0xfca014d4
y.create.l HWIO_MSS_HI0_CH5_FLUSH_STATE5_SD3_ADDR A:0xfca018d4
y.create.l HWIO_MSS_HI0_CH6_FLUSH_STATE5_SD0_ADDR A:0xfca00cd8
y.create.l HWIO_MSS_HI0_CH6_FLUSH_STATE5_SD1_ADDR A:0xfca010d8
y.create.l HWIO_MSS_HI0_CH6_FLUSH_STATE5_SD2_ADDR A:0xfca014d8
y.create.l HWIO_MSS_HI0_CH6_FLUSH_STATE5_SD3_ADDR A:0xfca018d8
y.create.l HWIO_MSS_HI0_CH7_FLUSH_STATE5_SD0_ADDR A:0xfca00cdc
y.create.l HWIO_MSS_HI0_CH7_FLUSH_STATE5_SD1_ADDR A:0xfca010dc
y.create.l HWIO_MSS_HI0_CH7_FLUSH_STATE5_SD2_ADDR A:0xfca014dc
y.create.l HWIO_MSS_HI0_CH7_FLUSH_STATE5_SD3_ADDR A:0xfca018dc
y.create.l HWIO_MSS_HI0_SEC_DOMAIN_IRQ_STATUS_SD0_ADDR A:0xfca00e80
y.create.l HWIO_MSS_HI0_SEC_DOMAIN_IRQ_STATUS_SD1_ADDR A:0xfca01280
y.create.l HWIO_MSS_HI0_SEC_DOMAIN_IRQ_STATUS_SD2_ADDR A:0xfca01680
y.create.l HWIO_MSS_HI0_SEC_DOMAIN_IRQ_STATUS_SD3_ADDR A:0xfca01a80
y.create.l HWIO_MSS_HI0_CH0_RSLT_CONF_SD0_ADDR A:0xfca00e00
y.create.l HWIO_MSS_HI0_CH0_RSLT_CONF_SD1_ADDR A:0xfca01200
y.create.l HWIO_MSS_HI0_CH0_RSLT_CONF_SD2_ADDR A:0xfca01600
y.create.l HWIO_MSS_HI0_CH0_RSLT_CONF_SD3_ADDR A:0xfca01a00
y.create.l HWIO_MSS_HI0_CH1_RSLT_CONF_SD0_ADDR A:0xfca00e04
y.create.l HWIO_MSS_HI0_CH1_RSLT_CONF_SD1_ADDR A:0xfca01204
y.create.l HWIO_MSS_HI0_CH1_RSLT_CONF_SD2_ADDR A:0xfca01604
y.create.l HWIO_MSS_HI0_CH1_RSLT_CONF_SD3_ADDR A:0xfca01a04
y.create.l HWIO_MSS_HI0_CH2_RSLT_CONF_SD0_ADDR A:0xfca00e08
y.create.l HWIO_MSS_HI0_CH2_RSLT_CONF_SD1_ADDR A:0xfca01208
y.create.l HWIO_MSS_HI0_CH2_RSLT_CONF_SD2_ADDR A:0xfca01608
y.create.l HWIO_MSS_HI0_CH2_RSLT_CONF_SD3_ADDR A:0xfca01a08
y.create.l HWIO_MSS_HI0_CH3_RSLT_CONF_SD0_ADDR A:0xfca00e0c
y.create.l HWIO_MSS_HI0_CH3_RSLT_CONF_SD1_ADDR A:0xfca0120c
y.create.l HWIO_MSS_HI0_CH3_RSLT_CONF_SD2_ADDR A:0xfca0160c
y.create.l HWIO_MSS_HI0_CH3_RSLT_CONF_SD3_ADDR A:0xfca01a0c
y.create.l HWIO_MSS_HI0_CH4_RSLT_CONF_SD0_ADDR A:0xfca00e10
y.create.l HWIO_MSS_HI0_CH4_RSLT_CONF_SD1_ADDR A:0xfca01210
y.create.l HWIO_MSS_HI0_CH4_RSLT_CONF_SD2_ADDR A:0xfca01610
y.create.l HWIO_MSS_HI0_CH4_RSLT_CONF_SD3_ADDR A:0xfca01a10
y.create.l HWIO_MSS_HI0_CH5_RSLT_CONF_SD0_ADDR A:0xfca00e14
y.create.l HWIO_MSS_HI0_CH5_RSLT_CONF_SD1_ADDR A:0xfca01214
y.create.l HWIO_MSS_HI0_CH5_RSLT_CONF_SD2_ADDR A:0xfca01614
y.create.l HWIO_MSS_HI0_CH5_RSLT_CONF_SD3_ADDR A:0xfca01a14
y.create.l HWIO_MSS_HI0_CH6_RSLT_CONF_SD0_ADDR A:0xfca00e18
y.create.l HWIO_MSS_HI0_CH6_RSLT_CONF_SD1_ADDR A:0xfca01218
y.create.l HWIO_MSS_HI0_CH6_RSLT_CONF_SD2_ADDR A:0xfca01618
y.create.l HWIO_MSS_HI0_CH6_RSLT_CONF_SD3_ADDR A:0xfca01a18
y.create.l HWIO_MSS_HI0_CH7_RSLT_CONF_SD0_ADDR A:0xfca00e1c
y.create.l HWIO_MSS_HI0_CH7_RSLT_CONF_SD1_ADDR A:0xfca0121c
y.create.l HWIO_MSS_HI0_CH7_RSLT_CONF_SD2_ADDR A:0xfca0161c
y.create.l HWIO_MSS_HI0_CH7_RSLT_CONF_SD3_ADDR A:0xfca01a1c
y.create.l HWIO_MSS_HI0_CH0_STATUS_SD0_ADDR A:0xfca00d00
y.create.l HWIO_MSS_HI0_CH0_STATUS_SD1_ADDR A:0xfca01100
y.create.l HWIO_MSS_HI0_CH0_STATUS_SD2_ADDR A:0xfca01500
y.create.l HWIO_MSS_HI0_CH0_STATUS_SD3_ADDR A:0xfca01900
y.create.l HWIO_MSS_HI0_CH1_STATUS_SD0_ADDR A:0xfca00d04
y.create.l HWIO_MSS_HI0_CH1_STATUS_SD1_ADDR A:0xfca01104
y.create.l HWIO_MSS_HI0_CH1_STATUS_SD2_ADDR A:0xfca01504
y.create.l HWIO_MSS_HI0_CH1_STATUS_SD3_ADDR A:0xfca01904
y.create.l HWIO_MSS_HI0_CH2_STATUS_SD0_ADDR A:0xfca00d08
y.create.l HWIO_MSS_HI0_CH2_STATUS_SD1_ADDR A:0xfca01108
y.create.l HWIO_MSS_HI0_CH2_STATUS_SD2_ADDR A:0xfca01508
y.create.l HWIO_MSS_HI0_CH2_STATUS_SD3_ADDR A:0xfca01908
y.create.l HWIO_MSS_HI0_CH3_STATUS_SD0_ADDR A:0xfca00d0c
y.create.l HWIO_MSS_HI0_CH3_STATUS_SD1_ADDR A:0xfca0110c
y.create.l HWIO_MSS_HI0_CH3_STATUS_SD2_ADDR A:0xfca0150c
y.create.l HWIO_MSS_HI0_CH3_STATUS_SD3_ADDR A:0xfca0190c
y.create.l HWIO_MSS_HI0_CH4_STATUS_SD0_ADDR A:0xfca00d10
y.create.l HWIO_MSS_HI0_CH4_STATUS_SD1_ADDR A:0xfca01110
y.create.l HWIO_MSS_HI0_CH4_STATUS_SD2_ADDR A:0xfca01510
y.create.l HWIO_MSS_HI0_CH4_STATUS_SD3_ADDR A:0xfca01910
y.create.l HWIO_MSS_HI0_CH5_STATUS_SD0_ADDR A:0xfca00d14
y.create.l HWIO_MSS_HI0_CH5_STATUS_SD1_ADDR A:0xfca01114
y.create.l HWIO_MSS_HI0_CH5_STATUS_SD2_ADDR A:0xfca01514
y.create.l HWIO_MSS_HI0_CH5_STATUS_SD3_ADDR A:0xfca01914
y.create.l HWIO_MSS_HI0_CH6_STATUS_SD0_ADDR A:0xfca00d18
y.create.l HWIO_MSS_HI0_CH6_STATUS_SD1_ADDR A:0xfca01118
y.create.l HWIO_MSS_HI0_CH6_STATUS_SD2_ADDR A:0xfca01518
y.create.l HWIO_MSS_HI0_CH6_STATUS_SD3_ADDR A:0xfca01918
y.create.l HWIO_MSS_HI0_CH7_STATUS_SD0_ADDR A:0xfca00d1c
y.create.l HWIO_MSS_HI0_CH7_STATUS_SD1_ADDR A:0xfca0111c
y.create.l HWIO_MSS_HI0_CH7_STATUS_SD2_ADDR A:0xfca0151c
y.create.l HWIO_MSS_HI0_CH7_STATUS_SD3_ADDR A:0xfca0191c
y.create.l HWIO_MSS_HI0_CH0_CONF_ADDR A:0xfca00d40
y.create.l HWIO_MSS_HI0_CH1_CONF_ADDR A:0xfca00d44
y.create.l HWIO_MSS_HI0_CH2_CONF_ADDR A:0xfca00d48
y.create.l HWIO_MSS_HI0_CH3_CONF_ADDR A:0xfca00d4c
y.create.l HWIO_MSS_HI0_CH4_CONF_ADDR A:0xfca00d50
y.create.l HWIO_MSS_HI0_CH5_CONF_ADDR A:0xfca00d54
y.create.l HWIO_MSS_HI0_CH6_CONF_ADDR A:0xfca00d58
y.create.l HWIO_MSS_HI0_CH7_CONF_ADDR A:0xfca00d5c
y.create.l HWIO_MSS_HI0_CH0_DBG_0_ADDR A:0xfca00d80
y.create.l HWIO_MSS_HI0_CH1_DBG_0_ADDR A:0xfca00d84
y.create.l HWIO_MSS_HI0_CH2_DBG_0_ADDR A:0xfca00d88
y.create.l HWIO_MSS_HI0_CH3_DBG_0_ADDR A:0xfca00d8c
y.create.l HWIO_MSS_HI0_CH4_DBG_0_ADDR A:0xfca00d90
y.create.l HWIO_MSS_HI0_CH5_DBG_0_ADDR A:0xfca00d94
y.create.l HWIO_MSS_HI0_CH6_DBG_0_ADDR A:0xfca00d98
y.create.l HWIO_MSS_HI0_CH7_DBG_0_ADDR A:0xfca00d9c
y.create.l HWIO_MSS_HI0_CH0_DBG_1_ADDR A:0xfca00dc0
y.create.l HWIO_MSS_HI0_CH1_DBG_1_ADDR A:0xfca00dc4
y.create.l HWIO_MSS_HI0_CH2_DBG_1_ADDR A:0xfca00dc8
y.create.l HWIO_MSS_HI0_CH3_DBG_1_ADDR A:0xfca00dcc
y.create.l HWIO_MSS_HI0_CH4_DBG_1_ADDR A:0xfca00dd0
y.create.l HWIO_MSS_HI0_CH5_DBG_1_ADDR A:0xfca00dd4
y.create.l HWIO_MSS_HI0_CH6_DBG_1_ADDR A:0xfca00dd8
y.create.l HWIO_MSS_HI0_CH7_DBG_1_ADDR A:0xfca00ddc
y.create.l HWIO_MSS_HI0_CI0_CONF_ADDR A:0xfca00e90
y.create.l HWIO_MSS_HI0_CI1_CONF_ADDR A:0xfca00e94
y.create.l HWIO_MSS_HI0_CI2_CONF_ADDR A:0xfca00e98
y.create.l HWIO_MSS_HI0_CI3_CONF_ADDR A:0xfca00e9c
y.create.l HWIO_MSS_HI0_CI4_CONF_ADDR A:0xfca00ea0
y.create.l HWIO_MSS_HI0_CI5_CONF_ADDR A:0xfca00ea4
y.create.l HWIO_MSS_HI0_CI6_CONF_ADDR A:0xfca00ea8
y.create.l HWIO_MSS_HI0_CI7_CONF_ADDR A:0xfca00eac
y.create.l HWIO_MSS_HI0_CI0_DBG_ERR_ADDR A:0xfca00eb0
y.create.l HWIO_MSS_HI0_CI1_DBG_ERR_ADDR A:0xfca00eb4
y.create.l HWIO_MSS_HI0_CI2_DBG_ERR_ADDR A:0xfca00eb8
y.create.l HWIO_MSS_HI0_CI3_DBG_ERR_ADDR A:0xfca00ebc
y.create.l HWIO_MSS_HI0_CI4_DBG_ERR_ADDR A:0xfca00ec0
y.create.l HWIO_MSS_HI0_CI5_DBG_ERR_ADDR A:0xfca00ec4
y.create.l HWIO_MSS_HI0_CI6_DBG_ERR_ADDR A:0xfca00ec8
y.create.l HWIO_MSS_HI0_CI7_DBG_ERR_ADDR A:0xfca00ecc
y.create.l HWIO_MSS_HI0_CRCI_DBG_ADDR A:0xfca00ed0
y.create.l HWIO_MSS_HI0_CRCI_STATUS_ADDR A:0xfca00ed4
y.create.l HWIO_MSS_HI0_GP_CTL_ADDR A:0xfca00ed8
y.create.l HWIO_MSS_HI0_GP_STATUS_ADDR A:0xfca00edc
y.create.l HWIO_MSS_HI0_GLBL_DBG_CMD_ENG_ADDR A:0xfca00ee0
y.create.l HWIO_MSS_HI0_GLBL_DBG_REQ_ENG_ADDR A:0xfca00ee4
y.create.l HWIO_MSS_HI0_GLBL_DBG_XFR_ENG_ADDR A:0xfca00ee8
y.create.l HWIO_MSS_HI0_GLBL_DBG_CHAN_BLK_ADDR A:0xfca00eec
y.create.l HWIO_MSS_HI0_GLBL_DBG_CHAN_BLK_CLR_ADDR A:0xfca00ef0
y.create.l HWIO_MSS_HI0_GLBL_DBG_TEST_SEL_ADDR A:0xfca00ef4
y.create.l HWIO_MSS_NAV_CLK_ENABLE_ADDR A:0xfcaf8000
y.create.l HWIO_MSS_NAV_CLK_RESET_ADDR A:0xfcaf8004
y.create.l HWIO_MSS_NAV_CLK_CTL_ADDR A:0xfcaf8008
y.create.l HWIO_MSS_NAV_CLK_FRAC31_M_ADDR A:0xfcaf800c
y.create.l HWIO_MSS_NAV_CLK_FRAC31_NOT_2D_ADDR A:0xfcaf8010
y.create.l HWIO_MSS_NAV_CLK_FRAC31_NOT_N_MINUS_M_ADDR A:0xfcaf8014
y.create.l HWIO_MSS_NAV_CLK_FRAC31_UPDATE_ADDR A:0xfcaf8018
y.create.l HWIO_MSS_NAV_CLK_GDS_ADDR A:0xfcaf801c
y.create.l HWIO_MSS_GNSS_ADC_CMD0_ADDR A:0xfcaf0000
y.create.l HWIO_MSS_GNSS_ADC_CMD1_ADDR A:0xfcaf0004
y.create.l HWIO_MSS_GNSS_ADC_CMD2_ADDR A:0xfcaf0008
y.create.l HWIO_MSS_GNSS_ADC_CMD3_ADDR A:0xfcaf000c
y.create.l HWIO_MSS_GNSS_ADC_IDDQ_ADDR A:0xfcaf0010
y.create.l HWIO_MEM_POOL_MEM_PAGE0_START_ADDR A:0xfcbc0000
y.create.l HWIO_MEM_POOL_MEM_PAGE0_END_ADDR A:0xfcbcfffc
y.create.l HWIO_MEM_POOL_MEM_PAGE1_START_ADDR A:0xfcbd0000
y.create.l HWIO_MEM_POOL_MEM_PAGE1_END_ADDR A:0xfcbdfffc
y.create.l HWIO_VPE_ENABLE_ADDR A:0xfcb80000
y.create.l HWIO_VPE_CLK_CTL_ADDR A:0xfcb80004
y.create.l HWIO_VPE_VU_CLK_EN_ADDR A:0xfcb80008
y.create.l HWIO_VPE_PWR_SEQ_EN_ADDR A:0xfcb8000c
y.create.l HWIO_VPE_MODE_CTL_ADDR A:0xfcb80010
y.create.l HWIO_VPE_PWR_SEQ_THRES_ADDR A:0xfcb80014
y.create.l HWIO_VPE_PWR_GATING_STATUS_ADDR A:0xfcb80018
y.create.l HWIO_VPE_AHB_MPBR_CTL_ADDR A:0xfcb8001c
y.create.l HWIO_VPE_AHB_MPBR_WDATA_ADDR A:0xfcb80020
y.create.l HWIO_VPE_AHB_MPBR_RDATA_ADDR A:0xfcb80024
y.create.l HWIO_VPE_AHB_MPBR_CH_EN_ADDR A:0xfcb80028
y.create.l HWIO_VPE_IU_IRQ_PEND_WDATA_ADDR A:0xfcb8002c
y.create.l HWIO_VPE_IU_IRQ_PEND_RDATA_ADDR A:0xfcb80030
y.create.l HWIO_VPE_MVP_SCHEDULE_ADDR A:0xfcb80034
y.create.l HWIO_VPE_DBG_EN_ADDR A:0xfcb80040
y.create.l HWIO_VPE_DBG_HWTRACE_CTL_ADDR A:0xfcb80044
y.create.l HWIO_VPE_DBG_PCTRACE_CTL_ADDR A:0xfcb80048
y.create.l HWIO_VPE_DBG_PCBUF_STAT_VP0_ADDR A:0xfcb8004c
y.create.l HWIO_VPE_DBG_PCBUF_STAT_VP1_ADDR A:0xfcb80050
y.create.l HWIO_VPE_DBG_PCBUF_STAT_VP2_ADDR A:0xfcb80054
y.create.l HWIO_VPE_DBG_PCBUF_STAT_VP3_ADDR A:0xfcb80058
y.create.l HWIO_VPE_DBG_PCBUF_DATA_VP0_ADDR A:0xfcb80060
y.create.l HWIO_VPE_DBG_PCBUF_DATA_VP1_ADDR A:0xfcb80064
y.create.l HWIO_VPE_DBG_PCBUF_DATA_VP2_ADDR A:0xfcb80068
y.create.l HWIO_VPE_DBG_PCBUF_DATA_VP3_ADDR A:0xfcb8006c
y.create.l HWIO_VPE_DMEM_START_ADDR A:0xfcb81000
y.create.l HWIO_VPE_DMEM_END_ADDR A:0xfcb86ffc
y.create.l HWIO_VPE_PMEM_START_ADDR A:0xfcb87000
y.create.l HWIO_VPE_PMEM_END_ADDR A:0xfcbaaffc
y.create.l HWIO_TX_ENABLE_ADDR A:0xfcb70000
y.create.l HWIO_TX_MODE_ADDR A:0xfcb70004
y.create.l HWIO_TX_DAC_OUTPUT_SEL_ADDR A:0xfcb70008
y.create.l HWIO_TX_MEM_ACCESS_CFG_ADDR A:0xfcb70010
y.create.l HWIO_TXR_CTRL_ADDR A:0xfcb70014
y.create.l HWIO_TX_MEM_PAGE_ADDR A:0xfcb70018
y.create.l HWIO_TX_MEMPOOL_WR_INTF_CTL_ADDR A:0xfcb7001c
y.create.l HWIO_TX_MEMPOOL_WR_INTF_EVENT_ADDR A:0xfcb70020
y.create.l HWIO_TX_MEMPOOL_RD_INTF_CTL_ADDR A:0xfcb70024
y.create.l HWIO_TX_MEMPOOL_RD_INTF_EVENT_ADDR A:0xfcb70028
y.create.l HWIO_TX_STMR_TRIG_FRAC_CNT_0_ADDR A:0xfcb7002c
y.create.l HWIO_TX_STMR_TRIG_FRAC_CNT_1_ADDR A:0xfcb70030
y.create.l HWIO_TX_FRAME_STB_FRAC_CNT_0_ADDR A:0xfcb70034
y.create.l HWIO_TX_FRAME_STB_FRAC_CNT_1_ADDR A:0xfcb70038
y.create.l HWIO_TX_MISR_CTRL_ADDR A:0xfcb7003c
y.create.l HWIO_TX_MISR_RD_DATA_ADDR A:0xfcb70040
y.create.l HWIO_TX_MISR_CAP_CMD_ADDR A:0xfcb70044
y.create.l HWIO_TX_TDS_CTRL_ADDR A:0xfcb70048
y.create.l HWIO_TX_TECH_MUX_CTRL_ADDR A:0xfcb7004c
y.create.l HWIO_HARQ_DONE_STATUS_ADDR A:0xfcb70050
y.create.l HWIO_TX_MODE_0_ADDR A:0xfcb70054
y.create.l HWIO_TX_MODE_1_ADDR A:0xfcb70058
y.create.l HWIO_TX_MODE_COMMON_ADDR A:0xfcb7005c
y.create.l HWIO_TX_MODE_OFDMA_ADDR A:0xfcb70060
y.create.l HWIO_TX_MODE_CDMA_ADDR A:0xfcb70064
y.create.l HWIO_TX_MODE_UMTS_ADDR A:0xfcb70068
y.create.l HWIO_TX_ENABLE_GSM_ADDR A:0xfcb7006c
y.create.l HWIO_TXC_MEM_TEST_ADDR A:0xfcb70070
y.create.l HWIO_MOD_MODE_ADDR A:0xfcb71000
y.create.l HWIO_I_PN_STATE_01_ADDR A:0xfcb71004
y.create.l HWIO_Q_PN_STATE_01_ADDR A:0xfcb71008
y.create.l HWIO_U_PN_STATE_03_ADDR A:0xfcb7100c
y.create.l HWIO_U_PN_STATE_45_ADDR A:0xfcb71010
y.create.l HWIO_U_PN_STATE_BOZO_ADDR A:0xfcb71014
y.create.l HWIO_U_PN_MASK_03_ADDR A:0xfcb71018
y.create.l HWIO_U_PN_MASK_45_ADDR A:0xfcb7101c
y.create.l HWIO_FRAME_OFF_ADDR A:0xfcb71020
y.create.l HWIO_MOD_STMR_MODIFIER_ADDR A:0xfcb71024
y.create.l HWIO_MOD_ADVRET_SLEW_CNT_ADDR A:0xfcb71028
y.create.l HWIO_MOD_ADVRET_CMD_ADDR A:0xfcb7102c
y.create.l HWIO_MOD_STMR_CTRL_REG_ADDR A:0xfcb71030
y.create.l HWIO_MOD_STMR_CMD_ADDR A:0xfcb71034
y.create.l HWIO_MOD_TX_TIME_LATCH_ADDR A:0xfcb71044
y.create.l HWIO_MOD_TX_TIME_RD_ADDR A:0xfcb71048
y.create.l HWIO_MOD_CH1_TIMING_CTL_ADDR A:0xfcb7104c
y.create.l HWIO_MOD_CH2_TIMING_CTL_ADDR A:0xfcb71050
y.create.l HWIO_MOD_CH3_TIMING_CTL_ADDR A:0xfcb71054
y.create.l HWIO_MOD_WCOVER_SEL_ADDR A:0xfcb71058
y.create.l HWIO_MOD_CH1_ENC_CTL_ADDR A:0xfcb7105c
y.create.l HWIO_MOD_CH1_CRC_POLY_ADDR A:0xfcb71060
y.create.l HWIO_MOD_CH1_PUNCT_PATN_1_ADDR A:0xfcb71064
y.create.l HWIO_MOD_CH1_PUNCT_PATN_0_ADDR A:0xfcb71068
y.create.l HWIO_MOD_CH2_ENC_CTL_0_ADDR A:0xfcb7106c
y.create.l HWIO_MOD_CH2_ENC_CTL_1_ADDR A:0xfcb71070
y.create.l HWIO_MOD_CH2_CRC_POLY_ADDR A:0xfcb71074
y.create.l HWIO_MOD_CH2_PUNCT_PATN_1_ADDR A:0xfcb71078
y.create.l HWIO_MOD_CH2_PUNCT_PATN_0_ADDR A:0xfcb7107c
y.create.l HWIO_MOD_CH3_ENC_CTL_0_ADDR A:0xfcb71110
y.create.l HWIO_MOD_CH3_ENC_CTL_1_ADDR A:0xfcb71114
y.create.l HWIO_MOD_CH3_CRC_POLY_ADDR A:0xfcb7111c
y.create.l HWIO_MOD_CH3_PUNCT_PATN_1_ADDR A:0xfcb71120
y.create.l HWIO_MOD_CH3_PUNCT_PATN_0_ADDR A:0xfcb71124
y.create.l HWIO_MOD_SCH_LTU_CTL_ADDR A:0xfcb71130
y.create.l HWIO_MOD_MISC_CTL_ADDR A:0xfcb71098
y.create.l HWIO_MOD_WSYM_STATE_ADDR A:0xfcb710a0
y.create.l HWIO_MOD_PICH_PCBIT_DATA_ADDR A:0xfcb710b0
y.create.l HWIO_MOD_PICH_PCBIT_MASK_ADDR A:0xfcb710b4
y.create.l HWIO_MOD_STATUS_ADDR A:0xfcb710b8
y.create.l HWIO_MASK_DATA_ADDR A:0xfcb710bc
y.create.l HWIO_MOD_IQ_MM_COEFF_A_ADDR A:0xfcb710cc
y.create.l HWIO_MOD_IQ_MM_COEFF_B_ADDR A:0xfcb710d0
y.create.l HWIO_MOD_VAR_GAIN_SHIFT_DLY_ADDR A:0xfcb710d4
y.create.l HWIO_MOD_CORDIC_DLY_ADDR A:0xfcb710d8
y.create.l HWIO_MOD_TEST_CTL_ADDR A:0xfcb710dc
y.create.l HWIO_REVMOD_PN_LONG_STATE_H_ADDR A:0xfcb71138
y.create.l HWIO_REVMOD_PN_LONG_STATE_L_ADDR A:0xfcb7113c
y.create.l HWIO_REVMOD_0_PN_I_LONG_MASK_H_ADDR A:0xfcb71140
y.create.l HWIO_REVMOD_0_PN_I_LONG_MASK_L_ADDR A:0xfcb71144
y.create.l HWIO_REVMOD_1_PN_I_LONG_MASK_H_ADDR A:0xfcb71148
y.create.l HWIO_REVMOD_1_PN_I_LONG_MASK_L_ADDR A:0xfcb7114c
y.create.l HWIO_REVMOD_2_PN_I_LONG_MASK_H_ADDR A:0xfcb71150
y.create.l HWIO_REVMOD_2_PN_I_LONG_MASK_L_ADDR A:0xfcb71154
y.create.l HWIO_REVMOD_0_PN_Q_LONG_MASK_H_ADDR A:0xfcb71158
y.create.l HWIO_REVMOD_0_PN_Q_LONG_MASK_L_ADDR A:0xfcb7115c
y.create.l HWIO_REVMOD_1_PN_Q_LONG_MASK_H_ADDR A:0xfcb71160
y.create.l HWIO_REVMOD_1_PN_Q_LONG_MASK_L_ADDR A:0xfcb71164
y.create.l HWIO_REVMOD_2_PN_Q_LONG_MASK_H_ADDR A:0xfcb71168
y.create.l HWIO_REVMOD_2_PN_Q_LONG_MASK_L_ADDR A:0xfcb7116c
y.create.l HWIO_REVMOD_0_MCDO_CTL_ADDR A:0xfcb71170
y.create.l HWIO_REVMOD_1_MCDO_CTL_ADDR A:0xfcb71174
y.create.l HWIO_REVMOD_2_MCDO_CTL_ADDR A:0xfcb71178
y.create.l HWIO_REVMOD_0_MCDO_FOC_PN_CTL_ADDR A:0xfcb7117c
y.create.l HWIO_REVMOD_1_MCDO_FOC_PN_CTL_ADDR A:0xfcb71180
y.create.l HWIO_REVMOD_2_MCDO_FOC_PN_CTL_ADDR A:0xfcb71184
y.create.l HWIO_REVMOD_MCDO_TRAFFIC_PN_CTL_ADDR A:0xfcb71188
y.create.l HWIO_REVMOD_PN_CTL_ADDR A:0xfcb7118c
y.create.l HWIO_REVMOD_FRAME_OFFSET_ADDR A:0xfcb71190
y.create.l HWIO_REVMOD_TIME_STAMP_CTL_ADDR A:0xfcb71194
y.create.l HWIO_REVMOD_TIME_STAMP_ADDR A:0xfcb71198
y.create.l HWIO_REVMOD_TIME_STAMP2_ADDR A:0xfcb7119c
y.create.l HWIO_REVMOD_FRM_CNT_OFFSET_ADDR A:0xfcb711a0
y.create.l HWIO_REVMOD_FRM_CNT_OFFSET_CTL_ADDR A:0xfcb711a4
y.create.l HWIO_REVMOD_TX_TIME_LATCH_ADDR A:0xfcb711a8
y.create.l HWIO_REVMOD_TX_TIME_RD_ADDR A:0xfcb711ac
y.create.l HWIO_REVMOD_FRAME_INT_OFFSET_ADDR A:0xfcb711b0
y.create.l HWIO_REVMOD_ENC_RATE_ADDR A:0xfcb711b4
y.create.l HWIO_REVMOD_EDI_CONTROL_ADDR A:0xfcb711b8
y.create.l HWIO_REVMOD_EDI_STATUS_ADDR A:0xfcb711e4
y.create.l HWIO_REVMOD_TENC_CTL_ADDR A:0xfcb711bc
y.create.l HWIO_REVMOD_TENC_STATUS_ADDR A:0xfcb711c0
y.create.l HWIO_REVMOD_0_INBUF_STATUS_ADDR A:0xfcb711c4
y.create.l HWIO_REVMOD_1_INBUF_STATUS_ADDR A:0xfcb711c8
y.create.l HWIO_REVMOD_2_INBUF_STATUS_ADDR A:0xfcb711cc
y.create.l HWIO_REVMOD_OUTBUF_STATUS_ADDR A:0xfcb711d0
y.create.l HWIO_REVMOD_RRI_REQUEST_ADDR A:0xfcb711d4
y.create.l HWIO_REVMOD_MOD_CTL_ADDR A:0xfcb711d8
y.create.l HWIO_REVMOD_ENC_MODE_ADDR A:0xfcb711dc
y.create.l HWIO_REVMOD_PA_CTL_ADDR A:0xfcb711e0
y.create.l HWIO_MOD_CDMA_TX_INT_STATUS_ADDR A:0xfcb711f8
y.create.l HWIO_MOD_CDMA_TX_INT_CLR_ADDR A:0xfcb711fc
y.create.l HWIO_MOD_CDMA_TX_INT_EN_ADDR A:0xfcb71200
y.create.l HWIO_MOD_SDO_SLOT_OFFSET_ADDR A:0xfcb71220
y.create.l HWIO_MOD_SDO_CTL_ADDR A:0xfcb71224
y.create.l HWIO_MOD_SDO_CNTR_RESET_ADDR A:0xfcb71228
y.create.l HWIO_REVMOD_0_DSP_INBUF_MUX_ADDR A:0xfcb7122c
y.create.l HWIO_REVMOD_0_DSP_RRI_ADDR A:0xfcb71230
y.create.l HWIO_REVMOD_0_DSC_VALUE_ADDR A:0xfcb71234
y.create.l HWIO_REVMOD_0_DRC_CODE_INDEX_ADDR A:0xfcb71238
y.create.l HWIO_REVMOD_0_DRC_WALSH_COVER_ADDR A:0xfcb7123c
y.create.l HWIO_REVMOD_0_ACK_CTL_ADDR A:0xfcb71240
y.create.l HWIO_REVMOD_1_DSP_INBUF_MUX_ADDR A:0xfcb71244
y.create.l HWIO_REVMOD_1_DSP_RRI_ADDR A:0xfcb71248
y.create.l HWIO_REVMOD_1_DSC_VALUE_ADDR A:0xfcb7124c
y.create.l HWIO_REVMOD_1_DRC_CODE_INDEX_ADDR A:0xfcb71250
y.create.l HWIO_REVMOD_1_DRC_WALSH_COVER_ADDR A:0xfcb71254
y.create.l HWIO_REVMOD_1_ACK_CTL_ADDR A:0xfcb71258
y.create.l HWIO_REVMOD_2_DSP_INBUF_MUX_ADDR A:0xfcb7125c
y.create.l HWIO_REVMOD_2_DSP_RRI_ADDR A:0xfcb71260
y.create.l HWIO_REVMOD_2_DSC_VALUE_ADDR A:0xfcb71264
y.create.l HWIO_REVMOD_2_DRC_CODE_INDEX_ADDR A:0xfcb71268
y.create.l HWIO_REVMOD_2_DRC_WALSH_COVER_ADDR A:0xfcb7126c
y.create.l HWIO_REVMOD_2_ACK_CTL_ADDR A:0xfcb71270
y.create.l HWIO_REVMOD_DSP_ENC_DATA_MUX_ADDR A:0xfcb71274
y.create.l HWIO_REVMOD_SCRAMB_INIT_ADDR A:0xfcb71278
y.create.l HWIO_REVMOD_START_ENC_ADDR A:0xfcb7127c
y.create.l HWIO_REVMOD_RATE_INDEX_ADDR A:0xfcb71280
y.create.l HWIO_SDO_DSP_GAIN_ADDR A:0xfcb71284
y.create.l HWIO_REVMOD_0_ROT_PHASE_INIT_ADDR A:0xfcb71294
y.create.l HWIO_REVMOD_1_ROT_PHASE_INIT_ADDR A:0xfcb71298
y.create.l HWIO_REVMOD_2_ROT_PHASE_INIT_ADDR A:0xfcb7129c
y.create.l HWIO_REVMOD_0_ROT_FREQ_STEP_ADDR A:0xfcb712a0
y.create.l HWIO_REVMOD_1_ROT_FREQ_STEP_ADDR A:0xfcb712a4
y.create.l HWIO_REVMOD_2_ROT_FREQ_STEP_ADDR A:0xfcb712a8
y.create.l HWIO_REVMOD_ROT_FREQ_CTL_ADDR A:0xfcb712ac
y.create.l HWIO_REVMOD_ROTANGLE_0_ADDR A:0xfcb712b0
y.create.l HWIO_REVMOD_ROTANGLE_1_ADDR A:0xfcb712b4
y.create.l HWIO_REVMOD_TX_SYS_TIME_ADDR A:0xfcb712b8
y.create.l HWIO_MOD_TX_SYS_TIME_ADDR A:0xfcb712bc
y.create.l HWIO_MOD_0_GAIN_0_1_ADDR A:0xfcb71300
y.create.l HWIO_MOD_0_GAIN_2_3_ADDR A:0xfcb71304
y.create.l HWIO_MOD_0_GAIN_4_5_ADDR A:0xfcb71308
y.create.l HWIO_MOD_0_GAIN_6_7_ADDR A:0xfcb7130c
y.create.l HWIO_MOD_0_GAIN_8_9_ADDR A:0xfcb71310
y.create.l HWIO_MOD_1_GAIN_0_1_ADDR A:0xfcb71314
y.create.l HWIO_MOD_1_GAIN_2_3_ADDR A:0xfcb71318
y.create.l HWIO_MOD_1_GAIN_4_5_ADDR A:0xfcb7131c
y.create.l HWIO_MOD_1_GAIN_6_7_ADDR A:0xfcb71320
y.create.l HWIO_MOD_1_GAIN_8_9_ADDR A:0xfcb71324
y.create.l HWIO_MOD_2_GAIN_0_1_ADDR A:0xfcb71328
y.create.l HWIO_MOD_2_GAIN_2_3_ADDR A:0xfcb7132c
y.create.l HWIO_MOD_2_GAIN_4_5_ADDR A:0xfcb71330
y.create.l HWIO_MOD_2_GAIN_6_7_ADDR A:0xfcb71334
y.create.l HWIO_MOD_2_GAIN_8_9_ADDR A:0xfcb71338
y.create.l HWIO_MOD_1X_GAIN_10_11_ADDR A:0xfcb7133c
y.create.l HWIO_MOD_1X_GAIN_12_13_ADDR A:0xfcb71340
y.create.l HWIO_MOD_1X_GAIN_14_15_ADDR A:0xfcb71344
y.create.l HWIO_MOD_0_BETAP_GAIN_ADDR A:0xfcb71410
y.create.l HWIO_MOD_1_BETAP_GAIN_ADDR A:0xfcb71414
y.create.l HWIO_MOD_2_BETAP_GAIN_ADDR A:0xfcb71418
y.create.l HWIO_MOD_BETAP_UPDATE_TIME_ADDR A:0xfcb7141c
y.create.l HWIO_MOD_DO_PA_RANGE_UPDATE_TIME_ADDR A:0xfcb71420
y.create.l HWIO_MOD_1X_PA_RANGE_UPDATE_TIME_ADDR A:0xfcb71350
y.create.l HWIO_MOD_DO_PA_RANGE_ADDR A:0xfcb71424
y.create.l HWIO_MOD_1X_PA_RANGE_ADDR A:0xfcb71428
y.create.l HWIO_MOD_1X_UPDATE_TIME_CTL_ADDR A:0xfcb7142c
y.create.l HWIO_MOD_DO_UPDATE_TIME_CTL_ADDR A:0xfcb7134c
y.create.l HWIO_MOD_MDSP_MISC_CTL_ADDR A:0xfcb71430
y.create.l HWIO_MOD_DO_TXC_VALID_UPDATE_TIME_ADDR A:0xfcb71348
y.create.l HWIO_MOD_1X_TXC_VALID_UPDATE_TIME_ADDR A:0xfcb71434
y.create.l HWIO_MOD_TXC_VALID_ADDR A:0xfcb71438
y.create.l HWIO_MOD_384CHIP_GAIN_UPDATE_EN_ADDR A:0xfcb7143c
y.create.l HWIO_MOD_DSP_SDO_MEM_DATA_ADDR A:0xfcb71440
y.create.l HWIO_MOD_DSP_SDO_MEM_WR_DONE_ADDR A:0xfcb71444
y.create.l HWIO_MOD_DSP_SDO_RATE_ADDR A:0xfcb71448
y.create.l HWIO_MOD_1X_BETAP_GAIN_ADDR A:0xfcb7144c
y.create.l HWIO_MOD_1X_BETAP_UPDATE_TIME_ADDR A:0xfcb71450
y.create.l HWIO_REVMOD_1X_ROT_PHASE_INIT_ADDR A:0xfcb71454
y.create.l HWIO_REVMOD_1X_ROT_FREQ_STEP_ADDR A:0xfcb71458
y.create.l HWIO_MOD_LOAD_STMR_UPDATE_TIME_ADDR A:0xfcb7145c
y.create.l HWIO_MOD_1X_BAND_EN_ADDR A:0xfcb71464
y.create.l HWIO_MOD_DO_BAND_EN_ADDR A:0xfcb71468
y.create.l HWIO_MOD_1X_BAND_EN_UPDATE_TIME_ADDR A:0xfcb7146c
y.create.l HWIO_MOD_DO_BAND_EN_UPDATE_TIME_ADDR A:0xfcb71470
y.create.l HWIO_MOD_PRED_CLIP_EN_ADDR A:0xfcb71480
y.create.l HWIO_MOD_0_PRED_THRES_OVERID_ADDR A:0xfcb71484
y.create.l HWIO_MOD_1_PRED_THRES_OVERID_ADDR A:0xfcb71488
y.create.l HWIO_MOD_2_PRED_THRES_OVERID_ADDR A:0xfcb7148c
y.create.l HWIO_MOD_1X_PRED_THRES_OVERID_ADDR A:0xfcb71490
y.create.l HWIO_MOD_PRED_GLOBAL_THRES_01_ADDR A:0xfcb71494
y.create.l HWIO_MOD_01_PRED_LOCAL_THRES_ADDR A:0xfcb71498
y.create.l HWIO_MOD_2_PRED_LOCAL_THRES_ADDR A:0xfcb7149c
y.create.l HWIO_MOD_1X_PRED_LOCAL_THRES_ADDR A:0xfcb714a0
y.create.l HWIO_MOD_STALL_SEL_ADDR A:0xfcb714b0
y.create.l HWIO_MOD_OFFLINE_DIV_ADDR A:0xfcb714b4
y.create.l HWIO_MOD_PWR_CTRL_WR_ADDR A:0xfcb714d4
y.create.l HWIO_I_PN_STATE_SLAM_01_ADDR A:0xfcb714d8
y.create.l HWIO_Q_PN_STATE_SLAM_01_ADDR A:0xfcb714dc
y.create.l HWIO_U_PN_STATE_SLAM_03_ADDR A:0xfcb714e0
y.create.l HWIO_U_PN_STATE_SLAM_45_ADDR A:0xfcb714e4
y.create.l HWIO_U_PN_MASK_SLAM_03_ADDR A:0xfcb714e8
y.create.l HWIO_U_PN_MASK_SLAM_45_ADDR A:0xfcb714ec
y.create.l HWIO_MOD_1X_ENC_TRIGGER_ADDR A:0xfcb714f0
y.create.l HWIO_MOD_DBR_MASKING_ADDR A:0xfcb714f8
y.create.l HWIO_MOD_DO_PREFILL_MODE_ADDR A:0xfcb714fc
y.create.l HWIO_MOD_1X_PREFILL_MODE_ADDR A:0xfcb7150c
y.create.l HWIO_MOD_CHAIN_0_CARRIER_ADDR A:0xfcb71500
y.create.l HWIO_MOD_CHAIN_1_CARRIER_ADDR A:0xfcb71504
y.create.l HWIO_MOD_CHAIN_CARRIER_CMD_ADDR A:0xfcb71508
y.create.l HWIO_REVMOD_SAMPLE_COUNT_OFFSET_ADDR A:0xfcb71600
y.create.l HWIO_REVMOD_SAMPLE_COUNT_ADJ_ADDR A:0xfcb71604
y.create.l HWIO_REVMOD_SAMPLE_COUNT_STROBES_ADDR A:0xfcb71608
y.create.l HWIO_MP_PN_SLAM_LONG_STATE_03_ADDR A:0xfcb7160c
y.create.l HWIO_MP_PN_SLAM_LONG_STATE_45_ADDR A:0xfcb71610
y.create.l HWIO_MOD_TXC0_STB_SEL_ADDR A:0xfcb71614
y.create.l HWIO_MOD_TXC1_STB_SEL_ADDR A:0xfcb71618
y.create.l HWIO_MOD_TEST_BUS_IN_SELECT_ADDR A:0xfcb7161c
y.create.l HWIO_MOD_SB_DO_OFFSET_ADDR A:0xfcb71628
y.create.l HWIO_MOD_SB_1X_OFFSET_ADDR A:0xfcb7162c
y.create.l HWIO_MOD_1X_STROBE_OFFSET_ADDR A:0xfcb71630
y.create.l HWIO_MOD_DO_STROBE_OFFSET_ADDR A:0xfcb71634
y.create.l HWIO_MOD_STREAM_WRITER_SEL_ADDR A:0xfcb71638
y.create.l HWIO_REVMOD_PREFILL_SLOT_NUM_ADDR A:0xfcb7163c
y.create.l HWIO_REVMOD_PREFILL_FRAME_NUM_ADDR A:0xfcb71640
y.create.l HWIO_REVMOD_PREFILL_CTL_ADDR A:0xfcb71644
y.create.l HWIO_MP_SHORT_PN_I_SLAM_ADDR A:0xfcb71648
y.create.l HWIO_MP_SHORT_PN_Q_SLAM_ADDR A:0xfcb7164c
y.create.l HWIO_MOD_SB_SVDO_CTL_ADDR A:0xfcb71650
y.create.l HWIO_MOD_ERAM_DATA_ADDR A:0xfcb72000
y.create.l HWIO_MOD_ERAM_DATA_CTL_ADDR A:0xfcb72908
y.create.l HWIO_MOD_ERAM_WR_DONE_ADDR A:0xfcb7290c
y.create.l HWIO_MOD_TEST_MEM_MODE_ADDR A:0xfcb72910
y.create.l HWIO_MOD_TEST_MEM_SEL_ADDR A:0xfcb72914
y.create.l HWIO_MOD_TEST_MEM_ADDR_ADDR A:0xfcb72918
y.create.l HWIO_MOD_TEST_MEM_DATA_ADDR A:0xfcb7291c
y.create.l HWIO_MOD_SDO_MEM_DATA_ADDR A:0xfcb72928
y.create.l HWIO_MOD_SDO_MEM_WR_DONE_ADDR A:0xfcb7292c
y.create.l HWIO_TX_TRBLK_PARAM_TRCH0_ADDR A:0xfcb74000
y.create.l HWIO_TX_TRBLK_PARAM_TRCH1_ADDR A:0xfcb74004
y.create.l HWIO_TX_TRBLK_PARAM_TRCH2_ADDR A:0xfcb74008
y.create.l HWIO_TX_TRBLK_PARAM_TRCH3_ADDR A:0xfcb7400c
y.create.l HWIO_TX_TRBLK_PARAM_TRCH4_ADDR A:0xfcb74010
y.create.l HWIO_TX_TRBLK_PARAM_TRCH5_ADDR A:0xfcb74014
y.create.l HWIO_TX_TRBLK_PARAM_TRCH6_ADDR A:0xfcb74018
y.create.l HWIO_TX_TRBLK_PARAM_TRCH7_ADDR A:0xfcb7401c
y.create.l HWIO_TX_ERAMB_ADDR_TRCH0_ADDR A:0xfcb74020
y.create.l HWIO_TX_ERAMB_ADDR_TRCH1_ADDR A:0xfcb74024
y.create.l HWIO_TX_ERAMB_ADDR_TRCH2_ADDR A:0xfcb74028
y.create.l HWIO_TX_ERAMB_ADDR_TRCH3_ADDR A:0xfcb7402c
y.create.l HWIO_TX_ERAMB_ADDR_TRCH4_ADDR A:0xfcb74030
y.create.l HWIO_TX_ERAMB_ADDR_TRCH5_ADDR A:0xfcb74034
y.create.l HWIO_TX_ERAMB_ADDR_TRCH6_ADDR A:0xfcb74038
y.create.l HWIO_TX_ERAMB_ADDR_TRCH7_ADDR A:0xfcb7403c
y.create.l HWIO_TX_CODING_PARAM_TRCH0_ADDR A:0xfcb74040
y.create.l HWIO_TX_CODING_PARAM_TRCH1_ADDR A:0xfcb74044
y.create.l HWIO_TX_CODING_PARAM_TRCH2_ADDR A:0xfcb74048
y.create.l HWIO_TX_CODING_PARAM_TRCH3_ADDR A:0xfcb7404c
y.create.l HWIO_TX_CODING_PARAM_TRCH4_ADDR A:0xfcb74050
y.create.l HWIO_TX_CODING_PARAM_TRCH5_ADDR A:0xfcb74054
y.create.l HWIO_TX_CODING_PARAM_TRCH6_ADDR A:0xfcb74058
y.create.l HWIO_TX_CODING_PARAM_TRCH7_ADDR A:0xfcb7405c
y.create.l HWIO_TX_CODE_SEG_SIZE_TRCH0_ADDR A:0xfcb74060
y.create.l HWIO_TX_CODE_SEG_SIZE_TRCH1_ADDR A:0xfcb74064
y.create.l HWIO_TX_CODE_SEG_SIZE_TRCH2_ADDR A:0xfcb74068
y.create.l HWIO_TX_CODE_SEG_SIZE_TRCH3_ADDR A:0xfcb7406c
y.create.l HWIO_TX_CODE_SEG_SIZE_TRCH4_ADDR A:0xfcb74070
y.create.l HWIO_TX_CODE_SEG_SIZE_TRCH5_ADDR A:0xfcb74074
y.create.l HWIO_TX_CODE_SEG_SIZE_TRCH6_ADDR A:0xfcb74078
y.create.l HWIO_TX_CODE_SEG_SIZE_TRCH7_ADDR A:0xfcb7407c
y.create.l HWIO_TX_RM_EINI_TRCH0_ADDR A:0xfcb74080
y.create.l HWIO_TX_RM_EINI_TRCH1_ADDR A:0xfcb74084
y.create.l HWIO_TX_RM_EINI_TRCH2_ADDR A:0xfcb74088
y.create.l HWIO_TX_RM_EINI_TRCH3_ADDR A:0xfcb7408c
y.create.l HWIO_TX_RM_EINI_TRCH4_ADDR A:0xfcb74090
y.create.l HWIO_TX_RM_EINI_TRCH5_ADDR A:0xfcb74094
y.create.l HWIO_TX_RM_EINI_TRCH6_ADDR A:0xfcb74098
y.create.l HWIO_TX_RM_EINI_TRCH7_ADDR A:0xfcb7409c
y.create.l HWIO_TX_RM_EMINUS_TRCH0_ADDR A:0xfcb740a0
y.create.l HWIO_TX_RM_EMINUS_TRCH1_ADDR A:0xfcb740a4
y.create.l HWIO_TX_RM_EMINUS_TRCH2_ADDR A:0xfcb740a8
y.create.l HWIO_TX_RM_EMINUS_TRCH3_ADDR A:0xfcb740ac
y.create.l HWIO_TX_RM_EMINUS_TRCH4_ADDR A:0xfcb740b0
y.create.l HWIO_TX_RM_EMINUS_TRCH5_ADDR A:0xfcb740b4
y.create.l HWIO_TX_RM_EMINUS_TRCH6_ADDR A:0xfcb740b8
y.create.l HWIO_TX_RM_EMINUS_TRCH7_ADDR A:0xfcb740bc
y.create.l HWIO_TX_RM_EPLUS_TRCH0_ADDR A:0xfcb740c0
y.create.l HWIO_TX_RM_EPLUS_TRCH1_ADDR A:0xfcb740c4
y.create.l HWIO_TX_RM_EPLUS_TRCH2_ADDR A:0xfcb740c8
y.create.l HWIO_TX_RM_EPLUS_TRCH3_ADDR A:0xfcb740cc
y.create.l HWIO_TX_RM_EPLUS_TRCH4_ADDR A:0xfcb740d0
y.create.l HWIO_TX_RM_EPLUS_TRCH5_ADDR A:0xfcb740d4
y.create.l HWIO_TX_RM_EPLUS_TRCH6_ADDR A:0xfcb740d8
y.create.l HWIO_TX_RM_EPLUS_TRCH7_ADDR A:0xfcb740dc
y.create.l HWIO_TX_TURBO_INTLV_PARAM0_TRCH0_ADDR A:0xfcb740e0
y.create.l HWIO_TX_TURBO_INTLV_PARAM0_TRCH1_ADDR A:0xfcb740e4
y.create.l HWIO_TX_TURBO_INTLV_PARAM0_TRCH2_ADDR A:0xfcb740e8
y.create.l HWIO_TX_TURBO_INTLV_PARAM0_TRCH3_ADDR A:0xfcb740ec
y.create.l HWIO_TX_TURBO_INTLV_PARAM0_TRCH4_ADDR A:0xfcb740f0
y.create.l HWIO_TX_TURBO_INTLV_PARAM0_TRCH5_ADDR A:0xfcb740f4
y.create.l HWIO_TX_TURBO_INTLV_PARAM0_TRCH6_ADDR A:0xfcb740f8
y.create.l HWIO_TX_TURBO_INTLV_PARAM0_TRCH7_ADDR A:0xfcb740fc
y.create.l HWIO_TX_TURBO_INTLV_PARAM1_TRCH0_ADDR A:0xfcb74100
y.create.l HWIO_TX_TURBO_INTLV_PARAM1_TRCH1_ADDR A:0xfcb74104
y.create.l HWIO_TX_TURBO_INTLV_PARAM1_TRCH2_ADDR A:0xfcb74108
y.create.l HWIO_TX_TURBO_INTLV_PARAM1_TRCH3_ADDR A:0xfcb7410c
y.create.l HWIO_TX_TURBO_INTLV_PARAM1_TRCH4_ADDR A:0xfcb74110
y.create.l HWIO_TX_TURBO_INTLV_PARAM1_TRCH5_ADDR A:0xfcb74114
y.create.l HWIO_TX_TURBO_INTLV_PARAM1_TRCH6_ADDR A:0xfcb74118
y.create.l HWIO_TX_TURBO_INTLV_PARAM1_TRCH7_ADDR A:0xfcb7411c
y.create.l HWIO_TX_TRCH_MUX_ORDER_ADDR A:0xfcb74120
y.create.l HWIO_TX_ENC_TIMING_CTL_ADDR A:0xfcb7412c
y.create.l HWIO_TX_ERAM_AB_TRCHS_ADDR A:0xfcb74130
y.create.l HWIO_TX_ERAMA_INCRACC_INIT_ADDR A:0xfcb74134
y.create.l HWIO_TX_DPDCH_OVSF_NUM_ADDR A:0xfcb74138
y.create.l HWIO_TX_DATA_SPR_FACTOR_ADDR A:0xfcb7413c
y.create.l HWIO_TX_SCR_CODE_INIT_ADDR A:0xfcb74140
y.create.l HWIO_TX_PHY_CH_TYPE_ADDR A:0xfcb7414c
y.create.l HWIO_TX_GENERAL_CTL_ADDR A:0xfcb74150
y.create.l HWIO_TX_TEST_CTL_ADDR A:0xfcb7415c
y.create.l HWIO_TX_ERAMA_INCRACC_ADDR A:0xfcb74160
y.create.l HWIO_TX_CIPHER_CK0_0_ADDR A:0xfcb74164
y.create.l HWIO_TX_CIPHER_CK0_1_ADDR A:0xfcb74168
y.create.l HWIO_TX_CIPHER_CK0_2_ADDR A:0xfcb7416c
y.create.l HWIO_TX_CIPHER_CK0_3_ADDR A:0xfcb74170
y.create.l HWIO_TX_CIPHER_CK1_0_ADDR A:0xfcb74174
y.create.l HWIO_TX_CIPHER_CK1_1_ADDR A:0xfcb74178
y.create.l HWIO_TX_CIPHER_CK1_2_ADDR A:0xfcb7417c
y.create.l HWIO_TX_CIPHER_CK1_3_ADDR A:0xfcb74180
y.create.l HWIO_TX_CIPHER_CK2_0_ADDR A:0xfcb74184
y.create.l HWIO_TX_CIPHER_CK2_1_ADDR A:0xfcb74188
y.create.l HWIO_TX_CIPHER_CK2_2_ADDR A:0xfcb7418c
y.create.l HWIO_TX_CIPHER_CK2_3_ADDR A:0xfcb74190
y.create.l HWIO_TX_CIPHER_CK3_0_ADDR A:0xfcb74194
y.create.l HWIO_TX_CIPHER_CK3_1_ADDR A:0xfcb74198
y.create.l HWIO_TX_CIPHER_CK3_2_ADDR A:0xfcb7419c
y.create.l HWIO_TX_CIPHER_CK3_3_ADDR A:0xfcb741a0
y.create.l HWIO_TX_CIPHER_CK4_0_ADDR A:0xfcb741a4
y.create.l HWIO_TX_CIPHER_CK4_1_ADDR A:0xfcb741a8
y.create.l HWIO_TX_CIPHER_CK4_2_ADDR A:0xfcb741ac
y.create.l HWIO_TX_CIPHER_CK4_3_ADDR A:0xfcb741b0
y.create.l HWIO_TX_CIPHER_CK5_0_ADDR A:0xfcb741b4
y.create.l HWIO_TX_CIPHER_CK5_1_ADDR A:0xfcb741b8
y.create.l HWIO_TX_CIPHER_CK5_2_ADDR A:0xfcb741bc
y.create.l HWIO_TX_CIPHER_CK5_3_ADDR A:0xfcb741c0
y.create.l HWIO_TX_FILLER_POLARITY_ADDR A:0xfcb741c4
y.create.l HWIO_TX_STATUS_ADDR A:0xfcb741c8
y.create.l HWIO_TX_HW_CLK_CTL_ADDR A:0xfcb741cc
y.create.l HWIO_TX_ARM_CLK_CTL_ADDR A:0xfcb741d0
y.create.l HWIO_TX_CLK_STATUS_ADDR A:0xfcb741d4
y.create.l HWIO_TX_HSDPCCH_OVSF_NUM_ADDR A:0xfcb741d8
y.create.l HWIO_TX_EUL_ERAM_MEMORY_BANK_ADDR A:0xfcb741e4
y.create.l HWIO_TX_EUL_INCRACC_INIT_ADDR A:0xfcb741e8
y.create.l HWIO_TX_EUL_ERAM_INCRACC_ADDR A:0xfcb741f0
y.create.l HWIO_TX_EUL_CODING_PARAM_BANK0_ADDR A:0xfcb74214
y.create.l HWIO_TX_EUL_CODING_PARAM_BANK1_ADDR A:0xfcb74218
y.create.l HWIO_TX_EUL_CODE_SEG_SIZE_BANK0_ADDR A:0xfcb74234
y.create.l HWIO_TX_EUL_CODE_SEG_SIZE_BANK1_ADDR A:0xfcb74238
y.create.l HWIO_TX_EUL_TURBO_INTLV_PARAM0_BANK0_ADDR A:0xfcb74254
y.create.l HWIO_TX_EUL_TURBO_INTLV_PARAM0_BANK1_ADDR A:0xfcb74258
y.create.l HWIO_TX_EUL_TURBO_INTLV_PARAM1_BANK0_ADDR A:0xfcb74274
y.create.l HWIO_TX_EUL_TURBO_INTLV_PARAM1_BANK1_ADDR A:0xfcb74278
y.create.l HWIO_TX_TEST_MEM_MODE_ADDR A:0xfcb74294
y.create.l HWIO_TX_TEST_MEM_SEL_ADDR A:0xfcb74298
y.create.l HWIO_TX_TXC_VALID_FALL_TIME_ADDR A:0xfcb742b0
y.create.l HWIO_TX_W_OFFL_ENC_FRAME_ADDR A:0xfcb742b4
y.create.l HWIO_TX_W_OFFL_HSDPCCH_OFFSET_ADDR A:0xfcb742b8
y.create.l HWIO_TX_TEST_MEM_ADDR_ADDR A:0xfcb742c4
y.create.l HWIO_TX_TEST_MEM_WDATA_ADDR A:0xfcb742c8
y.create.l HWIO_TX_TEST_MEM_RDATA_ADDR A:0xfcb742cc
y.create.l HWIO_TX_SCR_CODE_INIT_C1_ADDR A:0xfcb74540
y.create.l HWIO_TX_TEST_CTL_C1_ADDR A:0xfcb7455c
y.create.l HWIO_TX_FILLER_POLARITY_C1_ADDR A:0xfcb745c4
y.create.l HWIO_TX_STATUS_C1_ADDR A:0xfcb745c8
y.create.l HWIO_TX_HW_CLK_CTL_C1_ADDR A:0xfcb745cc
y.create.l HWIO_TX_ARM_CLK_CTL_C1_ADDR A:0xfcb745d0
y.create.l HWIO_TX_CLK_STATUS_C1_ADDR A:0xfcb745d4
y.create.l HWIO_TX_EUL_ERAM_MEMORY_BANK_C1_ADDR A:0xfcb745e4
y.create.l HWIO_TX_EUL_INCRACC_INIT_C1_ADDR A:0xfcb745e8
y.create.l HWIO_TX_EUL_ERAM_INCRACC_C1_ADDR A:0xfcb745f0
y.create.l HWIO_TX_EUL_CODING_PARAM_BANK0_C1_ADDR A:0xfcb74614
y.create.l HWIO_TX_EUL_CODING_PARAM_BANK1_C1_ADDR A:0xfcb74618
y.create.l HWIO_TX_EUL_CODE_SEG_SIZE_BANK0_C1_ADDR A:0xfcb74634
y.create.l HWIO_TX_EUL_CODE_SEG_SIZE_BANK1_C1_ADDR A:0xfcb74638
y.create.l HWIO_TX_EUL_TURBO_INTLV_PARAM0_BANK0_C1_ADDR A:0xfcb74654
y.create.l HWIO_TX_EUL_TURBO_INTLV_PARAM0_BANK1_C1_ADDR A:0xfcb74658
y.create.l HWIO_TX_EUL_TURBO_INTLV_PARAM1_BANK0_C1_ADDR A:0xfcb74674
y.create.l HWIO_TX_EUL_TURBO_INTLV_PARAM1_BANK1_C1_ADDR A:0xfcb74678
y.create.l HWIO_TX_TEST_MEM_MODE_C1_ADDR A:0xfcb74694
y.create.l HWIO_TX_TEST_MEM_SEL_C1_ADDR A:0xfcb74698
y.create.l HWIO_TX_TEST_MEM_ADDR_C1_ADDR A:0xfcb746c4
y.create.l HWIO_TX_TEST_MEM_WDATA_C1_ADDR A:0xfcb746c8
y.create.l HWIO_TX_TEST_MEM_RDATA_C1_ADDR A:0xfcb746cc
y.create.l HWIO_TX_CTL_CH_BIT_ADDR A:0xfcb75000
y.create.l HWIO_TX_RACH_CPCH_ENA_ADDR A:0xfcb75004
y.create.l HWIO_TX_RACH_SUCC_SIG_INDEX_ADDR A:0xfcb75008
y.create.l HWIO_TX_RACH_CTL_OVSF_NUM_ADDR A:0xfcb7500c
y.create.l HWIO_TX_RACH_CPCH_PREAMBLE_SIG_ADDR A:0xfcb75010
y.create.l HWIO_TX_HSDPCCH_DATA_ADDR A:0xfcb75020
y.create.l HWIO_TX_MDSP_BETA_GAIN_0_ADDR A:0xfcb75028
y.create.l HWIO_TX_MDSP_BETA_GAIN_1_ADDR A:0xfcb7502c
y.create.l HWIO_TX_EUL_HW_ENC_START_ADDR A:0xfcb75030
y.create.l HWIO_TX_EUL_ENC_BANK_CFG_ADDR A:0xfcb75034
y.create.l HWIO_TX_EUL_RM_SYS_EINI_ADDR A:0xfcb75038
y.create.l HWIO_TX_EUL_RM_SYS_EPLUS_EMINUS_ADDR A:0xfcb7503c
y.create.l HWIO_TX_EUL_RM_P1_EINI_ADDR A:0xfcb75040
y.create.l HWIO_TX_EUL_RM_P1_EPLUS_ADDR A:0xfcb75044
y.create.l HWIO_TX_EUL_RM_P1_EMINUS_ADDR A:0xfcb75048
y.create.l HWIO_TX_EUL_RM_P2_EINI_ADDR A:0xfcb7504c
y.create.l HWIO_TX_EUL_RM_P2_EPLUS_EMINUS_ADDR A:0xfcb75050
y.create.l HWIO_TX_EUL_RM_SYS_NUMBITS_ADDR A:0xfcb75054
y.create.l HWIO_TX_EUL_RM_P1P2_NUMBITS_ADDR A:0xfcb75058
y.create.l HWIO_TX_EUL_NUMBITS_EDPDCH0_ADDR A:0xfcb7505c
y.create.l HWIO_TX_EUL_NUMBITS_EDPDCH1_ADDR A:0xfcb75060
y.create.l HWIO_TX_EUL_NUMBITS_EDPDCH2_ADDR A:0xfcb75064
y.create.l HWIO_TX_EUL_NUMBITS_EDPDCH3_ADDR A:0xfcb75068
y.create.l HWIO_TX_EUL_RM_RAM_BASE_ADDR_ADDR A:0xfcb7506c
y.create.l HWIO_TX_EUL_CONFIG_EDPDCH_ADDR A:0xfcb75070
y.create.l HWIO_TX_EUL_PARAMS_EDPDCH0_ADDR A:0xfcb75074
y.create.l HWIO_TX_EUL_PARAMS_EDPDCH1_ADDR A:0xfcb75078
y.create.l HWIO_TX_EUL_PARAMS_EDPDCH2_ADDR A:0xfcb7507c
y.create.l HWIO_TX_EUL_PARAMS_EDPDCH3_ADDR A:0xfcb75080
y.create.l HWIO_TX_EUL_BETA_GAIN_EDPDCH0_ADDR A:0xfcb75084
y.create.l HWIO_TX_EUL_BETA_GAIN_EDPDCH1_ADDR A:0xfcb75088
y.create.l HWIO_TX_EUL_BETA_GAIN_EDPDCH2_ADDR A:0xfcb7508c
y.create.l HWIO_TX_EUL_BETA_GAIN_EDPDCH3_ADDR A:0xfcb75090
y.create.l HWIO_TX_EUL_EDPCCH_DATA_ADDR A:0xfcb75094
y.create.l HWIO_TX_EUL_PARAMS_EDPCCH_ADDR A:0xfcb75098
y.create.l HWIO_TX_EUL_BETA_GAIN_EDPCCH_ADDR A:0xfcb7509c
y.create.l HWIO_TX_EUL_MDSP_STATUS_ADDR A:0xfcb750a0
y.create.l HWIO_TX_EUL_MDSP_STATUS_CLEAR_ADDR A:0xfcb750a4
y.create.l HWIO_TX_MDSP_CLIPPING_ADDR A:0xfcb750ac
y.create.l HWIO_TX_W_OFFL_EN_ADDR A:0xfcb750b0
y.create.l HWIO_TX_W_OFFL_ADVRET_CMD_ADDR A:0xfcb750b4
y.create.l HWIO_TX_W_OFFL_DTX_ADDR A:0xfcb750b8
y.create.l HWIO_TX_W_OFFL_TIME_STATUS_ADDR A:0xfcb750bc
y.create.l HWIO_TX_CTL_CH_BIT_C1_ADDR A:0xfcb75400
y.create.l HWIO_TX_MDSP_BETA_GAIN_0_C1_ADDR A:0xfcb75428
y.create.l HWIO_TX_EUL_HW_ENC_START_C1_ADDR A:0xfcb75430
y.create.l HWIO_TX_EUL_ENC_BANK_CFG_C1_ADDR A:0xfcb75434
y.create.l HWIO_TX_EUL_RM_SYS_EINI_C1_ADDR A:0xfcb75438
y.create.l HWIO_TX_EUL_RM_SYS_EPLUS_EMINUS_C1_ADDR A:0xfcb7543c
y.create.l HWIO_TX_EUL_RM_P1_EINI_C1_ADDR A:0xfcb75440
y.create.l HWIO_TX_EUL_RM_P1_EPLUS_C1_ADDR A:0xfcb75444
y.create.l HWIO_TX_EUL_RM_P1_EMINUS_C1_ADDR A:0xfcb75448
y.create.l HWIO_TX_EUL_RM_P2_EINI_C1_ADDR A:0xfcb7544c
y.create.l HWIO_TX_EUL_RM_P2_EPLUS_EMINUS_C1_ADDR A:0xfcb75450
y.create.l HWIO_TX_EUL_RM_SYS_NUMBITS_C1_ADDR A:0xfcb75454
y.create.l HWIO_TX_EUL_RM_P1P2_NUMBITS_C1_ADDR A:0xfcb75458
y.create.l HWIO_TX_EUL_NUMBITS_EDPDCH0_C1_ADDR A:0xfcb7545c
y.create.l HWIO_TX_EUL_NUMBITS_EDPDCH1_C1_ADDR A:0xfcb75460
y.create.l HWIO_TX_EUL_NUMBITS_EDPDCH2_C1_ADDR A:0xfcb75464
y.create.l HWIO_TX_EUL_NUMBITS_EDPDCH3_C1_ADDR A:0xfcb75468
y.create.l HWIO_TX_EUL_RM_RAM_BASE_ADDR_C1_ADDR A:0xfcb7546c
y.create.l HWIO_TX_EUL_CONFIG_EDPDCH_C1_ADDR A:0xfcb75470
y.create.l HWIO_TX_EUL_PARAMS_EDPDCH0_C1_ADDR A:0xfcb75474
y.create.l HWIO_TX_EUL_PARAMS_EDPDCH1_C1_ADDR A:0xfcb75478
y.create.l HWIO_TX_EUL_PARAMS_EDPDCH2_C1_ADDR A:0xfcb7547c
y.create.l HWIO_TX_EUL_PARAMS_EDPDCH3_C1_ADDR A:0xfcb75480
y.create.l HWIO_TX_EUL_BETA_GAIN_EDPDCH0_C1_ADDR A:0xfcb75484
y.create.l HWIO_TX_EUL_BETA_GAIN_EDPDCH1_C1_ADDR A:0xfcb75488
y.create.l HWIO_TX_EUL_BETA_GAIN_EDPDCH2_C1_ADDR A:0xfcb7548c
y.create.l HWIO_TX_EUL_BETA_GAIN_EDPDCH3_C1_ADDR A:0xfcb75490
y.create.l HWIO_TX_EUL_EDPCCH_DATA_C1_ADDR A:0xfcb75494
y.create.l HWIO_TX_EUL_PARAMS_EDPCCH_C1_ADDR A:0xfcb75498
y.create.l HWIO_TX_EUL_BETA_GAIN_EDPCCH_C1_ADDR A:0xfcb7549c
y.create.l HWIO_TX_EUL_MDSP_STATUS_C1_ADDR A:0xfcb754a0
y.create.l HWIO_TX_EUL_MDSP_STATUS_CLEAR_C1_ADDR A:0xfcb754a4
y.create.l HWIO_TX_W_OFFL_DTX_C1_ADDR A:0xfcb754b8
y.create.l HWIO_TX_MIXER_CTL_ADDR A:0xfcb754c0
y.create.l HWIO_TX_PDA_CTRL_WD_C0_ADDR A:0xfcb754c4
y.create.l HWIO_TX_PDA_CTRL_WD_C1_ADDR A:0xfcb754cc
y.create.l HWIO_TX_PDA_CTRL_WD_OFFSET_C0_ADDR A:0xfcb754c8
y.create.l HWIO_TX_PDA_CTRL_WD_OFFSET_C1_ADDR A:0xfcb754d0
y.create.l HWIO_TX_SMART_CLIP_CTL_ADDR A:0xfcb754d4
y.create.l HWIO_O_TX_TEST_MODE_ADDR A:0xfcb76000
y.create.l HWIO_O_TX_CLK_CTL_ADDR A:0xfcb76004
y.create.l HWIO_O_TX_SW_CLK_CTL_ADDR A:0xfcb76008
y.create.l HWIO_O_TX_CLK_STATUS_REG_ADDR A:0xfcb7600c
y.create.l HWIO_O_TX_ENCODER_STATUS_ADDR A:0xfcb76010
y.create.l HWIO_O_TX_HW_IDLE_ADDR A:0xfcb76014
y.create.l HWIO_O_TX_BUS_TIMEOUT_ADDR A:0xfcb76018
y.create.l HWIO_O_TX_WMORE_INT_STATUS_ADDR A:0xfcb7601c
y.create.l HWIO_O_TX_WMORE_INT_CLEAR_ADDR A:0xfcb76020
y.create.l HWIO_O_TX_WMORE_TX_PWRDWN_ADDR A:0xfcb76024
y.create.l HWIO_O_TX_L0_DEC_ACK_BITS_ADDR A:0xfcb76028
y.create.l HWIO_O_TX_L1_DEC_ACK_BITS_ADDR A:0xfcb7602c
y.create.l HWIO_O_TX_WMORE_CLIP_THR1_ADDR A:0xfcb76030
y.create.l HWIO_O_TX_WMORE_CLIP_THR2_ADDR A:0xfcb76034
y.create.l HWIO_O_TX_WMORE_TS2_ADDR A:0xfcb76038
y.create.l HWIO_O_TX_WMORE_TS1_ADDR A:0xfcb7603c
y.create.l HWIO_O_TX_WMORE_CLIP_ENABLE_ADDR A:0xfcb76040
y.create.l HWIO_O_TX_WMORE_NOTCH_ENABLE_ADDR A:0xfcb76044
y.create.l HWIO_O_TX_WMORE_NOTCH_ALPHA_I_ADDR A:0xfcb76048
y.create.l HWIO_O_TX_WMORE_NOTCH_ALPHA_Q_ADDR A:0xfcb7604c
y.create.l HWIO_O_TX_WMORE_NOTCH_BETA_ADDR A:0xfcb76050
y.create.l HWIO_O_TX_WMORE_NOTCH_TS1_ADDR A:0xfcb76054
y.create.l HWIO_O_TX_WMORE_IFFT_SIZE_ADDR A:0xfcb76058
y.create.l HWIO_TD_TX_RM_EINI_ERUCCH_ADDR A:0xfcb7c000
y.create.l HWIO_TD_TX_RM_EMINUS_ERUCCH_ADDR A:0xfcb7c004
y.create.l HWIO_TD_TX_RM_EPLUS_ERUCCH_ADDR A:0xfcb7c008
y.create.l HWIO_TD_TX_NEW_FRAME_SW_ADDR A:0xfcb7c00c
y.create.l HWIO_TD_TX_ENC_TIMING_CTL_DCH_RACH_ADDR A:0xfcb7c010
y.create.l HWIO_TD_TX_ENC_TIMING_CTL_ERUCCH_ADDR A:0xfcb7c014
y.create.l HWIO_TD_TX_ERAM_AB_TRCHS_ADDR A:0xfcb7c018
y.create.l HWIO_TD_TX_ERAMA_INCRACC_INIT_ADDR A:0xfcb7c01c
y.create.l HWIO_TD_TX_ENDIAN_FRMT_CTL_ADDR A:0xfcb7c020
y.create.l HWIO_TD_TX_TEST_CTL_ADDR A:0xfcb7c024
y.create.l HWIO_TD_TX_CIPHER_CK0_0_ADDR A:0xfcb7c030
y.create.l HWIO_TD_TX_CIPHER_CK0_1_ADDR A:0xfcb7c034
y.create.l HWIO_TD_TX_CIPHER_CK0_2_ADDR A:0xfcb7c038
y.create.l HWIO_TD_TX_CIPHER_CK0_3_ADDR A:0xfcb7c03c
y.create.l HWIO_TD_TX_CIPHER_CK1_0_ADDR A:0xfcb7c040
y.create.l HWIO_TD_TX_CIPHER_CK1_1_ADDR A:0xfcb7c044
y.create.l HWIO_TD_TX_CIPHER_CK1_2_ADDR A:0xfcb7c048
y.create.l HWIO_TD_TX_CIPHER_CK1_3_ADDR A:0xfcb7c04c
y.create.l HWIO_TD_TX_CIPHER_CK2_0_ADDR A:0xfcb7c050
y.create.l HWIO_TD_TX_CIPHER_CK2_1_ADDR A:0xfcb7c054
y.create.l HWIO_TD_TX_CIPHER_CK2_2_ADDR A:0xfcb7c058
y.create.l HWIO_TD_TX_CIPHER_CK2_3_ADDR A:0xfcb7c05c
y.create.l HWIO_TD_TX_CIPHER_CK3_0_ADDR A:0xfcb7c060
y.create.l HWIO_TD_TX_CIPHER_CK3_1_ADDR A:0xfcb7c064
y.create.l HWIO_TD_TX_CIPHER_CK3_2_ADDR A:0xfcb7c068
y.create.l HWIO_TD_TX_CIPHER_CK3_3_ADDR A:0xfcb7c06c
y.create.l HWIO_TD_TX_CIPHER_CK4_0_ADDR A:0xfcb7c070
y.create.l HWIO_TD_TX_CIPHER_CK4_1_ADDR A:0xfcb7c074
y.create.l HWIO_TD_TX_CIPHER_CK4_2_ADDR A:0xfcb7c078
y.create.l HWIO_TD_TX_CIPHER_CK4_3_ADDR A:0xfcb7c07c
y.create.l HWIO_TD_TX_CIPHER_CK5_0_ADDR A:0xfcb7c080
y.create.l HWIO_TD_TX_CIPHER_CK5_1_ADDR A:0xfcb7c084
y.create.l HWIO_TD_TX_CIPHER_CK5_2_ADDR A:0xfcb7c088
y.create.l HWIO_TD_TX_CIPHER_CK5_3_ADDR A:0xfcb7c08c
y.create.l HWIO_TD_TX_FILLER_POLARITY_ADDR A:0xfcb7c090
y.create.l HWIO_TD_TX_ERUCCH_DATA0_ADDR A:0xfcb7c094
y.create.l HWIO_TD_TX_ERUCCH_DATA1_ADDR A:0xfcb7c098
y.create.l HWIO_TD_TX_TTI_ERUCCH_ADDR A:0xfcb7c0a0
y.create.l HWIO_TD_TX_STATUS_ADDR A:0xfcb7c0a4
y.create.l HWIO_TD_TX_EUL_ERAM_MEMORY_BANK_ADDR A:0xfcb7c0a8
y.create.l HWIO_TD_TX_EUL_INCRACC_INIT_ADDR A:0xfcb7c0ac
y.create.l HWIO_TD_TX_EUL_CODING_PARAM_BANK0_ADDR A:0xfcb7c0b0
y.create.l HWIO_TD_TX_EUL_CODING_PARAM_BANK1_ADDR A:0xfcb7c0b4
y.create.l HWIO_TD_TX_EUL_CODE_SEG_SIZE_BANK0_ADDR A:0xfcb7c0d0
y.create.l HWIO_TD_TX_EUL_CODE_SEG_SIZE_BANK1_ADDR A:0xfcb7c0d4
y.create.l HWIO_TD_TX_EUL_TURBO_INTLV_PARAM0_BANK0_ADDR A:0xfcb7c0f0
y.create.l HWIO_TD_TX_EUL_TURBO_INTLV_PARAM0_BANK1_ADDR A:0xfcb7c0f4
y.create.l HWIO_TD_TX_EUL_TURBO_INTLV_PARAM1_BANK0_ADDR A:0xfcb7c110
y.create.l HWIO_TD_TX_EUL_TURBO_INTLV_PARAM1_BANK1_ADDR A:0xfcb7c114
y.create.l HWIO_TD_TX_TEST_MEM_SEL_ADDR A:0xfcb7c130
y.create.l HWIO_TD_TX_TXC_VALID_FALL_TIME_ADDR A:0xfcb7c134
y.create.l HWIO_TD_TX_OFFL_ENC_FRAME_ADDR A:0xfcb7c138
y.create.l HWIO_TD_TX_TEST_MEM_ADDR_ADDR A:0xfcb7c13c
y.create.l HWIO_TD_TX_TEST_MEM_WDATA_ADDR A:0xfcb7c140
y.create.l HWIO_TD_TX_TEST_MEM_RDATA_ADDR A:0xfcb7c144
y.create.l HWIO_TD_TX_CCTRCH_SI_ADDR A:0xfcb7c148
y.create.l HWIO_TD_TX_CCTRCH_ADDR_ADDR A:0xfcb7c14c
y.create.l HWIO_TD_TX_SLOT_DATA_NUM0_CCTRCH1_ADDR A:0xfcb7c150
y.create.l HWIO_TD_TX_SLOT_DATA_NUM1_CCTRCH1_ADDR A:0xfcb7c154
y.create.l HWIO_TD_TX_SLOT_DATA_NUM2_CCTRCH1_ADDR A:0xfcb7c158
y.create.l HWIO_TD_TX_SLOT_DATA_NUM0_CCTRCH2_ADDR A:0xfcb7c15c
y.create.l HWIO_TD_TX_SLOT_DATA_NUM1_CCTRCH2_ADDR A:0xfcb7c160
y.create.l HWIO_TD_TX_SLOT_DATA_NUM2_CCTRCH2_ADDR A:0xfcb7c164
y.create.l HWIO_TD_TX_EUL_MOD_CTL_ADDR A:0xfcb7c168
y.create.l HWIO_TD_TX_EUL_HW_ENC_START_ADDR A:0xfcb7c16c
y.create.l HWIO_TD_TX_EUL_ENC_BANK_CFG_ADDR A:0xfcb7c170
y.create.l HWIO_TD_TX_EUL_RM_SYS_EINI_ADDR A:0xfcb7c174
y.create.l HWIO_TD_TX_EUL_RM_SYS_EPLUS_EMINUS_ADDR A:0xfcb7c178
y.create.l HWIO_TD_TX_EUL_RM_P1_EINI_ADDR A:0xfcb7c17c
y.create.l HWIO_TD_TX_EUL_RM_P1_EPLUS_ADDR A:0xfcb7c180
y.create.l HWIO_TD_TX_EUL_RM_P1_EMINUS_ADDR A:0xfcb7c184
y.create.l HWIO_TD_TX_EUL_RM_P2_EINI_ADDR A:0xfcb7c188
y.create.l HWIO_TD_TX_EUL_RM_P2_EPLUS_EMINUS_ADDR A:0xfcb7c18c
y.create.l HWIO_TD_TX_EUL_RM_SYS_NUMBITS_ADDR A:0xfcb7c190
y.create.l HWIO_TD_TX_EUL_RM_P1P2_NUMBITS_ADDR A:0xfcb7c194
y.create.l HWIO_TD_TX_EUL_NUMBITS_ADDR A:0xfcb7c198
y.create.l HWIO_TD_TX_EUL_RM_BANK_SEL_ADDR A:0xfcb7c19c
y.create.l HWIO_TD_TX_STATUS_CLR_ADDR A:0xfcb7c1a4
y.create.l HWIO_TD_TX_ERUCCH_ADDR_ADDR A:0xfcb7c1a8
y.create.l HWIO_TD_TX_SPR_ADDR A:0xfcb7c400
y.create.l HWIO_TD_TX_SCR_CODE_ADDR A:0xfcb7c404
y.create.l HWIO_TD_TX_SYNC_UL0_ADDR A:0xfcb7c408
y.create.l HWIO_TD_TX_SYNC_UL1_ADDR A:0xfcb7c40c
y.create.l HWIO_TD_TX_SYNC_UL2_ADDR A:0xfcb7c410
y.create.l HWIO_TD_TX_SYNC_UL3_ADDR A:0xfcb7c414
y.create.l HWIO_TD_TX_MIDAMBLE0_ADDR A:0xfcb7c418
y.create.l HWIO_TD_TX_MIDAMBLE1_ADDR A:0xfcb7c41c
y.create.l HWIO_TD_TX_MIDAMBLE2_ADDR A:0xfcb7c420
y.create.l HWIO_TD_TX_MIDAMBLE3_ADDR A:0xfcb7c424
y.create.l HWIO_TD_TX_MIDAMBLE_SHIFT_ADDR A:0xfcb7c428
y.create.l HWIO_TD_TX_TFCI_PHY_EVEN_ADDR A:0xfcb7c42c
y.create.l HWIO_TD_TX_TFCI_PHY_ODD_ADDR A:0xfcb7c430
y.create.l HWIO_TD_TX_TPC_PHY_EVEN_ADDR A:0xfcb7c434
y.create.l HWIO_TD_TX_TPC_PHY_ODD_ADDR A:0xfcb7c438
y.create.l HWIO_TD_TX_SS_PHY_EVEN_ADDR A:0xfcb7c440
y.create.l HWIO_TD_TX_SS_PHY_ODD_ADDR A:0xfcb7c444
y.create.l HWIO_TD_TX_BETA_GAIN_PHY_EVEN_ADDR A:0xfcb7c448
y.create.l HWIO_TD_TX_BETA_GAIN_PHY_ODD_ADDR A:0xfcb7c44c
y.create.l HWIO_TD_TX_BETA_GAIN_SYNC_UL_ADDR A:0xfcb7c450
y.create.l HWIO_TD_TX_SLOT_CTL_PHY_EVEN_ADDR A:0xfcb7c454
y.create.l HWIO_TD_TX_NUM_DATA_PHY_EVEN_ADDR A:0xfcb7c458
y.create.l HWIO_TD_TX_SLOT_CTL_PHY_ODD_ADDR A:0xfcb7c45c
y.create.l HWIO_TD_TX_NUM_DATA_PHY_ODD_ADDR A:0xfcb7c460
y.create.l HWIO_TD_TX_EUCCH_ADDR A:0xfcb7c464
y.create.l HWIO_TD_TX_HSSICH0_ADDR A:0xfcb7c468
y.create.l HWIO_TD_TX_HSSICH1_ADDR A:0xfcb7c46c
y.create.l HWIO_TD_TX_HSSICH2_ADDR A:0xfcb7c470
y.create.l HWIO_TD_TX_NEW_SUBFRAME_FW_ADDR A:0xfcb7c474
y.create.l HWIO_TD_TX_MDSP_CLIPPING_ADDR A:0xfcb7c478
y.create.l HWIO_TD_TX_OFFL_EN_ADDR A:0xfcb7c47c
y.create.l HWIO_TD_TX_GP_NUM_ADDR A:0xfcb7c480
y.create.l HWIO_TD_TX_BBF_WINDOW_ADDR A:0xfcb7c484
y.create.l HWIO_TD_TX_TRBLK_PARAM_TRCH0_ADDR A:0xfcb7c800
y.create.l HWIO_TD_TX_TRBLK_PARAM_TRCH1_ADDR A:0xfcb7c804
y.create.l HWIO_TD_TX_TRBLK_PARAM_TRCH2_ADDR A:0xfcb7c808
y.create.l HWIO_TD_TX_TRBLK_PARAM_TRCH3_ADDR A:0xfcb7c80c
y.create.l HWIO_TD_TX_TRBLK_PARAM_TRCH4_ADDR A:0xfcb7c810
y.create.l HWIO_TD_TX_TRBLK_PARAM_TRCH5_ADDR A:0xfcb7c814
y.create.l HWIO_TD_TX_TRBLK_PARAM_TRCH6_ADDR A:0xfcb7c818
y.create.l HWIO_TD_TX_TRBLK_PARAM_TRCH7_ADDR A:0xfcb7c81c
y.create.l HWIO_TD_TX_ERAMB_ADDR_TRCH0_ADDR A:0xfcb7c820
y.create.l HWIO_TD_TX_ERAMB_ADDR_TRCH1_ADDR A:0xfcb7c824
y.create.l HWIO_TD_TX_ERAMB_ADDR_TRCH2_ADDR A:0xfcb7c828
y.create.l HWIO_TD_TX_ERAMB_ADDR_TRCH3_ADDR A:0xfcb7c82c
y.create.l HWIO_TD_TX_ERAMB_ADDR_TRCH4_ADDR A:0xfcb7c830
y.create.l HWIO_TD_TX_ERAMB_ADDR_TRCH5_ADDR A:0xfcb7c834
y.create.l HWIO_TD_TX_ERAMB_ADDR_TRCH6_ADDR A:0xfcb7c838
y.create.l HWIO_TD_TX_ERAMB_ADDR_TRCH7_ADDR A:0xfcb7c83c
y.create.l HWIO_TD_TX_CODING_PARAM_TRCH0_ADDR A:0xfcb7c840
y.create.l HWIO_TD_TX_CODING_PARAM_TRCH1_ADDR A:0xfcb7c844
y.create.l HWIO_TD_TX_CODING_PARAM_TRCH2_ADDR A:0xfcb7c848
y.create.l HWIO_TD_TX_CODING_PARAM_TRCH3_ADDR A:0xfcb7c84c
y.create.l HWIO_TD_TX_CODING_PARAM_TRCH4_ADDR A:0xfcb7c850
y.create.l HWIO_TD_TX_CODING_PARAM_TRCH5_ADDR A:0xfcb7c854
y.create.l HWIO_TD_TX_CODING_PARAM_TRCH6_ADDR A:0xfcb7c858
y.create.l HWIO_TD_TX_CODING_PARAM_TRCH7_ADDR A:0xfcb7c85c
y.create.l HWIO_TD_TX_CODE_SEG_SIZE_TRCH0_ADDR A:0xfcb7c860
y.create.l HWIO_TD_TX_CODE_SEG_SIZE_TRCH1_ADDR A:0xfcb7c864
y.create.l HWIO_TD_TX_CODE_SEG_SIZE_TRCH2_ADDR A:0xfcb7c868
y.create.l HWIO_TD_TX_CODE_SEG_SIZE_TRCH3_ADDR A:0xfcb7c86c
y.create.l HWIO_TD_TX_CODE_SEG_SIZE_TRCH4_ADDR A:0xfcb7c870
y.create.l HWIO_TD_TX_CODE_SEG_SIZE_TRCH5_ADDR A:0xfcb7c874
y.create.l HWIO_TD_TX_CODE_SEG_SIZE_TRCH6_ADDR A:0xfcb7c878
y.create.l HWIO_TD_TX_CODE_SEG_SIZE_TRCH7_ADDR A:0xfcb7c87c
y.create.l HWIO_TD_TX_RM_EINI_TRCH0_ADDR A:0xfcb7c880
y.create.l HWIO_TD_TX_RM_EINI_TRCH1_ADDR A:0xfcb7c884
y.create.l HWIO_TD_TX_RM_EINI_TRCH2_ADDR A:0xfcb7c888
y.create.l HWIO_TD_TX_RM_EINI_TRCH3_ADDR A:0xfcb7c88c
y.create.l HWIO_TD_TX_RM_EINI_TRCH4_ADDR A:0xfcb7c890
y.create.l HWIO_TD_TX_RM_EINI_TRCH5_ADDR A:0xfcb7c894
y.create.l HWIO_TD_TX_RM_EINI_TRCH6_ADDR A:0xfcb7c898
y.create.l HWIO_TD_TX_RM_EINI_TRCH7_ADDR A:0xfcb7c89c
y.create.l HWIO_TD_TX_RM_EMINUS_TRCH0_ADDR A:0xfcb7c8a0
y.create.l HWIO_TD_TX_RM_EMINUS_TRCH1_ADDR A:0xfcb7c8a4
y.create.l HWIO_TD_TX_RM_EMINUS_TRCH2_ADDR A:0xfcb7c8a8
y.create.l HWIO_TD_TX_RM_EMINUS_TRCH3_ADDR A:0xfcb7c8ac
y.create.l HWIO_TD_TX_RM_EMINUS_TRCH4_ADDR A:0xfcb7c8b0
y.create.l HWIO_TD_TX_RM_EMINUS_TRCH5_ADDR A:0xfcb7c8b4
y.create.l HWIO_TD_TX_RM_EMINUS_TRCH6_ADDR A:0xfcb7c8b8
y.create.l HWIO_TD_TX_RM_EMINUS_TRCH7_ADDR A:0xfcb7c8bc
y.create.l HWIO_TD_TX_RM_EPLUS_TRCH0_ADDR A:0xfcb7c8c0
y.create.l HWIO_TD_TX_RM_EPLUS_TRCH1_ADDR A:0xfcb7c8c4
y.create.l HWIO_TD_TX_RM_EPLUS_TRCH2_ADDR A:0xfcb7c8c8
y.create.l HWIO_TD_TX_RM_EPLUS_TRCH3_ADDR A:0xfcb7c8cc
y.create.l HWIO_TD_TX_RM_EPLUS_TRCH4_ADDR A:0xfcb7c8d0
y.create.l HWIO_TD_TX_RM_EPLUS_TRCH5_ADDR A:0xfcb7c8d4
y.create.l HWIO_TD_TX_RM_EPLUS_TRCH6_ADDR A:0xfcb7c8d8
y.create.l HWIO_TD_TX_RM_EPLUS_TRCH7_ADDR A:0xfcb7c8dc
y.create.l HWIO_TD_TX_TURBO_INTLV_PARAM0_TRCH0_ADDR A:0xfcb7c8e0
y.create.l HWIO_TD_TX_TURBO_INTLV_PARAM0_TRCH1_ADDR A:0xfcb7c8e4
y.create.l HWIO_TD_TX_TURBO_INTLV_PARAM0_TRCH2_ADDR A:0xfcb7c8e8
y.create.l HWIO_TD_TX_TURBO_INTLV_PARAM0_TRCH3_ADDR A:0xfcb7c8ec
y.create.l HWIO_TD_TX_TURBO_INTLV_PARAM0_TRCH4_ADDR A:0xfcb7c8f0
y.create.l HWIO_TD_TX_TURBO_INTLV_PARAM0_TRCH5_ADDR A:0xfcb7c8f4
y.create.l HWIO_TD_TX_TURBO_INTLV_PARAM0_TRCH6_ADDR A:0xfcb7c8f8
y.create.l HWIO_TD_TX_TURBO_INTLV_PARAM0_TRCH7_ADDR A:0xfcb7c8fc
y.create.l HWIO_TD_TX_TURBO_INTLV_PARAM1_TRCH0_ADDR A:0xfcb7c900
y.create.l HWIO_TD_TX_TURBO_INTLV_PARAM1_TRCH1_ADDR A:0xfcb7c904
y.create.l HWIO_TD_TX_TURBO_INTLV_PARAM1_TRCH2_ADDR A:0xfcb7c908
y.create.l HWIO_TD_TX_TURBO_INTLV_PARAM1_TRCH3_ADDR A:0xfcb7c90c
y.create.l HWIO_TD_TX_TURBO_INTLV_PARAM1_TRCH4_ADDR A:0xfcb7c910
y.create.l HWIO_TD_TX_TURBO_INTLV_PARAM1_TRCH5_ADDR A:0xfcb7c914
y.create.l HWIO_TD_TX_TURBO_INTLV_PARAM1_TRCH6_ADDR A:0xfcb7c918
y.create.l HWIO_TD_TX_TURBO_INTLV_PARAM1_TRCH7_ADDR A:0xfcb7c91c
y.create.l HWIO_TD_TX_TRCH_MUX_ORDER_CCTRCH1_ADDR A:0xfcb7c920
y.create.l HWIO_TD_TX_TRCH_MUX_ORDER_CCTRCH2_ADDR A:0xfcb7c924
y.create.l HWIO_TD_TX_ERAMA_INCRACC_0_ADDR A:0xfcb7c928
y.create.l HWIO_TD_TX_ERAMA_INCRACC_1_ADDR A:0xfcb7c92c
y.create.l HWIO_TD_TX_ERAMA_INCRACC_2_ADDR A:0xfcb7c930
y.create.l HWIO_TD_TX_ERAMA_INCRACC_3_ADDR A:0xfcb7c934
y.create.l HWIO_TD_TX_EUL_ERAM_INCRACC_ADDR A:0xfcb7c938
y.create.l HWIO_TX_MEM_START_ADDR A:0xfcb7b000
y.create.l HWIO_TXC_TECH_SEL_A0_ADDR A:0xfcb77000
y.create.l HWIO_TXC_DP_CFG_A0_ADDR A:0xfcb77004
y.create.l HWIO_TXC_DP_CFG_2_A0_ADDR A:0xfcb77008
y.create.l HWIO_TXC_DP_ENV_SCALE_VAL_A0_ADDR A:0xfcb77010
y.create.l HWIO_TXC_DP_ENV_SCALE_VAL_SET2_A0_ADDR A:0xfcb77014
y.create.l HWIO_TXC_DP_RAMP_ARM_A0_ADDR A:0xfcb77024
y.create.l HWIO_TXC_DP_RAMP_START_TIME_A0_ADDR A:0xfcb77028
y.create.l HWIO_TXC_DP_RAMP_SLOT_A_CFG_A0_ADDR A:0xfcb77038
y.create.l HWIO_TXC_DP_RAMP_SLOT_B_CFG_A0_ADDR A:0xfcb7703c
y.create.l HWIO_TXC_DP_RAMP_GAP_A0_ADDR A:0xfcb77040
y.create.l HWIO_TXC_DP_PHASE_OVR_VAL_A0_ADDR A:0xfcb77080
y.create.l HWIO_TXC_PP_PHASE_OVR_VAL_A0_ADDR A:0xfcb77084
y.create.l HWIO_TXC_DP_ENV_OVR_VAL_A0_ADDR A:0xfcb77088
y.create.l HWIO_TXC_EP_ENV_OVR_VAL_A0_ADDR A:0xfcb7708c
y.create.l HWIO_TXC_EP_ENV_OVR_VAL_SET2_A0_ADDR A:0xfcb77090
y.create.l HWIO_TXC_DP_ROT_PHASE_INC_A0_ADDR A:0xfcb770a0
y.create.l HWIO_TXC_DP_ROT_PHASE_INC_SET2_A0_ADDR A:0xfcb770a4
y.create.l HWIO_TXC_DP_ROT_PHASE_INIT_A0_ADDR A:0xfcb770a8
y.create.l HWIO_TXC_DP_ROT_PHASE_INIT_SET2_A0_ADDR A:0xfcb770ac
y.create.l HWIO_TXC_DP_ROT_PHASE_SHIFT_A0_ADDR A:0xfcb770b0
y.create.l HWIO_TXC_DP_ROT_PHASE_SHIFT_SET2_A0_ADDR A:0xfcb770b4
y.create.l HWIO_TXC_DP_IQ_GAIN_A0_ADDR A:0xfcb770b8
y.create.l HWIO_TXC_DP_IQ_GAIN_SET2_A0_ADDR A:0xfcb770bc
y.create.l HWIO_TXC_DP_IQMC_A0_ADDR A:0xfcb770d0
y.create.l HWIO_TXC_DP_IQMC_SET2_A0_ADDR A:0xfcb770d4
y.create.l HWIO_TXC_DP_PEQ1_A0_ADDR A:0xfcb770d8
y.create.l HWIO_TXC_DP_PEQ1_SET2_A0_ADDR A:0xfcb770dc
y.create.l HWIO_TXC_DP_PEQ2_A0_ADDR A:0xfcb770f0
y.create.l HWIO_TXC_DP_PEQ2_SET2_A0_ADDR A:0xfcb770f4
y.create.l HWIO_TXC_DP_DCOC_A0_ADDR A:0xfcb770f8
y.create.l HWIO_TXC_DP_DCOC_SET2_A0_ADDR A:0xfcb770fc
y.create.l HWIO_TXC_DM1_CFG_A0_ADDR A:0xfcb77100
y.create.l HWIO_TXC_EP_GAIN_A0_ADDR A:0xfcb77160
y.create.l HWIO_TXC_EP_GAIN_SET2_A0_ADDR A:0xfcb77164
y.create.l HWIO_TXC_EP_PEQ1_A0_ADDR A:0xfcb77168
y.create.l HWIO_TXC_EP_PEQ1_SET2_A0_ADDR A:0xfcb7716c
y.create.l HWIO_TXC_EP_DCOC_A0_ADDR A:0xfcb77170
y.create.l HWIO_TXC_EP_DCOC_SET2_A0_ADDR A:0xfcb77174
y.create.l HWIO_TXC_EP_DM2_FINE_TAU_A0_ADDR A:0xfcb77178
y.create.l HWIO_TXC_EP_DM3_FRAC_TAU_A0_ADDR A:0xfcb7717c
y.create.l HWIO_TXC_PP_GAIN_A0_ADDR A:0xfcb77180
y.create.l HWIO_TXC_PP_SPILL_A0_ADDR A:0xfcb77190
y.create.l HWIO_TXC_EP_PEQ2_A0_ADDR A:0xfcb77198
y.create.l HWIO_TXC_TIMESTAMP_T1_A0_ADDR A:0xfcb771a0
y.create.l HWIO_TXC_TIMESTAMP_T2_A0_ADDR A:0xfcb771a8
y.create.l HWIO_TXC_TIMESTAMP_REUSE_A0_ADDR A:0xfcb771b0
y.create.l HWIO_TXC_SAMPLE_COUNT_A0_ADDR A:0xfcb771b4
y.create.l HWIO_TXC_SAMPLE_COUNT_CTL_A0_ADDR A:0xfcb771b8
y.create.l HWIO_TXC_REF_ARM_A0_ADDR A:0xfcb771c0
y.create.l HWIO_TXC_REF_DWN_FACTOR_A0_ADDR A:0xfcb771c4
y.create.l HWIO_TXC_REF_NUM_SAMPLES_A0_ADDR A:0xfcb771c8
y.create.l HWIO_TXC_REF_START_TIME_A0_ADDR A:0xfcb771cc
y.create.l HWIO_TXC_REF_STATUS_A0_ADDR A:0xfcb771d0
y.create.l HWIO_TXC_REF_PEAK_POWER_A0_ADDR A:0xfcb771d4
y.create.l HWIO_TXC_REF_RMS_POWER_M_A0_ADDR A:0xfcb771d8
y.create.l HWIO_TXC_REF_RMS_POWER_L_A0_ADDR A:0xfcb771dc
y.create.l HWIO_TXC_REF_MODE_A0_ADDR A:0xfcb771e0
y.create.l HWIO_TXC_REF_I_GAIN_VAL_A0_ADDR A:0xfcb771e4
y.create.l HWIO_TXC_REF_Q_GAIN_VAL_A0_ADDR A:0xfcb771e8
y.create.l HWIO_TXC_REF_POWERCALC_OR_LOG_A0_ADDR A:0xfcb771ec
y.create.l HWIO_TXC_TESTBUS_SELECT_A0_ADDR A:0xfcb771f0
y.create.l HWIO_TXC_DP_SAWEQ_COEFF0_A0_ADDR A:0xfcb77200
y.create.l HWIO_TXC_DP_SAWEQ_COEFF1_A0_ADDR A:0xfcb77204
y.create.l HWIO_TXC_DP_SAWEQ_COEFF2_A0_ADDR A:0xfcb77208
y.create.l HWIO_TXC_DP_SAWEQ_COEFF3_A0_ADDR A:0xfcb7720c
y.create.l HWIO_TXC_DP_SAWEQ_COEFF4_A0_ADDR A:0xfcb77210
y.create.l HWIO_TXC_DP_SAWEQ_COEFF5_A0_ADDR A:0xfcb77214
y.create.l HWIO_TXC_DP_SAWEQ_COEFF6_A0_ADDR A:0xfcb77218
y.create.l HWIO_TXC_DP_SAWEQ_COEFF7_A0_ADDR A:0xfcb7721c
y.create.l HWIO_TXC_AMAM_PENDING_A0_ADDR A:0xfcb77220
y.create.l HWIO_TXC_AMPM_PENDING_A0_ADDR A:0xfcb77224
y.create.l HWIO_TXC_EPDT_PENDING_A0_ADDR A:0xfcb77228
y.create.l HWIO_TXC_DP_RAMP_SLOT_B_ADDR_A0_ADDR A:0xfcb7722c
y.create.l HWIO_TXC_AMAM_PENDING_SET2_A0_ADDR A:0xfcb77230
y.create.l HWIO_TXC_AMPM_PENDING_SET2_A0_ADDR A:0xfcb77234
y.create.l HWIO_TXC_EPDT_PENDING_SET2_A0_ADDR A:0xfcb77238
y.create.l HWIO_TXC_AMAM_ACTIVE_A0_ADDR A:0xfcb77240
y.create.l HWIO_TXC_AMPM_ACTIVE_A0_ADDR A:0xfcb77244
y.create.l HWIO_TXC_EPDT_ACTIVE_A0_ADDR A:0xfcb77248
y.create.l HWIO_TXC_RAMP_ACTIVE_A0_ADDR A:0xfcb7724c
y.create.l HWIO_TXC_DP_RAMP_SLOT_A_ADDR_A0_ADDR A:0xfcb77250
y.create.l HWIO_TXC_DP_CFG_LATCHED_A0_ADDR A:0xfcb77300
y.create.l HWIO_TXC_DP_ENV_SCALE_VAL_LATCHED_A0_ADDR A:0xfcb77304
y.create.l HWIO_TXC_DP_PHASE_OVR_VAL_LATCHED_A0_ADDR A:0xfcb77308
y.create.l HWIO_TXC_PP_PHASE_OVR_VAL_LATCHED_A0_ADDR A:0xfcb7730c
y.create.l HWIO_TXC_DP_ENV_OVR_VAL_LATCHED_A0_ADDR A:0xfcb77310
y.create.l HWIO_TXC_EP_ENV_OVR_VAL_LATCHED_A0_ADDR A:0xfcb77314
y.create.l HWIO_TXC_DP_ROT_PHASE_INC_LATCHED_A0_ADDR A:0xfcb77318
y.create.l HWIO_TXC_DP_ROT_PHASE_INIT_LATCHED_A0_ADDR A:0xfcb7731c
y.create.l HWIO_TXC_DP_ROT_PHASE_SHIFT_LATCHED_A0_ADDR A:0xfcb77320
y.create.l HWIO_TXC_DP_IQ_GAIN_LATCHED_A0_ADDR A:0xfcb77324
y.create.l HWIO_TXC_DP_IQMC_LATCHED_A0_ADDR A:0xfcb77328
y.create.l HWIO_TXC_DP_PEQ1_LATCHED_A0_ADDR A:0xfcb7732c
y.create.l HWIO_TXC_DP_PEQ2_LATCHED_A0_ADDR A:0xfcb77330
y.create.l HWIO_TXC_DP_DCOC_LATCHED_A0_ADDR A:0xfcb77334
y.create.l HWIO_TXC_DM1_CFG_LATCHED_A0_ADDR A:0xfcb77338
y.create.l HWIO_TXC_EP_GAIN_LATCHED_A0_ADDR A:0xfcb7733c
y.create.l HWIO_TXC_EP_PEQ1_LATCHED_A0_ADDR A:0xfcb77340
y.create.l HWIO_TXC_EP_DCOC_LATCHED_A0_ADDR A:0xfcb77344
y.create.l HWIO_TXC_EP_DM2_FINE_TAU_LATCHED_A0_ADDR A:0xfcb77348
y.create.l HWIO_TXC_EP_DM3_FRAC_TAU_LATCHED_A0_ADDR A:0xfcb7734c
y.create.l HWIO_TXC_PP_GAIN_LATCHED_A0_ADDR A:0xfcb77350
y.create.l HWIO_TXC_PP_SPILL_LATCHED_A0_ADDR A:0xfcb77354
y.create.l HWIO_TXC_EP_PEQ2_LATCHED_A0_ADDR A:0xfcb77358
y.create.l HWIO_TXC_DP_CFG_2_LATCHED_A0_ADDR A:0xfcb7735c
y.create.l HWIO_TXC_DP_SAWEQ_COEFF0_LATCHED_A0_ADDR A:0xfcb77380
y.create.l HWIO_TXC_DP_SAWEQ_COEFF1_LATCHED_A0_ADDR A:0xfcb77384
y.create.l HWIO_TXC_DP_SAWEQ_COEFF2_LATCHED_A0_ADDR A:0xfcb77388
y.create.l HWIO_TXC_DP_SAWEQ_COEFF3_LATCHED_A0_ADDR A:0xfcb7738c
y.create.l HWIO_TXC_DP_SAWEQ_COEFF4_LATCHED_A0_ADDR A:0xfcb77390
y.create.l HWIO_TXC_DP_SAWEQ_COEFF5_LATCHED_A0_ADDR A:0xfcb77394
y.create.l HWIO_TXC_DP_SAWEQ_COEFF6_LATCHED_A0_ADDR A:0xfcb77398
y.create.l HWIO_TXC_DP_SAWEQ_COEFF7_LATCHED_A0_ADDR A:0xfcb7739c
y.create.l HWIO_TXR_IQ_DAC_A0_ADDR A:0xfcb79000
y.create.l HWIO_TXR_STR_CTRL_A0_ADDR A:0xfcb79008
y.create.l HWIO_TXR_PDA_CTRL_A0_ADDR A:0xfcb7900c
y.create.l HWIO_TXR_PDA_WD_UPDATE_CTRL_A0_ADDR A:0xfcb79010
y.create.l HWIO_TXR_PDA_CTRL_WD_OFFSET_A0_ADDR A:0xfcb79014
y.create.l HWIO_TXR_PDA_OFFSET_CMD_A0_ADDR A:0xfcb79018
y.create.l HWIO_TXR_PPDSM_CTL_A0_ADDR A:0xfcb7901c
y.create.l HWIO_TXR_PPDSM_OVERRIDE_VAL_A0_ADDR A:0xfcb79020
y.create.l HWIO_TXR_PPDSM_OVERRIDE_REP_A0_ADDR A:0xfcb79024
y.create.l HWIO_TXR_FIFO_PTR_DIFF_A_A0_ADDR A:0xfcb79028
y.create.l HWIO_TXR_FIFO_PTR_DIFF_B_A0_ADDR A:0xfcb7902c
y.create.l HWIO_TXR_FIFO_STATUS_A_A0_ADDR A:0xfcb79030
y.create.l HWIO_TXR_FIFO_STATUS_B_A0_ADDR A:0xfcb79034
y.create.l HWIO_TXR_FIFO_CMD_A0_ADDR A:0xfcb79038
y.create.l HWIO_TXR_FIFO_CTRL_A0_ADDR A:0xfcb7903c
y.create.l HWIO_TXR_STREAM_IF_CTRL_A0_ADDR A:0xfcb79040
y.create.l HWIO_TXR_FMT_CONV_CTL_A0_ADDR A:0xfcb79050
y.create.l HWIO_TXR_IQ_DAC_CURRENT_A0_ADDR A:0xfcb79054
y.create.l HWIO_TXR_STR_CTRL_CURRENT_A0_ADDR A:0xfcb79058
y.create.l HWIO_TXR_PDA_CTRL_CURRENT_A0_ADDR A:0xfcb7905c
y.create.l HWIO_TXR_PDA_WD_UPDATE_CTRL_CURRENT_A0_ADDR A:0xfcb79060
y.create.l HWIO_TXR_PDA_CTRL_WD_OFFSET_CURRENT_A0_ADDR A:0xfcb79064
y.create.l HWIO_TXR_PDA_OFFSET_CMD_CURRENT_A0_ADDR A:0xfcb79068
y.create.l HWIO_TXR_PPDSM_CTL_CURRENT_A0_ADDR A:0xfcb7906c
y.create.l HWIO_TXR_PPDSM_OVERRIDE_VAL_CURRENT_A0_ADDR A:0xfcb79070
y.create.l HWIO_TXR_PPDSM_OVERRIDE_REP_CURRENT_A0_ADDR A:0xfcb79074
y.create.l HWIO_TXR_STREAM_IF_CTRL_CURRENT_A0_ADDR A:0xfcb79078
y.create.l HWIO_TXR_FMT_CONV_CTL_CURRENT_A0_ADDR A:0xfcb7907c
y.create.l HWIO_TXC_TECH_SEL_A1_ADDR A:0xfcb78000
y.create.l HWIO_TXC_DP_CFG_A1_ADDR A:0xfcb78004
y.create.l HWIO_TXC_DP_CFG_2_A1_ADDR A:0xfcb78008
y.create.l HWIO_TXC_DP_ENV_SCALE_VAL_A1_ADDR A:0xfcb78010
y.create.l HWIO_TXC_DP_ENV_SCALE_VAL_SET2_A1_ADDR A:0xfcb78014
y.create.l HWIO_TXC_DP_RAMP_ARM_A1_ADDR A:0xfcb78024
y.create.l HWIO_TXC_DP_RAMP_START_TIME_A1_ADDR A:0xfcb78028
y.create.l HWIO_TXC_DP_RAMP_SLOT_A_CFG_A1_ADDR A:0xfcb78038
y.create.l HWIO_TXC_DP_RAMP_SLOT_B_CFG_A1_ADDR A:0xfcb7803c
y.create.l HWIO_TXC_DP_RAMP_GAP_A1_ADDR A:0xfcb78040
y.create.l HWIO_TXC_DP_PHASE_OVR_VAL_A1_ADDR A:0xfcb78080
y.create.l HWIO_TXC_PP_PHASE_OVR_VAL_A1_ADDR A:0xfcb78084
y.create.l HWIO_TXC_DP_ENV_OVR_VAL_A1_ADDR A:0xfcb78088
y.create.l HWIO_TXC_EP_ENV_OVR_VAL_A1_ADDR A:0xfcb7808c
y.create.l HWIO_TXC_EP_ENV_OVR_VAL_SET2_A1_ADDR A:0xfcb78090
y.create.l HWIO_TXC_DP_ROT_PHASE_INC_A1_ADDR A:0xfcb780a0
y.create.l HWIO_TXC_DP_ROT_PHASE_INC_SET2_A1_ADDR A:0xfcb780a4
y.create.l HWIO_TXC_DP_ROT_PHASE_INIT_A1_ADDR A:0xfcb780a8
y.create.l HWIO_TXC_DP_ROT_PHASE_INIT_SET2_A1_ADDR A:0xfcb780ac
y.create.l HWIO_TXC_DP_ROT_PHASE_SHIFT_A1_ADDR A:0xfcb780b0
y.create.l HWIO_TXC_DP_ROT_PHASE_SHIFT_SET2_A1_ADDR A:0xfcb780b4
y.create.l HWIO_TXC_DP_IQ_GAIN_A1_ADDR A:0xfcb780b8
y.create.l HWIO_TXC_DP_IQ_GAIN_SET2_A1_ADDR A:0xfcb780bc
y.create.l HWIO_TXC_DP_IQMC_A1_ADDR A:0xfcb780d0
y.create.l HWIO_TXC_DP_IQMC_SET2_A1_ADDR A:0xfcb780d4
y.create.l HWIO_TXC_DP_PEQ1_A1_ADDR A:0xfcb780d8
y.create.l HWIO_TXC_DP_PEQ1_SET2_A1_ADDR A:0xfcb780dc
y.create.l HWIO_TXC_DP_PEQ2_A1_ADDR A:0xfcb780f0
y.create.l HWIO_TXC_DP_PEQ2_SET2_A1_ADDR A:0xfcb780f4
y.create.l HWIO_TXC_DP_DCOC_A1_ADDR A:0xfcb780f8
y.create.l HWIO_TXC_DP_DCOC_SET2_A1_ADDR A:0xfcb780fc
y.create.l HWIO_TXC_DM1_CFG_A1_ADDR A:0xfcb78100
y.create.l HWIO_TXC_EP_GAIN_A1_ADDR A:0xfcb78160
y.create.l HWIO_TXC_EP_GAIN_SET2_A1_ADDR A:0xfcb78164
y.create.l HWIO_TXC_EP_PEQ1_A1_ADDR A:0xfcb78168
y.create.l HWIO_TXC_EP_PEQ1_SET2_A1_ADDR A:0xfcb7816c
y.create.l HWIO_TXC_EP_DCOC_A1_ADDR A:0xfcb78170
y.create.l HWIO_TXC_EP_DCOC_SET2_A1_ADDR A:0xfcb78174
y.create.l HWIO_TXC_EP_DM2_FINE_TAU_A1_ADDR A:0xfcb78178
y.create.l HWIO_TXC_EP_DM3_FRAC_TAU_A1_ADDR A:0xfcb7817c
y.create.l HWIO_TXC_PP_GAIN_A1_ADDR A:0xfcb78180
y.create.l HWIO_TXC_PP_SPILL_A1_ADDR A:0xfcb78190
y.create.l HWIO_TXC_EP_PEQ2_A1_ADDR A:0xfcb78198
y.create.l HWIO_TXC_TIMESTAMP_T1_A1_ADDR A:0xfcb781a0
y.create.l HWIO_TXC_TIMESTAMP_T2_A1_ADDR A:0xfcb781a8
y.create.l HWIO_TXC_TIMESTAMP_REUSE_A1_ADDR A:0xfcb781b0
y.create.l HWIO_TXC_SAMPLE_COUNT_A1_ADDR A:0xfcb781b4
y.create.l HWIO_TXC_SAMPLE_COUNT_CTL_A1_ADDR A:0xfcb781b8
y.create.l HWIO_TXC_REF_ARM_A1_ADDR A:0xfcb781c0
y.create.l HWIO_TXC_REF_DWN_FACTOR_A1_ADDR A:0xfcb781c4
y.create.l HWIO_TXC_REF_NUM_SAMPLES_A1_ADDR A:0xfcb781c8
y.create.l HWIO_TXC_REF_START_TIME_A1_ADDR A:0xfcb781cc
y.create.l HWIO_TXC_REF_STATUS_A1_ADDR A:0xfcb781d0
y.create.l HWIO_TXC_REF_PEAK_POWER_A1_ADDR A:0xfcb781d4
y.create.l HWIO_TXC_REF_RMS_POWER_M_A1_ADDR A:0xfcb781d8
y.create.l HWIO_TXC_REF_RMS_POWER_L_A1_ADDR A:0xfcb781dc
y.create.l HWIO_TXC_REF_MODE_A1_ADDR A:0xfcb781e0
y.create.l HWIO_TXC_REF_I_GAIN_VAL_A1_ADDR A:0xfcb781e4
y.create.l HWIO_TXC_REF_Q_GAIN_VAL_A1_ADDR A:0xfcb781e8
y.create.l HWIO_TXC_REF_POWERCALC_OR_LOG_A1_ADDR A:0xfcb781ec
y.create.l HWIO_TXC_TESTBUS_SELECT_A1_ADDR A:0xfcb781f0
y.create.l HWIO_TXC_DP_SAWEQ_COEFF0_A1_ADDR A:0xfcb78200
y.create.l HWIO_TXC_DP_SAWEQ_COEFF1_A1_ADDR A:0xfcb78204
y.create.l HWIO_TXC_DP_SAWEQ_COEFF2_A1_ADDR A:0xfcb78208
y.create.l HWIO_TXC_DP_SAWEQ_COEFF3_A1_ADDR A:0xfcb7820c
y.create.l HWIO_TXC_DP_SAWEQ_COEFF4_A1_ADDR A:0xfcb78210
y.create.l HWIO_TXC_DP_SAWEQ_COEFF5_A1_ADDR A:0xfcb78214
y.create.l HWIO_TXC_DP_SAWEQ_COEFF6_A1_ADDR A:0xfcb78218
y.create.l HWIO_TXC_DP_SAWEQ_COEFF7_A1_ADDR A:0xfcb7821c
y.create.l HWIO_TXC_AMAM_PENDING_A1_ADDR A:0xfcb78220
y.create.l HWIO_TXC_AMPM_PENDING_A1_ADDR A:0xfcb78224
y.create.l HWIO_TXC_EPDT_PENDING_A1_ADDR A:0xfcb78228
y.create.l HWIO_TXC_DP_RAMP_SLOT_B_ADDR_A1_ADDR A:0xfcb7822c
y.create.l HWIO_TXC_AMAM_PENDING_SET2_A1_ADDR A:0xfcb78230
y.create.l HWIO_TXC_AMPM_PENDING_SET2_A1_ADDR A:0xfcb78234
y.create.l HWIO_TXC_EPDT_PENDING_SET2_A1_ADDR A:0xfcb78238
y.create.l HWIO_TXC_AMAM_ACTIVE_A1_ADDR A:0xfcb78240
y.create.l HWIO_TXC_AMPM_ACTIVE_A1_ADDR A:0xfcb78244
y.create.l HWIO_TXC_EPDT_ACTIVE_A1_ADDR A:0xfcb78248
y.create.l HWIO_TXC_RAMP_ACTIVE_A1_ADDR A:0xfcb7824c
y.create.l HWIO_TXC_DP_RAMP_SLOT_A_ADDR_A1_ADDR A:0xfcb78250
y.create.l HWIO_TXC_DP_CFG_LATCHED_A1_ADDR A:0xfcb78300
y.create.l HWIO_TXC_DP_ENV_SCALE_VAL_LATCHED_A1_ADDR A:0xfcb78304
y.create.l HWIO_TXC_DP_PHASE_OVR_VAL_LATCHED_A1_ADDR A:0xfcb78308
y.create.l HWIO_TXC_PP_PHASE_OVR_VAL_LATCHED_A1_ADDR A:0xfcb7830c
y.create.l HWIO_TXC_DP_ENV_OVR_VAL_LATCHED_A1_ADDR A:0xfcb78310
y.create.l HWIO_TXC_EP_ENV_OVR_VAL_LATCHED_A1_ADDR A:0xfcb78314
y.create.l HWIO_TXC_DP_ROT_PHASE_INC_LATCHED_A1_ADDR A:0xfcb78318
y.create.l HWIO_TXC_DP_ROT_PHASE_INIT_LATCHED_A1_ADDR A:0xfcb7831c
y.create.l HWIO_TXC_DP_ROT_PHASE_SHIFT_LATCHED_A1_ADDR A:0xfcb78320
y.create.l HWIO_TXC_DP_IQ_GAIN_LATCHED_A1_ADDR A:0xfcb78324
y.create.l HWIO_TXC_DP_IQMC_LATCHED_A1_ADDR A:0xfcb78328
y.create.l HWIO_TXC_DP_PEQ1_LATCHED_A1_ADDR A:0xfcb7832c
y.create.l HWIO_TXC_DP_PEQ2_LATCHED_A1_ADDR A:0xfcb78330
y.create.l HWIO_TXC_DP_DCOC_LATCHED_A1_ADDR A:0xfcb78334
y.create.l HWIO_TXC_DM1_CFG_LATCHED_A1_ADDR A:0xfcb78338
y.create.l HWIO_TXC_EP_GAIN_LATCHED_A1_ADDR A:0xfcb7833c
y.create.l HWIO_TXC_EP_PEQ1_LATCHED_A1_ADDR A:0xfcb78340
y.create.l HWIO_TXC_EP_DCOC_LATCHED_A1_ADDR A:0xfcb78344
y.create.l HWIO_TXC_EP_DM2_FINE_TAU_LATCHED_A1_ADDR A:0xfcb78348
y.create.l HWIO_TXC_EP_DM3_FRAC_TAU_LATCHED_A1_ADDR A:0xfcb7834c
y.create.l HWIO_TXC_PP_GAIN_LATCHED_A1_ADDR A:0xfcb78350
y.create.l HWIO_TXC_PP_SPILL_LATCHED_A1_ADDR A:0xfcb78354
y.create.l HWIO_TXC_EP_PEQ2_LATCHED_A1_ADDR A:0xfcb78358
y.create.l HWIO_TXC_DP_CFG_2_LATCHED_A1_ADDR A:0xfcb7835c
y.create.l HWIO_TXC_DP_SAWEQ_COEFF0_LATCHED_A1_ADDR A:0xfcb78380
y.create.l HWIO_TXC_DP_SAWEQ_COEFF1_LATCHED_A1_ADDR A:0xfcb78384
y.create.l HWIO_TXC_DP_SAWEQ_COEFF2_LATCHED_A1_ADDR A:0xfcb78388
y.create.l HWIO_TXC_DP_SAWEQ_COEFF3_LATCHED_A1_ADDR A:0xfcb7838c
y.create.l HWIO_TXC_DP_SAWEQ_COEFF4_LATCHED_A1_ADDR A:0xfcb78390
y.create.l HWIO_TXC_DP_SAWEQ_COEFF5_LATCHED_A1_ADDR A:0xfcb78394
y.create.l HWIO_TXC_DP_SAWEQ_COEFF6_LATCHED_A1_ADDR A:0xfcb78398
y.create.l HWIO_TXC_DP_SAWEQ_COEFF7_LATCHED_A1_ADDR A:0xfcb7839c
y.create.l HWIO_TXR_IQ_DAC_A1_ADDR A:0xfcb7a000
y.create.l HWIO_TXR_STR_CTRL_A1_ADDR A:0xfcb7a008
y.create.l HWIO_TXR_PDA_CTRL_A1_ADDR A:0xfcb7a00c
y.create.l HWIO_TXR_PDA_WD_UPDATE_CTRL_A1_ADDR A:0xfcb7a010
y.create.l HWIO_TXR_PDA_CTRL_WD_OFFSET_A1_ADDR A:0xfcb7a014
y.create.l HWIO_TXR_PDA_OFFSET_CMD_A1_ADDR A:0xfcb7a018
y.create.l HWIO_TXR_PPDSM_CTL_A1_ADDR A:0xfcb7a01c
y.create.l HWIO_TXR_PPDSM_OVERRIDE_VAL_A1_ADDR A:0xfcb7a020
y.create.l HWIO_TXR_PPDSM_OVERRIDE_REP_A1_ADDR A:0xfcb7a024
y.create.l HWIO_TXR_FIFO_PTR_DIFF_A_A1_ADDR A:0xfcb7a028
y.create.l HWIO_TXR_FIFO_PTR_DIFF_B_A1_ADDR A:0xfcb7a02c
y.create.l HWIO_TXR_FIFO_STATUS_A_A1_ADDR A:0xfcb7a030
y.create.l HWIO_TXR_FIFO_STATUS_B_A1_ADDR A:0xfcb7a034
y.create.l HWIO_TXR_FIFO_CMD_A1_ADDR A:0xfcb7a038
y.create.l HWIO_TXR_FIFO_CTRL_A1_ADDR A:0xfcb7a03c
y.create.l HWIO_TXR_STREAM_IF_CTRL_A1_ADDR A:0xfcb7a040
y.create.l HWIO_TXR_FMT_CONV_CTL_A1_ADDR A:0xfcb7a050
y.create.l HWIO_TXR_IQ_DAC_CURRENT_A1_ADDR A:0xfcb7a054
y.create.l HWIO_TXR_STR_CTRL_CURRENT_A1_ADDR A:0xfcb7a058
y.create.l HWIO_TXR_PDA_CTRL_CURRENT_A1_ADDR A:0xfcb7a05c
y.create.l HWIO_TXR_PDA_WD_UPDATE_CTRL_CURRENT_A1_ADDR A:0xfcb7a060
y.create.l HWIO_TXR_PDA_CTRL_WD_OFFSET_CURRENT_A1_ADDR A:0xfcb7a064
y.create.l HWIO_TXR_PDA_OFFSET_CMD_CURRENT_A1_ADDR A:0xfcb7a068
y.create.l HWIO_TXR_PPDSM_CTL_CURRENT_A1_ADDR A:0xfcb7a06c
y.create.l HWIO_TXR_PPDSM_OVERRIDE_VAL_CURRENT_A1_ADDR A:0xfcb7a070
y.create.l HWIO_TXR_PPDSM_OVERRIDE_REP_CURRENT_A1_ADDR A:0xfcb7a074
y.create.l HWIO_TXR_STREAM_IF_CTRL_CURRENT_A1_ADDR A:0xfcb7a078
y.create.l HWIO_TXR_FMT_CONV_CTL_CURRENT_A1_ADDR A:0xfcb7a07c
y.create.l HWIO_TX_RDR_CFG0_ADDR A:0xfcb70f00
y.create.l HWIO_TX_RDR_CFG1_ADDR A:0xfcb70f04
y.create.l HWIO_TX_RDR_XFER_CTL_ADDR A:0xfcb70f08
y.create.l HWIO_TX_WRTR_CFG0_ADDR A:0xfcb70f0c
y.create.l HWIO_TX_WRTR_CFG1_ADDR A:0xfcb70f10
y.create.l HWIO_TX_WRTR_XFER_CTL_ADDR A:0xfcb70f14
y.create.l HWIO_TX_BRDG_CTL_ADDR A:0xfcb70f18
y.create.l HWIO_TX_BRDG_STATUS_ADDR A:0xfcb70f1c
y.create.l HWIO_TX_BRDG_CLEAR_ADDR A:0xfcb70f20
y.create.l HWIO_TX_RDR_VBUF_ADDR_ADDR A:0xfcb70f24
y.create.l HWIO_TX_WRTR_VBUF_ADDR_ADDR A:0xfcb70f28
y.create.l HWIO_TXC_MEM_BANK0_ADDR0_ADDR A:0xfcb7d000
y.create.l HWIO_TXC_MEM_BANK0_ADDR1_ADDR A:0xfcb7d004
y.create.l HWIO_TXC_MEM_BANK0_ADDR2_ADDR A:0xfcb7d008
y.create.l HWIO_TXC_MEM_BANK0_ADDR3_ADDR A:0xfcb7d00c
y.create.l HWIO_TXC_MEM_BANK1_ADDR0_ADDR A:0xfcb7d400
y.create.l HWIO_TXC_MEM_BANK1_ADDR1_ADDR A:0xfcb7d404
y.create.l HWIO_TXC_MEM_BANK1_ADDR2_ADDR A:0xfcb7d408
y.create.l HWIO_TXC_MEM_BANK1_ADDR3_ADDR A:0xfcb7d40c
y.create.l HWIO_TXC_MEM_BANK2_ADDR0_ADDR A:0xfcb7d800
y.create.l HWIO_TXC_MEM_BANK2_ADDR1_ADDR A:0xfcb7d804
y.create.l HWIO_TXC_MEM_BANK2_ADDR2_ADDR A:0xfcb7d808
y.create.l HWIO_TXC_MEM_BANK2_ADDR3_ADDR A:0xfcb7d80c
y.create.l HWIO_TXC_MEM_BANK3_ADDR0_ADDR A:0xfcb7dc00
y.create.l HWIO_TXC_MEM_BANK3_ADDR1_ADDR A:0xfcb7dc04
y.create.l HWIO_TXC_MEM_BANK3_ADDR2_ADDR A:0xfcb7dc08
y.create.l HWIO_TXC_MEM_BANK3_ADDR3_ADDR A:0xfcb7dc0c
y.create.l HWIO_TXC_MEM_BANK4_ADDR0_ADDR A:0xfcb7e000
y.create.l HWIO_TXC_MEM_BANK4_ADDR1_ADDR A:0xfcb7e004
y.create.l HWIO_TXC_MEM_BANK4_ADDR2_ADDR A:0xfcb7e008
y.create.l HWIO_TXC_MEM_BANK4_ADDR3_ADDR A:0xfcb7e00c
y.create.l HWIO_TXC_MEM_BANK5_ADDR0_ADDR A:0xfcb7e400
y.create.l HWIO_TXC_MEM_BANK5_ADDR1_ADDR A:0xfcb7e404
y.create.l HWIO_TXC_MEM_BANK5_ADDR2_ADDR A:0xfcb7e408
y.create.l HWIO_TXC_MEM_BANK5_ADDR3_ADDR A:0xfcb7e40c
y.create.l HWIO_TXC_MEM_BANK6_ADDR0_ADDR A:0xfcb7e800
y.create.l HWIO_TXC_MEM_BANK6_ADDR1_ADDR A:0xfcb7e804
y.create.l HWIO_TXC_MEM_BANK6_ADDR2_ADDR A:0xfcb7e808
y.create.l HWIO_TXC_MEM_BANK6_ADDR3_ADDR A:0xfcb7e80c
y.create.l HWIO_TXC_MEM_BANK7_ADDR0_ADDR A:0xfcb7ec00
y.create.l HWIO_TXC_MEM_BANK7_ADDR1_ADDR A:0xfcb7ec04
y.create.l HWIO_TXC_MEM_BANK7_ADDR2_ADDR A:0xfcb7ec08
y.create.l HWIO_TXC_MEM_BANK7_ADDR3_ADDR A:0xfcb7ec0c
y.create.l HWIO_TXC_MEM_BANK8_ADDR0_ADDR A:0xfcb7f000
y.create.l HWIO_TXC_MEM_BANK8_ADDR1_ADDR A:0xfcb7f004
y.create.l HWIO_TXC_MEM_BANK8_ADDR2_ADDR A:0xfcb7f008
y.create.l HWIO_TXC_MEM_BANK8_ADDR3_ADDR A:0xfcb7f00c
y.create.l HWIO_TXC_MEM_BANK9_ADDR0_ADDR A:0xfcb7f400
y.create.l HWIO_TXC_MEM_BANK9_ADDR1_ADDR A:0xfcb7f404
y.create.l HWIO_TXC_MEM_BANK9_ADDR2_ADDR A:0xfcb7f408
y.create.l HWIO_TXC_MEM_BANK9_ADDR3_ADDR A:0xfcb7f40c
y.create.l HWIO_O_TX_WMORE_STATUS_WORD0_ADDR A:0xfcb76200
y.create.l HWIO_TX_LTE_WMORE_WORD0_ADDR A:0xfcb76300
y.create.l HWIO_TX_LTE_WMORE_WORD1_ADDR A:0xfcb76304
y.create.l HWIO_TX_LTE_WMORE_WORD2_ADDR A:0xfcb76308
y.create.l HWIO_TX_LTE_WMORE_WORD3_ADDR A:0xfcb7630c
y.create.l HWIO_TX_LTE_WMORE_WORD4_ADDR A:0xfcb76310
y.create.l HWIO_TX_LTE_WMORE_WORD5_ADDR A:0xfcb76314
y.create.l HWIO_TX_LTE_WMORE_WORD6_ADDR A:0xfcb76318
y.create.l HWIO_TX_LTE_WMORE_WORD7_ADDR A:0xfcb7631c
y.create.l HWIO_TX_LTE_WMORE_UPPTS_WORD0_ADDR A:0xfcb76400
y.create.l HWIO_TX_LTE_WMORE_UPPTS_WORD1_ADDR A:0xfcb76404
y.create.l HWIO_TX_LTE_WMORE_UPPTS_WORD2_ADDR A:0xfcb76408
y.create.l HWIO_TX_LTE_WMORE_UPPTS_WORD3_ADDR A:0xfcb7640c
y.create.l HWIO_TX_LTE_WMORE_PRACH_WORD0_ADDR A:0xfcb76500
y.create.l HWIO_TX_LTE_WMORE_PRACH_WORD1_ADDR A:0xfcb76504
y.create.l HWIO_TX_LTE_WMORE_PRACH_WORD2_ADDR A:0xfcb76508
y.create.l HWIO_O_TX_ENC_STATUS_WORD0_ADDR A:0xfcb76600
y.create.l HWIO_TX_LTE_PUSCH_ENC_WORD0_ADDR A:0xfcb76700
y.create.l HWIO_TX_LTE_PUSCH_ENC_WORD1_ADDR A:0xfcb76704
y.create.l HWIO_TX_LTE_PUSCH_ENC_WORD2_ADDR A:0xfcb76708
y.create.l HWIO_TX_LTE_PUSCH_ENC_WORD3_ADDR A:0xfcb7670c
y.create.l HWIO_TX_LTE_PUSCH_ENC_WORD4_ADDR A:0xfcb76710
y.create.l HWIO_O_TX_MOD_STATUS_WORD0_ADDR A:0xfcb76800
y.create.l HWIO_TX_LTE_PUSCH_MOD_WORD0_ADDR A:0xfcb76900
y.create.l HWIO_TX_LTE_PUSCH_MOD_WORD1_ADDR A:0xfcb76904
y.create.l HWIO_TX_LTE_PUSCH_MOD_WORD2_ADDR A:0xfcb76908
y.create.l HWIO_TX_LTE_PUSCH_MOD_WORD3_ADDR A:0xfcb7690c
y.create.l HWIO_TX_LTE_PUSCH_MOD_WORD4_ADDR A:0xfcb76910
y.create.l HWIO_TX_LTE_PUSCH_MOD_WORD5_ADDR A:0xfcb76914
y.create.l HWIO_TX_LTE_PUSCH_MOD_WORD6_ADDR A:0xfcb76918
y.create.l HWIO_TX_LTE_PUSCH_MOD_WORD7_ADDR A:0xfcb7691c
y.create.l HWIO_TX_LTE_PUSCH_MOD_WORD8_ADDR A:0xfcb76920
y.create.l HWIO_TX_LTE_PUSCH_MOD_WORD9_ADDR A:0xfcb76924
y.create.l HWIO_TX_LTE_PUSCH_MOD_WORD10_ADDR A:0xfcb76928
y.create.l HWIO_TX_LTE_PUSCH_MOD_WORD11_ADDR A:0xfcb7692c
y.create.l HWIO_TX_LTE_PUSCH_MOD_WORD12_ADDR A:0xfcb76930
y.create.l HWIO_TX_LTE_PUSCH_MOD_WORD13_ADDR A:0xfcb76934
y.create.l HWIO_TX_LTE_PUSCH_MOD_WORD14_ADDR A:0xfcb76938
y.create.l HWIO_TX_LTE_PUSCH_MOD_WORD15_ADDR A:0xfcb7693c
y.create.l HWIO_TX_LTE_PUSCH_MOD_WORD16_ADDR A:0xfcb76940
y.create.l HWIO_TX_LTE_PUSCH_MOD_WORD17_ADDR A:0xfcb76944
y.create.l HWIO_TX_LTE_PUSCH_MOD_WORD18_ADDR A:0xfcb76948
y.create.l HWIO_TX_LTE_PUSCH_MOD_WORD19_ADDR A:0xfcb7694c
y.create.l HWIO_TX_LTE_PUSCH_MOD_WORD20_ADDR A:0xfcb76950
y.create.l HWIO_TX_LTE_PUSCH_MOD_WORD21_ADDR A:0xfcb76954
y.create.l HWIO_TX_LTE_PUCCH_MOD_WORD0_ADDR A:0xfcb76a00
y.create.l HWIO_TX_LTE_PUCCH_MOD_WORD1_ADDR A:0xfcb76a04
y.create.l HWIO_TX_LTE_PUCCH_MOD_WORD2_ADDR A:0xfcb76a08
y.create.l HWIO_TX_LTE_PUCCH_MOD_WORD3_ADDR A:0xfcb76a0c
y.create.l HWIO_TX_LTE_PUCCH_MOD_WORD4_ADDR A:0xfcb76a10
y.create.l HWIO_TX_LTE_PUCCH_MOD_WORD5_ADDR A:0xfcb76a14
y.create.l HWIO_TX_LTE_PUCCH_MOD_WORD6_ADDR A:0xfcb76a18
y.create.l HWIO_TX_LTE_PUCCH_MOD_WORD7_ADDR A:0xfcb76a1c
y.create.l HWIO_TX_LTE_PUCCH_MOD_WORD8_ADDR A:0xfcb76a20
y.create.l HWIO_TX_LTE_PUCCH_MOD_WORD9_ADDR A:0xfcb76a24
y.create.l HWIO_TX_LTE_PUCCH_MOD_WORD10_ADDR A:0xfcb76a28
y.create.l HWIO_TX_LTE_PUCCH_MOD_WORD11_ADDR A:0xfcb76a2c
y.create.l HWIO_TX_LTE_PUCCH_MOD_WORD12_ADDR A:0xfcb76a30
y.create.l HWIO_TX_LTE_PUCCH_MOD_WORD13_ADDR A:0xfcb76a34
y.create.l HWIO_TX_LTE_PRACH_MOD_WORD0_ADDR A:0xfcb76b00
y.create.l HWIO_TX_LTE_PRACH_MOD_WORD1_ADDR A:0xfcb76b04
y.create.l HWIO_TX_LTE_PRACH_MOD_WORD2_ADDR A:0xfcb76b08
y.create.l HWIO_TX_LTE_PRACH_MOD_WORD3_ADDR A:0xfcb76b0c
y.create.l HWIO_TX_LTE_PRACH_MOD_WORD4_ADDR A:0xfcb76b10
y.create.l HWIO_TX_LTE_PRACH_MOD_WORD5_ADDR A:0xfcb76b14
y.create.l HWIO_TX_LTE_UPPTS_MOD_WORD0_ADDR A:0xfcb76c00
y.create.l HWIO_TX_LTE_UPPTS_MOD_WORD1_ADDR A:0xfcb76c04
y.create.l HWIO_TX_LTE_UPPTS_MOD_WORD2_ADDR A:0xfcb76c08
y.create.l HWIO_TX_LTE_UPPTS_MOD_WORD3_ADDR A:0xfcb76c0c
y.create.l HWIO_TX_LTE_UPPTS_MOD_WORD4_ADDR A:0xfcb76c10
y.create.l HWIO_TX_LTE_UPPTS_MOD_WORD5_ADDR A:0xfcb76c14
y.create.l HWIO_TX_LTE_UPPTS_MOD_WORD6_ADDR A:0xfcb76c18
y.create.l HWIO_TX_LTE_UPPTS_MOD_WORD7_ADDR A:0xfcb76c1c
y.create.l HWIO_TX_LTE_UPPTS_MOD_WORD8_ADDR A:0xfcb76c20
y.create.l HWIO_TX_LTE_UPPTS_MOD_WORD9_ADDR A:0xfcb76c24
y.create.l HWIO_TX_LTE_PUSCH_MOD_ACK_WORD0_ADDR A:0xfcb76d00
y.create.l HWIO_TX_LTE_PUCCH_MOD_ACK_WORD0_ADDR A:0xfcb76e00
y.create.l HWIO_RXFE_ENABLE_ADDR A:0xfcb60000
y.create.l HWIO_RXFE_ADC0_LOGIC_CFG_ADDR A:0xfcb60004
y.create.l HWIO_RXFE_ADC1_LOGIC_CFG_ADDR A:0xfcb60008
y.create.l HWIO_RXFE_ADC2_LOGIC_CFG_ADDR A:0xfcb6000c
y.create.l HWIO_RXFE_ADC3_LOGIC_CFG_ADDR A:0xfcb60010
y.create.l HWIO_RXFE_WB0_ADCMUX_CFG_ADDR A:0xfcb60014
y.create.l HWIO_RXFE_WB1_ADCMUX_CFG_ADDR A:0xfcb60018
y.create.l HWIO_RXFE_WB2_ADCMUX_CFG_ADDR A:0xfcb6001c
y.create.l HWIO_RXFE_WB3_ADCMUX_CFG_ADDR A:0xfcb60020
y.create.l HWIO_RXFE_NB0_WBMUX_CFG_ADDR A:0xfcb60024
y.create.l HWIO_RXFE_NB1_WBMUX_CFG_ADDR A:0xfcb60028
y.create.l HWIO_RXFE_NB2_WBMUX_CFG_ADDR A:0xfcb6002c
y.create.l HWIO_RXFE_NB3_WBMUX_CFG_ADDR A:0xfcb60030
y.create.l HWIO_RXFE_NB4_WBMUX_CFG_ADDR A:0xfcb60034
y.create.l HWIO_RXFE_NB5_WBMUX_CFG_ADDR A:0xfcb60038
y.create.l HWIO_RXFE_NB6_WBMUX_CFG_ADDR A:0xfcb6003c
y.create.l HWIO_RXFE_TOP_STATUS_ADDR A:0xfcb60040
y.create.l HWIO_RXFE_RFIF_UPDATE_CMD_ADDR A:0xfcb60044
y.create.l HWIO_RXFE_CMNNOTCH_FILT0_CFG0_ADDR A:0xfcb60048
y.create.l HWIO_RXFE_CMNNOTCH_FILT0_CFG1_ADDR A:0xfcb6004c
y.create.l HWIO_RXFE_CMNNOTCH_FILT1_CFG0_ADDR A:0xfcb60050
y.create.l HWIO_RXFE_CMNNOTCH_FILT1_CFG1_ADDR A:0xfcb60054
y.create.l HWIO_RXFE_CMNNOTCH_FILT2_CFG0_ADDR A:0xfcb60058
y.create.l HWIO_RXFE_CMNNOTCH_FILT2_CFG1_ADDR A:0xfcb6005c
y.create.l HWIO_RXFE_CMNNOTCH_FILT3_CFG0_ADDR A:0xfcb60060
y.create.l HWIO_RXFE_CMNNOTCH_FILT3_CFG1_ADDR A:0xfcb60064
y.create.l HWIO_RXFE_CMNNOTCH_FILT01_CFG_ADDR A:0xfcb60068
y.create.l HWIO_RXFE_CMNNOTCH_FILT23_CFG_ADDR A:0xfcb6006c
y.create.l HWIO_RXFE_ACI_FILT0_CFG_ADDR A:0xfcb60070
y.create.l HWIO_RXFE_ACI_FILT1_CFG_ADDR A:0xfcb60074
y.create.l HWIO_RXFE_DBG_ENABLES_ADDR A:0xfcb60078
y.create.l HWIO_RXFE_DBG_PROBE_CTL_ADDR A:0xfcb6007c
y.create.l HWIO_RXFE_DBG_CMD_ADDR A:0xfcb60080
y.create.l HWIO_RXFE_PBS_CFG_ADDR A:0xfcb60084
y.create.l HWIO_RXFE_TOP_SPARE_REG_ADDR A:0xfcb60088
y.create.l HWIO_RXFE_ADC_TEST1_REG_ADC0_ADDR A:0xfcb62000
y.create.l HWIO_RXFE_ADC_TEST2_REG_ADC0_ADDR A:0xfcb62004
y.create.l HWIO_RXFE_ADC_TEST3_REG_ADC0_ADDR A:0xfcb62008
y.create.l HWIO_RXFE_ADC_CONTROL_REG_ADC0_ADDR A:0xfcb6200c
y.create.l HWIO_RXFE_ADC_CONFIG_REG_ADC0_ADDR A:0xfcb62010
y.create.l HWIO_RXFE_ADC_TEST1_REG_ADC1_ADDR A:0xfcb62100
y.create.l HWIO_RXFE_ADC_TEST2_REG_ADC1_ADDR A:0xfcb62104
y.create.l HWIO_RXFE_ADC_TEST3_REG_ADC1_ADDR A:0xfcb62108
y.create.l HWIO_RXFE_ADC_CONTROL_REG_ADC1_ADDR A:0xfcb6210c
y.create.l HWIO_RXFE_ADC_CONFIG_REG_ADC1_ADDR A:0xfcb62110
y.create.l HWIO_RXFE_ADC_TEST1_REG_ADC2_ADDR A:0xfcb62200
y.create.l HWIO_RXFE_ADC_TEST2_REG_ADC2_ADDR A:0xfcb62204
y.create.l HWIO_RXFE_ADC_TEST3_REG_ADC2_ADDR A:0xfcb62208
y.create.l HWIO_RXFE_ADC_CONTROL_REG_ADC2_ADDR A:0xfcb6220c
y.create.l HWIO_RXFE_ADC_CONFIG_REG_ADC2_ADDR A:0xfcb62210
y.create.l HWIO_RXFE_ADC_TEST1_REG_ADC3_ADDR A:0xfcb62300
y.create.l HWIO_RXFE_ADC_TEST2_REG_ADC3_ADDR A:0xfcb62304
y.create.l HWIO_RXFE_ADC_TEST3_REG_ADC3_ADDR A:0xfcb62308
y.create.l HWIO_RXFE_ADC_CONTROL_REG_ADC3_ADDR A:0xfcb6230c
y.create.l HWIO_RXFE_ADC_CONFIG_REG_ADC3_ADDR A:0xfcb62310
y.create.l HWIO_RXFE_WB_TOP_CTL_WB0_ADDR A:0xfcb64000
y.create.l HWIO_RXFE_WB_TOP_CMD_WB0_ADDR A:0xfcb64004
y.create.l HWIO_RXFE_WB_TOP_STATUS_WB0_ADDR A:0xfcb64008
y.create.l HWIO_RXFE_WB_STOPGATE_ACTION_SAMPLE_WB0_ADDR A:0xfcb6400c
y.create.l HWIO_RXFE_WB_TIMINGCTL_STATUS_WB0_ADDR A:0xfcb64010
y.create.l HWIO_RXFE_WB_MISC_CFG_WB0_ADDR A:0xfcb64014
y.create.l HWIO_RXFE_WB_WBPWR_CFG_WB0_ADDR A:0xfcb64018
y.create.l HWIO_RXFE_WB_WBPWR_CMD_WB0_ADDR A:0xfcb6401c
y.create.l HWIO_RXFE_WB_WBPWR_START_ACTION_SAMPLE_WB0_ADDR A:0xfcb64020
y.create.l HWIO_RXFE_WB_WBPWR_START_MASK_WB0_ADDR A:0xfcb64024
y.create.l HWIO_RXFE_WB_WBPWR_STOP_ACTION_SAMPLE_WB0_ADDR A:0xfcb64028
y.create.l HWIO_RXFE_WB_WBPWR_FINAL_ACC_WB0_ADDR A:0xfcb6402c
y.create.l HWIO_RXFE_WB_WBPWR_CURR_ACC_WB0_ADDR A:0xfcb64030
y.create.l HWIO_RXFE_WB_WBPWR_MAX_ACC_WB0_ADDR A:0xfcb64034
y.create.l HWIO_RXFE_WB_WBDC_CFG_WB0_ADDR A:0xfcb64038
y.create.l HWIO_RXFE_WB_WBDC_CMD_WB0_ADDR A:0xfcb6403c
y.create.l HWIO_RXFE_WB_WBDC_START_ACTION_SAMPLE_WB0_ADDR A:0xfcb64040
y.create.l HWIO_RXFE_WB_WBDC_STOP_ACTION_SAMPLE_WB0_ADDR A:0xfcb64044
y.create.l HWIO_RXFE_WB_WBDC_UPDATE_ACTION_SAMPLE_WB0_ADDR A:0xfcb64048
y.create.l HWIO_RXFE_WB_WBDC_UPDATE_DELAY_WB0_ADDR A:0xfcb6404c
y.create.l HWIO_RXFE_WB_WBDC_OVRD_I_WB0_ADDR A:0xfcb64050
y.create.l HWIO_RXFE_WB_WBDC_OVRD_Q_WB0_ADDR A:0xfcb64054
y.create.l HWIO_RXFE_WB_WBDC_EST1_CURR_I_WB0_ADDR A:0xfcb64058
y.create.l HWIO_RXFE_WB_WBDC_EST1_CURR_Q_WB0_ADDR A:0xfcb6405c
y.create.l HWIO_RXFE_WB_WBDC_EST1_PREV_I_WB0_ADDR A:0xfcb64060
y.create.l HWIO_RXFE_WB_WBDC_EST1_PREV_Q_WB0_ADDR A:0xfcb64064
y.create.l HWIO_RXFE_WB_WBDC_EST1_LOAD_I_WB0_ADDR A:0xfcb64068
y.create.l HWIO_RXFE_WB_WBDC_EST1_LOAD_Q_WB0_ADDR A:0xfcb6406c
y.create.l HWIO_RXFE_WB_WBDC_EST2_CURR_I_WB0_ADDR A:0xfcb64070
y.create.l HWIO_RXFE_WB_WBDC_EST2_CURR_Q_WB0_ADDR A:0xfcb64074
y.create.l HWIO_RXFE_WB_WBDC_EST2_PREV_I_WB0_ADDR A:0xfcb64078
y.create.l HWIO_RXFE_WB_WBDC_EST2_PREV_Q_WB0_ADDR A:0xfcb6407c
y.create.l HWIO_RXFE_WB_WBDC_EST2_LOAD_I_WB0_ADDR A:0xfcb64080
y.create.l HWIO_RXFE_WB_WBDC_EST2_LOAD_Q_WB0_ADDR A:0xfcb64084
y.create.l HWIO_RXFE_WB_VSRC_CFG_WB0_ADDR A:0xfcb64088
y.create.l HWIO_RXFE_WB_VSRC_T2BYT1M1_WB0_ADDR A:0xfcb6408c
y.create.l HWIO_RXFE_WB_VSRC_CMD_WB0_ADDR A:0xfcb64090
y.create.l HWIO_RXFE_WB_VSRC_STATUS_WB0_ADDR A:0xfcb64094
y.create.l HWIO_RXFE_WB_VSRC_UPDT_ACTION_SAMPLE_WB0_ADDR A:0xfcb64098
y.create.l HWIO_RXFE_WB_VSRC_CURR_T1BYT2_WB0_ADDR A:0xfcb6409c
y.create.l HWIO_RXFE_WB_VSRC_CURR_T2BYT1M1_WB0_ADDR A:0xfcb640a0
y.create.l HWIO_RXFE_WB_VSRC_SCTR_LOAD_VALUE_WB0_ADDR A:0xfcb640a4
y.create.l HWIO_RXFE_WB_VSRC_SCTR_WA_WB0_ADDR A:0xfcb640a8
y.create.l HWIO_RXFE_WB_VSRC_SCTR_SNAPSHOT_WB0_ADDR A:0xfcb640ac
y.create.l HWIO_RXFE_WB_VSRC_ACC_SNAPSHOT_WB0_ADDR A:0xfcb640b0
y.create.l HWIO_RXFE_WB_DEC_FILT_CFG_WB0_ADDR A:0xfcb640b4
y.create.l HWIO_RXFE_WB_IQMC_CFG0_WB0_ADDR A:0xfcb640b8
y.create.l HWIO_RXFE_WB_IQMC_CFG1_WB0_ADDR A:0xfcb640bc
y.create.l HWIO_RXFE_WB_IQMC_CURR_VALS_WB0_ADDR A:0xfcb640c0
y.create.l HWIO_RXFE_WB_IQMC_UPDT_CMD_WB0_ADDR A:0xfcb640c4
y.create.l HWIO_RXFE_WB_IQMC_UPDT_ACTION_SAMPLE_WB0_ADDR A:0xfcb640c8
y.create.l HWIO_RXFE_WB_NOTCH_FILT0_CFG0_WB0_ADDR A:0xfcb640cc
y.create.l HWIO_RXFE_WB_NOTCH_FILT1_CFG0_WB0_ADDR A:0xfcb640d4
y.create.l HWIO_RXFE_WB_NOTCH_FILT0_CFG1_WB0_ADDR A:0xfcb640d0
y.create.l HWIO_RXFE_WB_NOTCH_FILT1_CFG1_WB0_ADDR A:0xfcb640d8
y.create.l HWIO_RXFE_WB_NOTCH_FILT01_CFG_WB0_ADDR A:0xfcb640dc
y.create.l HWIO_RXFE_WB_SPARE_REG_WB0_ADDR A:0xfcb640e0
y.create.l HWIO_RXFE_WB_TOP_CTL_WB1_ADDR A:0xfcb65000
y.create.l HWIO_RXFE_WB_TOP_CMD_WB1_ADDR A:0xfcb65004
y.create.l HWIO_RXFE_WB_TOP_STATUS_WB1_ADDR A:0xfcb65008
y.create.l HWIO_RXFE_WB_STOPGATE_ACTION_SAMPLE_WB1_ADDR A:0xfcb6500c
y.create.l HWIO_RXFE_WB_TIMINGCTL_STATUS_WB1_ADDR A:0xfcb65010
y.create.l HWIO_RXFE_WB_MISC_CFG_WB1_ADDR A:0xfcb65014
y.create.l HWIO_RXFE_WB_WBPWR_CFG_WB1_ADDR A:0xfcb65018
y.create.l HWIO_RXFE_WB_WBPWR_CMD_WB1_ADDR A:0xfcb6501c
y.create.l HWIO_RXFE_WB_WBPWR_START_ACTION_SAMPLE_WB1_ADDR A:0xfcb65020
y.create.l HWIO_RXFE_WB_WBPWR_START_MASK_WB1_ADDR A:0xfcb65024
y.create.l HWIO_RXFE_WB_WBPWR_STOP_ACTION_SAMPLE_WB1_ADDR A:0xfcb65028
y.create.l HWIO_RXFE_WB_WBPWR_FINAL_ACC_WB1_ADDR A:0xfcb6502c
y.create.l HWIO_RXFE_WB_WBPWR_CURR_ACC_WB1_ADDR A:0xfcb65030
y.create.l HWIO_RXFE_WB_WBPWR_MAX_ACC_WB1_ADDR A:0xfcb65034
y.create.l HWIO_RXFE_WB_WBDC_CFG_WB1_ADDR A:0xfcb65038
y.create.l HWIO_RXFE_WB_WBDC_CMD_WB1_ADDR A:0xfcb6503c
y.create.l HWIO_RXFE_WB_WBDC_START_ACTION_SAMPLE_WB1_ADDR A:0xfcb65040
y.create.l HWIO_RXFE_WB_WBDC_STOP_ACTION_SAMPLE_WB1_ADDR A:0xfcb65044
y.create.l HWIO_RXFE_WB_WBDC_UPDATE_ACTION_SAMPLE_WB1_ADDR A:0xfcb65048
y.create.l HWIO_RXFE_WB_WBDC_UPDATE_DELAY_WB1_ADDR A:0xfcb6504c
y.create.l HWIO_RXFE_WB_WBDC_OVRD_I_WB1_ADDR A:0xfcb65050
y.create.l HWIO_RXFE_WB_WBDC_OVRD_Q_WB1_ADDR A:0xfcb65054
y.create.l HWIO_RXFE_WB_WBDC_EST1_CURR_I_WB1_ADDR A:0xfcb65058
y.create.l HWIO_RXFE_WB_WBDC_EST1_CURR_Q_WB1_ADDR A:0xfcb6505c
y.create.l HWIO_RXFE_WB_WBDC_EST1_PREV_I_WB1_ADDR A:0xfcb65060
y.create.l HWIO_RXFE_WB_WBDC_EST1_PREV_Q_WB1_ADDR A:0xfcb65064
y.create.l HWIO_RXFE_WB_WBDC_EST1_LOAD_I_WB1_ADDR A:0xfcb65068
y.create.l HWIO_RXFE_WB_WBDC_EST1_LOAD_Q_WB1_ADDR A:0xfcb6506c
y.create.l HWIO_RXFE_WB_WBDC_EST2_CURR_I_WB1_ADDR A:0xfcb65070
y.create.l HWIO_RXFE_WB_WBDC_EST2_CURR_Q_WB1_ADDR A:0xfcb65074
y.create.l HWIO_RXFE_WB_WBDC_EST2_PREV_I_WB1_ADDR A:0xfcb65078
y.create.l HWIO_RXFE_WB_WBDC_EST2_PREV_Q_WB1_ADDR A:0xfcb6507c
y.create.l HWIO_RXFE_WB_WBDC_EST2_LOAD_I_WB1_ADDR A:0xfcb65080
y.create.l HWIO_RXFE_WB_WBDC_EST2_LOAD_Q_WB1_ADDR A:0xfcb65084
y.create.l HWIO_RXFE_WB_VSRC_CFG_WB1_ADDR A:0xfcb65088
y.create.l HWIO_RXFE_WB_VSRC_T2BYT1M1_WB1_ADDR A:0xfcb6508c
y.create.l HWIO_RXFE_WB_VSRC_CMD_WB1_ADDR A:0xfcb65090
y.create.l HWIO_RXFE_WB_VSRC_STATUS_WB1_ADDR A:0xfcb65094
y.create.l HWIO_RXFE_WB_VSRC_UPDT_ACTION_SAMPLE_WB1_ADDR A:0xfcb65098
y.create.l HWIO_RXFE_WB_VSRC_CURR_T1BYT2_WB1_ADDR A:0xfcb6509c
y.create.l HWIO_RXFE_WB_VSRC_CURR_T2BYT1M1_WB1_ADDR A:0xfcb650a0
y.create.l HWIO_RXFE_WB_VSRC_SCTR_LOAD_VALUE_WB1_ADDR A:0xfcb650a4
y.create.l HWIO_RXFE_WB_VSRC_SCTR_WA_WB1_ADDR A:0xfcb650a8
y.create.l HWIO_RXFE_WB_VSRC_SCTR_SNAPSHOT_WB1_ADDR A:0xfcb650ac
y.create.l HWIO_RXFE_WB_VSRC_ACC_SNAPSHOT_WB1_ADDR A:0xfcb650b0
y.create.l HWIO_RXFE_WB_DEC_FILT_CFG_WB1_ADDR A:0xfcb650b4
y.create.l HWIO_RXFE_WB_IQMC_CFG0_WB1_ADDR A:0xfcb650b8
y.create.l HWIO_RXFE_WB_IQMC_CFG1_WB1_ADDR A:0xfcb650bc
y.create.l HWIO_RXFE_WB_IQMC_CURR_VALS_WB1_ADDR A:0xfcb650c0
y.create.l HWIO_RXFE_WB_IQMC_UPDT_CMD_WB1_ADDR A:0xfcb650c4
y.create.l HWIO_RXFE_WB_IQMC_UPDT_ACTION_SAMPLE_WB1_ADDR A:0xfcb650c8
y.create.l HWIO_RXFE_WB_NOTCH_FILT0_CFG0_WB1_ADDR A:0xfcb650cc
y.create.l HWIO_RXFE_WB_NOTCH_FILT1_CFG0_WB1_ADDR A:0xfcb650d4
y.create.l HWIO_RXFE_WB_NOTCH_FILT0_CFG1_WB1_ADDR A:0xfcb650d0
y.create.l HWIO_RXFE_WB_NOTCH_FILT1_CFG1_WB1_ADDR A:0xfcb650d8
y.create.l HWIO_RXFE_WB_NOTCH_FILT01_CFG_WB1_ADDR A:0xfcb650dc
y.create.l HWIO_RXFE_WB_SPARE_REG_WB1_ADDR A:0xfcb650e0
y.create.l HWIO_RXFE_WB_TOP_CTL_WB2_ADDR A:0xfcb66000
y.create.l HWIO_RXFE_WB_TOP_CMD_WB2_ADDR A:0xfcb66004
y.create.l HWIO_RXFE_WB_TOP_STATUS_WB2_ADDR A:0xfcb66008
y.create.l HWIO_RXFE_WB_STOPGATE_ACTION_SAMPLE_WB2_ADDR A:0xfcb6600c
y.create.l HWIO_RXFE_WB_TIMINGCTL_STATUS_WB2_ADDR A:0xfcb66010
y.create.l HWIO_RXFE_WB_MISC_CFG_WB2_ADDR A:0xfcb66014
y.create.l HWIO_RXFE_WB_WBPWR_CFG_WB2_ADDR A:0xfcb66018
y.create.l HWIO_RXFE_WB_WBPWR_CMD_WB2_ADDR A:0xfcb6601c
y.create.l HWIO_RXFE_WB_WBPWR_START_ACTION_SAMPLE_WB2_ADDR A:0xfcb66020
y.create.l HWIO_RXFE_WB_WBPWR_START_MASK_WB2_ADDR A:0xfcb66024
y.create.l HWIO_RXFE_WB_WBPWR_STOP_ACTION_SAMPLE_WB2_ADDR A:0xfcb66028
y.create.l HWIO_RXFE_WB_WBPWR_FINAL_ACC_WB2_ADDR A:0xfcb6602c
y.create.l HWIO_RXFE_WB_WBPWR_CURR_ACC_WB2_ADDR A:0xfcb66030
y.create.l HWIO_RXFE_WB_WBPWR_MAX_ACC_WB2_ADDR A:0xfcb66034
y.create.l HWIO_RXFE_WB_WBDC_CFG_WB2_ADDR A:0xfcb66038
y.create.l HWIO_RXFE_WB_WBDC_CMD_WB2_ADDR A:0xfcb6603c
y.create.l HWIO_RXFE_WB_WBDC_START_ACTION_SAMPLE_WB2_ADDR A:0xfcb66040
y.create.l HWIO_RXFE_WB_WBDC_STOP_ACTION_SAMPLE_WB2_ADDR A:0xfcb66044
y.create.l HWIO_RXFE_WB_WBDC_UPDATE_ACTION_SAMPLE_WB2_ADDR A:0xfcb66048
y.create.l HWIO_RXFE_WB_WBDC_UPDATE_DELAY_WB2_ADDR A:0xfcb6604c
y.create.l HWIO_RXFE_WB_WBDC_OVRD_I_WB2_ADDR A:0xfcb66050
y.create.l HWIO_RXFE_WB_WBDC_OVRD_Q_WB2_ADDR A:0xfcb66054
y.create.l HWIO_RXFE_WB_WBDC_EST1_CURR_I_WB2_ADDR A:0xfcb66058
y.create.l HWIO_RXFE_WB_WBDC_EST1_CURR_Q_WB2_ADDR A:0xfcb6605c
y.create.l HWIO_RXFE_WB_WBDC_EST1_PREV_I_WB2_ADDR A:0xfcb66060
y.create.l HWIO_RXFE_WB_WBDC_EST1_PREV_Q_WB2_ADDR A:0xfcb66064
y.create.l HWIO_RXFE_WB_WBDC_EST1_LOAD_I_WB2_ADDR A:0xfcb66068
y.create.l HWIO_RXFE_WB_WBDC_EST1_LOAD_Q_WB2_ADDR A:0xfcb6606c
y.create.l HWIO_RXFE_WB_WBDC_EST2_CURR_I_WB2_ADDR A:0xfcb66070
y.create.l HWIO_RXFE_WB_WBDC_EST2_CURR_Q_WB2_ADDR A:0xfcb66074
y.create.l HWIO_RXFE_WB_WBDC_EST2_PREV_I_WB2_ADDR A:0xfcb66078
y.create.l HWIO_RXFE_WB_WBDC_EST2_PREV_Q_WB2_ADDR A:0xfcb6607c
y.create.l HWIO_RXFE_WB_WBDC_EST2_LOAD_I_WB2_ADDR A:0xfcb66080
y.create.l HWIO_RXFE_WB_WBDC_EST2_LOAD_Q_WB2_ADDR A:0xfcb66084
y.create.l HWIO_RXFE_WB_VSRC_CFG_WB2_ADDR A:0xfcb66088
y.create.l HWIO_RXFE_WB_VSRC_T2BYT1M1_WB2_ADDR A:0xfcb6608c
y.create.l HWIO_RXFE_WB_VSRC_CMD_WB2_ADDR A:0xfcb66090
y.create.l HWIO_RXFE_WB_VSRC_STATUS_WB2_ADDR A:0xfcb66094
y.create.l HWIO_RXFE_WB_VSRC_UPDT_ACTION_SAMPLE_WB2_ADDR A:0xfcb66098
y.create.l HWIO_RXFE_WB_VSRC_CURR_T1BYT2_WB2_ADDR A:0xfcb6609c
y.create.l HWIO_RXFE_WB_VSRC_CURR_T2BYT1M1_WB2_ADDR A:0xfcb660a0
y.create.l HWIO_RXFE_WB_VSRC_SCTR_LOAD_VALUE_WB2_ADDR A:0xfcb660a4
y.create.l HWIO_RXFE_WB_VSRC_SCTR_WA_WB2_ADDR A:0xfcb660a8
y.create.l HWIO_RXFE_WB_VSRC_SCTR_SNAPSHOT_WB2_ADDR A:0xfcb660ac
y.create.l HWIO_RXFE_WB_VSRC_ACC_SNAPSHOT_WB2_ADDR A:0xfcb660b0
y.create.l HWIO_RXFE_WB_DEC_FILT_CFG_WB2_ADDR A:0xfcb660b4
y.create.l HWIO_RXFE_WB_IQMC_CFG0_WB2_ADDR A:0xfcb660b8
y.create.l HWIO_RXFE_WB_IQMC_CFG1_WB2_ADDR A:0xfcb660bc
y.create.l HWIO_RXFE_WB_IQMC_CURR_VALS_WB2_ADDR A:0xfcb660c0
y.create.l HWIO_RXFE_WB_IQMC_UPDT_CMD_WB2_ADDR A:0xfcb660c4
y.create.l HWIO_RXFE_WB_IQMC_UPDT_ACTION_SAMPLE_WB2_ADDR A:0xfcb660c8
y.create.l HWIO_RXFE_WB_NOTCH_FILT0_CFG0_WB2_ADDR A:0xfcb660cc
y.create.l HWIO_RXFE_WB_NOTCH_FILT1_CFG0_WB2_ADDR A:0xfcb660d4
y.create.l HWIO_RXFE_WB_NOTCH_FILT0_CFG1_WB2_ADDR A:0xfcb660d0
y.create.l HWIO_RXFE_WB_NOTCH_FILT1_CFG1_WB2_ADDR A:0xfcb660d8
y.create.l HWIO_RXFE_WB_NOTCH_FILT01_CFG_WB2_ADDR A:0xfcb660dc
y.create.l HWIO_RXFE_WB_SPARE_REG_WB2_ADDR A:0xfcb660e0
y.create.l HWIO_RXFE_WB_TOP_CTL_WB3_ADDR A:0xfcb67000
y.create.l HWIO_RXFE_WB_TOP_CMD_WB3_ADDR A:0xfcb67004
y.create.l HWIO_RXFE_WB_TOP_STATUS_WB3_ADDR A:0xfcb67008
y.create.l HWIO_RXFE_WB_STOPGATE_ACTION_SAMPLE_WB3_ADDR A:0xfcb6700c
y.create.l HWIO_RXFE_WB_TIMINGCTL_STATUS_WB3_ADDR A:0xfcb67010
y.create.l HWIO_RXFE_WB_MISC_CFG_WB3_ADDR A:0xfcb67014
y.create.l HWIO_RXFE_WB_WBPWR_CFG_WB3_ADDR A:0xfcb67018
y.create.l HWIO_RXFE_WB_WBPWR_CMD_WB3_ADDR A:0xfcb6701c
y.create.l HWIO_RXFE_WB_WBPWR_START_ACTION_SAMPLE_WB3_ADDR A:0xfcb67020
y.create.l HWIO_RXFE_WB_WBPWR_START_MASK_WB3_ADDR A:0xfcb67024
y.create.l HWIO_RXFE_WB_WBPWR_STOP_ACTION_SAMPLE_WB3_ADDR A:0xfcb67028
y.create.l HWIO_RXFE_WB_WBPWR_FINAL_ACC_WB3_ADDR A:0xfcb6702c
y.create.l HWIO_RXFE_WB_WBPWR_CURR_ACC_WB3_ADDR A:0xfcb67030
y.create.l HWIO_RXFE_WB_WBPWR_MAX_ACC_WB3_ADDR A:0xfcb67034
y.create.l HWIO_RXFE_WB_WBDC_CFG_WB3_ADDR A:0xfcb67038
y.create.l HWIO_RXFE_WB_WBDC_CMD_WB3_ADDR A:0xfcb6703c
y.create.l HWIO_RXFE_WB_WBDC_START_ACTION_SAMPLE_WB3_ADDR A:0xfcb67040
y.create.l HWIO_RXFE_WB_WBDC_STOP_ACTION_SAMPLE_WB3_ADDR A:0xfcb67044
y.create.l HWIO_RXFE_WB_WBDC_UPDATE_ACTION_SAMPLE_WB3_ADDR A:0xfcb67048
y.create.l HWIO_RXFE_WB_WBDC_UPDATE_DELAY_WB3_ADDR A:0xfcb6704c
y.create.l HWIO_RXFE_WB_WBDC_OVRD_I_WB3_ADDR A:0xfcb67050
y.create.l HWIO_RXFE_WB_WBDC_OVRD_Q_WB3_ADDR A:0xfcb67054
y.create.l HWIO_RXFE_WB_WBDC_EST1_CURR_I_WB3_ADDR A:0xfcb67058
y.create.l HWIO_RXFE_WB_WBDC_EST1_CURR_Q_WB3_ADDR A:0xfcb6705c
y.create.l HWIO_RXFE_WB_WBDC_EST1_PREV_I_WB3_ADDR A:0xfcb67060
y.create.l HWIO_RXFE_WB_WBDC_EST1_PREV_Q_WB3_ADDR A:0xfcb67064
y.create.l HWIO_RXFE_WB_WBDC_EST1_LOAD_I_WB3_ADDR A:0xfcb67068
y.create.l HWIO_RXFE_WB_WBDC_EST1_LOAD_Q_WB3_ADDR A:0xfcb6706c
y.create.l HWIO_RXFE_WB_WBDC_EST2_CURR_I_WB3_ADDR A:0xfcb67070
y.create.l HWIO_RXFE_WB_WBDC_EST2_CURR_Q_WB3_ADDR A:0xfcb67074
y.create.l HWIO_RXFE_WB_WBDC_EST2_PREV_I_WB3_ADDR A:0xfcb67078
y.create.l HWIO_RXFE_WB_WBDC_EST2_PREV_Q_WB3_ADDR A:0xfcb6707c
y.create.l HWIO_RXFE_WB_WBDC_EST2_LOAD_I_WB3_ADDR A:0xfcb67080
y.create.l HWIO_RXFE_WB_WBDC_EST2_LOAD_Q_WB3_ADDR A:0xfcb67084
y.create.l HWIO_RXFE_WB_VSRC_CFG_WB3_ADDR A:0xfcb67088
y.create.l HWIO_RXFE_WB_VSRC_T2BYT1M1_WB3_ADDR A:0xfcb6708c
y.create.l HWIO_RXFE_WB_VSRC_CMD_WB3_ADDR A:0xfcb67090
y.create.l HWIO_RXFE_WB_VSRC_STATUS_WB3_ADDR A:0xfcb67094
y.create.l HWIO_RXFE_WB_VSRC_UPDT_ACTION_SAMPLE_WB3_ADDR A:0xfcb67098
y.create.l HWIO_RXFE_WB_VSRC_CURR_T1BYT2_WB3_ADDR A:0xfcb6709c
y.create.l HWIO_RXFE_WB_VSRC_CURR_T2BYT1M1_WB3_ADDR A:0xfcb670a0
y.create.l HWIO_RXFE_WB_VSRC_SCTR_LOAD_VALUE_WB3_ADDR A:0xfcb670a4
y.create.l HWIO_RXFE_WB_VSRC_SCTR_WA_WB3_ADDR A:0xfcb670a8
y.create.l HWIO_RXFE_WB_VSRC_SCTR_SNAPSHOT_WB3_ADDR A:0xfcb670ac
y.create.l HWIO_RXFE_WB_VSRC_ACC_SNAPSHOT_WB3_ADDR A:0xfcb670b0
y.create.l HWIO_RXFE_WB_DEC_FILT_CFG_WB3_ADDR A:0xfcb670b4
y.create.l HWIO_RXFE_WB_IQMC_CFG0_WB3_ADDR A:0xfcb670b8
y.create.l HWIO_RXFE_WB_IQMC_CFG1_WB3_ADDR A:0xfcb670bc
y.create.l HWIO_RXFE_WB_IQMC_CURR_VALS_WB3_ADDR A:0xfcb670c0
y.create.l HWIO_RXFE_WB_IQMC_UPDT_CMD_WB3_ADDR A:0xfcb670c4
y.create.l HWIO_RXFE_WB_IQMC_UPDT_ACTION_SAMPLE_WB3_ADDR A:0xfcb670c8
y.create.l HWIO_RXFE_WB_NOTCH_FILT0_CFG0_WB3_ADDR A:0xfcb670cc
y.create.l HWIO_RXFE_WB_NOTCH_FILT1_CFG0_WB3_ADDR A:0xfcb670d4
y.create.l HWIO_RXFE_WB_NOTCH_FILT0_CFG1_WB3_ADDR A:0xfcb670d0
y.create.l HWIO_RXFE_WB_NOTCH_FILT1_CFG1_WB3_ADDR A:0xfcb670d8
y.create.l HWIO_RXFE_WB_NOTCH_FILT01_CFG_WB3_ADDR A:0xfcb670dc
y.create.l HWIO_RXFE_WB_SPARE_REG_WB3_ADDR A:0xfcb670e0
y.create.l HWIO_RXFE_NB_TOP_CTL_NB0_ADDR A:0xfcb68000
y.create.l HWIO_RXFE_NB_GATE_CMD_NB0_ADDR A:0xfcb68004
y.create.l HWIO_RXFE_NB_GATE_STATUS_NB0_ADDR A:0xfcb68008
y.create.l HWIO_RXFE_NB_GATE_ACTION_SAMPLE_NB0_ADDR A:0xfcb6800c
y.create.l HWIO_RXFE_NB_TIMINGCTL_STATUS_NB0_ADDR A:0xfcb68010
y.create.l HWIO_RXFE_NB_CSR_CFG_NB0_ADDR A:0xfcb68014
y.create.l HWIO_RXFE_NB_CSR_CMD_NB0_ADDR A:0xfcb68018
y.create.l HWIO_RXFE_NB_CSR_PHASEUPDT_ACTION_SAMPLE_NB0_ADDR A:0xfcb6801c
y.create.l HWIO_RXFE_NB_CSR_FREQUPDT_ACTION_SAMPLE_NB0_ADDR A:0xfcb68020
y.create.l HWIO_RXFE_NB_CSR_PHASE_OFFSET_NB0_ADDR A:0xfcb68024
y.create.l HWIO_RXFE_NB_CSR_FREQ_OFFSET_NB0_ADDR A:0xfcb68028
y.create.l HWIO_RXFE_NB_CSR_CURR_PHASE_OFFSET_NB0_ADDR A:0xfcb6802c
y.create.l HWIO_RXFE_NB_CSR_CURR_FREQ_OFFSET_NB0_ADDR A:0xfcb68030
y.create.l HWIO_RXFE_NB_FILTERS_CFG_NB0_ADDR A:0xfcb68034
y.create.l HWIO_RXFE_NB_ICI_COEF0_NB0_ADDR A:0xfcb6803c
y.create.l HWIO_RXFE_NB_ICI_COEF1_NB0_ADDR A:0xfcb68040
y.create.l HWIO_RXFE_NB_ICI_COEF2_NB0_ADDR A:0xfcb68044
y.create.l HWIO_RXFE_NB_ICI_COEF3_NB0_ADDR A:0xfcb68048
y.create.l HWIO_RXFE_NB_ICI_COEF4_NB0_ADDR A:0xfcb6804c
y.create.l HWIO_RXFE_NB_ICI_COEF5_NB0_ADDR A:0xfcb68050
y.create.l HWIO_RXFE_NB_ICI_COEF6_NB0_ADDR A:0xfcb68054
y.create.l HWIO_RXFE_NB_ICI_COEF7_NB0_ADDR A:0xfcb68058
y.create.l HWIO_RXFE_NB_ICI_COEF8_NB0_ADDR A:0xfcb6805c
y.create.l HWIO_RXFE_NB_ICI_COEF9_NB0_ADDR A:0xfcb68060
y.create.l HWIO_RXFE_NB_GDA_NB0_ADDR A:0xfcb68068
y.create.l HWIO_RXFE_NB_NBDC_COMPVAL_I_NB0_ADDR A:0xfcb6806c
y.create.l HWIO_RXFE_NB_NBDC_COMPVAL_Q_NB0_ADDR A:0xfcb68070
y.create.l HWIO_RXFE_NB_NBPWR_CFG_NB0_ADDR A:0xfcb68074
y.create.l HWIO_RXFE_NB_NBPWR_CMD_NB0_ADDR A:0xfcb68078
y.create.l HWIO_RXFE_NB_NBPWR_START_ACTION_SAMPLE_NB0_ADDR A:0xfcb6807c
y.create.l HWIO_RXFE_NB_NBPWR_START_MASK_NB0_ADDR A:0xfcb68080
y.create.l HWIO_RXFE_NB_NBPWR_STOP_ACTION_SAMPLE_NB0_ADDR A:0xfcb68084
y.create.l HWIO_RXFE_NB_NBPWR_FINAL_ACC_NB0_ADDR A:0xfcb68088
y.create.l HWIO_RXFE_NB_NBPWR_CURR_ACC_NB0_ADDR A:0xfcb6808c
y.create.l HWIO_RXFE_NB_NBPWR_MAX_ACC_NB0_ADDR A:0xfcb68090
y.create.l HWIO_RXFE_NB_DVGA_CFG_NB0_ADDR A:0xfcb68094
y.create.l HWIO_RXFE_NB_DVGA_RXFE_GAIN_NB0_ADDR A:0xfcb68098
y.create.l HWIO_RXFE_NB_DVGA_OVERRIDE_DVGA_GAIN_NB0_ADDR A:0xfcb6809c
y.create.l HWIO_RXFE_NB_DVGA_CMD_NB0_ADDR A:0xfcb680a0
y.create.l HWIO_RXFE_NB_DVGA_UPDT_ACTION_SAMPLE_NB0_ADDR A:0xfcb680a4
y.create.l HWIO_RXFE_NB_DVGA_UPDT_MASK_NB0_ADDR A:0xfcb680a8
y.create.l HWIO_RXFE_NB_FINAL_BITWIDTHS_CFG_NB0_ADDR A:0xfcb680ac
y.create.l HWIO_RXFE_NB_WTR_CFG_NB0_ADDR A:0xfcb680b0
y.create.l HWIO_RXFE_NB_WTR_FUNC_CFG_NB0_ADDR A:0xfcb680b4
y.create.l HWIO_RXFE_NB_WTR_DBG_CFG0_NB0_ADDR A:0xfcb680b8
y.create.l HWIO_RXFE_NB_WTR_DBG_CFG1_NB0_ADDR A:0xfcb680bc
y.create.l HWIO_RXFE_NB_WTR_CMD_NB0_ADDR A:0xfcb680c0
y.create.l HWIO_RXFE_NB_WTR_START_ACTION_SAMPLE_NB0_ADDR A:0xfcb680c4
y.create.l HWIO_RXFE_NB_WTR_STOP_ACTION_SAMPLE_NB0_ADDR A:0xfcb680c8
y.create.l HWIO_RXFE_NB_WTR_STATUS_NB0_ADDR A:0xfcb680d0
y.create.l HWIO_RXFE_NB_WTR_ADDR_SNAPSHOT_NB0_ADDR A:0xfcb680d4
y.create.l HWIO_RXFE_NB_SPARE_REG_NB0_ADDR A:0xfcb680d8
y.create.l HWIO_RXFE_NB_TOP_CTL_NB1_ADDR A:0xfcb69000
y.create.l HWIO_RXFE_NB_GATE_CMD_NB1_ADDR A:0xfcb69004
y.create.l HWIO_RXFE_NB_GATE_STATUS_NB1_ADDR A:0xfcb69008
y.create.l HWIO_RXFE_NB_GATE_ACTION_SAMPLE_NB1_ADDR A:0xfcb6900c
y.create.l HWIO_RXFE_NB_TIMINGCTL_STATUS_NB1_ADDR A:0xfcb69010
y.create.l HWIO_RXFE_NB_CSR_CFG_NB1_ADDR A:0xfcb69014
y.create.l HWIO_RXFE_NB_CSR_CMD_NB1_ADDR A:0xfcb69018
y.create.l HWIO_RXFE_NB_CSR_PHASEUPDT_ACTION_SAMPLE_NB1_ADDR A:0xfcb6901c
y.create.l HWIO_RXFE_NB_CSR_FREQUPDT_ACTION_SAMPLE_NB1_ADDR A:0xfcb69020
y.create.l HWIO_RXFE_NB_CSR_PHASE_OFFSET_NB1_ADDR A:0xfcb69024
y.create.l HWIO_RXFE_NB_CSR_FREQ_OFFSET_NB1_ADDR A:0xfcb69028
y.create.l HWIO_RXFE_NB_CSR_CURR_PHASE_OFFSET_NB1_ADDR A:0xfcb6902c
y.create.l HWIO_RXFE_NB_CSR_CURR_FREQ_OFFSET_NB1_ADDR A:0xfcb69030
y.create.l HWIO_RXFE_NB_FILTERS_CFG_NB1_ADDR A:0xfcb69034
y.create.l HWIO_RXFE_NB_ICI_COEF0_NB1_ADDR A:0xfcb6903c
y.create.l HWIO_RXFE_NB_ICI_COEF1_NB1_ADDR A:0xfcb69040
y.create.l HWIO_RXFE_NB_ICI_COEF2_NB1_ADDR A:0xfcb69044
y.create.l HWIO_RXFE_NB_ICI_COEF3_NB1_ADDR A:0xfcb69048
y.create.l HWIO_RXFE_NB_ICI_COEF4_NB1_ADDR A:0xfcb6904c
y.create.l HWIO_RXFE_NB_ICI_COEF5_NB1_ADDR A:0xfcb69050
y.create.l HWIO_RXFE_NB_ICI_COEF6_NB1_ADDR A:0xfcb69054
y.create.l HWIO_RXFE_NB_ICI_COEF7_NB1_ADDR A:0xfcb69058
y.create.l HWIO_RXFE_NB_ICI_COEF8_NB1_ADDR A:0xfcb6905c
y.create.l HWIO_RXFE_NB_ICI_COEF9_NB1_ADDR A:0xfcb69060
y.create.l HWIO_RXFE_NB_GDA_NB1_ADDR A:0xfcb69068
y.create.l HWIO_RXFE_NB_NBDC_COMPVAL_I_NB1_ADDR A:0xfcb6906c
y.create.l HWIO_RXFE_NB_NBDC_COMPVAL_Q_NB1_ADDR A:0xfcb69070
y.create.l HWIO_RXFE_NB_NBPWR_CFG_NB1_ADDR A:0xfcb69074
y.create.l HWIO_RXFE_NB_NBPWR_CMD_NB1_ADDR A:0xfcb69078
y.create.l HWIO_RXFE_NB_NBPWR_START_ACTION_SAMPLE_NB1_ADDR A:0xfcb6907c
y.create.l HWIO_RXFE_NB_NBPWR_START_MASK_NB1_ADDR A:0xfcb69080
y.create.l HWIO_RXFE_NB_NBPWR_STOP_ACTION_SAMPLE_NB1_ADDR A:0xfcb69084
y.create.l HWIO_RXFE_NB_NBPWR_FINAL_ACC_NB1_ADDR A:0xfcb69088
y.create.l HWIO_RXFE_NB_NBPWR_CURR_ACC_NB1_ADDR A:0xfcb6908c
y.create.l HWIO_RXFE_NB_NBPWR_MAX_ACC_NB1_ADDR A:0xfcb69090
y.create.l HWIO_RXFE_NB_DVGA_CFG_NB1_ADDR A:0xfcb69094
y.create.l HWIO_RXFE_NB_DVGA_RXFE_GAIN_NB1_ADDR A:0xfcb69098
y.create.l HWIO_RXFE_NB_DVGA_OVERRIDE_DVGA_GAIN_NB1_ADDR A:0xfcb6909c
y.create.l HWIO_RXFE_NB_DVGA_CMD_NB1_ADDR A:0xfcb690a0
y.create.l HWIO_RXFE_NB_DVGA_UPDT_ACTION_SAMPLE_NB1_ADDR A:0xfcb690a4
y.create.l HWIO_RXFE_NB_DVGA_UPDT_MASK_NB1_ADDR A:0xfcb690a8
y.create.l HWIO_RXFE_NB_FINAL_BITWIDTHS_CFG_NB1_ADDR A:0xfcb690ac
y.create.l HWIO_RXFE_NB_WTR_CFG_NB1_ADDR A:0xfcb690b0
y.create.l HWIO_RXFE_NB_WTR_FUNC_CFG_NB1_ADDR A:0xfcb690b4
y.create.l HWIO_RXFE_NB_WTR_DBG_CFG0_NB1_ADDR A:0xfcb690b8
y.create.l HWIO_RXFE_NB_WTR_DBG_CFG1_NB1_ADDR A:0xfcb690bc
y.create.l HWIO_RXFE_NB_WTR_CMD_NB1_ADDR A:0xfcb690c0
y.create.l HWIO_RXFE_NB_WTR_START_ACTION_SAMPLE_NB1_ADDR A:0xfcb690c4
y.create.l HWIO_RXFE_NB_WTR_STOP_ACTION_SAMPLE_NB1_ADDR A:0xfcb690c8
y.create.l HWIO_RXFE_NB_WTR_STATUS_NB1_ADDR A:0xfcb690d0
y.create.l HWIO_RXFE_NB_WTR_ADDR_SNAPSHOT_NB1_ADDR A:0xfcb690d4
y.create.l HWIO_RXFE_NB_SPARE_REG_NB1_ADDR A:0xfcb690d8
y.create.l HWIO_RXFE_NB_TOP_CTL_NB2_ADDR A:0xfcb6a000
y.create.l HWIO_RXFE_NB_GATE_CMD_NB2_ADDR A:0xfcb6a004
y.create.l HWIO_RXFE_NB_GATE_STATUS_NB2_ADDR A:0xfcb6a008
y.create.l HWIO_RXFE_NB_GATE_ACTION_SAMPLE_NB2_ADDR A:0xfcb6a00c
y.create.l HWIO_RXFE_NB_TIMINGCTL_STATUS_NB2_ADDR A:0xfcb6a010
y.create.l HWIO_RXFE_NB_CSR_CFG_NB2_ADDR A:0xfcb6a014
y.create.l HWIO_RXFE_NB_CSR_CMD_NB2_ADDR A:0xfcb6a018
y.create.l HWIO_RXFE_NB_CSR_PHASEUPDT_ACTION_SAMPLE_NB2_ADDR A:0xfcb6a01c
y.create.l HWIO_RXFE_NB_CSR_FREQUPDT_ACTION_SAMPLE_NB2_ADDR A:0xfcb6a020
y.create.l HWIO_RXFE_NB_CSR_PHASE_OFFSET_NB2_ADDR A:0xfcb6a024
y.create.l HWIO_RXFE_NB_CSR_FREQ_OFFSET_NB2_ADDR A:0xfcb6a028
y.create.l HWIO_RXFE_NB_CSR_CURR_PHASE_OFFSET_NB2_ADDR A:0xfcb6a02c
y.create.l HWIO_RXFE_NB_CSR_CURR_FREQ_OFFSET_NB2_ADDR A:0xfcb6a030
y.create.l HWIO_RXFE_NB_FILTERS_CFG_NB2_ADDR A:0xfcb6a034
y.create.l HWIO_RXFE_NB_ICI_COEF0_NB2_ADDR A:0xfcb6a03c
y.create.l HWIO_RXFE_NB_ICI_COEF1_NB2_ADDR A:0xfcb6a040
y.create.l HWIO_RXFE_NB_ICI_COEF2_NB2_ADDR A:0xfcb6a044
y.create.l HWIO_RXFE_NB_ICI_COEF3_NB2_ADDR A:0xfcb6a048
y.create.l HWIO_RXFE_NB_ICI_COEF4_NB2_ADDR A:0xfcb6a04c
y.create.l HWIO_RXFE_NB_ICI_COEF5_NB2_ADDR A:0xfcb6a050
y.create.l HWIO_RXFE_NB_ICI_COEF6_NB2_ADDR A:0xfcb6a054
y.create.l HWIO_RXFE_NB_ICI_COEF7_NB2_ADDR A:0xfcb6a058
y.create.l HWIO_RXFE_NB_ICI_COEF8_NB2_ADDR A:0xfcb6a05c
y.create.l HWIO_RXFE_NB_ICI_COEF9_NB2_ADDR A:0xfcb6a060
y.create.l HWIO_RXFE_NB_GDA_NB2_ADDR A:0xfcb6a068
y.create.l HWIO_RXFE_NB_NBDC_COMPVAL_I_NB2_ADDR A:0xfcb6a06c
y.create.l HWIO_RXFE_NB_NBDC_COMPVAL_Q_NB2_ADDR A:0xfcb6a070
y.create.l HWIO_RXFE_NB_NBPWR_CFG_NB2_ADDR A:0xfcb6a074
y.create.l HWIO_RXFE_NB_NBPWR_CMD_NB2_ADDR A:0xfcb6a078
y.create.l HWIO_RXFE_NB_NBPWR_START_ACTION_SAMPLE_NB2_ADDR A:0xfcb6a07c
y.create.l HWIO_RXFE_NB_NBPWR_START_MASK_NB2_ADDR A:0xfcb6a080
y.create.l HWIO_RXFE_NB_NBPWR_STOP_ACTION_SAMPLE_NB2_ADDR A:0xfcb6a084
y.create.l HWIO_RXFE_NB_NBPWR_FINAL_ACC_NB2_ADDR A:0xfcb6a088
y.create.l HWIO_RXFE_NB_NBPWR_CURR_ACC_NB2_ADDR A:0xfcb6a08c
y.create.l HWIO_RXFE_NB_NBPWR_MAX_ACC_NB2_ADDR A:0xfcb6a090
y.create.l HWIO_RXFE_NB_DVGA_CFG_NB2_ADDR A:0xfcb6a094
y.create.l HWIO_RXFE_NB_DVGA_RXFE_GAIN_NB2_ADDR A:0xfcb6a098
y.create.l HWIO_RXFE_NB_DVGA_OVERRIDE_DVGA_GAIN_NB2_ADDR A:0xfcb6a09c
y.create.l HWIO_RXFE_NB_DVGA_CMD_NB2_ADDR A:0xfcb6a0a0
y.create.l HWIO_RXFE_NB_DVGA_UPDT_ACTION_SAMPLE_NB2_ADDR A:0xfcb6a0a4
y.create.l HWIO_RXFE_NB_DVGA_UPDT_MASK_NB2_ADDR A:0xfcb6a0a8
y.create.l HWIO_RXFE_NB_FINAL_BITWIDTHS_CFG_NB2_ADDR A:0xfcb6a0ac
y.create.l HWIO_RXFE_NB_WTR_CFG_NB2_ADDR A:0xfcb6a0b0
y.create.l HWIO_RXFE_NB_WTR_FUNC_CFG_NB2_ADDR A:0xfcb6a0b4
y.create.l HWIO_RXFE_NB_WTR_DBG_CFG0_NB2_ADDR A:0xfcb6a0b8
y.create.l HWIO_RXFE_NB_WTR_DBG_CFG1_NB2_ADDR A:0xfcb6a0bc
y.create.l HWIO_RXFE_NB_WTR_CMD_NB2_ADDR A:0xfcb6a0c0
y.create.l HWIO_RXFE_NB_WTR_START_ACTION_SAMPLE_NB2_ADDR A:0xfcb6a0c4
y.create.l HWIO_RXFE_NB_WTR_STOP_ACTION_SAMPLE_NB2_ADDR A:0xfcb6a0c8
y.create.l HWIO_RXFE_NB_WTR_STATUS_NB2_ADDR A:0xfcb6a0d0
y.create.l HWIO_RXFE_NB_WTR_ADDR_SNAPSHOT_NB2_ADDR A:0xfcb6a0d4
y.create.l HWIO_RXFE_NB_SPARE_REG_NB2_ADDR A:0xfcb6a0d8
y.create.l HWIO_RXFE_NB_TOP_CTL_NB3_ADDR A:0xfcb6b000
y.create.l HWIO_RXFE_NB_GATE_CMD_NB3_ADDR A:0xfcb6b004
y.create.l HWIO_RXFE_NB_GATE_STATUS_NB3_ADDR A:0xfcb6b008
y.create.l HWIO_RXFE_NB_GATE_ACTION_SAMPLE_NB3_ADDR A:0xfcb6b00c
y.create.l HWIO_RXFE_NB_TIMINGCTL_STATUS_NB3_ADDR A:0xfcb6b010
y.create.l HWIO_RXFE_NB_CSR_CFG_NB3_ADDR A:0xfcb6b014
y.create.l HWIO_RXFE_NB_CSR_CMD_NB3_ADDR A:0xfcb6b018
y.create.l HWIO_RXFE_NB_CSR_PHASEUPDT_ACTION_SAMPLE_NB3_ADDR A:0xfcb6b01c
y.create.l HWIO_RXFE_NB_CSR_FREQUPDT_ACTION_SAMPLE_NB3_ADDR A:0xfcb6b020
y.create.l HWIO_RXFE_NB_CSR_PHASE_OFFSET_NB3_ADDR A:0xfcb6b024
y.create.l HWIO_RXFE_NB_CSR_FREQ_OFFSET_NB3_ADDR A:0xfcb6b028
y.create.l HWIO_RXFE_NB_CSR_CURR_PHASE_OFFSET_NB3_ADDR A:0xfcb6b02c
y.create.l HWIO_RXFE_NB_CSR_CURR_FREQ_OFFSET_NB3_ADDR A:0xfcb6b030
y.create.l HWIO_RXFE_NB_FILTERS_CFG_NB3_ADDR A:0xfcb6b034
y.create.l HWIO_RXFE_NB_ICI_COEF0_NB3_ADDR A:0xfcb6b03c
y.create.l HWIO_RXFE_NB_ICI_COEF1_NB3_ADDR A:0xfcb6b040
y.create.l HWIO_RXFE_NB_ICI_COEF2_NB3_ADDR A:0xfcb6b044
y.create.l HWIO_RXFE_NB_ICI_COEF3_NB3_ADDR A:0xfcb6b048
y.create.l HWIO_RXFE_NB_ICI_COEF4_NB3_ADDR A:0xfcb6b04c
y.create.l HWIO_RXFE_NB_ICI_COEF5_NB3_ADDR A:0xfcb6b050
y.create.l HWIO_RXFE_NB_ICI_COEF6_NB3_ADDR A:0xfcb6b054
y.create.l HWIO_RXFE_NB_ICI_COEF7_NB3_ADDR A:0xfcb6b058
y.create.l HWIO_RXFE_NB_ICI_COEF8_NB3_ADDR A:0xfcb6b05c
y.create.l HWIO_RXFE_NB_ICI_COEF9_NB3_ADDR A:0xfcb6b060
y.create.l HWIO_RXFE_NB_GDA_NB3_ADDR A:0xfcb6b068
y.create.l HWIO_RXFE_NB_NBDC_COMPVAL_I_NB3_ADDR A:0xfcb6b06c
y.create.l HWIO_RXFE_NB_NBDC_COMPVAL_Q_NB3_ADDR A:0xfcb6b070
y.create.l HWIO_RXFE_NB_NBPWR_CFG_NB3_ADDR A:0xfcb6b074
y.create.l HWIO_RXFE_NB_NBPWR_CMD_NB3_ADDR A:0xfcb6b078
y.create.l HWIO_RXFE_NB_NBPWR_START_ACTION_SAMPLE_NB3_ADDR A:0xfcb6b07c
y.create.l HWIO_RXFE_NB_NBPWR_START_MASK_NB3_ADDR A:0xfcb6b080
y.create.l HWIO_RXFE_NB_NBPWR_STOP_ACTION_SAMPLE_NB3_ADDR A:0xfcb6b084
y.create.l HWIO_RXFE_NB_NBPWR_FINAL_ACC_NB3_ADDR A:0xfcb6b088
y.create.l HWIO_RXFE_NB_NBPWR_CURR_ACC_NB3_ADDR A:0xfcb6b08c
y.create.l HWIO_RXFE_NB_NBPWR_MAX_ACC_NB3_ADDR A:0xfcb6b090
y.create.l HWIO_RXFE_NB_DVGA_CFG_NB3_ADDR A:0xfcb6b094
y.create.l HWIO_RXFE_NB_DVGA_RXFE_GAIN_NB3_ADDR A:0xfcb6b098
y.create.l HWIO_RXFE_NB_DVGA_OVERRIDE_DVGA_GAIN_NB3_ADDR A:0xfcb6b09c
y.create.l HWIO_RXFE_NB_DVGA_CMD_NB3_ADDR A:0xfcb6b0a0
y.create.l HWIO_RXFE_NB_DVGA_UPDT_ACTION_SAMPLE_NB3_ADDR A:0xfcb6b0a4
y.create.l HWIO_RXFE_NB_DVGA_UPDT_MASK_NB3_ADDR A:0xfcb6b0a8
y.create.l HWIO_RXFE_NB_FINAL_BITWIDTHS_CFG_NB3_ADDR A:0xfcb6b0ac
y.create.l HWIO_RXFE_NB_WTR_CFG_NB3_ADDR A:0xfcb6b0b0
y.create.l HWIO_RXFE_NB_WTR_FUNC_CFG_NB3_ADDR A:0xfcb6b0b4
y.create.l HWIO_RXFE_NB_WTR_DBG_CFG0_NB3_ADDR A:0xfcb6b0b8
y.create.l HWIO_RXFE_NB_WTR_DBG_CFG1_NB3_ADDR A:0xfcb6b0bc
y.create.l HWIO_RXFE_NB_WTR_CMD_NB3_ADDR A:0xfcb6b0c0
y.create.l HWIO_RXFE_NB_WTR_START_ACTION_SAMPLE_NB3_ADDR A:0xfcb6b0c4
y.create.l HWIO_RXFE_NB_WTR_STOP_ACTION_SAMPLE_NB3_ADDR A:0xfcb6b0c8
y.create.l HWIO_RXFE_NB_WTR_STATUS_NB3_ADDR A:0xfcb6b0d0
y.create.l HWIO_RXFE_NB_WTR_ADDR_SNAPSHOT_NB3_ADDR A:0xfcb6b0d4
y.create.l HWIO_RXFE_NB_SPARE_REG_NB3_ADDR A:0xfcb6b0d8
y.create.l HWIO_RXFE_NB_TOP_CTL_NB4_ADDR A:0xfcb6c000
y.create.l HWIO_RXFE_NB_GATE_CMD_NB4_ADDR A:0xfcb6c004
y.create.l HWIO_RXFE_NB_GATE_STATUS_NB4_ADDR A:0xfcb6c008
y.create.l HWIO_RXFE_NB_GATE_ACTION_SAMPLE_NB4_ADDR A:0xfcb6c00c
y.create.l HWIO_RXFE_NB_TIMINGCTL_STATUS_NB4_ADDR A:0xfcb6c010
y.create.l HWIO_RXFE_NB_CSR_CFG_NB4_ADDR A:0xfcb6c014
y.create.l HWIO_RXFE_NB_CSR_CMD_NB4_ADDR A:0xfcb6c018
y.create.l HWIO_RXFE_NB_CSR_PHASEUPDT_ACTION_SAMPLE_NB4_ADDR A:0xfcb6c01c
y.create.l HWIO_RXFE_NB_CSR_FREQUPDT_ACTION_SAMPLE_NB4_ADDR A:0xfcb6c020
y.create.l HWIO_RXFE_NB_CSR_PHASE_OFFSET_NB4_ADDR A:0xfcb6c024
y.create.l HWIO_RXFE_NB_CSR_FREQ_OFFSET_NB4_ADDR A:0xfcb6c028
y.create.l HWIO_RXFE_NB_CSR_CURR_PHASE_OFFSET_NB4_ADDR A:0xfcb6c02c
y.create.l HWIO_RXFE_NB_CSR_CURR_FREQ_OFFSET_NB4_ADDR A:0xfcb6c030
y.create.l HWIO_RXFE_NB_FILTERS_CFG_NB4_ADDR A:0xfcb6c034
y.create.l HWIO_RXFE_NB_ICI_COEF0_NB4_ADDR A:0xfcb6c03c
y.create.l HWIO_RXFE_NB_ICI_COEF1_NB4_ADDR A:0xfcb6c040
y.create.l HWIO_RXFE_NB_ICI_COEF2_NB4_ADDR A:0xfcb6c044
y.create.l HWIO_RXFE_NB_ICI_COEF3_NB4_ADDR A:0xfcb6c048
y.create.l HWIO_RXFE_NB_ICI_COEF4_NB4_ADDR A:0xfcb6c04c
y.create.l HWIO_RXFE_NB_ICI_COEF5_NB4_ADDR A:0xfcb6c050
y.create.l HWIO_RXFE_NB_ICI_COEF6_NB4_ADDR A:0xfcb6c054
y.create.l HWIO_RXFE_NB_ICI_COEF7_NB4_ADDR A:0xfcb6c058
y.create.l HWIO_RXFE_NB_ICI_COEF8_NB4_ADDR A:0xfcb6c05c
y.create.l HWIO_RXFE_NB_ICI_COEF9_NB4_ADDR A:0xfcb6c060
y.create.l HWIO_RXFE_NB_GDA_NB4_ADDR A:0xfcb6c068
y.create.l HWIO_RXFE_NB_NBDC_COMPVAL_I_NB4_ADDR A:0xfcb6c06c
y.create.l HWIO_RXFE_NB_NBDC_COMPVAL_Q_NB4_ADDR A:0xfcb6c070
y.create.l HWIO_RXFE_NB_NBPWR_CFG_NB4_ADDR A:0xfcb6c074
y.create.l HWIO_RXFE_NB_NBPWR_CMD_NB4_ADDR A:0xfcb6c078
y.create.l HWIO_RXFE_NB_NBPWR_START_ACTION_SAMPLE_NB4_ADDR A:0xfcb6c07c
y.create.l HWIO_RXFE_NB_NBPWR_START_MASK_NB4_ADDR A:0xfcb6c080
y.create.l HWIO_RXFE_NB_NBPWR_STOP_ACTION_SAMPLE_NB4_ADDR A:0xfcb6c084
y.create.l HWIO_RXFE_NB_NBPWR_FINAL_ACC_NB4_ADDR A:0xfcb6c088
y.create.l HWIO_RXFE_NB_NBPWR_CURR_ACC_NB4_ADDR A:0xfcb6c08c
y.create.l HWIO_RXFE_NB_NBPWR_MAX_ACC_NB4_ADDR A:0xfcb6c090
y.create.l HWIO_RXFE_NB_DVGA_CFG_NB4_ADDR A:0xfcb6c094
y.create.l HWIO_RXFE_NB_DVGA_RXFE_GAIN_NB4_ADDR A:0xfcb6c098
y.create.l HWIO_RXFE_NB_DVGA_OVERRIDE_DVGA_GAIN_NB4_ADDR A:0xfcb6c09c
y.create.l HWIO_RXFE_NB_DVGA_CMD_NB4_ADDR A:0xfcb6c0a0
y.create.l HWIO_RXFE_NB_DVGA_UPDT_ACTION_SAMPLE_NB4_ADDR A:0xfcb6c0a4
y.create.l HWIO_RXFE_NB_DVGA_UPDT_MASK_NB4_ADDR A:0xfcb6c0a8
y.create.l HWIO_RXFE_NB_FINAL_BITWIDTHS_CFG_NB4_ADDR A:0xfcb6c0ac
y.create.l HWIO_RXFE_NB_WTR_CFG_NB4_ADDR A:0xfcb6c0b0
y.create.l HWIO_RXFE_NB_WTR_FUNC_CFG_NB4_ADDR A:0xfcb6c0b4
y.create.l HWIO_RXFE_NB_WTR_DBG_CFG0_NB4_ADDR A:0xfcb6c0b8
y.create.l HWIO_RXFE_NB_WTR_DBG_CFG1_NB4_ADDR A:0xfcb6c0bc
y.create.l HWIO_RXFE_NB_WTR_CMD_NB4_ADDR A:0xfcb6c0c0
y.create.l HWIO_RXFE_NB_WTR_START_ACTION_SAMPLE_NB4_ADDR A:0xfcb6c0c4
y.create.l HWIO_RXFE_NB_WTR_STOP_ACTION_SAMPLE_NB4_ADDR A:0xfcb6c0c8
y.create.l HWIO_RXFE_NB_WTR_STATUS_NB4_ADDR A:0xfcb6c0d0
y.create.l HWIO_RXFE_NB_WTR_ADDR_SNAPSHOT_NB4_ADDR A:0xfcb6c0d4
y.create.l HWIO_RXFE_NB_SPARE_REG_NB4_ADDR A:0xfcb6c0d8
y.create.l HWIO_RXFE_NB_TOP_CTL_NB5_ADDR A:0xfcb6d000
y.create.l HWIO_RXFE_NB_GATE_CMD_NB5_ADDR A:0xfcb6d004
y.create.l HWIO_RXFE_NB_GATE_STATUS_NB5_ADDR A:0xfcb6d008
y.create.l HWIO_RXFE_NB_GATE_ACTION_SAMPLE_NB5_ADDR A:0xfcb6d00c
y.create.l HWIO_RXFE_NB_TIMINGCTL_STATUS_NB5_ADDR A:0xfcb6d010
y.create.l HWIO_RXFE_NB_CSR_CFG_NB5_ADDR A:0xfcb6d014
y.create.l HWIO_RXFE_NB_CSR_CMD_NB5_ADDR A:0xfcb6d018
y.create.l HWIO_RXFE_NB_CSR_PHASEUPDT_ACTION_SAMPLE_NB5_ADDR A:0xfcb6d01c
y.create.l HWIO_RXFE_NB_CSR_FREQUPDT_ACTION_SAMPLE_NB5_ADDR A:0xfcb6d020
y.create.l HWIO_RXFE_NB_CSR_PHASE_OFFSET_NB5_ADDR A:0xfcb6d024
y.create.l HWIO_RXFE_NB_CSR_FREQ_OFFSET_NB5_ADDR A:0xfcb6d028
y.create.l HWIO_RXFE_NB_CSR_CURR_PHASE_OFFSET_NB5_ADDR A:0xfcb6d02c
y.create.l HWIO_RXFE_NB_CSR_CURR_FREQ_OFFSET_NB5_ADDR A:0xfcb6d030
y.create.l HWIO_RXFE_NB_FILTERS_CFG_NB5_ADDR A:0xfcb6d034
y.create.l HWIO_RXFE_NB_ICI_COEF0_NB5_ADDR A:0xfcb6d03c
y.create.l HWIO_RXFE_NB_ICI_COEF1_NB5_ADDR A:0xfcb6d040
y.create.l HWIO_RXFE_NB_ICI_COEF2_NB5_ADDR A:0xfcb6d044
y.create.l HWIO_RXFE_NB_ICI_COEF3_NB5_ADDR A:0xfcb6d048
y.create.l HWIO_RXFE_NB_ICI_COEF4_NB5_ADDR A:0xfcb6d04c
y.create.l HWIO_RXFE_NB_ICI_COEF5_NB5_ADDR A:0xfcb6d050
y.create.l HWIO_RXFE_NB_ICI_COEF6_NB5_ADDR A:0xfcb6d054
y.create.l HWIO_RXFE_NB_ICI_COEF7_NB5_ADDR A:0xfcb6d058
y.create.l HWIO_RXFE_NB_ICI_COEF8_NB5_ADDR A:0xfcb6d05c
y.create.l HWIO_RXFE_NB_ICI_COEF9_NB5_ADDR A:0xfcb6d060
y.create.l HWIO_RXFE_NB_GDA_NB5_ADDR A:0xfcb6d068
y.create.l HWIO_RXFE_NB_NBDC_COMPVAL_I_NB5_ADDR A:0xfcb6d06c
y.create.l HWIO_RXFE_NB_NBDC_COMPVAL_Q_NB5_ADDR A:0xfcb6d070
y.create.l HWIO_RXFE_NB_NBPWR_CFG_NB5_ADDR A:0xfcb6d074
y.create.l HWIO_RXFE_NB_NBPWR_CMD_NB5_ADDR A:0xfcb6d078
y.create.l HWIO_RXFE_NB_NBPWR_START_ACTION_SAMPLE_NB5_ADDR A:0xfcb6d07c
y.create.l HWIO_RXFE_NB_NBPWR_START_MASK_NB5_ADDR A:0xfcb6d080
y.create.l HWIO_RXFE_NB_NBPWR_STOP_ACTION_SAMPLE_NB5_ADDR A:0xfcb6d084
y.create.l HWIO_RXFE_NB_NBPWR_FINAL_ACC_NB5_ADDR A:0xfcb6d088
y.create.l HWIO_RXFE_NB_NBPWR_CURR_ACC_NB5_ADDR A:0xfcb6d08c
y.create.l HWIO_RXFE_NB_NBPWR_MAX_ACC_NB5_ADDR A:0xfcb6d090
y.create.l HWIO_RXFE_NB_DVGA_CFG_NB5_ADDR A:0xfcb6d094
y.create.l HWIO_RXFE_NB_DVGA_RXFE_GAIN_NB5_ADDR A:0xfcb6d098
y.create.l HWIO_RXFE_NB_DVGA_OVERRIDE_DVGA_GAIN_NB5_ADDR A:0xfcb6d09c
y.create.l HWIO_RXFE_NB_DVGA_CMD_NB5_ADDR A:0xfcb6d0a0
y.create.l HWIO_RXFE_NB_DVGA_UPDT_ACTION_SAMPLE_NB5_ADDR A:0xfcb6d0a4
y.create.l HWIO_RXFE_NB_DVGA_UPDT_MASK_NB5_ADDR A:0xfcb6d0a8
y.create.l HWIO_RXFE_NB_FINAL_BITWIDTHS_CFG_NB5_ADDR A:0xfcb6d0ac
y.create.l HWIO_RXFE_NB_WTR_CFG_NB5_ADDR A:0xfcb6d0b0
y.create.l HWIO_RXFE_NB_WTR_FUNC_CFG_NB5_ADDR A:0xfcb6d0b4
y.create.l HWIO_RXFE_NB_WTR_DBG_CFG0_NB5_ADDR A:0xfcb6d0b8
y.create.l HWIO_RXFE_NB_WTR_DBG_CFG1_NB5_ADDR A:0xfcb6d0bc
y.create.l HWIO_RXFE_NB_WTR_CMD_NB5_ADDR A:0xfcb6d0c0
y.create.l HWIO_RXFE_NB_WTR_START_ACTION_SAMPLE_NB5_ADDR A:0xfcb6d0c4
y.create.l HWIO_RXFE_NB_WTR_STOP_ACTION_SAMPLE_NB5_ADDR A:0xfcb6d0c8
y.create.l HWIO_RXFE_NB_WTR_STATUS_NB5_ADDR A:0xfcb6d0d0
y.create.l HWIO_RXFE_NB_WTR_ADDR_SNAPSHOT_NB5_ADDR A:0xfcb6d0d4
y.create.l HWIO_RXFE_NB_SPARE_REG_NB5_ADDR A:0xfcb6d0d8
y.create.l HWIO_RXFE_NB_TOP_CTL_NB6_ADDR A:0xfcb6e000
y.create.l HWIO_RXFE_NB_GATE_CMD_NB6_ADDR A:0xfcb6e004
y.create.l HWIO_RXFE_NB_GATE_STATUS_NB6_ADDR A:0xfcb6e008
y.create.l HWIO_RXFE_NB_GATE_ACTION_SAMPLE_NB6_ADDR A:0xfcb6e00c
y.create.l HWIO_RXFE_NB_TIMINGCTL_STATUS_NB6_ADDR A:0xfcb6e010
y.create.l HWIO_RXFE_NB_CSR_CFG_NB6_ADDR A:0xfcb6e014
y.create.l HWIO_RXFE_NB_CSR_CMD_NB6_ADDR A:0xfcb6e018
y.create.l HWIO_RXFE_NB_CSR_PHASEUPDT_ACTION_SAMPLE_NB6_ADDR A:0xfcb6e01c
y.create.l HWIO_RXFE_NB_CSR_FREQUPDT_ACTION_SAMPLE_NB6_ADDR A:0xfcb6e020
y.create.l HWIO_RXFE_NB_CSR_PHASE_OFFSET_NB6_ADDR A:0xfcb6e024
y.create.l HWIO_RXFE_NB_CSR_FREQ_OFFSET_NB6_ADDR A:0xfcb6e028
y.create.l HWIO_RXFE_NB_CSR_CURR_PHASE_OFFSET_NB6_ADDR A:0xfcb6e02c
y.create.l HWIO_RXFE_NB_CSR_CURR_FREQ_OFFSET_NB6_ADDR A:0xfcb6e030
y.create.l HWIO_RXFE_NB_FILTERS_CFG_NB6_ADDR A:0xfcb6e034
y.create.l HWIO_RXFE_NB_ICI_COEF0_NB6_ADDR A:0xfcb6e03c
y.create.l HWIO_RXFE_NB_ICI_COEF1_NB6_ADDR A:0xfcb6e040
y.create.l HWIO_RXFE_NB_ICI_COEF2_NB6_ADDR A:0xfcb6e044
y.create.l HWIO_RXFE_NB_ICI_COEF3_NB6_ADDR A:0xfcb6e048
y.create.l HWIO_RXFE_NB_ICI_COEF4_NB6_ADDR A:0xfcb6e04c
y.create.l HWIO_RXFE_NB_ICI_COEF5_NB6_ADDR A:0xfcb6e050
y.create.l HWIO_RXFE_NB_ICI_COEF6_NB6_ADDR A:0xfcb6e054
y.create.l HWIO_RXFE_NB_ICI_COEF7_NB6_ADDR A:0xfcb6e058
y.create.l HWIO_RXFE_NB_ICI_COEF8_NB6_ADDR A:0xfcb6e05c
y.create.l HWIO_RXFE_NB_ICI_COEF9_NB6_ADDR A:0xfcb6e060
y.create.l HWIO_RXFE_NB_GDA_NB6_ADDR A:0xfcb6e068
y.create.l HWIO_RXFE_NB_NBDC_COMPVAL_I_NB6_ADDR A:0xfcb6e06c
y.create.l HWIO_RXFE_NB_NBDC_COMPVAL_Q_NB6_ADDR A:0xfcb6e070
y.create.l HWIO_RXFE_NB_NBPWR_CFG_NB6_ADDR A:0xfcb6e074
y.create.l HWIO_RXFE_NB_NBPWR_CMD_NB6_ADDR A:0xfcb6e078
y.create.l HWIO_RXFE_NB_NBPWR_START_ACTION_SAMPLE_NB6_ADDR A:0xfcb6e07c
y.create.l HWIO_RXFE_NB_NBPWR_START_MASK_NB6_ADDR A:0xfcb6e080
y.create.l HWIO_RXFE_NB_NBPWR_STOP_ACTION_SAMPLE_NB6_ADDR A:0xfcb6e084
y.create.l HWIO_RXFE_NB_NBPWR_FINAL_ACC_NB6_ADDR A:0xfcb6e088
y.create.l HWIO_RXFE_NB_NBPWR_CURR_ACC_NB6_ADDR A:0xfcb6e08c
y.create.l HWIO_RXFE_NB_NBPWR_MAX_ACC_NB6_ADDR A:0xfcb6e090
y.create.l HWIO_RXFE_NB_DVGA_CFG_NB6_ADDR A:0xfcb6e094
y.create.l HWIO_RXFE_NB_DVGA_RXFE_GAIN_NB6_ADDR A:0xfcb6e098
y.create.l HWIO_RXFE_NB_DVGA_OVERRIDE_DVGA_GAIN_NB6_ADDR A:0xfcb6e09c
y.create.l HWIO_RXFE_NB_DVGA_CMD_NB6_ADDR A:0xfcb6e0a0
y.create.l HWIO_RXFE_NB_DVGA_UPDT_ACTION_SAMPLE_NB6_ADDR A:0xfcb6e0a4
y.create.l HWIO_RXFE_NB_DVGA_UPDT_MASK_NB6_ADDR A:0xfcb6e0a8
y.create.l HWIO_RXFE_NB_FINAL_BITWIDTHS_CFG_NB6_ADDR A:0xfcb6e0ac
y.create.l HWIO_RXFE_NB_WTR_CFG_NB6_ADDR A:0xfcb6e0b0
y.create.l HWIO_RXFE_NB_WTR_FUNC_CFG_NB6_ADDR A:0xfcb6e0b4
y.create.l HWIO_RXFE_NB_WTR_DBG_CFG0_NB6_ADDR A:0xfcb6e0b8
y.create.l HWIO_RXFE_NB_WTR_DBG_CFG1_NB6_ADDR A:0xfcb6e0bc
y.create.l HWIO_RXFE_NB_WTR_CMD_NB6_ADDR A:0xfcb6e0c0
y.create.l HWIO_RXFE_NB_WTR_START_ACTION_SAMPLE_NB6_ADDR A:0xfcb6e0c4
y.create.l HWIO_RXFE_NB_WTR_STOP_ACTION_SAMPLE_NB6_ADDR A:0xfcb6e0c8
y.create.l HWIO_RXFE_NB_WTR_STATUS_NB6_ADDR A:0xfcb6e0d0
y.create.l HWIO_RXFE_NB_WTR_ADDR_SNAPSHOT_NB6_ADDR A:0xfcb6e0d4
y.create.l HWIO_RXFE_NB_SPARE_REG_NB6_ADDR A:0xfcb6e0d8
y.create.l HWIO_RXFE_WRTR0_CFG0_ADDR A:0xfcb6f000
y.create.l HWIO_RXFE_WRTR1_CFG0_ADDR A:0xfcb6f008
y.create.l HWIO_RXFE_WRTR2_CFG0_ADDR A:0xfcb6f010
y.create.l HWIO_RXFE_WRTR3_CFG0_ADDR A:0xfcb6f018
y.create.l HWIO_RXFE_WRTR4_CFG0_ADDR A:0xfcb6f020
y.create.l HWIO_RXFE_WRTR5_CFG0_ADDR A:0xfcb6f028
y.create.l HWIO_RXFE_WRTR6_CFG0_ADDR A:0xfcb6f030
y.create.l HWIO_RXFE_WRTR0_CFG1_ADDR A:0xfcb6f004
y.create.l HWIO_RXFE_WRTR1_CFG1_ADDR A:0xfcb6f00c
y.create.l HWIO_RXFE_WRTR2_CFG1_ADDR A:0xfcb6f014
y.create.l HWIO_RXFE_WRTR3_CFG1_ADDR A:0xfcb6f01c
y.create.l HWIO_RXFE_WRTR4_CFG1_ADDR A:0xfcb6f024
y.create.l HWIO_RXFE_WRTR5_CFG1_ADDR A:0xfcb6f02c
y.create.l HWIO_RXFE_WRTR6_CFG1_ADDR A:0xfcb6f034
y.create.l HWIO_RXFE_WRTR_XFER_CTL_ADDR A:0xfcb6f038
y.create.l HWIO_RXFE_BRDG_CTL_ADDR A:0xfcb6f03c
y.create.l HWIO_RXFE_BRDG_STATUS_ADDR A:0xfcb6f040
y.create.l HWIO_RXFE_BRDG_CLEAR_ADDR A:0xfcb6f044
y.create.l HWIO_DEMBACK_EN_ADDR A:0xfcb40000
y.create.l HWIO_DEMBACK_MODE_SEL_ADDR A:0xfcb40004
y.create.l HWIO_DEMBACK_AHB_ERR_ADDR A:0xfcb40008
y.create.l HWIO_DEMBACK_MM_RDR0_CFG0_ADDR A:0xfcb41000
y.create.l HWIO_DEMBACK_MM_RDR1_CFG0_ADDR A:0xfcb4100c
y.create.l HWIO_DEMBACK_MM_RDR2_CFG0_ADDR A:0xfcb41018
y.create.l HWIO_DEMBACK_MM_RDR0_CFG1_ADDR A:0xfcb41004
y.create.l HWIO_DEMBACK_MM_RDR1_CFG1_ADDR A:0xfcb41010
y.create.l HWIO_DEMBACK_MM_RDR2_CFG1_ADDR A:0xfcb4101c
y.create.l HWIO_DEMBACK_MM_RDR0_XFER_CTL_ADDR A:0xfcb41008
y.create.l HWIO_DEMBACK_MM_RDR1_XFER_CTL_ADDR A:0xfcb41014
y.create.l HWIO_DEMBACK_MM_RDR2_XFER_CTL_ADDR A:0xfcb41020
y.create.l HWIO_DEMBACK_RDR3_CFG0_ADDR A:0xfcb41024
y.create.l HWIO_DEMBACK_RDR3_CFG1_ADDR A:0xfcb41028
y.create.l HWIO_DEMBACK_RDR3_XFER_CTL_ADDR A:0xfcb4102c
y.create.l HWIO_DEMBACK_NN_RDR0_CFG0_ADDR A:0xfcb41030
y.create.l HWIO_DEMBACK_NN_RDR1_CFG0_ADDR A:0xfcb4103c
y.create.l HWIO_DEMBACK_NN_RDR0_CFG1_ADDR A:0xfcb41034
y.create.l HWIO_DEMBACK_NN_RDR1_CFG1_ADDR A:0xfcb41040
y.create.l HWIO_DEMBACK_NN_RDR0_XFER_CTL_ADDR A:0xfcb41038
y.create.l HWIO_DEMBACK_NN_RDR1_XFER_CTL_ADDR A:0xfcb41044
y.create.l HWIO_DEMBACK_NN_RDR2_CFG0_ADDR A:0xfcb41048
y.create.l HWIO_DEMBACK_NN_RDR2_CFG1_ADDR A:0xfcb4104c
y.create.l HWIO_DEMBACK_NN_RDR2_XFER_CTL_ADDR A:0xfcb41050
y.create.l HWIO_DEMBACK_NN_RDR3_CFG0_ADDR A:0xfcb41054
y.create.l HWIO_DEMBACK_NN_RDR3_CFG1_ADDR A:0xfcb41058
y.create.l HWIO_DEMBACK_NN_RDR3_XFER_CTL_ADDR A:0xfcb4105c
y.create.l HWIO_DEMBACK_WRTR0_CFG0_ADDR A:0xfcb41060
y.create.l HWIO_DEMBACK_WRTR1_CFG0_ADDR A:0xfcb4106c
y.create.l HWIO_DEMBACK_WRTR0_CFG1_ADDR A:0xfcb41064
y.create.l HWIO_DEMBACK_WRTR1_CFG1_ADDR A:0xfcb41070
y.create.l HWIO_DEMBACK_WRTR0_XFER_CTL_ADDR A:0xfcb41068
y.create.l HWIO_DEMBACK_WRTR1_XFER_CTL_ADDR A:0xfcb41074
y.create.l HWIO_DEMBACK_WRTR2_CFG0_ADDR A:0xfcb41078
y.create.l HWIO_DEMBACK_WRTR2_CFG1_ADDR A:0xfcb4107c
y.create.l HWIO_DEMBACK_WRTR2_XFER_CTL_ADDR A:0xfcb41080
y.create.l HWIO_DEMBACK_WRTR3_CFG0_ADDR A:0xfcb41084
y.create.l HWIO_DEMBACK_WRTR3_CFG1_ADDR A:0xfcb41088
y.create.l HWIO_DEMBACK_WRTR3_XFER_CTL_ADDR A:0xfcb4108c
y.create.l HWIO_DEMBACK_BRDG_CTL_ADDR A:0xfcb41090
y.create.l HWIO_DEMBACK_BRDG_STATUS_ADDR A:0xfcb41094
y.create.l HWIO_DEMBACK_BRDG_CLEAR_ADDR A:0xfcb41098
y.create.l HWIO_DEMBACK_DBG_CFG0_ADDR A:0xfcb4109c
y.create.l HWIO_DEMBACK_DBG_CFG1_ADDR A:0xfcb410a0
y.create.l HWIO_DEMBACK_DBG_CTL_ADDR A:0xfcb410a4
y.create.l HWIO_DEMBACK_DBG_MATCH_MASK0_ADDR A:0xfcb410a8
y.create.l HWIO_DEMBACK_DBG_MATCH_MASK1_ADDR A:0xfcb410ac
y.create.l HWIO_DEMBACK_DBG_MATCH_PATTERN0_ADDR A:0xfcb410b0
y.create.l HWIO_DEMBACK_DBG_MATCH_PATTERN1_ADDR A:0xfcb410b4
y.create.l HWIO_DEMBACK_DBG_TRACE_LEN_ADDR A:0xfcb410b8
y.create.l HWIO_DEMBACK_DBG_WINDOW_LEN_ADDR A:0xfcb410bc
y.create.l HWIO_DEMBACK_DBG_TRIGGER_LEN_ADDR A:0xfcb410c0
y.create.l HWIO_LTE_DBE_PHICH_STATUS_ADDR A:0xfcb42000
y.create.l HWIO_LTE_DBE_PCFICH_STATUS_ADDR A:0xfcb42004
y.create.l HWIO_LTE_DBE_SCRAMBLE_SEED_FF_X1_SEED_ADDR A:0xfcb42008
y.create.l HWIO_LTE_DBE_TESTBUS_ENABLE_ADDR A:0xfcb4200c
y.create.l HWIO_LTE_DBE_TESTBUS_STATUS_ADDR A:0xfcb42010
y.create.l HWIO_LTE_DBE_PBCH_CMD_COUNT_ADDR A:0xfcb42014
y.create.l HWIO_LTE_DBE_PDCCH_CMD_COUNT_ADDR A:0xfcb42018
y.create.l HWIO_LTE_DBE_PDSCH_CMD_COUNT_ADDR A:0xfcb4201c
y.create.l HWIO_LTE_DBE_PBCH_DONE_COUNT_ADDR A:0xfcb42020
y.create.l HWIO_LTE_DBE_PDCCH_DONE_COUNT_ADDR A:0xfcb42024
y.create.l HWIO_LTE_DBE_PDSCH_DONE_COUNT_ADDR A:0xfcb42028
y.create.l HWIO_TESTBUS_ENABLE_ADDR A:0xfcb43000
y.create.l HWIO_TESTBUS_STATUS_ADDR A:0xfcb43004
y.create.l HWIO_DBACK_AMP_EST0_0_ADDR A:0xfcb44000
y.create.l HWIO_DBACK_AMP_EST0_1_ADDR A:0xfcb44008
y.create.l HWIO_DBACK_AMP_EST0_2_ADDR A:0xfcb44010
y.create.l HWIO_DBACK_AMP_EST0_3_ADDR A:0xfcb44018
y.create.l HWIO_DBACK_AMP_EST0_4_ADDR A:0xfcb44020
y.create.l HWIO_DBACK_AMP_EST0_5_ADDR A:0xfcb44028
y.create.l HWIO_DBACK_ENG_EST0_0_ADDR A:0xfcb44004
y.create.l HWIO_DBACK_ENG_EST0_1_ADDR A:0xfcb4400c
y.create.l HWIO_DBACK_ENG_EST0_2_ADDR A:0xfcb44014
y.create.l HWIO_DBACK_ENG_EST0_3_ADDR A:0xfcb4401c
y.create.l HWIO_DBACK_ENG_EST0_4_ADDR A:0xfcb44024
y.create.l HWIO_DBACK_ENG_EST0_5_ADDR A:0xfcb4402c
y.create.l HWIO_DBACK_AMP_EST1_0_ADDR A:0xfcb44030
y.create.l HWIO_DBACK_AMP_EST1_1_ADDR A:0xfcb44038
y.create.l HWIO_DBACK_AMP_EST1_2_ADDR A:0xfcb44040
y.create.l HWIO_DBACK_AMP_EST1_3_ADDR A:0xfcb44048
y.create.l HWIO_DBACK_AMP_EST1_4_ADDR A:0xfcb44050
y.create.l HWIO_DBACK_AMP_EST1_5_ADDR A:0xfcb44058
y.create.l HWIO_DBACK_ENG_EST1_0_ADDR A:0xfcb44034
y.create.l HWIO_DBACK_ENG_EST1_1_ADDR A:0xfcb4403c
y.create.l HWIO_DBACK_ENG_EST1_2_ADDR A:0xfcb44044
y.create.l HWIO_DBACK_ENG_EST1_3_ADDR A:0xfcb4404c
y.create.l HWIO_DBACK_ENG_EST1_4_ADDR A:0xfcb44054
y.create.l HWIO_DBACK_ENG_EST1_5_ADDR A:0xfcb4405c
y.create.l HWIO_DBACK_HS_CH0_PART1_DEC_DATA0_ADDR A:0xfcb44060
y.create.l HWIO_DBACK_HS_CH1_PART1_DEC_DATA0_ADDR A:0xfcb4406c
y.create.l HWIO_DBACK_HS_CH2_PART1_DEC_DATA0_ADDR A:0xfcb44078
y.create.l HWIO_DBACK_HS_CH3_PART1_DEC_DATA0_ADDR A:0xfcb44084
y.create.l HWIO_DBACK_HS_CH4_PART1_DEC_DATA0_ADDR A:0xfcb44090
y.create.l HWIO_DBACK_HS_CH5_PART1_DEC_DATA0_ADDR A:0xfcb4409c
y.create.l HWIO_DBACK_HS_CH6_PART1_DEC_DATA0_ADDR A:0xfcb440a8
y.create.l HWIO_DBACK_HS_CH7_PART1_DEC_DATA0_ADDR A:0xfcb440b4
y.create.l HWIO_DBACK_HS_CH8_PART1_DEC_DATA0_ADDR A:0xfcb440c0
y.create.l HWIO_DBACK_HS_CH9_PART1_DEC_DATA0_ADDR A:0xfcb440cc
y.create.l HWIO_DBACK_HS_CH0_PART1_DEC_STAT_ADDR A:0xfcb44064
y.create.l HWIO_DBACK_HS_CH1_PART1_DEC_STAT_ADDR A:0xfcb44070
y.create.l HWIO_DBACK_HS_CH2_PART1_DEC_STAT_ADDR A:0xfcb4407c
y.create.l HWIO_DBACK_HS_CH3_PART1_DEC_STAT_ADDR A:0xfcb44088
y.create.l HWIO_DBACK_HS_CH4_PART1_DEC_STAT_ADDR A:0xfcb44094
y.create.l HWIO_DBACK_HS_CH5_PART1_DEC_STAT_ADDR A:0xfcb440a0
y.create.l HWIO_DBACK_HS_CH6_PART1_DEC_STAT_ADDR A:0xfcb440ac
y.create.l HWIO_DBACK_HS_CH7_PART1_DEC_STAT_ADDR A:0xfcb440b8
y.create.l HWIO_DBACK_HS_CH8_PART1_DEC_STAT_ADDR A:0xfcb440c4
y.create.l HWIO_DBACK_HS_CH9_PART1_DEC_STAT_ADDR A:0xfcb440d0
y.create.l HWIO_DBACK_HS_CH0_SLOT1_AE_EST_ADDR A:0xfcb44068
y.create.l HWIO_DBACK_HS_CH1_SLOT1_AE_EST_ADDR A:0xfcb44074
y.create.l HWIO_DBACK_HS_CH2_SLOT1_AE_EST_ADDR A:0xfcb44080
y.create.l HWIO_DBACK_HS_CH3_SLOT1_AE_EST_ADDR A:0xfcb4408c
y.create.l HWIO_DBACK_HS_CH4_SLOT1_AE_EST_ADDR A:0xfcb44098
y.create.l HWIO_DBACK_HS_CH5_SLOT1_AE_EST_ADDR A:0xfcb440a4
y.create.l HWIO_DBACK_HS_CH6_SLOT1_AE_EST_ADDR A:0xfcb440b0
y.create.l HWIO_DBACK_HS_CH7_SLOT1_AE_EST_ADDR A:0xfcb440bc
y.create.l HWIO_DBACK_HS_CH8_SLOT1_AE_EST_ADDR A:0xfcb440c8
y.create.l HWIO_DBACK_HS_CH9_SLOT1_AE_EST_ADDR A:0xfcb440d4
y.create.l HWIO_DBACK_HS_CH0_PART2_DEC_DATA1_ADDR A:0xfcb440d8
y.create.l HWIO_DBACK_HS_CH1_PART2_DEC_DATA1_ADDR A:0xfcb440e8
y.create.l HWIO_DBACK_HS_CH2_PART2_DEC_DATA1_ADDR A:0xfcb440f8
y.create.l HWIO_DBACK_HS_CH3_PART2_DEC_DATA1_ADDR A:0xfcb44108
y.create.l HWIO_DBACK_HS_CH4_PART2_DEC_DATA1_ADDR A:0xfcb44118
y.create.l HWIO_DBACK_HS_CH5_PART2_DEC_DATA1_ADDR A:0xfcb44128
y.create.l HWIO_DBACK_HS_CH6_PART2_DEC_DATA1_ADDR A:0xfcb44138
y.create.l HWIO_DBACK_HS_CH7_PART2_DEC_DATA1_ADDR A:0xfcb44148
y.create.l HWIO_DBACK_HS_CH8_PART2_DEC_DATA1_ADDR A:0xfcb44158
y.create.l HWIO_DBACK_HS_CH9_PART2_DEC_DATA1_ADDR A:0xfcb44168
y.create.l HWIO_DBACK_HS_CH0_PART2_DEC_STAT_ADDR A:0xfcb440dc
y.create.l HWIO_DBACK_HS_CH1_PART2_DEC_STAT_ADDR A:0xfcb440ec
y.create.l HWIO_DBACK_HS_CH2_PART2_DEC_STAT_ADDR A:0xfcb440fc
y.create.l HWIO_DBACK_HS_CH3_PART2_DEC_STAT_ADDR A:0xfcb4410c
y.create.l HWIO_DBACK_HS_CH4_PART2_DEC_STAT_ADDR A:0xfcb4411c
y.create.l HWIO_DBACK_HS_CH5_PART2_DEC_STAT_ADDR A:0xfcb4412c
y.create.l HWIO_DBACK_HS_CH6_PART2_DEC_STAT_ADDR A:0xfcb4413c
y.create.l HWIO_DBACK_HS_CH7_PART2_DEC_STAT_ADDR A:0xfcb4414c
y.create.l HWIO_DBACK_HS_CH8_PART2_DEC_STAT_ADDR A:0xfcb4415c
y.create.l HWIO_DBACK_HS_CH9_PART2_DEC_STAT_ADDR A:0xfcb4416c
y.create.l HWIO_DBACK_HS_CH0_SLOT2_AE_EST_ADDR A:0xfcb440e0
y.create.l HWIO_DBACK_HS_CH1_SLOT2_AE_EST_ADDR A:0xfcb440f0
y.create.l HWIO_DBACK_HS_CH2_SLOT2_AE_EST_ADDR A:0xfcb44100
y.create.l HWIO_DBACK_HS_CH3_SLOT2_AE_EST_ADDR A:0xfcb44110
y.create.l HWIO_DBACK_HS_CH4_SLOT2_AE_EST_ADDR A:0xfcb44120
y.create.l HWIO_DBACK_HS_CH5_SLOT2_AE_EST_ADDR A:0xfcb44130
y.create.l HWIO_DBACK_HS_CH6_SLOT2_AE_EST_ADDR A:0xfcb44140
y.create.l HWIO_DBACK_HS_CH7_SLOT2_AE_EST_ADDR A:0xfcb44150
y.create.l HWIO_DBACK_HS_CH8_SLOT2_AE_EST_ADDR A:0xfcb44160
y.create.l HWIO_DBACK_HS_CH9_SLOT2_AE_EST_ADDR A:0xfcb44170
y.create.l HWIO_DBACK_HS_CH0_SLOT3_AE_EST_ADDR A:0xfcb440e4
y.create.l HWIO_DBACK_HS_CH1_SLOT3_AE_EST_ADDR A:0xfcb440f4
y.create.l HWIO_DBACK_HS_CH2_SLOT3_AE_EST_ADDR A:0xfcb44104
y.create.l HWIO_DBACK_HS_CH3_SLOT3_AE_EST_ADDR A:0xfcb44114
y.create.l HWIO_DBACK_HS_CH4_SLOT3_AE_EST_ADDR A:0xfcb44124
y.create.l HWIO_DBACK_HS_CH5_SLOT3_AE_EST_ADDR A:0xfcb44134
y.create.l HWIO_DBACK_HS_CH6_SLOT3_AE_EST_ADDR A:0xfcb44144
y.create.l HWIO_DBACK_HS_CH7_SLOT3_AE_EST_ADDR A:0xfcb44154
y.create.l HWIO_DBACK_HS_CH8_SLOT3_AE_EST_ADDR A:0xfcb44164
y.create.l HWIO_DBACK_HS_CH9_SLOT3_AE_EST_ADDR A:0xfcb44174
y.create.l HWIO_DBACK_EAGCH_DEC_DATA_ADDR A:0xfcb44178
y.create.l HWIO_DBACK_EAGCH_DEC_STAT_ADDR A:0xfcb4417c
y.create.l HWIO_DBACK_EAGCH_METRIC_ADDR A:0xfcb44180
y.create.l HWIO_DBACK_HSSCCH_CTL1_ADDR A:0xfcb44184
y.create.l HWIO_DBACK_HSSCCH_CTL2_ADDR A:0xfcb44188
y.create.l HWIO_HS_SCCH_PART2_DECODE_MAP_ADDR A:0xfcb4418c
y.create.l HWIO_DBACK_CH0_UEID_MASK_0_ADDR A:0xfcb44190
y.create.l HWIO_DBACK_CH1_UEID_MASK_0_ADDR A:0xfcb44194
y.create.l HWIO_DBACK_CH2_UEID_MASK_0_ADDR A:0xfcb44198
y.create.l HWIO_DBACK_CH3_UEID_MASK_0_ADDR A:0xfcb4419c
y.create.l HWIO_DBACK_CH4_UEID_MASK_0_ADDR A:0xfcb441a0
y.create.l HWIO_DBACK_CH5_UEID_MASK_0_ADDR A:0xfcb441a4
y.create.l HWIO_DBACK_CH6_UEID_MASK_0_ADDR A:0xfcb441a8
y.create.l HWIO_DBACK_CH7_UEID_MASK_0_ADDR A:0xfcb441ac
y.create.l HWIO_DBACK_CH8_UEID_MASK_0_ADDR A:0xfcb441b0
y.create.l HWIO_DBACK_CH9_UEID_MASK_0_ADDR A:0xfcb441b4
y.create.l HWIO_DBACK_CH0_UEID_MASK_1_ADDR A:0xfcb441b8
y.create.l HWIO_DBACK_CH1_UEID_MASK_1_ADDR A:0xfcb441bc
y.create.l HWIO_DBACK_CH2_UEID_MASK_1_ADDR A:0xfcb441c0
y.create.l HWIO_DBACK_CH3_UEID_MASK_1_ADDR A:0xfcb441c4
y.create.l HWIO_DBACK_CH4_UEID_MASK_1_ADDR A:0xfcb441c8
y.create.l HWIO_DBACK_CH5_UEID_MASK_1_ADDR A:0xfcb441cc
y.create.l HWIO_DBACK_CH6_UEID_MASK_1_ADDR A:0xfcb441d0
y.create.l HWIO_DBACK_CH7_UEID_MASK_1_ADDR A:0xfcb441d4
y.create.l HWIO_DBACK_CH8_UEID_MASK_1_ADDR A:0xfcb441d8
y.create.l HWIO_DBACK_CH9_UEID_MASK_1_ADDR A:0xfcb441dc
y.create.l HWIO_DBACK_HSSCCH_PART1_TRIGGER_ADDR A:0xfcb441e0
y.create.l HWIO_DBACK_HSSCCH_YAM_THRES_ADDR A:0xfcb441e4
y.create.l HWIO_DBACK_HSSCCH_PART2_TRIGGER_ADDR A:0xfcb441e8
y.create.l HWIO_DBACK_HSSCCH_STATUS_ADDR A:0xfcb441ec
y.create.l HWIO_DBACK_EAGCH_CONFIG_ADDR A:0xfcb441f0
y.create.l HWIO_DBACK_EAGCH_CTL_ADDR A:0xfcb441f4
y.create.l HWIO_DBACK_EAGCH_TRIGGER_ADDR A:0xfcb441f8
y.create.l HWIO_DBACK_EAGCH_RM_PATTERN_0_ADDR A:0xfcb441fc
y.create.l HWIO_DBACK_EAGCH_RM_PATTERN_1_ADDR A:0xfcb44200
y.create.l HWIO_DBACK_EAGCH_RM_PATTERN_2_ADDR A:0xfcb44204
y.create.l HWIO_DBACK_HS_EUL_CTL_CH_RST_ADDR A:0xfcb44208
y.create.l HWIO_DBACK_NONHS_WCB_SIZE_ADDR A:0xfcb4420c
y.create.l HWIO_DBACK_HS_WCB_SIZE_ADDR A:0xfcb44210
y.create.l HWIO_DBACK_PART1_INT_STATUS_ADDR A:0xfcb44214
y.create.l HWIO_DBACK_PART1_INT_CLR_ADDR A:0xfcb44218
y.create.l HWIO_DBACK_PART1_INT_EN_ADDR A:0xfcb4421c
y.create.l HWIO_DBACK_PART2_INT_STATUS_ADDR A:0xfcb44220
y.create.l HWIO_DBACK_PART2_INT_CLR_ADDR A:0xfcb44224
y.create.l HWIO_DBACK_PART2_INT_EN_ADDR A:0xfcb44228
y.create.l HWIO_DBACK_EAGCH_INT_EN_ADDR A:0xfcb4422c
y.create.l HWIO_DBACK_TEST_MEM_SEL_ADDR A:0xfcb44230
y.create.l HWIO_DBACK_TEST_BUS_SEL_ADDR A:0xfcb44234
y.create.l HWIO_DBACK_MEM_ADDR_ADDR A:0xfcb44238
y.create.l HWIO_DBACK_MEM_DATA0_ADDR A:0xfcb4423c
y.create.l HWIO_DBACK_MEM_DATA1_ADDR A:0xfcb44240
y.create.l HWIO_DBACK_MEM_DATA2_ADDR A:0xfcb44244
y.create.l HWIO_DBACK_MEM_DATA3_ADDR A:0xfcb44248
y.create.l HWIO_DBACK_MEM_DATA4_ADDR A:0xfcb4424c
y.create.l HWIO_T_DBACK_HS_CH0_DEC_DATA0_ADDR A:0xfcb45000
y.create.l HWIO_T_DBACK_HS_CH1_DEC_DATA0_ADDR A:0xfcb4500c
y.create.l HWIO_T_DBACK_HS_CH2_DEC_DATA0_ADDR A:0xfcb45018
y.create.l HWIO_T_DBACK_HS_CH3_DEC_DATA0_ADDR A:0xfcb45024
y.create.l HWIO_T_DBACK_HS_CH0_DEC_DATA1_ADDR A:0xfcb45004
y.create.l HWIO_T_DBACK_HS_CH1_DEC_DATA1_ADDR A:0xfcb45010
y.create.l HWIO_T_DBACK_HS_CH2_DEC_DATA1_ADDR A:0xfcb4501c
y.create.l HWIO_T_DBACK_HS_CH3_DEC_DATA1_ADDR A:0xfcb45028
y.create.l HWIO_T_DBACK_HS_CH0_DEC_STAT_ADDR A:0xfcb45008
y.create.l HWIO_T_DBACK_HS_CH1_DEC_STAT_ADDR A:0xfcb45014
y.create.l HWIO_T_DBACK_HS_CH2_DEC_STAT_ADDR A:0xfcb45020
y.create.l HWIO_T_DBACK_HS_CH3_DEC_STAT_ADDR A:0xfcb4502c
y.create.l HWIO_T_DBACK_EAGCH0_DEC_DATA0_ADDR A:0xfcb45030
y.create.l HWIO_T_DBACK_EAGCH1_DEC_DATA0_ADDR A:0xfcb45040
y.create.l HWIO_T_DBACK_EAGCH2_DEC_DATA0_ADDR A:0xfcb45050
y.create.l HWIO_T_DBACK_EAGCH3_DEC_DATA0_ADDR A:0xfcb45060
y.create.l HWIO_T_DBACK_EAGCH0_DEC_DATA1_ADDR A:0xfcb45034
y.create.l HWIO_T_DBACK_EAGCH1_DEC_DATA1_ADDR A:0xfcb45044
y.create.l HWIO_T_DBACK_EAGCH2_DEC_DATA1_ADDR A:0xfcb45054
y.create.l HWIO_T_DBACK_EAGCH3_DEC_DATA1_ADDR A:0xfcb45064
y.create.l HWIO_T_DBACK_EAGCH0_DEC_STAT_ADDR A:0xfcb45038
y.create.l HWIO_T_DBACK_EAGCH1_DEC_STAT_ADDR A:0xfcb45048
y.create.l HWIO_T_DBACK_EAGCH2_DEC_STAT_ADDR A:0xfcb45058
y.create.l HWIO_T_DBACK_EAGCH3_DEC_STAT_ADDR A:0xfcb45068
y.create.l HWIO_T_DBACK_EAGCH0_METRIC_ADDR A:0xfcb4503c
y.create.l HWIO_T_DBACK_EAGCH1_METRIC_ADDR A:0xfcb4504c
y.create.l HWIO_T_DBACK_EAGCH2_METRIC_ADDR A:0xfcb4505c
y.create.l HWIO_T_DBACK_EAGCH3_METRIC_ADDR A:0xfcb4506c
y.create.l HWIO_T_DBACK_FPACH_DEC_DATA0_ADDR A:0xfcb45070
y.create.l HWIO_T_DBACK_FPACH_DEC_DATA1_ADDR A:0xfcb45074
y.create.l HWIO_T_DBACK_FPACH_DEC_STAT_ADDR A:0xfcb45078
y.create.l HWIO_T_DBACK_TEST_MEM_SEL_ADDR A:0xfcb4507c
y.create.l HWIO_T_DBACK_TEST_BUS_SEL_ADDR A:0xfcb45080
y.create.l HWIO_T_DBACK_MEM_ADDR_ADDR A:0xfcb45084
y.create.l HWIO_T_DBACK_MEM_DATA0_ADDR A:0xfcb45088
y.create.l HWIO_T_DBACK_MEM_DATA1_ADDR A:0xfcb4508c
y.create.l HWIO_T_DBACK_MEM_DATA2_ADDR A:0xfcb45090
y.create.l HWIO_T_DBACK_MEM_DATA3_ADDR A:0xfcb45094
y.create.l HWIO_T_DBACK_MEM_DATA4_ADDR A:0xfcb45098
y.create.l HWIO_DINT_CFG_ADDR A:0xfcb46000
y.create.l HWIO_DINT_CH0_CFG_ADDR A:0xfcb46004
y.create.l HWIO_DINT_CH1_CFG_ADDR A:0xfcb46008
y.create.l HWIO_DINT_CH2_CFG_ADDR A:0xfcb4600c
y.create.l HWIO_TD_BLOCK_SIZE_ADDR A:0xfcb46014
y.create.l HWIO_TD_INTLV_CFG_LO_ADDR A:0xfcb46018
y.create.l HWIO_TD_INTLV_CFG_HI_ADDR A:0xfcb4601c
y.create.l HWIO_TD_INTLV_SIZE_LO_ADDR A:0xfcb46020
y.create.l HWIO_TD_PUNCT_LO_ADDR A:0xfcb46024
y.create.l HWIO_TD_PUNCT_HI_ADDR A:0xfcb46028
y.create.l HWIO_DINT_PKT_OFFSET_ADDR A:0xfcb46030
y.create.l HWIO_DINT_PKT_CFG_ADDR A:0xfcb46034
y.create.l HWIO_DINT_TASK_OFFSET_ADDR A:0xfcb46038
y.create.l HWIO_DINT_TASK_LIST_ADDR A:0xfcb4603c
y.create.l HWIO_TST_SYNC_DINT_ADDR A:0xfcb46040
y.create.l HWIO_TST_CH0_SYMS_ADDR A:0xfcb46044
y.create.l HWIO_TST_CH1_SYMS_ADDR A:0xfcb46048
y.create.l HWIO_TST_CH2_SYMS_ADDR A:0xfcb4604c
y.create.l HWIO_TST_SEL_DINT_ADDR A:0xfcb46054
y.create.l HWIO_DINT_OTD_CFG_ADDR A:0xfcb46058
y.create.l HWIO_TST_SYS_TIME_ADDR A:0xfcb46070
y.create.l HWIO_DEINT_DBG_BUS_CTL_ADDR A:0xfcb46074
y.create.l HWIO_DEC_CLR_INT_STATUS_ADDR A:0xfcb46084
y.create.l HWIO_DEINT_CLK_STATUS_ADDR A:0xfcb46088
y.create.l HWIO_DEC_DONE_INT_STATUS_ADDR A:0xfcb4608c
y.create.l HWIO_DEINT_TASK_STATUS_ADDR A:0xfcb46090
y.create.l HWIO_DEINT_FRMHYP_STATUS_ADDR A:0xfcb46094
y.create.l HWIO_DINT_VD_RD_ADDR_ADDR A:0xfcb46098
y.create.l HWIO_DINT_FCH_CFG0_ADDR A:0xfcb4609c
y.create.l HWIO_DINT_FCH_CFG1_ADDR A:0xfcb460a0
y.create.l HWIO_DINT_FCH_TRIGGER_ADDR A:0xfcb460a4
y.create.l HWIO_DINT_FCH_WR_BANK_ADDR A:0xfcb460a8
y.create.l HWIO_DINT_FCH_EGTH_HYP_CFG0_ADDR A:0xfcb460ac
y.create.l HWIO_DINT_FCH_EGTH_HYP_CFG1_ADDR A:0xfcb460b0
y.create.l HWIO_DINT_FCH_EGTH_HYP_CFG2_ADDR A:0xfcb460b4
y.create.l HWIO_DINT_FCH_EGTH_HYP_CFG3_ADDR A:0xfcb460b8
y.create.l HWIO_DINT_FCH_QRTR_HYP_CFG0_ADDR A:0xfcb460bc
y.create.l HWIO_DINT_FCH_QRTR_HYP_CFG1_ADDR A:0xfcb460c0
y.create.l HWIO_DINT_FCH_QRTR_HYP_CFG2_ADDR A:0xfcb460c4
y.create.l HWIO_DINT_FCH_QRTR_HYP_CFG3_ADDR A:0xfcb460c8
y.create.l HWIO_DINT_FCH_HALF_HYP_CFG0_ADDR A:0xfcb460cc
y.create.l HWIO_DINT_FCH_HALF_HYP_CFG1_ADDR A:0xfcb460d0
y.create.l HWIO_DINT_FCH_HALF_HYP_CFG2_ADDR A:0xfcb460d4
y.create.l HWIO_DINT_FCH_HALF_HYP_CFG3_ADDR A:0xfcb460d8
y.create.l HWIO_DINT_FCH_FULL_HYP_CFG0_ADDR A:0xfcb460dc
y.create.l HWIO_DINT_FCH_FULL_HYP_CFG1_ADDR A:0xfcb460e0
y.create.l HWIO_DINT_FCH_FULL_HYP_CFG2_ADDR A:0xfcb460e4
y.create.l HWIO_DINT_FCH_FULL_HYP_CFG3_ADDR A:0xfcb460e8
y.create.l HWIO_HDR_DINT_STATUS_ADDR A:0xfcb47024
y.create.l HWIO_HDR_DINT_DGB_BUS_ADDR A:0xfcb47080
y.create.l HWIO_HDR_DINT_CLK_STATUS_ADDR A:0xfcb47084
y.create.l HWIO_SVD_TBVD_CLK_STATUS_REG_ADDR A:0xfcb48000
y.create.l HWIO_SVD_TBVD_HW_IDLE_ADDR A:0xfcb48004
y.create.l HWIO_SVD_TBVD_TESTBUS_ENABLE_ADDR A:0xfcb48008
y.create.l HWIO_SVD_MODE_ADDR A:0xfcb4800c
y.create.l HWIO_SVD_POLY2IJ_ADDR A:0xfcb48010
y.create.l HWIO_SVD_POLY3IJ_ADDR A:0xfcb48014
y.create.l HWIO_SVD_POLY3K_ADDR A:0xfcb48018
y.create.l HWIO_SVD_POLY4IJ_ADDR A:0xfcb4801c
y.create.l HWIO_SVD_POLY4KL_ADDR A:0xfcb48020
y.create.l HWIO_SVD_TESTCON_ADDR A:0xfcb48024
y.create.l HWIO_SVD_TESTOUT_ADDR A:0xfcb48028
y.create.l HWIO_SVD_TEST_MEM_SEL_ADDR A:0xfcb4802c
y.create.l HWIO_SVD_TEST_MEM_ADDR_ADDR A:0xfcb48030
y.create.l HWIO_SVD_TEST_MEM_WRITE_ADDR A:0xfcb48034
y.create.l HWIO_SVD_TEST_MEM_READ0_ADDR A:0xfcb48038
y.create.l HWIO_SVD_TEST_MEM_READ1_ADDR A:0xfcb4803c
y.create.l HWIO_SVD_TEST_MEM_DIN_ADDR A:0xfcb48040
y.create.l HWIO_TBVD_DEBUG_MEM_CMD_ADDR A:0xfcb48044
y.create.l HWIO_TBVD_DEBUG_MEM_WR_ADDR A:0xfcb48048
y.create.l HWIO_TBVD_DEBUG_MEM_RD_ADDR A:0xfcb4804c
y.create.l HWIO_LTE_DEMBACK_SCH_STATUS_WORD0_ADDR A:0xfcb49000
y.create.l HWIO_LTE_DEMBACK_SCH_SHARED_WORD0_ADDR A:0xfcb49100
y.create.l HWIO_LTE_DEMBACK_SCH_SHARED_WORD1_ADDR A:0xfcb49104
y.create.l HWIO_LTE_DEMBACK_SCH_SHARED_WORD2_ADDR A:0xfcb49108
y.create.l HWIO_LTE_DEMBACK_SCH_SHARED_WORD3_ADDR A:0xfcb4910c
y.create.l HWIO_LTE_DEMBACK_SCH_SHARED_WORD4_ADDR A:0xfcb49110
y.create.l HWIO_LTE_DEMBACK_SCH_SHARED_WORD5_ADDR A:0xfcb49114
y.create.l HWIO_PDSCH_HARQ_CFG_WORD0_ADDR A:0xfcb49200
y.create.l HWIO_PDSCH_HARQ_CFG_WORD1_ADDR A:0xfcb49204
y.create.l HWIO_PDSCH_HARQ_CFG_WORD2_ADDR A:0xfcb49208
y.create.l HWIO_PDSCH_HARQ_CFG_WORD3_ADDR A:0xfcb4920c
y.create.l HWIO_PDSCH_HARQ_CFG_WORD4_ADDR A:0xfcb49210
y.create.l HWIO_PDSCH_HARQ_CFG_WORD5_ADDR A:0xfcb49214
y.create.l HWIO_PDSCH_HARQ_CFG_WORD6_ADDR A:0xfcb49218
y.create.l HWIO_PDSCH_HARQ_CFG_WORD7_ADDR A:0xfcb4921c
y.create.l HWIO_PDSCH_HARQ_CFG_WORD8_ADDR A:0xfcb49220
y.create.l HWIO_LTE_DEMBACK_CCH_STATUS_WORD0_ADDR A:0xfcb4a000
y.create.l HWIO_LTE_DEMBACK_CCH_SHARED_WORD0_ADDR A:0xfcb4a100
y.create.l HWIO_LTE_DEMBACK_CCH_SHARED_WORD1_ADDR A:0xfcb4a104
y.create.l HWIO_LTE_DEMBACK_CCH_SHARED_WORD2_ADDR A:0xfcb4a108
y.create.l HWIO_LTE_DEMBACK_CCH_SHARED_WORD3_ADDR A:0xfcb4a10c
y.create.l HWIO_LTE_DEMBACK_CCH_SHARED_WORD4_ADDR A:0xfcb4a110
y.create.l HWIO_LTE_DEMBACK_CCH_SHARED_WORD5_ADDR A:0xfcb4a114
y.create.l HWIO_LTE_DEMBACK_CCH_SHARED_WORD6_ADDR A:0xfcb4a118
y.create.l HWIO_LTE_DEMBACK_CCH_SHARED_WORD7_ADDR A:0xfcb4a11c
y.create.l HWIO_PDCCH_DEINT_CFG_WORD0_ADDR A:0xfcb4a200
y.create.l HWIO_PDCCH_DEINT_CFG_WORD1_ADDR A:0xfcb4a204
y.create.l HWIO_PDCCH_DEINT_CFG_WORD2_ADDR A:0xfcb4a208
y.create.l HWIO_SYMBOL0_REG_MAP_0_WORD0_ADDR A:0xfcb4a300
y.create.l HWIO_SYMBOL0_REG_MAP_0_WORD1_ADDR A:0xfcb4a304
y.create.l HWIO_SYMBOL0_REG_MAP_0_WORD2_ADDR A:0xfcb4a308
y.create.l HWIO_SYMBOL0_REG_MAP_0_WORD3_ADDR A:0xfcb4a30c
y.create.l HWIO_SYMBOL0_REG_MAP_0_WORD4_ADDR A:0xfcb4a310
y.create.l HWIO_SYMBOL0_REG_MAP_0_WORD5_ADDR A:0xfcb4a314
y.create.l HWIO_SYMBOL0_REG_MAP_0_WORD6_ADDR A:0xfcb4a318
y.create.l HWIO_SYMBOL0_REG_MAP_0_WORD7_ADDR A:0xfcb4a31c
y.create.l HWIO_SYMBOL0_REG_MAP_1_WORD0_ADDR A:0xfcb4a400
y.create.l HWIO_SYMBOL0_REG_MAP_1_WORD1_ADDR A:0xfcb4a404
y.create.l HWIO_SYMBOL0_REG_MAP_1_WORD2_ADDR A:0xfcb4a408
y.create.l HWIO_SYMBOL0_REG_MAP_1_WORD3_ADDR A:0xfcb4a40c
y.create.l HWIO_SYMBOL0_REG_MAP_1_WORD4_ADDR A:0xfcb4a410
y.create.l HWIO_SYMBOL0_REG_MAP_1_WORD5_ADDR A:0xfcb4a414
y.create.l HWIO_SYMBOL0_REG_MAP_1_WORD6_ADDR A:0xfcb4a418
y.create.l HWIO_SYMBOL0_REG_MAP_1_WORD7_ADDR A:0xfcb4a41c
y.create.l HWIO_SYMBOL0_REG_MAP_2_WORD0_ADDR A:0xfcb4a500
y.create.l HWIO_SYMBOL0_REG_MAP_2_WORD1_ADDR A:0xfcb4a504
y.create.l HWIO_SYMBOL0_REG_MAP_2_WORD2_ADDR A:0xfcb4a508
y.create.l HWIO_SYMBOL0_REG_MAP_2_WORD3_ADDR A:0xfcb4a50c
y.create.l HWIO_SYMBOL0_REG_MAP_2_WORD4_ADDR A:0xfcb4a510
y.create.l HWIO_SYMBOL0_REG_MAP_2_WORD5_ADDR A:0xfcb4a514
y.create.l HWIO_SYMBOL0_REG_MAP_2_WORD6_ADDR A:0xfcb4a518
y.create.l HWIO_SYMBOL0_REG_MAP_2_WORD7_ADDR A:0xfcb4a51c
y.create.l HWIO_SYMBOL1_REG_MAP_0_WORD0_ADDR A:0xfcb4a600
y.create.l HWIO_SYMBOL1_REG_MAP_0_WORD1_ADDR A:0xfcb4a604
y.create.l HWIO_SYMBOL1_REG_MAP_0_WORD2_ADDR A:0xfcb4a608
y.create.l HWIO_SYMBOL1_REG_MAP_0_WORD3_ADDR A:0xfcb4a60c
y.create.l HWIO_SYMBOL1_REG_MAP_0_WORD4_ADDR A:0xfcb4a610
y.create.l HWIO_SYMBOL1_REG_MAP_0_WORD5_ADDR A:0xfcb4a614
y.create.l HWIO_SYMBOL1_REG_MAP_0_WORD6_ADDR A:0xfcb4a618
y.create.l HWIO_SYMBOL1_REG_MAP_0_WORD7_ADDR A:0xfcb4a61c
y.create.l HWIO_SYMBOL1_REG_MAP_0_WORD8_ADDR A:0xfcb4a620
y.create.l HWIO_SYMBOL1_REG_MAP_0_WORD9_ADDR A:0xfcb4a624
y.create.l HWIO_SYMBOL1_REG_MAP_0_WORD10_ADDR A:0xfcb4a628
y.create.l HWIO_SYMBOL1_REG_MAP_1_WORD0_ADDR A:0xfcb4a700
y.create.l HWIO_SYMBOL1_REG_MAP_1_WORD1_ADDR A:0xfcb4a704
y.create.l HWIO_SYMBOL1_REG_MAP_1_WORD2_ADDR A:0xfcb4a708
y.create.l HWIO_SYMBOL1_REG_MAP_1_WORD3_ADDR A:0xfcb4a70c
y.create.l HWIO_SYMBOL1_REG_MAP_1_WORD4_ADDR A:0xfcb4a710
y.create.l HWIO_SYMBOL1_REG_MAP_1_WORD5_ADDR A:0xfcb4a714
y.create.l HWIO_SYMBOL1_REG_MAP_1_WORD6_ADDR A:0xfcb4a718
y.create.l HWIO_SYMBOL1_REG_MAP_1_WORD7_ADDR A:0xfcb4a71c
y.create.l HWIO_SYMBOL1_REG_MAP_1_WORD8_ADDR A:0xfcb4a720
y.create.l HWIO_SYMBOL1_REG_MAP_1_WORD9_ADDR A:0xfcb4a724
y.create.l HWIO_SYMBOL1_REG_MAP_1_WORD10_ADDR A:0xfcb4a728
y.create.l HWIO_SYMBOL2_REG_MAP_WORD0_ADDR A:0xfcb4a800
y.create.l HWIO_SYMBOL2_REG_MAP_WORD1_ADDR A:0xfcb4a804
y.create.l HWIO_SYMBOL2_REG_MAP_WORD2_ADDR A:0xfcb4a808
y.create.l HWIO_SYMBOL2_REG_MAP_WORD3_ADDR A:0xfcb4a80c
y.create.l HWIO_SYMBOL2_REG_MAP_WORD4_ADDR A:0xfcb4a810
y.create.l HWIO_SYMBOL2_REG_MAP_WORD5_ADDR A:0xfcb4a814
y.create.l HWIO_SYMBOL2_REG_MAP_WORD6_ADDR A:0xfcb4a818
y.create.l HWIO_SYMBOL2_REG_MAP_WORD7_ADDR A:0xfcb4a81c
y.create.l HWIO_SYMBOL2_REG_MAP_WORD8_ADDR A:0xfcb4a820
y.create.l HWIO_SYMBOL2_REG_MAP_WORD9_ADDR A:0xfcb4a824
y.create.l HWIO_SYMBOL2_REG_MAP_WORD10_ADDR A:0xfcb4a828
y.create.l HWIO_PBCH_DEINT_CFG_WORD0_ADDR A:0xfcb4a900
y.create.l HWIO_PBCH_DEINT_CFG_WORD1_ADDR A:0xfcb4a904
y.create.l HWIO_PBCH_DEINT_CFG_WORD2_ADDR A:0xfcb4a908
y.create.l HWIO_PBCH_DEINT_CFG_WORD3_ADDR A:0xfcb4a90c
y.create.l HWIO_PBCH_DEINT_CFG_WORD4_ADDR A:0xfcb4a910
y.create.l HWIO_PBCH_DEINT_CFG_WORD5_ADDR A:0xfcb4a914
y.create.l HWIO_PBCH_DEINT_CFG_WORD6_ADDR A:0xfcb4a918
y.create.l HWIO_PBCH_DEINT_CFG_WORD7_ADDR A:0xfcb4a91c
y.create.l HWIO_PBCH_DEINT_CFG_WORD8_ADDR A:0xfcb4a920
y.create.l HWIO_PBCH_DEINT_CFG_WORD9_ADDR A:0xfcb4a924
y.create.l HWIO_PBCH_DEINT_CFG_WORD10_ADDR A:0xfcb4a928
y.create.l HWIO_PDCCH_REG_REORDER_WORD0_ADDR A:0xfcb4aa00
y.create.l HWIO_PDCCH_REG_REORDER_WORD1_ADDR A:0xfcb4aa04
y.create.l HWIO_PDCCH_REG_REORDER_WORD2_ADDR A:0xfcb4aa08
y.create.l HWIO_PDCCH_REG_REORDER_WORD3_ADDR A:0xfcb4aa0c
y.create.l HWIO_PDCCH_REG_REORDER_WORD4_ADDR A:0xfcb4aa10
y.create.l HWIO_PBCH_FOH_WORD0_ADDR A:0xfcb4ab00
y.create.l HWIO_PBCH_FOH_WORD1_ADDR A:0xfcb4ab04
y.create.l HWIO_PBCH_FOH_WORD2_ADDR A:0xfcb4ab08
y.create.l HWIO_PDSCH_REENC_TB_CFG_WORD0_ADDR A:0xfcb4b100
y.create.l HWIO_PDSCH_REENC_TB_CFG_WORD1_ADDR A:0xfcb4b104
y.create.l HWIO_PDSCH_REENC_TB_CFG_WORD2_ADDR A:0xfcb4b108
y.create.l HWIO_PDSCH_REENC_CB_WORD0_ADDR A:0xfcb4b200
y.create.l HWIO_PDSCH_REENC_CB_WORD1_ADDR A:0xfcb4b204
y.create.l HWIO_PDSCH_REENC_CB_WORD2_ADDR A:0xfcb4b208
y.create.l HWIO_PBCH_REENC_WORD0_ADDR A:0xfcb4b300
y.create.l HWIO_PBCH_REENC_WORD1_ADDR A:0xfcb4b304
y.create.l HWIO_PBCH_REENC_WORD2_ADDR A:0xfcb4b308
y.create.l HWIO_W_DBACK_HS_SHARED_WORD0_ADDR A:0xfcb4c100
y.create.l HWIO_W_DBACK_HS_SHARED_WORD1_ADDR A:0xfcb4c104
y.create.l HWIO_W_DBACK_HS_SHARED_WORD2_ADDR A:0xfcb4c108
y.create.l HWIO_W_DBACK_HS_SHARED_WORD3_ADDR A:0xfcb4c10c
y.create.l HWIO_W_DBACK_HS_SHARED_WORD4_ADDR A:0xfcb4c110
y.create.l HWIO_W_DBACK_HS_SHARED_WORD5_ADDR A:0xfcb4c114
y.create.l HWIO_W_DBACK_HS_SHARED_WORD6_ADDR A:0xfcb4c118
y.create.l HWIO_W_DBACK_HS_SHARED_WORD7_ADDR A:0xfcb4c11c
y.create.l HWIO_W_DBACK_HS_SHARED_WORD8_ADDR A:0xfcb4c120
y.create.l HWIO_W_DBACK_HS_SHARED_WORD9_ADDR A:0xfcb4c124
y.create.l HWIO_W_DBACK_HS_SHARED_WORD10_ADDR A:0xfcb4c128
y.create.l HWIO_W_DBACK_HS_SHARED_WORD11_ADDR A:0xfcb4c12c
y.create.l HWIO_W_DBACK_HS_SHARED_WORD12_ADDR A:0xfcb4c130
y.create.l HWIO_W_DBACK_HS_SHARED_WORD13_ADDR A:0xfcb4c134
y.create.l HWIO_W_DBACK_HS_SHARED_WORD14_ADDR A:0xfcb4c138
y.create.l HWIO_W_DBACK_HS_SHARED_WORD15_ADDR A:0xfcb4c13c
y.create.l HWIO_W_DBACK_HS_SHARED_WORD16_ADDR A:0xfcb4c140
y.create.l HWIO_W_DBACK_HS_SHARED_WORD17_ADDR A:0xfcb4c144
y.create.l HWIO_W_DBACK_HS_SHARED_WORD18_ADDR A:0xfcb4c148
y.create.l HWIO_W_DBACK_HS_SHARED_WORD19_ADDR A:0xfcb4c14c
y.create.l HWIO_W_DBACK_HS_SHARED_WORD20_ADDR A:0xfcb4c150
y.create.l HWIO_W_DBACK_HS_SHARED_WORD21_ADDR A:0xfcb4c154
y.create.l HWIO_W_DBACK_HS_SHARED_WORD22_ADDR A:0xfcb4c158
y.create.l HWIO_W_DBACK_HS_SHARED_WORD23_ADDR A:0xfcb4c15c
y.create.l HWIO_W_DBACK_HS_SHARED_WORD24_ADDR A:0xfcb4c160
y.create.l HWIO_W_DBACK_HS_SHARED_WORD25_ADDR A:0xfcb4c164
y.create.l HWIO_W_DBACK_HS_SHARED_WORD26_ADDR A:0xfcb4c168
y.create.l HWIO_W_DBACK_HS_SHARED_WORD27_ADDR A:0xfcb4c16c
y.create.l HWIO_W_DBACK_HS_SHARED_WORD28_ADDR A:0xfcb4c170
y.create.l HWIO_W_DBACK_HS_SHARED_WORD29_ADDR A:0xfcb4c174
y.create.l HWIO_W_DBACK_HS_SHARED_WORD30_ADDR A:0xfcb4c178
y.create.l HWIO_W_DBACK_HS_SHARED_WORD31_ADDR A:0xfcb4c17c
y.create.l HWIO_W_DBACK_HS_SHARED_WORD32_ADDR A:0xfcb4c180
y.create.l HWIO_W_DBACK_HS_SHARED_WORD33_ADDR A:0xfcb4c184
y.create.l HWIO_W_DBACK_HS_SHARED_WORD34_ADDR A:0xfcb4c188
y.create.l HWIO_W_DBACK_HS_SHARED_WORD35_ADDR A:0xfcb4c18c
y.create.l HWIO_W_DBACK_HS_SHARED_WORD36_ADDR A:0xfcb4c190
y.create.l HWIO_W_DBACK_HS_SHARED_WORD37_ADDR A:0xfcb4c194
y.create.l HWIO_W_DBACK_HS_SHARED_WORD38_ADDR A:0xfcb4c198
y.create.l HWIO_W_DBACK_HS_SHARED_WORD39_ADDR A:0xfcb4c19c
y.create.l HWIO_W_DBACK_HS_SHARED_WORD40_ADDR A:0xfcb4c1a0
y.create.l HWIO_W_DBACK_HS_SHARED_WORD41_ADDR A:0xfcb4c1a4
y.create.l HWIO_W_DBACK_HS_SHARED_WORD42_ADDR A:0xfcb4c1a8
y.create.l HWIO_W_DBACK_HS_SHARED_WORD43_ADDR A:0xfcb4c1ac
y.create.l HWIO_W_DBACK_HS_SHARED_WORD44_ADDR A:0xfcb4c1b0
y.create.l HWIO_W_DBACK_HS_SHARED_WORD45_ADDR A:0xfcb4c1b4
y.create.l HWIO_W_DBACK_HS_SHARED_WORD46_ADDR A:0xfcb4c1b8
y.create.l HWIO_W_DBACK_HS_SHARED_WORD47_ADDR A:0xfcb4c1bc
y.create.l HWIO_W_DBACK_HS_SHARED_WORD48_ADDR A:0xfcb4c1c0
y.create.l HWIO_W_DBACK_HS_SHARED_WORD49_ADDR A:0xfcb4c1c4
y.create.l HWIO_W_DBACK_HS_SHARED_WORD50_ADDR A:0xfcb4c1c8
y.create.l HWIO_W_DBACK_HS_SHARED_WORD51_ADDR A:0xfcb4c1cc
y.create.l HWIO_W_DBACK_HS_SHARED_WORD52_ADDR A:0xfcb4c1d0
y.create.l HWIO_W_DBACK_HS_SHARED_WORD53_ADDR A:0xfcb4c1d4
y.create.l HWIO_W_DBACK_HS_SHARED_WORD54_ADDR A:0xfcb4c1d8
y.create.l HWIO_W_DBACK_HS_SHARED_WORD55_ADDR A:0xfcb4c1dc
y.create.l HWIO_W_DBACK_HS_SHARED_WORD56_ADDR A:0xfcb4c1e0
y.create.l HWIO_W_DBACK_HS_SHARED_WORD57_ADDR A:0xfcb4c1e4
y.create.l HWIO_W_DBACK_HS_TD_DECIB_WRITER_WORD0_ADDR A:0xfcb4c200
y.create.l HWIO_W_DBACK_HS_TD_DECIB_WRITER_CFG_WORD0_ADDR A:0xfcb4c300
y.create.l HWIO_W_DBACK_HS_TD_DECIB_WRITER_CFG_WORD1_ADDR A:0xfcb4c304
y.create.l HWIO_W_DBACK_HS_TD_DECIB_WRITER_CFG_WORD2_ADDR A:0xfcb4c308
y.create.l HWIO_W_DBACK_HS_TD_DECIB_WRITER_CFG_WORD3_ADDR A:0xfcb4c30c
y.create.l HWIO_W_DBACK_HS_TD_DECIB_WRITER_CFG_WORD4_ADDR A:0xfcb4c310
y.create.l HWIO_W_DBACK_HS_TD_DECIB_WRITER_CFG_WORD5_ADDR A:0xfcb4c314
y.create.l HWIO_W_DBACK_HS_TD_DECIB_WRITER_CFG_WORD6_ADDR A:0xfcb4c318
y.create.l HWIO_W_DBACK_HS_TD_DECIB_WRITER_CFG_WORD7_ADDR A:0xfcb4c31c
y.create.l HWIO_W_DBACK_NONHS_SHARED_WORD0_ADDR A:0xfcb4d100
y.create.l HWIO_W_DBACK_NONHS_SHARED_WORD1_ADDR A:0xfcb4d104
y.create.l HWIO_W_DBACK_NONHS_SHARED_WORD2_ADDR A:0xfcb4d108
y.create.l HWIO_W_DBACK_NONHS_SHARED_WORD3_ADDR A:0xfcb4d10c
y.create.l HWIO_W_DBACK_NONHS_SHARED_WORD4_ADDR A:0xfcb4d110
y.create.l HWIO_W_DBACK_NONHS_SHARED_WORD5_ADDR A:0xfcb4d114
y.create.l HWIO_W_DBACK_NONHS_SHARED_WORD6_ADDR A:0xfcb4d118
y.create.l HWIO_W_DBACK_NONHS_SHARED_WORD7_ADDR A:0xfcb4d11c
y.create.l HWIO_W_DBACK_NONHS_DRM_CFG_WORD0_ADDR A:0xfcb4d200
y.create.l HWIO_W_DBACK_NONHS_DRM_CFG_WORD1_ADDR A:0xfcb4d204
y.create.l HWIO_W_DBACK_NONHS_DRM_CFG_WORD2_ADDR A:0xfcb4d208
y.create.l HWIO_W_DBACK_NONHS_DRM_CFG_WORD3_ADDR A:0xfcb4d20c
y.create.l HWIO_W_DBACK_NONHS_DRM_CFG_WORD4_ADDR A:0xfcb4d210
y.create.l HWIO_W_DBACK_NONHS_DRM_CFG_WORD5_ADDR A:0xfcb4d214
y.create.l HWIO_W_DBACK_NONHS_DRM_CFG_WORD6_ADDR A:0xfcb4d218
y.create.l HWIO_W_DBACK_NONHS_DRM_CFG_WORD7_ADDR A:0xfcb4d21c
y.create.l HWIO_W_DBACK_NONHS_DRM_CFG_WORD8_ADDR A:0xfcb4d220
y.create.l HWIO_W_DBACK_NONHS_DRM_CFG_WORD9_ADDR A:0xfcb4d224
y.create.l HWIO_W_DBACK_NONHS_DRM_CFG_WORD10_ADDR A:0xfcb4d228
y.create.l HWIO_W_DBACK_NONHS_DRM_CFG_WORD11_ADDR A:0xfcb4d22c
y.create.l HWIO_W_DBACK_NONHS_DRM_CFG_WORD12_ADDR A:0xfcb4d230
y.create.l HWIO_W_DBACK_NONHS_DRM_CFG_WORD13_ADDR A:0xfcb4d234
y.create.l HWIO_W_DBACK_NONHS_DRM_CFG_WORD14_ADDR A:0xfcb4d238
y.create.l HWIO_W_DBACK_NONHS_DRM_CFG_WORD15_ADDR A:0xfcb4d23c
y.create.l HWIO_W_DBACK_NONHS_TD_DECIB_WRITER_CFG_WORD0_ADDR A:0xfcb4d300
y.create.l HWIO_W_DBACK_NONHS_TD_DECIB_WRITER_CFG_WORD1_ADDR A:0xfcb4d304
y.create.l HWIO_T_DBACK_SHARED_WORD0_ADDR A:0xfcb4e100
y.create.l HWIO_T_DBACK_SHARED_WORD1_ADDR A:0xfcb4e104
y.create.l HWIO_T_DBACK_SHARED_WORD2_ADDR A:0xfcb4e108
y.create.l HWIO_T_DBACK_SHARED_WORD3_ADDR A:0xfcb4e10c
y.create.l HWIO_T_DBACK_SHARED_WORD4_ADDR A:0xfcb4e110
y.create.l HWIO_T_DBACK_SHARED_WORD5_ADDR A:0xfcb4e114
y.create.l HWIO_T_DBACK_SHARED_WORD6_ADDR A:0xfcb4e118
y.create.l HWIO_T_DBACK_SHARED_WORD7_ADDR A:0xfcb4e11c
y.create.l HWIO_T_DBACK_SHARED_WORD8_ADDR A:0xfcb4e120
y.create.l HWIO_T_DBACK_SHARED_WORD9_ADDR A:0xfcb4e124
y.create.l HWIO_T_DBACK_SHARED_WORD10_ADDR A:0xfcb4e128
y.create.l HWIO_T_DBACK_SHARED_WORD11_ADDR A:0xfcb4e12c
y.create.l HWIO_T_DBACK_SHARED_WORD12_ADDR A:0xfcb4e130
y.create.l HWIO_T_DBACK_SHARED_WORD13_ADDR A:0xfcb4e134
y.create.l HWIO_T_DBACK_SHARED_WORD14_ADDR A:0xfcb4e138
y.create.l HWIO_T_DBACK_SHARED_WORD15_ADDR A:0xfcb4e13c
y.create.l HWIO_T_DBACK_SHARED_WORD16_ADDR A:0xfcb4e140
y.create.l HWIO_T_DBACK_SHARED_WORD17_ADDR A:0xfcb4e144
y.create.l HWIO_T_DBACK_SHARED_WORD18_ADDR A:0xfcb4e148
y.create.l HWIO_T_DBACK_SHARED_WORD19_ADDR A:0xfcb4e14c
y.create.l HWIO_T_DBACK_SHARED_WORD20_ADDR A:0xfcb4e150
y.create.l HWIO_T_DBACK_SHARED_WORD21_ADDR A:0xfcb4e154
y.create.l HWIO_T_DBACK_SHARED_WORD22_ADDR A:0xfcb4e158
y.create.l HWIO_T_DBACK_SHARED_WORD23_ADDR A:0xfcb4e15c
y.create.l HWIO_T_DBACK_SHARED_WORD24_ADDR A:0xfcb4e160
y.create.l HWIO_T_DBACK_SHARED_WORD25_ADDR A:0xfcb4e164
y.create.l HWIO_T_DBACK_SHARED_WORD26_ADDR A:0xfcb4e168
y.create.l HWIO_T_DBACK_SHARED_WORD27_ADDR A:0xfcb4e16c
y.create.l HWIO_T_DBACK_SHARED_WORD28_ADDR A:0xfcb4e170
y.create.l HWIO_T_DBACK_SHARED_WORD29_ADDR A:0xfcb4e174
y.create.l HWIO_T_DBACK_SHARED_WORD30_ADDR A:0xfcb4e178
y.create.l HWIO_T_DBACK_SHARED_WORD31_ADDR A:0xfcb4e17c
y.create.l HWIO_T_DBACK_SHARED_WORD32_ADDR A:0xfcb4e180
y.create.l HWIO_T_DBACK_SHARED_WORD33_ADDR A:0xfcb4e184
y.create.l HWIO_T_DBACK_SHARED_WORD34_ADDR A:0xfcb4e188
y.create.l HWIO_T_DBACK_SHARED_WORD35_ADDR A:0xfcb4e18c
y.create.l HWIO_T_DBACK_SHARED_WORD36_ADDR A:0xfcb4e190
y.create.l HWIO_T_DBACK_SHARED_WORD37_ADDR A:0xfcb4e194
y.create.l HWIO_T_DBACK_NONHS_DRM_CFG_WORD0_ADDR A:0xfcb4e200
y.create.l HWIO_T_DBACK_NONHS_DRM_CFG_WORD1_ADDR A:0xfcb4e204
y.create.l HWIO_T_DBACK_NONHS_DRM_CFG_WORD2_ADDR A:0xfcb4e208
y.create.l HWIO_T_DBACK_NONHS_DRM_CFG_WORD3_ADDR A:0xfcb4e20c
y.create.l HWIO_T_DBACK_NONHS_DRM_CFG_WORD4_ADDR A:0xfcb4e210
y.create.l HWIO_T_DBACK_NONHS_DRM_CFG_WORD5_ADDR A:0xfcb4e214
y.create.l HWIO_T_DBACK_NONHS_DRM_CFG_WORD6_ADDR A:0xfcb4e218
y.create.l HWIO_T_DBACK_NONHS_DRM_CFG_WORD7_ADDR A:0xfcb4e21c
y.create.l HWIO_T_DBACK_NONHS_DRM_CFG_WORD8_ADDR A:0xfcb4e220
y.create.l HWIO_T_DBACK_NONHS_DRM_CFG_WORD9_ADDR A:0xfcb4e224
y.create.l HWIO_T_DBACK_NONHS_DRM_CFG_WORD10_ADDR A:0xfcb4e228
y.create.l HWIO_T_DBACK_NONHS_DRM_CFG_WORD11_ADDR A:0xfcb4e22c
y.create.l HWIO_T_DBACK_NONHS_DRM_CFG_WORD12_ADDR A:0xfcb4e230
y.create.l HWIO_T_DBACK_NONHS_DRM_CFG_WORD13_ADDR A:0xfcb4e234
y.create.l HWIO_T_DBACK_NONHS_DRM_CFG_WORD14_ADDR A:0xfcb4e238
y.create.l HWIO_T_DBACK_NONHS_DRM_CFG_WORD15_ADDR A:0xfcb4e23c
y.create.l HWIO_T_DBACK_NONHS_DRM_CFG_WORD16_ADDR A:0xfcb4e240
y.create.l HWIO_T_DBACK_NONHS_DRM_CFG_WORD17_ADDR A:0xfcb4e244
y.create.l HWIO_T_DBACK_NONHS_DRM_CFG_WORD18_ADDR A:0xfcb4e248
y.create.l HWIO_T_DBACK_NONHS_DRM_CFG_WORD19_ADDR A:0xfcb4e24c
y.create.l HWIO_T_DBACK_NONHS_DRM_CFG_WORD20_ADDR A:0xfcb4e250
y.create.l HWIO_T_DBACK_NONHS_DRM_CFG_WORD21_ADDR A:0xfcb4e254
y.create.l HWIO_T_DBACK_NONHS_DRM_CFG_WORD22_ADDR A:0xfcb4e258
y.create.l HWIO_T_DBACK_NONHS_DRM_CFG_WORD23_ADDR A:0xfcb4e25c
y.create.l HWIO_T_DBACK_NONHS_DRM_CFG_WORD24_ADDR A:0xfcb4e260
y.create.l HWIO_T_DBACK_NONHS_DRM_CFG_WORD25_ADDR A:0xfcb4e264
y.create.l HWIO_T_DBACK_NONHS_TD_DECIB_WRITER_CFG_WORD0_ADDR A:0xfcb4e300
y.create.l HWIO_T_DBACK_NONHS_TD_DECIB_WRITER_CFG_WORD1_ADDR A:0xfcb4e304
y.create.l HWIO_T_DBACK_HS_TD_DECIB_WRITER_CFG_WORD0_ADDR A:0xfcb4e400
y.create.l HWIO_T_DBACK_HS_TD_DECIB_WRITER_CFG_WORD1_ADDR A:0xfcb4e404
y.create.l HWIO_T_DBACK_HS_TD_DECIB_WRITER_CFG_WORD2_ADDR A:0xfcb4e408
y.create.l HWIO_T_DBACK_HS_TD_DECIB_WRITER_CFG_WORD3_ADDR A:0xfcb4e40c
y.create.l HWIO_T_DBACK_HS_TD_DECIB_WRITER_CFG_WORD4_ADDR A:0xfcb4e410
y.create.l HWIO_T_DBACK_HS_TD_DECIB_WRITER_CFG_WORD5_ADDR A:0xfcb4e414
y.create.l HWIO_T_DBACK_HS_TD_DECIB_WRITER_CFG_WORD6_ADDR A:0xfcb4e418
y.create.l HWIO_T_DBACK_HS_TD_DECIB_WRITER_CFG_WORD7_ADDR A:0xfcb4e41c
y.create.l HWIO_HDR_DEINT_CFG_WORD0_ADDR A:0xfcb4f100
y.create.l HWIO_HDR_DEINT_CFG_WORD1_ADDR A:0xfcb4f104
y.create.l HWIO_HDR_DEINT_CFG_WORD2_ADDR A:0xfcb4f108
y.create.l HWIO_HDR_DEINT_CFG_WORD3_ADDR A:0xfcb4f10c
y.create.l HWIO_HDR_DEINT_CFG_WORD4_ADDR A:0xfcb4f110
y.create.l HWIO_HDR_DEINT_CFG_WORD5_ADDR A:0xfcb4f114
y.create.l HWIO_HDR_DEINT_CFG_WORD6_ADDR A:0xfcb4f118
y.create.l HWIO_HDR_DEINT_CFG_WORD7_ADDR A:0xfcb4f11c
y.create.l HWIO_HDR_DEINT_CFG_WORD8_ADDR A:0xfcb4f120
y.create.l HWIO_HDR_DEINT_CFG_WORD9_ADDR A:0xfcb4f124
y.create.l HWIO_HDR_DEINT_CFG_WORD10_ADDR A:0xfcb4f128
y.create.l HWIO_HDR_DEINT_CFG_WORD11_ADDR A:0xfcb4f12c
y.create.l HWIO_HDR_DEINT_CFG_WORD12_ADDR A:0xfcb4f130
y.create.l HWIO_HDR_DEINT_CFG_WORD13_ADDR A:0xfcb4f134
y.create.l HWIO_HDR_DEINT_CFG_WORD14_ADDR A:0xfcb4f138
y.create.l HWIO_HDR_DEINT_CFG_WORD15_ADDR A:0xfcb4f13c
y.create.l HWIO_HDR_DEINT_CFG_WORD16_ADDR A:0xfcb4f140
y.create.l HWIO_HDR_DEINT_WORD0_ADDR A:0xfcb4f200
y.create.l HWIO_HDR_DEINT_WORD1_ADDR A:0xfcb4f204
y.create.l HWIO_HDR_DEINT_WORD2_ADDR A:0xfcb4f208
y.create.l HWIO_HDR_DEINT_WORD3_ADDR A:0xfcb4f20c
y.create.l HWIO_HDR_DEINT_WORD4_ADDR A:0xfcb4f210
y.create.l HWIO_HDR_DEINT_WORD5_ADDR A:0xfcb4f214
y.create.l HWIO_HDR_DEINT_WORD6_ADDR A:0xfcb4f218
y.create.l HWIO_HDR_DEINT_WORD7_ADDR A:0xfcb4f21c
y.create.l HWIO_HDR_DEINT_WORD8_ADDR A:0xfcb4f220
y.create.l HWIO_HDR_DEINT_WORD9_ADDR A:0xfcb4f224
y.create.l HWIO_HDR_DEINT_WORD10_ADDR A:0xfcb4f228
y.create.l HWIO_HDR_DEINT_WORD11_ADDR A:0xfcb4f22c
y.create.l HWIO_HDR_DEINT_WORD12_ADDR A:0xfcb4f230
y.create.l HWIO_HDR_DEINT_WORD13_ADDR A:0xfcb4f234
y.create.l HWIO_TBVD_CCH_STATUS_WORD0_ADDR A:0xfcb50000
y.create.l HWIO_TBVD_CCH_LTE_CFG_WORD0_ADDR A:0xfcb50100
y.create.l HWIO_TBVD_CCH_LTE_CFG_WORD1_ADDR A:0xfcb50104
y.create.l HWIO_TBVD_CCH_LTE_CFG_WORD2_ADDR A:0xfcb50108
y.create.l HWIO_TBVD_CCH_LTE_CFG_WORD3_ADDR A:0xfcb5010c
y.create.l HWIO_TBVD_CCH_LTE_CFG_WORD4_ADDR A:0xfcb50110
y.create.l HWIO_TBVD_CCH_LTE_CFG_WORD5_ADDR A:0xfcb50114
y.create.l HWIO_TBVD_CCH_LTE_CFG_WORD6_ADDR A:0xfcb50118
y.create.l HWIO_TBVD_CCH_LTE_CFG_WORD7_ADDR A:0xfcb5011c
y.create.l HWIO_TBVD_CCH_LTE_CFG_WORD8_ADDR A:0xfcb50120
y.create.l HWIO_TBVD_CCH_LTE_CFG_WORD9_ADDR A:0xfcb50124
y.create.l HWIO_TBVD_CCH_LTE_CFG_WORD10_ADDR A:0xfcb50128
y.create.l HWIO_TBVD_CCH_LTE_CFG_WORD11_ADDR A:0xfcb5012c
y.create.l HWIO_TBVD_CCH_LTE_CFG_WORD12_ADDR A:0xfcb50130
y.create.l HWIO_TBVD_CCH_LTE_CFG_WORD13_ADDR A:0xfcb50134
y.create.l HWIO_TBVD_CCH_LTE_CFG_WORD14_ADDR A:0xfcb50138
y.create.l HWIO_TBVD_CCH_LTE_CFG_WORD15_ADDR A:0xfcb5013c
y.create.l HWIO_TBVD_CCH_LTE_CFG_WORD16_ADDR A:0xfcb50140
y.create.l HWIO_TBVD_CCH_LTE_CFG_WORD17_ADDR A:0xfcb50144
y.create.l HWIO_TBVD_CCH_LTE_CFG_WORD18_ADDR A:0xfcb50148
y.create.l HWIO_TBVD_CCH_LTE_CFG_WORD19_ADDR A:0xfcb5014c
y.create.l HWIO_TBVD_CCH_LTE_PDCCH_WORD0_ADDR A:0xfcb50200
y.create.l HWIO_TBVD_CCH_LTE_PDCCH_WORD1_ADDR A:0xfcb50204
y.create.l HWIO_TBVD_CCH_LTE_PDCCH_WORD2_ADDR A:0xfcb50208
y.create.l HWIO_TBVD_CCH_LTE_PDCCH_WORD3_ADDR A:0xfcb5020c
y.create.l HWIO_TBVD_CCH_LTE_PDCCH_WORD4_ADDR A:0xfcb50210
y.create.l HWIO_TBVD_CCH_LTE_PDCCH_WORD5_ADDR A:0xfcb50214
y.create.l HWIO_TBVD_CCH_LTE_PDCCH_WORD6_ADDR A:0xfcb50218
y.create.l HWIO_DEC_O_CCH_W_NONHS_LTE_PBCH_WORD0_ADDR A:0xfcb50300
y.create.l HWIO_DEC_O_CCH_W_NONHS_LTE_PBCH_WORD1_ADDR A:0xfcb50304
y.create.l HWIO_DEC_O_CCH_W_NONHS_LTE_PBCH_WORD2_ADDR A:0xfcb50308
y.create.l HWIO_DEMBACK_ENABLE_ADDR A:0xfcb54000
y.create.l HWIO_DEMBACK_BUFF_MODE_ADDR A:0xfcb54004
y.create.l HWIO_DEMBACK_BUFF_MEM_CMD_ADDR A:0xfcb54010
y.create.l HWIO_DEMBACK_BUFF_MEM_WR_ADDR A:0xfcb54014
y.create.l HWIO_DEMBACK_BUFF_MEM_RD_ADDR A:0xfcb54018
y.create.l HWIO_DEMBACK_BUFF_TBVD_DECOB_RD_MIN_ADDR A:0xfcb55000
y.create.l HWIO_DEMBACK_BUFF_TBVD_DECOB_RD_MAX_ADDR A:0xfcb5577c
y.create.l HWIO_DEMBACK_BUFF_SVD_DECOB_RD_MIN_ADDR A:0xfcb56000
y.create.l HWIO_DEMBACK_BUFF_SVD_DECOB_RD_MAX_ADDR A:0xfcb56d7c
y.create.l HWIO_TDEC_CLK_CTL_ADDR A:0xfcb3c000
y.create.l HWIO_TDEC_SW_CLK_EN_ADDR A:0xfcb3c004
y.create.l HWIO_TDEC_CLK_STATUS_REG_ADDR A:0xfcb3c008
y.create.l HWIO_TDEC_MODE_CTL_ADDR A:0xfcb3c00c
y.create.l HWIO_TDECIB_CLK_CTL_ADDR A:0xfcb3c010
y.create.l HWIO_TDECIB_SW_CLK_EN_ADDR A:0xfcb3c014
y.create.l HWIO_TDECIB_CLK_STATUS_ADDR A:0xfcb3c018
y.create.l HWIO_TD_COMMON_CFG0_ADDR A:0xfcb3c020
y.create.l HWIO_TD_COMMON_CFG1_ADDR A:0xfcb3c024
y.create.l HWIO_TD_COMMON_CFG2_ADDR A:0xfcb3c028
y.create.l HWIO_TD_COMMON_CFG3_ADDR A:0xfcb3c02c
y.create.l HWIO_TD_COMMON_CFG4_ADDR A:0xfcb3c030
y.create.l HWIO_TD_COMMON_CFG5_ADDR A:0xfcb3c034
y.create.l HWIO_TD_COMMON_START_ADDR A:0xfcb3c038
y.create.l HWIO_TD_1X_CFG_ADDR A:0xfcb3c03c
y.create.l HWIO_TD_1X_DECOB_WRITE_PTR_ADDR A:0xfcb3c040
y.create.l HWIO_TDEC_HW_IDLE_ADDR A:0xfcb3c044
y.create.l HWIO_TDEC_PING_STATUS_0_ADDR A:0xfcb3c048
y.create.l HWIO_TDEC_PING_STATUS_1_ADDR A:0xfcb3c04c
y.create.l HWIO_TDEC_PONG_STATUS_0_ADDR A:0xfcb3c050
y.create.l HWIO_TDEC_PONG_STATUS_1_ADDR A:0xfcb3c054
y.create.l HWIO_TDEC_GERAN_STATUS_0_ADDR A:0xfcb3c058
y.create.l HWIO_TDEC_GERAN_STATUS_1_ADDR A:0xfcb3c05c
y.create.l HWIO_TDEC_TESTBUS_ENABLE_ADDR A:0xfcb3c060
y.create.l HWIO_TDEC_TESTBUS_STATUS_ADDR A:0xfcb3c064
y.create.l HWIO_DECIB_PAGE_ID_ADDR A:0xfcb3c068
y.create.l HWIO_TDEC_AHB_ERROR_ADDR_RD_ADDR A:0xfcb3c070
y.create.l HWIO_TEST_CRC_000_RD_ADDR A:0xfcb3c074
y.create.l HWIO_TEST_CRC_001_RD_ADDR A:0xfcb3c078
y.create.l HWIO_TEST_CRC_010_RD_ADDR A:0xfcb3c07c
y.create.l HWIO_TEST_CRC_011_RD_ADDR A:0xfcb3c080
y.create.l HWIO_TEST_CRC_100_RD_ADDR A:0xfcb3c084
y.create.l HWIO_TEST_CRC_101_RD_ADDR A:0xfcb3c088
y.create.l HWIO_TEST_CRC_110_RD_ADDR A:0xfcb3c08c
y.create.l HWIO_TEST_CRC_111_RD_ADDR A:0xfcb3c090
y.create.l HWIO_A2_TEST_SW_CFG_DATA0_ADDR A:0xfcb3c094
y.create.l HWIO_A2_TEST_SW_CFG_DATA1_ADDR A:0xfcb3c098
y.create.l HWIO_A2_TEST_SW_CFG_DATA2_ADDR A:0xfcb3c09c
y.create.l HWIO_A2_TEST_SW_CFG_DATA3_ADDR A:0xfcb3c0a0
y.create.l HWIO_A2_TEST_SW_CFG_DATA4_ADDR A:0xfcb3c0a4
y.create.l HWIO_TD_CFG_STATUS_WORD0_ADDR A:0xfcb3d000
y.create.l HWIO_LTE_CFG_WORD0_ADDR A:0xfcb3d100
y.create.l HWIO_LTE_CFG_WORD1_ADDR A:0xfcb3d104
y.create.l HWIO_LTE_CFG_WORD2_ADDR A:0xfcb3d108
y.create.l HWIO_W_TD_CFG_WORD0_0_ADDR A:0xfcb3d200
y.create.l HWIO_W_TD_CFG_WORD1_0_ADDR A:0xfcb3d204
y.create.l HWIO_W_TD_CFG_WORD2_0_ADDR A:0xfcb3d208
y.create.l HWIO_W_TD_CFG_WORD3_0_ADDR A:0xfcb3d20c
y.create.l HWIO_W_TD_CFG_WORD4_0_ADDR A:0xfcb3d210
y.create.l HWIO_W_TD_CFG_WORD5_0_ADDR A:0xfcb3d214
y.create.l HWIO_W_TD_CFG_WORD6_0_ADDR A:0xfcb3d218
y.create.l HWIO_W_TD_CFG_WORD7_0_ADDR A:0xfcb3d21c
y.create.l HWIO_W_TD_CFG_WORD8_0_ADDR A:0xfcb3d220
y.create.l HWIO_W_TD_CFG_WORD9_0_ADDR A:0xfcb3d224
y.create.l HWIO_W_TD_CFG_WORD0_1_ADDR A:0xfcb3d300
y.create.l HWIO_W_TD_CFG_WORD1_1_ADDR A:0xfcb3d304
y.create.l HWIO_W_TD_CFG_WORD2_1_ADDR A:0xfcb3d308
y.create.l HWIO_W_TD_CFG_WORD3_1_ADDR A:0xfcb3d30c
y.create.l HWIO_W_TD_CFG_WORD4_1_ADDR A:0xfcb3d310
y.create.l HWIO_W_TD_CFG_WORD5_1_ADDR A:0xfcb3d314
y.create.l HWIO_W_TD_CFG_WORD6_1_ADDR A:0xfcb3d318
y.create.l HWIO_W_TD_CFG_WORD7_1_ADDR A:0xfcb3d31c
y.create.l HWIO_W_TD_CFG_WORD8_1_ADDR A:0xfcb3d320
y.create.l HWIO_W_TD_CFG_WORD9_1_ADDR A:0xfcb3d324
y.create.l HWIO_LTE_TRBLK_CFG_WORD0_0_ADDR A:0xfcb3d400
y.create.l HWIO_LTE_TRBLK_CFG_WORD1_0_ADDR A:0xfcb3d404
y.create.l HWIO_LTE_TRBLK_CFG_WORD2_0_ADDR A:0xfcb3d408
y.create.l HWIO_LTE_TRBLK_CFG_WORD3_0_ADDR A:0xfcb3d40c
y.create.l HWIO_LTE_TRBLK_CFG_WORD4_0_ADDR A:0xfcb3d410
y.create.l HWIO_LTE_TRBLK_CFG_WORD5_0_ADDR A:0xfcb3d414
y.create.l HWIO_LTE_TRBLK_CFG_WORD0_1_ADDR A:0xfcb3d500
y.create.l HWIO_LTE_TRBLK_CFG_WORD1_1_ADDR A:0xfcb3d504
y.create.l HWIO_LTE_TRBLK_CFG_WORD2_1_ADDR A:0xfcb3d508
y.create.l HWIO_LTE_TRBLK_CFG_WORD3_1_ADDR A:0xfcb3d50c
y.create.l HWIO_LTE_TRBLK_CFG_WORD4_1_ADDR A:0xfcb3d510
y.create.l HWIO_LTE_TRBLK_CFG_WORD5_1_ADDR A:0xfcb3d514
y.create.l HWIO_GERAN_TD_CFG_WORD0_0_ADDR A:0xfcb3d600
y.create.l HWIO_GERAN_TD_CFG_WORD1_0_ADDR A:0xfcb3d604
y.create.l HWIO_GERAN_TD_CFG_WORD2_0_ADDR A:0xfcb3d608
y.create.l HWIO_GERAN_TD_CFG_WORD3_0_ADDR A:0xfcb3d60c
y.create.l HWIO_GERAN_TD_CFG_WORD0_1_ADDR A:0xfcb3d700
y.create.l HWIO_GERAN_TD_CFG_WORD1_1_ADDR A:0xfcb3d704
y.create.l HWIO_GERAN_TD_CFG_WORD2_1_ADDR A:0xfcb3d708
y.create.l HWIO_GERAN_TD_CFG_WORD3_1_ADDR A:0xfcb3d70c
y.create.l HWIO_HDR_TD_CFG_WORD0_0_ADDR A:0xfcb3d800
y.create.l HWIO_HDR_TD_CFG_WORD1_0_ADDR A:0xfcb3d804
y.create.l HWIO_HDR_TD_CFG_WORD2_0_ADDR A:0xfcb3d808
y.create.l HWIO_HDR_TD_CFG_WORD0_1_ADDR A:0xfcb3d900
y.create.l HWIO_HDR_TD_CFG_WORD1_1_ADDR A:0xfcb3d904
y.create.l HWIO_HDR_TD_CFG_WORD2_1_ADDR A:0xfcb3d908
y.create.l HWIO_TD_STATUS_WORD0_ADDR A:0xfcb3e000
y.create.l HWIO_W_TD_WORD0_0_ADDR A:0xfcb3e100
y.create.l HWIO_W_TD_WORD0_1_ADDR A:0xfcb3e200
y.create.l HWIO_LTE_PDSCH_WORD0_0_ADDR A:0xfcb3e300
y.create.l HWIO_LTE_PDSCH_WORD1_0_ADDR A:0xfcb3e304
y.create.l HWIO_LTE_PDSCH_WORD2_0_ADDR A:0xfcb3e308
y.create.l HWIO_LTE_PDSCH_WORD0_1_ADDR A:0xfcb3e400
y.create.l HWIO_LTE_PDSCH_WORD1_1_ADDR A:0xfcb3e404
y.create.l HWIO_LTE_PDSCH_WORD2_1_ADDR A:0xfcb3e408
y.create.l HWIO_GERAN_TD_WORD0_0_ADDR A:0xfcb3e500
y.create.l HWIO_GERAN_TD_WORD1_0_ADDR A:0xfcb3e504
y.create.l HWIO_GERAN_TD_WORD2_0_ADDR A:0xfcb3e508
y.create.l HWIO_GERAN_TD_WORD3_0_ADDR A:0xfcb3e50c
y.create.l HWIO_GERAN_TD_WORD4_0_ADDR A:0xfcb3e510
y.create.l HWIO_GERAN_TD_WORD5_0_ADDR A:0xfcb3e514
y.create.l HWIO_GERAN_TD_WORD6_0_ADDR A:0xfcb3e518
y.create.l HWIO_GERAN_TD_WORD0_1_ADDR A:0xfcb3e600
y.create.l HWIO_GERAN_TD_WORD1_1_ADDR A:0xfcb3e604
y.create.l HWIO_GERAN_TD_WORD2_1_ADDR A:0xfcb3e608
y.create.l HWIO_GERAN_TD_WORD3_1_ADDR A:0xfcb3e60c
y.create.l HWIO_GERAN_TD_WORD4_1_ADDR A:0xfcb3e610
y.create.l HWIO_GERAN_TD_WORD5_1_ADDR A:0xfcb3e614
y.create.l HWIO_GERAN_TD_WORD6_1_ADDR A:0xfcb3e618
y.create.l HWIO_HDR_TD_WORD0_0_ADDR A:0xfcb3e700
y.create.l HWIO_HDR_TD_WORD1_0_ADDR A:0xfcb3e704
y.create.l HWIO_HDR_TD_WORD2_0_ADDR A:0xfcb3e708
y.create.l HWIO_HDR_TD_WORD3_0_ADDR A:0xfcb3e70c
y.create.l HWIO_HDR_TD_WORD4_0_ADDR A:0xfcb3e710
y.create.l HWIO_HDR_TD_WORD5_0_ADDR A:0xfcb3e714
y.create.l HWIO_HDR_TD_WORD0_1_ADDR A:0xfcb3e800
y.create.l HWIO_HDR_TD_WORD1_1_ADDR A:0xfcb3e804
y.create.l HWIO_HDR_TD_WORD2_1_ADDR A:0xfcb3e808
y.create.l HWIO_HDR_TD_WORD3_1_ADDR A:0xfcb3e80c
y.create.l HWIO_HDR_TD_WORD4_1_ADDR A:0xfcb3e810
y.create.l HWIO_HDR_TD_WORD5_1_ADDR A:0xfcb3e814
y.create.l HWIO_TDECIB_MEM_START_ADDR A:0xfcb3f000
y.create.l HWIO_TDECIB_MEM_END_ADDR A:0xfcb3fffc
y.create.l HWIO_MEMSS_ENABLE_ADDR A:0xfcb38000
y.create.l HWIO_MEM_PL_BRDG_CH0_CFG0_ADDR A:0xfcb38004
y.create.l HWIO_MEM_PL_BRDG_CH1_CFG0_ADDR A:0xfcb38010
y.create.l HWIO_MEM_PL_BRDG_CH0_CFG1_ADDR A:0xfcb38008
y.create.l HWIO_MEM_PL_BRDG_CH1_CFG1_ADDR A:0xfcb38014
y.create.l HWIO_MEM_PL_MEM_CH0_PAGE_NUM_ADDR A:0xfcb3800c
y.create.l HWIO_MEM_PL_MEM_CH1_PAGE_NUM_ADDR A:0xfcb38018
y.create.l HWIO_MEM_PL_MEMSS_SLAVE_ERR_ADDR A:0xfcb3801c
y.create.l HWIO_MEM_PL_MEMSS_CLR_SLAVE_ERR_ADDR A:0xfcb38020
y.create.l HWIO_MEM_PL_BNK_GRP0_SLT_0_ADDR A:0xfcb38400
y.create.l HWIO_MEM_PL_BNK_GRP0_SLT_1_ADDR A:0xfcb38404
y.create.l HWIO_MEM_PL_BNK_GRP0_SLT_2_ADDR A:0xfcb38408
y.create.l HWIO_MEM_PL_BNK_GRP0_SLT_3_ADDR A:0xfcb3840c
y.create.l HWIO_MEM_PL_BNK_GRP1_SLT_0_ADDR A:0xfcb38480
y.create.l HWIO_MEM_PL_BNK_GRP1_SLT_1_ADDR A:0xfcb38484
y.create.l HWIO_MEM_PL_BNK_GRP1_SLT_2_ADDR A:0xfcb38488
y.create.l HWIO_MEM_PL_BNK_GRP1_SLT_3_ADDR A:0xfcb3848c
y.create.l HWIO_MEM_PL_TDM_UPDATE_ADDR A:0xfcb38500
y.create.l HWIO_USRCH_STATUS_ADDR A:0xfcb30000
y.create.l HWIO_USRCH_CONFIG_WORD0_ADDR A:0xfcb30100
y.create.l HWIO_USRCH_ACC_WORD0_ADDR A:0xfcb30200
y.create.l HWIO_USRCH_ACC_WORD1_ADDR A:0xfcb30204
y.create.l HWIO_USRCH_ACC_WORD2_ADDR A:0xfcb30208
y.create.l HWIO_USRCH_ACC_WORD3_ADDR A:0xfcb3020c
y.create.l HWIO_USRCH_ACC_WORD4_ADDR A:0xfcb30210
y.create.l HWIO_USRCH_ACC_WORD5_ADDR A:0xfcb30214
y.create.l HWIO_USRCH_ACC_WORD6_ADDR A:0xfcb30218
y.create.l HWIO_USRCH_ACC_WORD7_ADDR A:0xfcb3021c
y.create.l HWIO_USRCH_PEAK_SORT_WORD0_ADDR A:0xfcb30300
y.create.l HWIO_USRCH_PEAK_SORT_WORD1_ADDR A:0xfcb30304
y.create.l HWIO_USRCH_PEAK_SORT_WORD2_ADDR A:0xfcb30308
y.create.l HWIO_USRCH_PEAK_SORT_WORD3_ADDR A:0xfcb3030c
y.create.l HWIO_USRCH_PEAK_SORT_WORD4_ADDR A:0xfcb30310
y.create.l HWIO_USRCH_CMD_WORD0_ADDR A:0xfcb30400
y.create.l HWIO_USRCH_STATUS_BUS_0_ADDR A:0xfcb30500
y.create.l HWIO_USRCH_STATUS_BUS_1_ADDR A:0xfcb30504
y.create.l HWIO_USRCH_STATUS_BUS_2_ADDR A:0xfcb30508
y.create.l HWIO_USRCH_STATUS_BUS_3_ADDR A:0xfcb3050c
y.create.l HWIO_USRCH_STATUS_BUS_4_ADDR A:0xfcb30510
y.create.l HWIO_USRCH_STATUS_BUS_5_ADDR A:0xfcb30514
y.create.l HWIO_USRCH_STATUS_BUS_6_ADDR A:0xfcb30518
y.create.l HWIO_USRCH_STATUS_BUS_7_ADDR A:0xfcb3051c
y.create.l HWIO_USRCH_STATUS_BUS_8_ADDR A:0xfcb30520
y.create.l HWIO_USRCH_STATUS_BUS_9_ADDR A:0xfcb30524
y.create.l HWIO_USRCH_STATUS_BUS_10_ADDR A:0xfcb30528
y.create.l HWIO_USRCH_STATUS_BUS_11_ADDR A:0xfcb3052c
y.create.l HWIO_USRCH_STATUS_BUS_12_ADDR A:0xfcb30530
y.create.l HWIO_USRCH_STATUS_BUS_13_ADDR A:0xfcb30534
y.create.l HWIO_USRCH_STATUS_BUS_14_ADDR A:0xfcb30538
y.create.l HWIO_USRCH_STATUS_BUS_15_ADDR A:0xfcb3053c
y.create.l HWIO_USRCH_STATUS_BUS_16_ADDR A:0xfcb30540
y.create.l HWIO_USRCH_STATUS_BUS_17_ADDR A:0xfcb30544
y.create.l HWIO_USRCH_STATUS_BUS_18_ADDR A:0xfcb30548
y.create.l HWIO_USRCH_STATUS_BUS_19_ADDR A:0xfcb3054c
y.create.l HWIO_USRCH_STATUS_BUS_20_ADDR A:0xfcb30550
y.create.l HWIO_USRCH_STATUS_BUS_21_ADDR A:0xfcb30554
y.create.l HWIO_USRCH_STATUS_BUS_22_ADDR A:0xfcb30558
y.create.l HWIO_USRCH_STATUS_BUS_23_ADDR A:0xfcb3055c
y.create.l HWIO_USRCH_STATUS_BUS_24_ADDR A:0xfcb30560
y.create.l HWIO_USRCH_STATUS_BUS_25_ADDR A:0xfcb30564
y.create.l HWIO_USRCH_STATUS_BUS_26_ADDR A:0xfcb30568
y.create.l HWIO_USRCH_STATUS_BUS_27_ADDR A:0xfcb3056c
y.create.l HWIO_USRCH_STATUS_BUS_28_ADDR A:0xfcb30570
y.create.l HWIO_USRCH_STATUS_BUS_29_ADDR A:0xfcb30574
y.create.l HWIO_USRCH_STATUS_BUS_30_ADDR A:0xfcb30578
y.create.l HWIO_USRCH_STATUS_BUS_31_ADDR A:0xfcb3057c
y.create.l HWIO_USRCH_PS_RESULT_0_ADDR A:0xfcb30580
y.create.l HWIO_USRCH_PS_RESULT_1_WORD0_ADDR A:0xfcb30584
y.create.l HWIO_USRCH_PS_RESULT_1_WORD1_ADDR A:0xfcb30588
y.create.l HWIO_DEMSS_RDR0_CFG0_ADDR A:0xfcb32000
y.create.l HWIO_DEMSS_RDR0_CFG1_ADDR A:0xfcb32004
y.create.l HWIO_DEMSS_RDR0_XFER_CTL_ADDR A:0xfcb32008
y.create.l HWIO_DEMSS_RDR1_CFG0_0_ADDR A:0xfcb3200c
y.create.l HWIO_DEMSS_RDR1_CFG0_1_ADDR A:0xfcb32014
y.create.l HWIO_DEMSS_RDR1_CFG1_0_ADDR A:0xfcb32010
y.create.l HWIO_DEMSS_RDR1_CFG1_1_ADDR A:0xfcb32018
y.create.l HWIO_DEMSS_RDR1_XFER_CTL_ADDR A:0xfcb3201c
y.create.l HWIO_DEMSS_RDR2_CFG0_ADDR A:0xfcb32020
y.create.l HWIO_DEMSS_RDR2_CFG1_ADDR A:0xfcb32024
y.create.l HWIO_DEMSS_RDR2_XFER_CTL_ADDR A:0xfcb32028
y.create.l HWIO_DEMSS_RDR3_CFG0_0_ADDR A:0xfcb3202c
y.create.l HWIO_DEMSS_RDR3_CFG0_1_ADDR A:0xfcb32034
y.create.l HWIO_DEMSS_RDR3_CFG0_2_ADDR A:0xfcb3203c
y.create.l HWIO_DEMSS_RDR3_CFG0_3_ADDR A:0xfcb32044
y.create.l HWIO_DEMSS_RDR3_CFG0_4_ADDR A:0xfcb3204c
y.create.l HWIO_DEMSS_RDR3_CFG0_5_ADDR A:0xfcb32054
y.create.l HWIO_DEMSS_RDR3_CFG0_6_ADDR A:0xfcb3205c
y.create.l HWIO_DEMSS_RDR3_CFG0_7_ADDR A:0xfcb32064
y.create.l HWIO_DEMSS_RDR3_CFG1_0_ADDR A:0xfcb32030
y.create.l HWIO_DEMSS_RDR3_CFG1_1_ADDR A:0xfcb32038
y.create.l HWIO_DEMSS_RDR3_CFG1_2_ADDR A:0xfcb32040
y.create.l HWIO_DEMSS_RDR3_CFG1_3_ADDR A:0xfcb32048
y.create.l HWIO_DEMSS_RDR3_CFG1_4_ADDR A:0xfcb32050
y.create.l HWIO_DEMSS_RDR3_CFG1_5_ADDR A:0xfcb32058
y.create.l HWIO_DEMSS_RDR3_CFG1_6_ADDR A:0xfcb32060
y.create.l HWIO_DEMSS_RDR3_CFG1_7_ADDR A:0xfcb32068
y.create.l HWIO_DEMSS_RDR3_XFER_CTL_ADDR A:0xfcb3206c
y.create.l HWIO_DEMSS_RDR4_CFG0_0_ADDR A:0xfcb32070
y.create.l HWIO_DEMSS_RDR4_CFG0_1_ADDR A:0xfcb32078
y.create.l HWIO_DEMSS_RDR4_CFG0_2_ADDR A:0xfcb32080
y.create.l HWIO_DEMSS_RDR4_CFG0_3_ADDR A:0xfcb32088
y.create.l HWIO_DEMSS_RDR4_CFG1_0_ADDR A:0xfcb32074
y.create.l HWIO_DEMSS_RDR4_CFG1_1_ADDR A:0xfcb3207c
y.create.l HWIO_DEMSS_RDR4_CFG1_2_ADDR A:0xfcb32084
y.create.l HWIO_DEMSS_RDR4_CFG1_3_ADDR A:0xfcb3208c
y.create.l HWIO_DEMSS_RDR4_XFER_CTL_ADDR A:0xfcb32090
y.create.l HWIO_DEMSS_BRDG_CTL_ADDR A:0xfcb32094
y.create.l HWIO_DEMSS_BRDG_STATUS_ADDR A:0xfcb32098
y.create.l HWIO_DEMSS_BRDG_CLEAR_ADDR A:0xfcb3209c
y.create.l HWIO_QLIC_TASK_FIFO_START_ADDR A:0xfcb33000
y.create.l HWIO_QLIC_TASK_FIFO_END_ADDR A:0xfcb33004
y.create.l HWIO_QLIC_TASK_WR_PTR_ADDR A:0xfcb33008
y.create.l HWIO_QLIC_TASK_RD_PTR_ADDR A:0xfcb3300c
y.create.l HWIO_QLIC_CTL_ADDR A:0xfcb33010
y.create.l HWIO_QLIC_TASK_STATUS_RD_ADDR A:0xfcb33014
y.create.l HWIO_QLIC_ENGINE_IIR_SCALE_ADDR A:0xfcb33018
y.create.l HWIO_QLIC_ENGINE_NORM_SEC0_RD_ADDR A:0xfcb3301c
y.create.l HWIO_QLIC_ENGINE_NORM_SEC1_RD_ADDR A:0xfcb33020
y.create.l HWIO_QLIC_ENGINE_NORM_SEC2_RD_ADDR A:0xfcb33024
y.create.l HWIO_QLIC_ENGINE_NORM_SEC3_RD_ADDR A:0xfcb33028
y.create.l HWIO_QLIC_ENGINE_NORM_SEC4_RD_ADDR A:0xfcb3302c
y.create.l HWIO_QLIC_ENGINE_NORM_SEC5_RD_ADDR A:0xfcb33030
y.create.l HWIO_QLIC_ENGINE_NORM_SEC6_RD_ADDR A:0xfcb33034
y.create.l HWIO_QLIC_ENGINE_NORM_SEC7_RD_ADDR A:0xfcb33038
y.create.l HWIO_QLIC_ENGINE_NORM_SEC8_RD_ADDR A:0xfcb3303c
y.create.l HWIO_QLIC_ENGINE_NORM_SEC9_RD_ADDR A:0xfcb33040
y.create.l HWIO_QLIC_ENGINE_NOISE_SEC0_RD_ADDR A:0xfcb33044
y.create.l HWIO_QLIC_ENGINE_NOISE_SEC1_RD_ADDR A:0xfcb33048
y.create.l HWIO_QLIC_ENGINE_NOISE_SEC2_RD_ADDR A:0xfcb3304c
y.create.l HWIO_QLIC_ENGINE_NOISE_SEC3_RD_ADDR A:0xfcb33050
y.create.l HWIO_QLIC_ENGINE_NOISE_SEC4_RD_ADDR A:0xfcb33054
y.create.l HWIO_QLIC_ENGINE_NOISE_SEC5_RD_ADDR A:0xfcb33058
y.create.l HWIO_QLIC_ENGINE_NOISE_SEC6_RD_ADDR A:0xfcb3305c
y.create.l HWIO_QLIC_ENGINE_NOISE_SEC7_RD_ADDR A:0xfcb33060
y.create.l HWIO_QLIC_ENGINE_NOISE_SEC8_RD_ADDR A:0xfcb33064
y.create.l HWIO_QLIC_ENGINE_NOISE_SEC9_RD_ADDR A:0xfcb33068
y.create.l HWIO_QLIC_ENGINE_O_RAM_ADDR_ADDR A:0xfcb3306c
y.create.l HWIO_QLIC_ENGINE_O_RAM_DATA_MSB_RD_ADDR A:0xfcb33070
y.create.l HWIO_QLIC_ENGINE_O_RAM_DATA_LSB_RD_ADDR A:0xfcb33074
y.create.l HWIO_QLIC_STATE_FW_ADDR A:0xfcb33080
y.create.l HWIO_QLIC_TEST_CONFIG_ADDR A:0xfcb33084
y.create.l HWIO_QLIC_TESTBUS_FW_ADDR A:0xfcb33088
y.create.l HWIO_QLIC_MTI_CTL_ADDR A:0xfcb33400
y.create.l HWIO_QLIC_FERAM0_WORD0_ADDR A:0xfcb33404
y.create.l HWIO_QLIC_FERAM0_WORD1_ADDR A:0xfcb33408
y.create.l HWIO_QLIC_FERAM1_WORD0_ADDR A:0xfcb3340c
y.create.l HWIO_QLIC_FERAM1_WORD1_ADDR A:0xfcb33410
y.create.l HWIO_QLIC_OMGRAM_WORD0_ADDR A:0xfcb33414
y.create.l HWIO_QLIC_OMGRAM_WORD1_ADDR A:0xfcb33418
y.create.l HWIO_QLIC_SECRAM_WORD0_ADDR A:0xfcb3341c
y.create.l HWIO_QLIC_SECRAM_WORD1_ADDR A:0xfcb33420
y.create.l HWIO_QLIC_SECRAM_WORD2_ADDR A:0xfcb33424
y.create.l HWIO_QLIC_COMBRAM0_WORD0_ADDR A:0xfcb33428
y.create.l HWIO_QLIC_COMBRAM0_WORD1_ADDR A:0xfcb3342c
y.create.l HWIO_QLIC_COMBRAM0_WORD2_ADDR A:0xfcb33430
y.create.l HWIO_QLIC_COMBRAM1_WORD0_ADDR A:0xfcb33434
y.create.l HWIO_QLIC_COMBRAM1_WORD1_ADDR A:0xfcb33438
y.create.l HWIO_QLIC_COMBRAM1_WORD2_ADDR A:0xfcb3343c
y.create.l HWIO_QLIC_STATE_SW_ADDR A:0xfcb33440
y.create.l HWIO_QLIC_TESTBUS_SW_ADDR A:0xfcb3344c
y.create.l HWIO_QLIC_FE_TASK_WORD_0_ADDR A:0xfcb33800
y.create.l HWIO_QLIC_FE_TASK_WORD_1_ADDR A:0xfcb33804
y.create.l HWIO_QLIC_FE_TASK_WORD_2_ADDR A:0xfcb33808
y.create.l HWIO_QLIC_FE_TASK_WORD_3_ADDR A:0xfcb3380c
y.create.l HWIO_QLIC_ENGINE_TASK_WORD_0_ADDR A:0xfcb33810
y.create.l HWIO_QLIC_ENGINE_TASK_WORD_1_ADDR A:0xfcb33814
y.create.l HWIO_QLIC_BE_TASK_WORD_0_ADDR A:0xfcb33820
y.create.l HWIO_QLIC_BE_TASK_WORD_1_ADDR A:0xfcb33824
y.create.l HWIO_QLIC_BE_TASK_WORD_2_ADDR A:0xfcb33828
y.create.l HWIO_QLIC_BE_TASK_WORD_3_ADDR A:0xfcb3382c
y.create.l HWIO_QLIC_ERAM_TASK_WORD_0_ADDR A:0xfcb33830
y.create.l HWIO_QLIC_ERAM_TASK_WORD_1_ADDR A:0xfcb33834
y.create.l HWIO_EDGE_ENABLE_ADDR A:0xfcb34000
y.create.l HWIO_TEST_PT_CTL_RW_ADDR A:0xfcb34004
y.create.l HWIO_ENCRYPT_ACC_RESET_ADDR A:0xfcb34100
y.create.l HWIO_ENCRYPT_ACC_CGC_CTL_ADDR A:0xfcb34104
y.create.l HWIO_ENCRYPT_ACC_CGC_STATUS_ADDR A:0xfcb34108
y.create.l HWIO_GEA_CONFIG_0_ADDR A:0xfcb3410c
y.create.l HWIO_GEA_INPUT_ADDR A:0xfcb34110
y.create.l HWIO_GEA_KC_0_ADDR A:0xfcb34114
y.create.l HWIO_GEA_KC_1_ADDR A:0xfcb34118
y.create.l HWIO_GEA_KC_2_ADDR A:0xfcb3411c
y.create.l HWIO_GEA_KC_3_ADDR A:0xfcb34120
y.create.l HWIO_GEA34_KS_LENGTH_ADDR A:0xfcb34124
y.create.l HWIO_GEA34_STATUS_ADDR A:0xfcb34128
y.create.l HWIO_GEA34_KEY_STRM_DOUT_ADDR A:0xfcb3412c
y.create.l HWIO_AMBA_KEY_STRM_WORD0_RD_ADDR A:0xfcb34130
y.create.l HWIO_AMBA_KEY_STRM_WORD1_RD_ADDR A:0xfcb34134
y.create.l HWIO_AMBA_KEY_STRM_WORD2_RD_ADDR A:0xfcb34138
y.create.l HWIO_AMBA_KEY_STRM_WORD3_RD_ADDR A:0xfcb3413c
y.create.l HWIO_AMBA_KEY_STRM_WORD4_RD_ADDR A:0xfcb34140
y.create.l HWIO_AMBA_KEY_STRM_WORD5_RD_ADDR A:0xfcb34144
y.create.l HWIO_AMBA_KEY_STRM_WORD6_RD_ADDR A:0xfcb34148
y.create.l HWIO_AMBA_KEY_STRM_WORD7_RD_ADDR A:0xfcb3414c
y.create.l HWIO_AMBA_KEY_STRM_STATUS_ADDR A:0xfcb34150
y.create.l HWIO_AFIVE_CONFIG_0_ADDR A:0xfcb34154
y.create.l HWIO_AFIVE_INPUT_ADDR A:0xfcb34158
y.create.l HWIO_AFIVE_KC_0_ADDR A:0xfcb3415c
y.create.l HWIO_AFIVE_KC_1_ADDR A:0xfcb34160
y.create.l HWIO_AFIVE_KC_2_ADDR A:0xfcb34164
y.create.l HWIO_AFIVE_KC_3_ADDR A:0xfcb34168
y.create.l HWIO_AFIVE_KEY_STRM_WORD0_RD_ADDR A:0xfcb3416c
y.create.l HWIO_AFIVE_KEY_STRM_WORD1_RD_ADDR A:0xfcb34170
y.create.l HWIO_AFIVE_KEY_STRM_WORD2_RD_ADDR A:0xfcb34174
y.create.l HWIO_AFIVE_KEY_STRM_WORD3_RD_ADDR A:0xfcb34178
y.create.l HWIO_AFIVE_KEY_STRM_WORD4_RD_ADDR A:0xfcb3417c
y.create.l HWIO_AFIVE_KEY_STRM_WORD5_RD_ADDR A:0xfcb34180
y.create.l HWIO_AFIVE_KEY_STRM_WORD6_RD_ADDR A:0xfcb34184
y.create.l HWIO_AFIVE_KEY_STRM_WORD7_RD_ADDR A:0xfcb34188
y.create.l HWIO_AFIVE_KEY_STRM_WORD8_RD_ADDR A:0xfcb3418c
y.create.l HWIO_AFIVE_KEY_STRM_WORD9_RD_ADDR A:0xfcb34190
y.create.l HWIO_AFIVE34_STATUS_ADDR A:0xfcb34198
y.create.l HWIO_EEQ_RESET_ADDR A:0xfcb34200
y.create.l HWIO_EEQ_CGC_CTL_ADDR A:0xfcb34204
y.create.l HWIO_EEQ_CGC_STATUS_ADDR A:0xfcb34208
y.create.l HWIO_EEQ_TRIGGER_ADDR A:0xfcb3420c
y.create.l HWIO_EEQ_CONFIG_ADDR A:0xfcb34210
y.create.l HWIO_INIT_HD_BITS_REV_ADDR A:0xfcb34214
y.create.l HWIO_INIT_HD_BITS_FWD_ADDR A:0xfcb34218
y.create.l HWIO_WMF_DMA_BASE_ADDR A:0xfcb3421c
y.create.l HWIO_SOFT_DEC_BASE_ADDR A:0xfcb34220
y.create.l HWIO_INIT_CH_EST0_ADDR A:0xfcb34224
y.create.l HWIO_INIT_CH_EST1_ADDR A:0xfcb34228
y.create.l HWIO_INIT_CH_EST2_ADDR A:0xfcb3422c
y.create.l HWIO_INIT_CH_EST3_ADDR A:0xfcb34230
y.create.l HWIO_REV_NOISE_POWER_ADDR A:0xfcb34234
y.create.l HWIO_FWD_NOISE_POWER_ADDR A:0xfcb34238
y.create.l HWIO_REV_SEMIBURST_HD_BITS_ADDR A:0xfcb3423c
y.create.l HWIO_FWD_SEMIBURST_HD_BITS_ADDR A:0xfcb34240
y.create.l HWIO_EVMOD_CGC_CTL_ADDR A:0xfcb34300
y.create.l HWIO_EVMOD_CGC_STATUS_ADDR A:0xfcb34304
y.create.l HWIO_EVMOD_DMA_START_ADDR_ADDR A:0xfcb34308
y.create.l HWIO_EVMOD_DMA_CIRC_BUF_TOP_ADDR A:0xfcb3430c
y.create.l HWIO_EVMOD_DMA_CIRC_BUF_LEN_ADDR A:0xfcb34310
y.create.l HWIO_EVMOD_MODLTR_CONFIG_1_ADDR A:0xfcb34314
y.create.l HWIO_EVMOD_MODLTR_CONFIG_2_ADDR A:0xfcb34318
y.create.l HWIO_EVMOD_MODLTR_CONFIG_3_ADDR A:0xfcb3431c
y.create.l HWIO_EVMOD_MODLTR_ARM_ADDR A:0xfcb34320
y.create.l HWIO_EVMOD_C0_LUT_DATA_ADDR A:0xfcb34324
y.create.l HWIO_EVMOD_C1_LUT_DATA_ADDR A:0xfcb34328
y.create.l HWIO_EVMOD_CONST_MAP_GMSK_ADDR A:0xfcb3432c
y.create.l HWIO_EVMOD_CONST_MAP_EPSK_0_ADDR A:0xfcb34330
y.create.l HWIO_EVMOD_CONST_MAP_EPSK_1_ADDR A:0xfcb34334
y.create.l HWIO_EVMOD_CONST_MAP_QAM16_ADDR A:0xfcb34338
y.create.l HWIO_EVMOD_DPL_PAR_CTRL_ADDR A:0xfcb3433c
y.create.l HWIO_EVMOD_DPL_CTRL_ADDR A:0xfcb34340
y.create.l HWIO_EVMOD_DPL_GAIN_ADDR A:0xfcb34344
y.create.l HWIO_EVMOD_PAR_CTRL_ADDR A:0xfcb34348
y.create.l HWIO_EVMOD_PAR_LPF_GAIN_ADDR A:0xfcb3434c
y.create.l HWIO_EVMOD_PAR_CORRECTION_GAIN_ADDR A:0xfcb34350
y.create.l HWIO_EVMOD_DPL_PAR_LPF_H0_ADDR A:0xfcb34354
y.create.l HWIO_EVMOD_DPL_PAR_LPF_H1_ADDR A:0xfcb34358
y.create.l HWIO_EVMOD_DPL_PAR_LPF_H2_ADDR A:0xfcb3435c
y.create.l HWIO_EVMOD_DPL_PAR_LPF_H3_ADDR A:0xfcb34360
y.create.l HWIO_EVMOD_DPL_PAR_LPF_H4_ADDR A:0xfcb34364
y.create.l HWIO_EVMOD_DPL_PAR_LPF_H5_ADDR A:0xfcb34368
y.create.l HWIO_EVMOD_DPL_PAR_LPF_H6_ADDR A:0xfcb3436c
y.create.l HWIO_EVMOD_DPL_PAR_LPF_H7_ADDR A:0xfcb34370
y.create.l HWIO_EVMOD_TIMESTAMP_T1_ADDR A:0xfcb34374
y.create.l HWIO_EVMOD_SAMPLE_COUNT_ADDR A:0xfcb34378
y.create.l HWIO_EVMOD_SAMPLE_COUNT_CTRL_ADDR A:0xfcb3437c
y.create.l HWIO_EVMOD_DPL_PAR_DEBUG_CTRL_ADDR A:0xfcb34380
y.create.l HWIO_EVMOD_DPL_PAR_DEBUG_DATA_ADDR A:0xfcb34384
y.create.l HWIO_CSRCH_ENABLE_ADDR A:0xfcb35000
y.create.l HWIO_SRCH_QUEUE_CMD_ADDR A:0xfcb35004
y.create.l HWIO_SRCH_QUEUE_CTL_0_ADDR A:0xfcb35008
y.create.l HWIO_SRCH_QUEUE_CTL_1_ADDR A:0xfcb3500c
y.create.l HWIO_SRCH_QUEUE_STATUS_ADDR A:0xfcb35010
y.create.l HWIO_SRCH_QUEUE_WRITE_PTR_ADDR A:0xfcb35014
y.create.l HWIO_SRCH_QUEUE_CMP_ADDR A:0xfcb35018
y.create.l HWIO_SRCH_QUEUE_TST_ADDR A:0xfcb3501c
y.create.l HWIO_SRCH_TEST_MODE_ADDR A:0xfcb35020
y.create.l HWIO_SRCH_TEST_STATUS_ADDR A:0xfcb35024
y.create.l HWIO_SRCH_OFFLINE_WRITE_PTR_ADDR A:0xfcb35028
y.create.l HWIO_SRCH_SEARCH_CTL_DBG_ADDR A:0xfcb3502c
y.create.l HWIO_SRCH_WINDOW_CTL_DBG_ADDR A:0xfcb35030
y.create.l HWIO_SRCH_SAMPLE_CTL1_DBG_ADDR A:0xfcb35034
y.create.l HWIO_SRCH_SAMPLE_CTL2_DBG_ADDR A:0xfcb35038
y.create.l HWIO_SRCH_PILOT_CTL_DBG_ADDR A:0xfcb3503c
y.create.l HWIO_SRCH_RESULT_CTL_DBG_ADDR A:0xfcb35040
y.create.l HWIO_FING_STATUS_RD_ADDR A:0xfcb36000
y.create.l HWIO_FING_DESKEW_ADDR_RD_ADDR A:0xfcb36004
y.create.l HWIO_FING_SLOT_SYM_NUM_RD_ADDR A:0xfcb36008
y.create.l HWIO_FING_CHAN_ENABLE_RD_ADDR A:0xfcb3600c
y.create.l HWIO_FING_ON_TIME_RD_ADDR A:0xfcb36010
y.create.l HWIO_FING_ON_TIME_DIV_RD_ADDR A:0xfcb36014
y.create.l HWIO_FING_SYM_CH0_RD_ADDR A:0xfcb36018
y.create.l HWIO_FING_SYM_CH0_DIV_RD_ADDR A:0xfcb3601c
y.create.l HWIO_FING_EARLY_LATE_RD_ADDR A:0xfcb36020
y.create.l HWIO_FING_EARLY_LATE_DIV_RD_ADDR A:0xfcb36024
y.create.l HWIO_FINGER_POSITION_RD_ADDR A:0xfcb36028
y.create.l HWIO_FINGER_PN_OFFSET_RD_ADDR A:0xfcb3602c
y.create.l HWIO_FING_MMSE_RXX_RD_ADDR A:0xfcb36030
y.create.l HWIO_FING_MMSE_RE_RXY_RD_ADDR A:0xfcb36034
y.create.l HWIO_FING_MMSE_RYY_RD_ADDR A:0xfcb36038
y.create.l HWIO_FING_MMSE_IM_RXY_RD_ADDR A:0xfcb3603c
y.create.l HWIO_COMB_DESKEW_ADDR_RD_ADDR A:0xfcb36040
y.create.l HWIO_COMB_STATUS13_RD_ADDR A:0xfcb36044
y.create.l HWIO_COMB_STATUS15_RD_ADDR A:0xfcb36048
y.create.l HWIO_COMB_STATUS16_RD_ADDR A:0xfcb3604c
y.create.l HWIO_COMB_BETA_CH0_SW_RD_ADDR A:0xfcb36050
y.create.l HWIO_COMB_PN_SCRAM_IQ_CH0_RD_ADDR A:0xfcb36054
y.create.l HWIO_COMB_SYS_TIME_RD_ADDR A:0xfcb36058
y.create.l HWIO_FING_ROT_FREQ_WR_ADDR A:0xfcb37000
y.create.l HWIO_FING_ROT_PHASE_WR_ADDR A:0xfcb37004
y.create.l HWIO_FING_IQ_PILOT0_WR_ADDR A:0xfcb37008
y.create.l HWIO_FING_IQ_PILOT1_WR_ADDR A:0xfcb3700c
y.create.l HWIO_FING_QLIC_IQ_CH_EST0_ADDR A:0xfcb37010
y.create.l HWIO_FING_QLIC_IQ_CH_EST1_ADDR A:0xfcb37014
y.create.l HWIO_FING_QLIC_CFG_ADDR A:0xfcb37018
y.create.l HWIO_FING_RESULT_TCM_ADDR_ADDR A:0xfcb3701c
y.create.l HWIO_DEM1X_F0_PILOT_IMMED_ADDR A:0xfcb37100
y.create.l HWIO_DEM1X_F1_PILOT_IMMED_ADDR A:0xfcb37140
y.create.l HWIO_DEM1X_F2_PILOT_IMMED_ADDR A:0xfcb37180
y.create.l HWIO_DEM1X_F3_PILOT_IMMED_ADDR A:0xfcb371c0
y.create.l HWIO_DEM1X_F4_PILOT_IMMED_ADDR A:0xfcb37200
y.create.l HWIO_DEM1X_F5_PILOT_IMMED_ADDR A:0xfcb37240
y.create.l HWIO_DEM1X_F6_PILOT_IMMED_ADDR A:0xfcb37280
y.create.l HWIO_DEM1X_F7_PILOT_IMMED_ADDR A:0xfcb372c0
y.create.l HWIO_DEM1X_F0_DIVERSITY_IMMED_ADDR A:0xfcb37104
y.create.l HWIO_DEM1X_F1_DIVERSITY_IMMED_ADDR A:0xfcb37144
y.create.l HWIO_DEM1X_F2_DIVERSITY_IMMED_ADDR A:0xfcb37184
y.create.l HWIO_DEM1X_F3_DIVERSITY_IMMED_ADDR A:0xfcb371c4
y.create.l HWIO_DEM1X_F4_DIVERSITY_IMMED_ADDR A:0xfcb37204
y.create.l HWIO_DEM1X_F5_DIVERSITY_IMMED_ADDR A:0xfcb37244
y.create.l HWIO_DEM1X_F6_DIVERSITY_IMMED_ADDR A:0xfcb37284
y.create.l HWIO_DEM1X_F7_DIVERSITY_IMMED_ADDR A:0xfcb372c4
y.create.l HWIO_DEM1X_F0_WALSH_ACC0_IMMED_ADDR A:0xfcb37108
y.create.l HWIO_DEM1X_F0_WALSH_ACC1_IMMED_ADDR A:0xfcb3710c
y.create.l HWIO_DEM1X_F0_WALSH_ACC2_IMMED_ADDR A:0xfcb37110
y.create.l HWIO_DEM1X_F0_WALSH_ACC3_IMMED_ADDR A:0xfcb37114
y.create.l HWIO_DEM1X_F1_WALSH_ACC0_IMMED_ADDR A:0xfcb37148
y.create.l HWIO_DEM1X_F1_WALSH_ACC1_IMMED_ADDR A:0xfcb3714c
y.create.l HWIO_DEM1X_F1_WALSH_ACC2_IMMED_ADDR A:0xfcb37150
y.create.l HWIO_DEM1X_F1_WALSH_ACC3_IMMED_ADDR A:0xfcb37154
y.create.l HWIO_DEM1X_F2_WALSH_ACC0_IMMED_ADDR A:0xfcb37188
y.create.l HWIO_DEM1X_F2_WALSH_ACC1_IMMED_ADDR A:0xfcb3718c
y.create.l HWIO_DEM1X_F2_WALSH_ACC2_IMMED_ADDR A:0xfcb37190
y.create.l HWIO_DEM1X_F2_WALSH_ACC3_IMMED_ADDR A:0xfcb37194
y.create.l HWIO_DEM1X_F3_WALSH_ACC0_IMMED_ADDR A:0xfcb371c8
y.create.l HWIO_DEM1X_F3_WALSH_ACC1_IMMED_ADDR A:0xfcb371cc
y.create.l HWIO_DEM1X_F3_WALSH_ACC2_IMMED_ADDR A:0xfcb371d0
y.create.l HWIO_DEM1X_F3_WALSH_ACC3_IMMED_ADDR A:0xfcb371d4
y.create.l HWIO_DEM1X_F4_WALSH_ACC0_IMMED_ADDR A:0xfcb37208
y.create.l HWIO_DEM1X_F4_WALSH_ACC1_IMMED_ADDR A:0xfcb3720c
y.create.l HWIO_DEM1X_F4_WALSH_ACC2_IMMED_ADDR A:0xfcb37210
y.create.l HWIO_DEM1X_F4_WALSH_ACC3_IMMED_ADDR A:0xfcb37214
y.create.l HWIO_DEM1X_F5_WALSH_ACC0_IMMED_ADDR A:0xfcb37248
y.create.l HWIO_DEM1X_F5_WALSH_ACC1_IMMED_ADDR A:0xfcb3724c
y.create.l HWIO_DEM1X_F5_WALSH_ACC2_IMMED_ADDR A:0xfcb37250
y.create.l HWIO_DEM1X_F5_WALSH_ACC3_IMMED_ADDR A:0xfcb37254
y.create.l HWIO_DEM1X_F6_WALSH_ACC0_IMMED_ADDR A:0xfcb37288
y.create.l HWIO_DEM1X_F6_WALSH_ACC1_IMMED_ADDR A:0xfcb3728c
y.create.l HWIO_DEM1X_F6_WALSH_ACC2_IMMED_ADDR A:0xfcb37290
y.create.l HWIO_DEM1X_F6_WALSH_ACC3_IMMED_ADDR A:0xfcb37294
y.create.l HWIO_DEM1X_F7_WALSH_ACC0_IMMED_ADDR A:0xfcb372c8
y.create.l HWIO_DEM1X_F7_WALSH_ACC1_IMMED_ADDR A:0xfcb372cc
y.create.l HWIO_DEM1X_F7_WALSH_ACC2_IMMED_ADDR A:0xfcb372d0
y.create.l HWIO_DEM1X_F7_WALSH_ACC3_IMMED_ADDR A:0xfcb372d4
y.create.l HWIO_DEM1X_F0_WALSH_ACC0_FRAME_ADDR A:0xfcb37308
y.create.l HWIO_DEM1X_F0_WALSH_ACC1_FRAME_ADDR A:0xfcb3730c
y.create.l HWIO_DEM1X_F0_WALSH_ACC2_FRAME_ADDR A:0xfcb37310
y.create.l HWIO_DEM1X_F0_WALSH_ACC3_FRAME_ADDR A:0xfcb37314
y.create.l HWIO_DEM1X_F1_WALSH_ACC0_FRAME_ADDR A:0xfcb37348
y.create.l HWIO_DEM1X_F1_WALSH_ACC1_FRAME_ADDR A:0xfcb3734c
y.create.l HWIO_DEM1X_F1_WALSH_ACC2_FRAME_ADDR A:0xfcb37350
y.create.l HWIO_DEM1X_F1_WALSH_ACC3_FRAME_ADDR A:0xfcb37354
y.create.l HWIO_DEM1X_F2_WALSH_ACC0_FRAME_ADDR A:0xfcb37388
y.create.l HWIO_DEM1X_F2_WALSH_ACC1_FRAME_ADDR A:0xfcb3738c
y.create.l HWIO_DEM1X_F2_WALSH_ACC2_FRAME_ADDR A:0xfcb37390
y.create.l HWIO_DEM1X_F2_WALSH_ACC3_FRAME_ADDR A:0xfcb37394
y.create.l HWIO_DEM1X_F3_WALSH_ACC0_FRAME_ADDR A:0xfcb373c8
y.create.l HWIO_DEM1X_F3_WALSH_ACC1_FRAME_ADDR A:0xfcb373cc
y.create.l HWIO_DEM1X_F3_WALSH_ACC2_FRAME_ADDR A:0xfcb373d0
y.create.l HWIO_DEM1X_F3_WALSH_ACC3_FRAME_ADDR A:0xfcb373d4
y.create.l HWIO_DEM1X_F4_WALSH_ACC0_FRAME_ADDR A:0xfcb37408
y.create.l HWIO_DEM1X_F4_WALSH_ACC1_FRAME_ADDR A:0xfcb3740c
y.create.l HWIO_DEM1X_F4_WALSH_ACC2_FRAME_ADDR A:0xfcb37410
y.create.l HWIO_DEM1X_F4_WALSH_ACC3_FRAME_ADDR A:0xfcb37414
y.create.l HWIO_DEM1X_F5_WALSH_ACC0_FRAME_ADDR A:0xfcb37448
y.create.l HWIO_DEM1X_F5_WALSH_ACC1_FRAME_ADDR A:0xfcb3744c
y.create.l HWIO_DEM1X_F5_WALSH_ACC2_FRAME_ADDR A:0xfcb37450
y.create.l HWIO_DEM1X_F5_WALSH_ACC3_FRAME_ADDR A:0xfcb37454
y.create.l HWIO_DEM1X_F6_WALSH_ACC0_FRAME_ADDR A:0xfcb37488
y.create.l HWIO_DEM1X_F6_WALSH_ACC1_FRAME_ADDR A:0xfcb3748c
y.create.l HWIO_DEM1X_F6_WALSH_ACC2_FRAME_ADDR A:0xfcb37490
y.create.l HWIO_DEM1X_F6_WALSH_ACC3_FRAME_ADDR A:0xfcb37494
y.create.l HWIO_DEM1X_F7_WALSH_ACC0_FRAME_ADDR A:0xfcb374c8
y.create.l HWIO_DEM1X_F7_WALSH_ACC1_FRAME_ADDR A:0xfcb374cc
y.create.l HWIO_DEM1X_F7_WALSH_ACC2_FRAME_ADDR A:0xfcb374d0
y.create.l HWIO_DEM1X_F7_WALSH_ACC3_FRAME_ADDR A:0xfcb374d4
y.create.l HWIO_DEM1X_F0_HW_CH1_IMMED_ADDR A:0xfcb37138
y.create.l HWIO_DEM1X_F1_HW_CH1_IMMED_ADDR A:0xfcb37178
y.create.l HWIO_DEM1X_F2_HW_CH1_IMMED_ADDR A:0xfcb371b8
y.create.l HWIO_DEM1X_F3_HW_CH1_IMMED_ADDR A:0xfcb371f8
y.create.l HWIO_DEM1X_F4_HW_CH1_IMMED_ADDR A:0xfcb37238
y.create.l HWIO_DEM1X_F5_HW_CH1_IMMED_ADDR A:0xfcb37278
y.create.l HWIO_DEM1X_F6_HW_CH1_IMMED_ADDR A:0xfcb372b8
y.create.l HWIO_DEM1X_F7_HW_CH1_IMMED_ADDR A:0xfcb372f8
y.create.l HWIO_DEM1X_F0_HW_CH1_FRAME_ADDR A:0xfcb37338
y.create.l HWIO_DEM1X_F1_HW_CH1_FRAME_ADDR A:0xfcb37378
y.create.l HWIO_DEM1X_F2_HW_CH1_FRAME_ADDR A:0xfcb373b8
y.create.l HWIO_DEM1X_F3_HW_CH1_FRAME_ADDR A:0xfcb373f8
y.create.l HWIO_DEM1X_F4_HW_CH1_FRAME_ADDR A:0xfcb37438
y.create.l HWIO_DEM1X_F5_HW_CH1_FRAME_ADDR A:0xfcb37478
y.create.l HWIO_DEM1X_F6_HW_CH1_FRAME_ADDR A:0xfcb374b8
y.create.l HWIO_DEM1X_F7_HW_CH1_FRAME_ADDR A:0xfcb374f8
y.create.l HWIO_DEM1X_F0_HW_CH2_IMMED_ADDR A:0xfcb3713c
y.create.l HWIO_DEM1X_F1_HW_CH2_IMMED_ADDR A:0xfcb3717c
y.create.l HWIO_DEM1X_F2_HW_CH2_IMMED_ADDR A:0xfcb371bc
y.create.l HWIO_DEM1X_F3_HW_CH2_IMMED_ADDR A:0xfcb371fc
y.create.l HWIO_DEM1X_F4_HW_CH2_IMMED_ADDR A:0xfcb3723c
y.create.l HWIO_DEM1X_F5_HW_CH2_IMMED_ADDR A:0xfcb3727c
y.create.l HWIO_DEM1X_F6_HW_CH2_IMMED_ADDR A:0xfcb372bc
y.create.l HWIO_DEM1X_F7_HW_CH2_IMMED_ADDR A:0xfcb372fc
y.create.l HWIO_DEM1X_F0_HW_CH2_FRAME_ADDR A:0xfcb3733c
y.create.l HWIO_DEM1X_F1_HW_CH2_FRAME_ADDR A:0xfcb3737c
y.create.l HWIO_DEM1X_F2_HW_CH2_FRAME_ADDR A:0xfcb373bc
y.create.l HWIO_DEM1X_F3_HW_CH2_FRAME_ADDR A:0xfcb373fc
y.create.l HWIO_DEM1X_F4_HW_CH2_FRAME_ADDR A:0xfcb3743c
y.create.l HWIO_DEM1X_F5_HW_CH2_FRAME_ADDR A:0xfcb3747c
y.create.l HWIO_DEM1X_F6_HW_CH2_FRAME_ADDR A:0xfcb374bc
y.create.l HWIO_DEM1X_F7_HW_CH2_FRAME_ADDR A:0xfcb374fc
y.create.l HWIO_DEM1X_SYNC_ADDR A:0xfcb37800
y.create.l HWIO_DEM1X_LATCH_ADDR A:0xfcb37804
y.create.l HWIO_DEM1X_TRACKING_ADDR A:0xfcb37808
y.create.l HWIO_DEM1X_FRAME_OFFSET_ADDR A:0xfcb3780c
y.create.l HWIO_DEM1X_OFFLINE_ADDR A:0xfcb37810
y.create.l HWIO_DEM1X_REF_COUNT_ADDR A:0xfcb37814
y.create.l HWIO_DEM1X_RTC_ADJUST_ADDR A:0xfcb37818
y.create.l HWIO_DEM1X_RTF_CTL_SEL_ADDR A:0xfcb3781c
y.create.l HWIO_DEM1X_FINGER_MERGE_F8_ADDR A:0xfcb37820
y.create.l HWIO_DEM1X_COMBINER_TIME_LOAD_ADDR A:0xfcb37a00
y.create.l HWIO_DEM1X_ARM_COMBINER_SLAM_ADDR A:0xfcb37a04
y.create.l HWIO_DEM1X_SLEW_COMBINER_TIME_ADDR A:0xfcb37a08
y.create.l HWIO_DEM1X_LC_STATE_LOAD_LO_ADDR A:0xfcb37a0c
y.create.l HWIO_DEM1X_LC_STATE_LOAD_HI_ADDR A:0xfcb37a10
y.create.l HWIO_DEM1X_ARM_LC_STATE_LOAD_ADDR A:0xfcb37a14
y.create.l HWIO_DEM1X_COMBINER_TIME_ADDR A:0xfcb37a18
y.create.l HWIO_DEM1X_FRAME_COUNT_ADDR A:0xfcb37a1c
y.create.l HWIO_DEM1X_LC_STATE_LO_ADDR A:0xfcb37a20
y.create.l HWIO_DEM1X_LC_STATE_HI_ADDR A:0xfcb37a24
y.create.l HWIO_DEM1X_TRAFFIC_REV_PWR_CTL_ADDR A:0xfcb37a28
y.create.l HWIO_DEM1X_COMMON_REV_PWR_CTL_ADDR A:0xfcb37a2c
y.create.l HWIO_DEM1X_COMMON_REV_PWR_CTL2_ADDR A:0xfcb37a30
y.create.l HWIO_DEM1X_FWD_PWR_CTL_IMMED_ADDR A:0xfcb37a34
y.create.l HWIO_DEM1X_FWD_PWR_CTL_FRAME_ADDR A:0xfcb37a38
y.create.l HWIO_DEM1X_FWD_PWR_CTL_TIMING_ADDR A:0xfcb37a3c
y.create.l HWIO_DEM1X_BETA_TIMING_ADDR A:0xfcb37a40
y.create.l HWIO_DEM1X_TIME_INT1_ENABLE_ADDR A:0xfcb37a44
y.create.l HWIO_DEM1X_TIME_INT1_STATUS_ADDR A:0xfcb37a48
y.create.l HWIO_DEM1X_TIME_INT1_CLEAR_ADDR A:0xfcb37a4c
y.create.l HWIO_DEM1X_TIME_INT2_ENABLE_ADDR A:0xfcb37a50
y.create.l HWIO_DEM1X_TIME_INT2_STATUS_ADDR A:0xfcb37a54
y.create.l HWIO_DEM1X_TIME_INT2_CLEAR_ADDR A:0xfcb37a58
y.create.l HWIO_DEM1X_CH0_LC_MASK_LO_IMMED_ADDR A:0xfcb37a5c
y.create.l HWIO_DEM1X_CH1_LC_MASK_LO_IMMED_ADDR A:0xfcb37a64
y.create.l HWIO_DEM1X_CH2_LC_MASK_LO_IMMED_ADDR A:0xfcb37a6c
y.create.l HWIO_DEM1X_CH0_LC_MASK_HI_IMMED_ADDR A:0xfcb37a60
y.create.l HWIO_DEM1X_CH1_LC_MASK_HI_IMMED_ADDR A:0xfcb37a68
y.create.l HWIO_DEM1X_CH2_LC_MASK_HI_IMMED_ADDR A:0xfcb37a70
y.create.l HWIO_DEM1X_CH7_LC_MASK_LO_IMMED_ADDR A:0xfcb37a74
y.create.l HWIO_DEM1X_CH7_LC_MASK_HI_IMMED_ADDR A:0xfcb37a78
y.create.l HWIO_DEM1X_CH8_LC_MASK_LO_IMMED_ADDR A:0xfcb37a7c
y.create.l HWIO_DEM1X_CH8_LC_MASK_HI_IMMED_ADDR A:0xfcb37a80
y.create.l HWIO_DEM1X_CH0_LC_MASK_LO_SPN_ROLL_ADDR A:0xfcb37a84
y.create.l HWIO_DEM1X_CH1_LC_MASK_LO_SPN_ROLL_ADDR A:0xfcb37a8c
y.create.l HWIO_DEM1X_CH2_LC_MASK_LO_SPN_ROLL_ADDR A:0xfcb37a94
y.create.l HWIO_DEM1X_CH0_LC_MASK_HI_SPN_ROLL_ADDR A:0xfcb37a88
y.create.l HWIO_DEM1X_CH1_LC_MASK_HI_SPN_ROLL_ADDR A:0xfcb37a90
y.create.l HWIO_DEM1X_CH2_LC_MASK_HI_SPN_ROLL_ADDR A:0xfcb37a98
y.create.l HWIO_DEM1X_CH7_LC_MASK_LO_SPN_ROLL_ADDR A:0xfcb37a9c
y.create.l HWIO_DEM1X_CH7_LC_MASK_HI_SPN_ROLL_ADDR A:0xfcb37aa0
y.create.l HWIO_DEM1X_CH8_LC_MASK_LO_SPN_ROLL_ADDR A:0xfcb37aa4
y.create.l HWIO_DEM1X_CH8_LC_MASK_HI_SPN_ROLL_ADDR A:0xfcb37aa8
y.create.l HWIO_DEM1X_COMBINER_CTL_ADDR A:0xfcb37aac
y.create.l HWIO_DEM1X_FW_CH_ENABLE_IMMED_ADDR A:0xfcb37ab0
y.create.l HWIO_DEM1X_FW_CH_ENABLE_FRAME_ADDR A:0xfcb37ab4
y.create.l HWIO_DEM1X_CHANNEL0_IMMED_ADDR A:0xfcb37ab8
y.create.l HWIO_DEM1X_CHANNEL0_FRAME_ADDR A:0xfcb37abc
y.create.l HWIO_DEM1X_CHANNEL1_IMMED_ADDR A:0xfcb37ac0
y.create.l HWIO_DEM1X_CHANNEL1_FRAME_ADDR A:0xfcb37ac4
y.create.l HWIO_DEM1X_CHANNEL2_IMMED_ADDR A:0xfcb37ac8
y.create.l HWIO_DEM1X_CHANNEL2_FRAME_ADDR A:0xfcb37acc
y.create.l HWIO_DEM1X_CHANNEL8_IMMED_ADDR A:0xfcb37ad0
y.create.l HWIO_DEM1X_CHANNEL8_FRAME_ADDR A:0xfcb37ad4
y.create.l HWIO_DEM1X_SYS_TIME_GP_COMPARE_ADDR A:0xfcb37ad8
y.create.l HWIO_DEM1X_LPN_ADV_ADDR A:0xfcb37adc
y.create.l HWIO_FING_LOCK_WR_ADDR A:0xfcb37c00
y.create.l HWIO_FING_PAGE_WR_ADDR A:0xfcb37c04
y.create.l HWIO_FING_PROC_DONE_WR_ADDR A:0xfcb37c08
y.create.l HWIO_FING_PAGE_RD_ADDR A:0xfcb37c0c
y.create.l HWIO_FING_SYM_CH1_RD_ADDR A:0xfcb37c10
y.create.l HWIO_FING_SYM_CH2_RD_ADDR A:0xfcb37c14
y.create.l HWIO_FING_SYM_CH8_RD_ADDR A:0xfcb37c18
y.create.l HWIO_FING_SYM_CH1_DIV_RD_ADDR A:0xfcb37c1c
y.create.l HWIO_FING_SYM_CH2_DIV_RD_ADDR A:0xfcb37c20
y.create.l HWIO_FING_SYM_CH8_DIV_RD_ADDR A:0xfcb37c24
y.create.l HWIO_COMB_TRK_LO_ADJ_WR_ADDR A:0xfcb37c28
y.create.l HWIO_COMB_CH1_IQ_ACC_RD_ADDR A:0xfcb37c2c
y.create.l HWIO_COMB_CH2_IQ_ACC_RD_ADDR A:0xfcb37c30
y.create.l HWIO_COMB_PN_SCRAM_IQ_CACKCH_RD_ADDR A:0xfcb37c34
y.create.l HWIO_COMB_FUND_SOFT_DEC_IQ_WR_ADDR A:0xfcb37c38
y.create.l HWIO_COMB_BETA_CH1_SW_RD_ADDR A:0xfcb37c3c
y.create.l HWIO_COMB_COUNT_RD_ADDR A:0xfcb37c40
y.create.l HWIO_COMB_FUND_DEINT_BUSY_ADDR A:0xfcb37c44
y.create.l HWIO_COMB_CACKCH_STATUS_RD_ADDR A:0xfcb37c48
y.create.l HWIO_COMB_FWD_LINK_PWR_CTRL_WR_ADDR A:0xfcb37c4c
y.create.l HWIO_DEM1X_FINGER0_FW_ADDR A:0xfcb37c50
y.create.l HWIO_DEM1X_FINGER1_FW_ADDR A:0xfcb37c54
y.create.l HWIO_DEM1X_FINGER2_FW_ADDR A:0xfcb37c58
y.create.l HWIO_DEM1X_FINGER3_FW_ADDR A:0xfcb37c5c
y.create.l HWIO_DEM1X_FINGER4_FW_ADDR A:0xfcb37c60
y.create.l HWIO_DEM1X_FINGER5_FW_ADDR A:0xfcb37c64
y.create.l HWIO_DEM1X_FINGER6_FW_ADDR A:0xfcb37c68
y.create.l HWIO_DEM1X_FINGER7_FW_ADDR A:0xfcb37c6c
y.create.l HWIO_FING_TT_WR_ADDR A:0xfcb37c70
y.create.l HWIO_DEM1X_FING_DMA_CTRL_ADDR A:0xfcb37c74
y.create.l HWIO_DEM1X_FING_IRQ_DISABLE_ADDR A:0xfcb37c78
y.create.l HWIO_DEM1X_FING_IRQ_CLEAR_ADDR A:0xfcb37c7c
y.create.l HWIO_DEM1X_FING_IRQ_STATUS_ADDR A:0xfcb37c80
y.create.l HWIO_DEM1X_FFE_TEST_ADDR A:0xfcb37e00
y.create.l HWIO_DEM1X_TEST_MEM_SEL_ADDR A:0xfcb37e04
y.create.l HWIO_DEM1X_TEST_MEM_ADDR_ADDR A:0xfcb37e08
y.create.l HWIO_DEM1X_TEST_MEM_WRITE_ADDR A:0xfcb37e0c
y.create.l HWIO_DEM1X_TEST_MEM_READ0_ADDR A:0xfcb37e10
y.create.l HWIO_DEM1X_TEST_BUS_SEL_ADDR A:0xfcb37e14
y.create.l HWIO_DEM1X_TEST_BUS_READ_ADDR A:0xfcb37e18
y.create.l HWIO_CDMA_DEMOD_ENABLE_ADDR A:0xfcb37e1c
y.create.l HWIO_PDMEM_MIN_ADDR A:0xfcb00000
y.create.l HWIO_PDMEM_MAX_ADDR A:0xfcb0fffc
y.create.l HWIO_CCS_MSTS_ADDR A:0xfcb1fc00
y.create.l HWIO_CCS_MCTL_ADDR A:0xfcb1fc04
y.create.l HWIO_CCS_IPC_ADDR A:0xfcb1fc08
y.create.l HWIO_CCS_PIC0MSK_ADDR A:0xfcb1fc0c
y.create.l HWIO_CCS_PIC0STS_ADDR A:0xfcb1fc10
y.create.l HWIO_CCS_PIC1MSK_ADDR A:0xfcb1fc14
y.create.l HWIO_CCS_PIC1STS_ADDR A:0xfcb1fc18
y.create.l HWIO_CCS_PIC2MSK_ADDR A:0xfcb1fc1c
y.create.l HWIO_CCS_PIC2STS_ADDR A:0xfcb1fc20
y.create.l HWIO_CCS_PIC3MSK_ADDR A:0xfcb1fc24
y.create.l HWIO_CCS_PIC3STS_ADDR A:0xfcb1fc28
y.create.l HWIO_CCS_PIC4MSK_ADDR A:0xfcb1fc2c
y.create.l HWIO_CCS_PIC4STS_ADDR A:0xfcb1fc30
y.create.l HWIO_CCS_PIC5MSK_ADDR A:0xfcb1fc34
y.create.l HWIO_CCS_PIC5STS_ADDR A:0xfcb1fc38
y.create.l HWIO_CCS_PIC6MSK_ADDR A:0xfcb1fc3c
y.create.l HWIO_CCS_PIC6STS_ADDR A:0xfcb1fc40
y.create.l HWIO_CCS_PIT_ADDR A:0xfcb1fc44
y.create.l HWIO_CCS_UTIME_ADDR A:0xfcb1fc48
y.create.l HWIO_CCS_MON0_ADDR A:0xfcb1fc4c
y.create.l HWIO_CCS_MON1_ADDR A:0xfcb1fc50
y.create.l HWIO_CCS_MON2_ADDR A:0xfcb1fc54
y.create.l HWIO_CCS_MON3_ADDR A:0xfcb1fc58
y.create.l HWIO_CCS_MON4_ADDR A:0xfcb1fc5c
y.create.l HWIO_CCS_MON5_ADDR A:0xfcb1fc60
y.create.l HWIO_CCS_MON6_ADDR A:0xfcb1fc64
y.create.l HWIO_CCS_MON7_ADDR A:0xfcb1fc68
y.create.l HWIO_CCS_MON8_ADDR A:0xfcb1fc6c
y.create.l HWIO_CCS_MON9_ADDR A:0xfcb1fc70
y.create.l HWIO_CCS_TMR0_ADDR A:0xfcb1fc7c
y.create.l HWIO_CCS_TMR1_ADDR A:0xfcb1fc80
y.create.l HWIO_CCS_TMR2_ADDR A:0xfcb1fc84
y.create.l HWIO_CCS_TMR3_ADDR A:0xfcb1fc88
y.create.l HWIO_CCS_DMAC_ADDR A:0xfcb1fc8c
y.create.l HWIO_CCS_DMAC0SRC_ADDR A:0xfcb1fc90
y.create.l HWIO_CCS_DMAC1SRC_ADDR A:0xfcb1fca0
y.create.l HWIO_CCS_DMAC2SRC_ADDR A:0xfcb1fcb0
y.create.l HWIO_CCS_DMAC3SRC_ADDR A:0xfcb1fcc0
y.create.l HWIO_CCS_DMAC4SRC_ADDR A:0xfcb1fcd0
y.create.l HWIO_CCS_DMAC5SRC_ADDR A:0xfcb1fce0
y.create.l HWIO_CCS_DMAC6SRC_ADDR A:0xfcb1fcf0
y.create.l HWIO_CCS_DMAC7SRC_ADDR A:0xfcb1fd00
y.create.l HWIO_CCS_DMAC0DST_ADDR A:0xfcb1fc94
y.create.l HWIO_CCS_DMAC1DST_ADDR A:0xfcb1fca4
y.create.l HWIO_CCS_DMAC2DST_ADDR A:0xfcb1fcb4
y.create.l HWIO_CCS_DMAC3DST_ADDR A:0xfcb1fcc4
y.create.l HWIO_CCS_DMAC4DST_ADDR A:0xfcb1fcd4
y.create.l HWIO_CCS_DMAC5DST_ADDR A:0xfcb1fce4
y.create.l HWIO_CCS_DMAC6DST_ADDR A:0xfcb1fcf4
y.create.l HWIO_CCS_DMAC7DST_ADDR A:0xfcb1fd04
y.create.l HWIO_CCS_DMAC0LNK_ADDR A:0xfcb1fc98
y.create.l HWIO_CCS_DMAC1LNK_ADDR A:0xfcb1fca8
y.create.l HWIO_CCS_DMAC2LNK_ADDR A:0xfcb1fcb8
y.create.l HWIO_CCS_DMAC3LNK_ADDR A:0xfcb1fcc8
y.create.l HWIO_CCS_DMAC4LNK_ADDR A:0xfcb1fcd8
y.create.l HWIO_CCS_DMAC5LNK_ADDR A:0xfcb1fce8
y.create.l HWIO_CCS_DMAC6LNK_ADDR A:0xfcb1fcf8
y.create.l HWIO_CCS_DMAC7LNK_ADDR A:0xfcb1fd08
y.create.l HWIO_CCS_DMAC0CTL_ADDR A:0xfcb1fc9c
y.create.l HWIO_CCS_DMAC1CTL_ADDR A:0xfcb1fcac
y.create.l HWIO_CCS_DMAC2CTL_ADDR A:0xfcb1fcbc
y.create.l HWIO_CCS_DMAC3CTL_ADDR A:0xfcb1fccc
y.create.l HWIO_CCS_DMAC4CTL_ADDR A:0xfcb1fcdc
y.create.l HWIO_CCS_DMAC5CTL_ADDR A:0xfcb1fcec
y.create.l HWIO_CCS_DMAC6CTL_ADDR A:0xfcb1fcfc
y.create.l HWIO_CCS_DMAC7CTL_ADDR A:0xfcb1fd0c
y.create.l HWIO_CCS_RFI_ADDR A:0xfcb1fd10
y.create.l HWIO_CCS_SSBI0_ADDR A:0xfcb1fd14
y.create.l HWIO_CCS_SSBI1_ADDR A:0xfcb1fd1c
y.create.l HWIO_CCS_SSBI2_ADDR A:0xfcb1fd24
y.create.l HWIO_CCS_SSBI3_ADDR A:0xfcb1fd2c
y.create.l HWIO_CCS_SSBI4_ADDR A:0xfcb1fd34
y.create.l HWIO_CCS_SSBI5_ADDR A:0xfcb1fd3c
y.create.l HWIO_CCS_SSBI0DAT_ADDR A:0xfcb1fd18
y.create.l HWIO_CCS_SSBI1DAT_ADDR A:0xfcb1fd20
y.create.l HWIO_CCS_SSBI2DAT_ADDR A:0xfcb1fd28
y.create.l HWIO_CCS_SSBI3DAT_ADDR A:0xfcb1fd30
y.create.l HWIO_CCS_SSBI4DAT_ADDR A:0xfcb1fd38
y.create.l HWIO_CCS_SSBI5DAT_ADDR A:0xfcb1fd40
y.create.l HWIO_CCS_GRFC_SET_ADDR A:0xfcb1fd44
y.create.l HWIO_CCS_GRFC_CLR_ADDR A:0xfcb1fd48
y.create.l HWIO_CCS_RFFE0_ADDR A:0xfcb1fd4c
y.create.l HWIO_CCS_RFFE1_ADDR A:0xfcb1fd54
y.create.l HWIO_CCS_RFFE0DAT_ADDR A:0xfcb1fd50
y.create.l HWIO_CCS_RFFE1DAT_ADDR A:0xfcb1fd58
y.create.l HWIO_CCS_QPT_ADDR A:0xfcb1fd5c
y.create.l HWIO_CCS_BP0_ADDR A:0xfcb1fd60
y.create.l HWIO_CCS_BP1_ADDR A:0xfcb1fd64
y.create.l HWIO_MTC_ENABLE_ADDR A:0xfcb20000
y.create.l HWIO_MODEM_PWRUP_ADDR A:0xfcb20004
y.create.l HWIO_MODEM_PWRON_ADDR A:0xfcb20008
y.create.l HWIO_MODEM_ID_ADDR A:0xfcb2000c
y.create.l HWIO_MODEM_FEATURE_EN_ADDR A:0xfcb20010
y.create.l HWIO_MODEM_OPTION_EN_ADDR A:0xfcb20014
y.create.l HWIO_MODEM_CLK_MP_CFG_ADDR A:0xfcb20018
y.create.l HWIO_MODEM_CLK_MP_TRIG_ADDR A:0xfcb2001c
y.create.l HWIO_MODEM_CLK_MP_STATUS_ADDR A:0xfcb20020
y.create.l HWIO_MODEM_CLK_TDEC_CFG_ADDR A:0xfcb20024
y.create.l HWIO_MODEM_CLK_TDEC_TRIG_ADDR A:0xfcb20028
y.create.l HWIO_MODEM_CLK_TDEC_STATUS_ADDR A:0xfcb2002c
y.create.l HWIO_MODEM_CLK_DBG_CFG_ADDR A:0xfcb20030
y.create.l HWIO_MODEM_CLK_SPARE_ADDR A:0xfcb20034
y.create.l HWIO_MCDMA_RESET_ADDR A:0xfcb20400
y.create.l HWIO_MCDMA_ENABLE_ADDR A:0xfcb2049c
y.create.l HWIO_MCDMA_LOG_CH_BUSY_ADDR A:0xfcb20404
y.create.l HWIO_MCDMA_LOG_HW_CH0_SYNC_ADDR A:0xfcb20408
y.create.l HWIO_MCDMA_LOG_HW_CH1_SYNC_ADDR A:0xfcb2040c
y.create.l HWIO_MCDMA_LOG_HW_CH2_SYNC_ADDR A:0xfcb20410
y.create.l HWIO_MCDMA_LOG_HW_CH3_SYNC_ADDR A:0xfcb20414
y.create.l HWIO_MCDMA_LOG_HW_CH4_SYNC_ADDR A:0xfcb20418
y.create.l HWIO_MCDMA_LOG_HW_CH0_CTL_ADDR A:0xfcb20420
y.create.l HWIO_MCDMA_LOG_HW_CH1_CTL_ADDR A:0xfcb20424
y.create.l HWIO_MCDMA_LOG_HW_CH2_CTL_ADDR A:0xfcb20428
y.create.l HWIO_MCDMA_LOG_HW_CH3_CTL_ADDR A:0xfcb2042c
y.create.l HWIO_MCDMA_LOG_HW_CH4_CTL_ADDR A:0xfcb20430
y.create.l HWIO_MCDMA_LOG_SW_CH0_RESET_ADDR A:0xfcb20438
y.create.l HWIO_MCDMA_LOG_SW_CH1_RESET_ADDR A:0xfcb2043c
y.create.l HWIO_MCDMA_LOG_SW_CH2_RESET_ADDR A:0xfcb20440
y.create.l HWIO_MCDMA_LOG_SW_CH3_RESET_ADDR A:0xfcb20444
y.create.l HWIO_MCDMA_LOG_SW_CH0_CTL_ADDR A:0xfcb2044c
y.create.l HWIO_MCDMA_LOG_SW_CH1_CTL_ADDR A:0xfcb20450
y.create.l HWIO_MCDMA_LOG_SW_CH2_CTL_ADDR A:0xfcb20454
y.create.l HWIO_MCDMA_LOG_SW_CH3_CTL_ADDR A:0xfcb20458
y.create.l HWIO_MCDMA_PHY_CH_CTL_ADDR A:0xfcb20460
y.create.l HWIO_MCDMA_LOG_HW_CH0_DBG_ADDR A:0xfcb20464
y.create.l HWIO_MCDMA_LOG_HW_CH1_DBG_ADDR A:0xfcb20468
y.create.l HWIO_MCDMA_LOG_HW_CH2_DBG_ADDR A:0xfcb2046c
y.create.l HWIO_MCDMA_LOG_HW_CH3_DBG_ADDR A:0xfcb20470
y.create.l HWIO_MCDMA_LOG_HW_CH4_DBG_ADDR A:0xfcb20474
y.create.l HWIO_MCDMA_LOG_SW_CH0_DBG_ADDR A:0xfcb20478
y.create.l HWIO_MCDMA_LOG_SW_CH1_DBG_ADDR A:0xfcb2047c
y.create.l HWIO_MCDMA_LOG_SW_CH2_DBG_ADDR A:0xfcb20480
y.create.l HWIO_MCDMA_LOG_SW_CH3_DBG_ADDR A:0xfcb20484
y.create.l HWIO_MCDMA_PHY_CH_DBG_ADDR A:0xfcb20488
y.create.l HWIO_MCDMA_VBUF_CFG_DBG_ADDR A:0xfcb2048c
y.create.l HWIO_MCDMA_VBUF_CFG_SEL_ADDR A:0xfcb20490
y.create.l HWIO_MCDMA_VBUF_CFG_RD0_ADDR A:0xfcb20494
y.create.l HWIO_MCDMA_VBUF_CFG_RD1_ADDR A:0xfcb20498
y.create.l HWIO_A2_SW_RESET_THRD_ADDR A:0xfcb20800
y.create.l HWIO_A2_SW_RESET_ACC_ADDR A:0xfcb20804
y.create.l HWIO_A2_TASK0_EN_ADDR A:0xfcb20808
y.create.l HWIO_A2_TASK1_EN_ADDR A:0xfcb2080c
y.create.l HWIO_A2_TASK2_EN_ADDR A:0xfcb20810
y.create.l HWIO_A2_TASK3_EN_ADDR A:0xfcb20814
y.create.l HWIO_A2_TASK0_WR_PTR_ADDR A:0xfcb20820
y.create.l HWIO_A2_TASK1_WR_PTR_ADDR A:0xfcb20824
y.create.l HWIO_A2_TASK2_WR_PTR_ADDR A:0xfcb20828
y.create.l HWIO_A2_TASK3_WR_PTR_ADDR A:0xfcb2082c
y.create.l HWIO_A2_TASK0_RD_PTR_ADDR A:0xfcb20840
y.create.l HWIO_A2_TASK1_RD_PTR_ADDR A:0xfcb20844
y.create.l HWIO_A2_TASK2_RD_PTR_ADDR A:0xfcb20848
y.create.l HWIO_A2_TASK3_RD_PTR_ADDR A:0xfcb2084c
y.create.l HWIO_A2_TASK0_RD_PTR_INIT_ADDR A:0xfcb20860
y.create.l HWIO_A2_TASK1_RD_PTR_INIT_ADDR A:0xfcb20864
y.create.l HWIO_A2_TASK2_RD_PTR_INIT_ADDR A:0xfcb20868
y.create.l HWIO_A2_TASK3_RD_PTR_INIT_ADDR A:0xfcb2086c
y.create.l HWIO_A2_TASK0_RD_PTR_INIT_EN_ADDR A:0xfcb20880
y.create.l HWIO_A2_TASK1_RD_PTR_INIT_EN_ADDR A:0xfcb20884
y.create.l HWIO_A2_TASK2_RD_PTR_INIT_EN_ADDR A:0xfcb20888
y.create.l HWIO_A2_TASK3_RD_PTR_INIT_EN_ADDR A:0xfcb2088c
y.create.l HWIO_A2_QUEUE_UPPER_ADDR_ADDR A:0xfcb208b0
y.create.l HWIO_A2_STATUS0_WR_EN_ADDR A:0xfcb208c8
y.create.l HWIO_A2_STATUS1_WR_EN_ADDR A:0xfcb208cc
y.create.l HWIO_A2_STATUS2_WR_EN_ADDR A:0xfcb208d0
y.create.l HWIO_A2_STATUS3_WR_EN_ADDR A:0xfcb208d4
y.create.l HWIO_A2_STATUS4_WR_EN_ADDR A:0xfcb208d8
y.create.l HWIO_A2_STATUS0_WR_START_ADDR A:0xfcb208dc
y.create.l HWIO_A2_STATUS1_WR_START_ADDR A:0xfcb208e0
y.create.l HWIO_A2_STATUS2_WR_START_ADDR A:0xfcb208e4
y.create.l HWIO_A2_STATUS3_WR_START_ADDR A:0xfcb208e8
y.create.l HWIO_A2_STATUS4_WR_START_ADDR A:0xfcb208ec
y.create.l HWIO_A2_STATUS0_WR_END_ADDR A:0xfcb208f0
y.create.l HWIO_A2_STATUS1_WR_END_ADDR A:0xfcb208f4
y.create.l HWIO_A2_STATUS2_WR_END_ADDR A:0xfcb208f8
y.create.l HWIO_A2_STATUS3_WR_END_ADDR A:0xfcb208fc
y.create.l HWIO_A2_STATUS4_WR_END_ADDR A:0xfcb20900
y.create.l HWIO_A2_STATUS0_WR_PTR_INIT_ADDR A:0xfcb20904
y.create.l HWIO_A2_STATUS1_WR_PTR_INIT_ADDR A:0xfcb20908
y.create.l HWIO_A2_STATUS2_WR_PTR_INIT_ADDR A:0xfcb2090c
y.create.l HWIO_A2_STATUS3_WR_PTR_INIT_ADDR A:0xfcb20910
y.create.l HWIO_A2_STATUS4_WR_PTR_INIT_ADDR A:0xfcb20914
y.create.l HWIO_A2_STATUS0_WR_PTR_INIT_EN_ADDR A:0xfcb20918
y.create.l HWIO_A2_STATUS1_WR_PTR_INIT_EN_ADDR A:0xfcb2091c
y.create.l HWIO_A2_STATUS2_WR_PTR_INIT_EN_ADDR A:0xfcb20920
y.create.l HWIO_A2_STATUS3_WR_PTR_INIT_EN_ADDR A:0xfcb20924
y.create.l HWIO_A2_STATUS4_WR_PTR_INIT_EN_ADDR A:0xfcb20928
y.create.l HWIO_A2_STATUS0_WR_PTR_CURRENT_ADDR A:0xfcb2092c
y.create.l HWIO_A2_STATUS1_WR_PTR_CURRENT_ADDR A:0xfcb20930
y.create.l HWIO_A2_STATUS2_WR_PTR_CURRENT_ADDR A:0xfcb20934
y.create.l HWIO_A2_STATUS3_WR_PTR_CURRENT_ADDR A:0xfcb20938
y.create.l HWIO_A2_STATUS4_WR_PTR_CURRENT_ADDR A:0xfcb2093c
y.create.l HWIO_A2_STATUS0_WR_PTR_ADDR A:0xfcb20940
y.create.l HWIO_A2_STATUS1_WR_PTR_ADDR A:0xfcb20944
y.create.l HWIO_A2_STATUS2_WR_PTR_ADDR A:0xfcb20948
y.create.l HWIO_A2_STATUS3_WR_PTR_ADDR A:0xfcb2094c
y.create.l HWIO_A2_STATUS4_WR_PTR_ADDR A:0xfcb20950
y.create.l HWIO_A2_STATUS0_RD_PTR_ADDR A:0xfcb20954
y.create.l HWIO_A2_STATUS1_RD_PTR_ADDR A:0xfcb20958
y.create.l HWIO_A2_STATUS2_RD_PTR_ADDR A:0xfcb2095c
y.create.l HWIO_A2_STATUS3_RD_PTR_ADDR A:0xfcb20960
y.create.l HWIO_A2_STATUS4_RD_PTR_ADDR A:0xfcb20964
y.create.l HWIO_A2_FRAG0_THRESHOLD_ADDR A:0xfcb209c0
y.create.l HWIO_A2_FRAG1_THRESHOLD_ADDR A:0xfcb209c4
y.create.l HWIO_A2_FRAG0_REFILL_EN_ADDR A:0xfcb209c8
y.create.l HWIO_A2_FRAG1_REFILL_EN_ADDR A:0xfcb209cc
y.create.l HWIO_A2_FRAG0_LEN_ADDR A:0xfcb209d0
y.create.l HWIO_A2_FRAG1_LEN_ADDR A:0xfcb209d4
y.create.l HWIO_A2_FRAG0_ADDR_ADDR A:0xfcb209d8
y.create.l HWIO_A2_FRAG1_ADDR_ADDR A:0xfcb209dc
y.create.l HWIO_A2_FRAG0_PTR_ADDR A:0xfcb209e0
y.create.l HWIO_A2_FRAG1_PTR_ADDR A:0xfcb209e4
y.create.l HWIO_A2_FRAG_CACHE_LINE_ADDR A:0xfcb209e8
y.create.l HWIO_A2_FRAG_CACHE_LINE_MASK_ADDR A:0xfcb209ec
y.create.l HWIO_A2_FRAG0_TRANSFER_LEN_ADDR A:0xfcb209f0
y.create.l HWIO_A2_FRAG1_TRANSFER_LEN_ADDR A:0xfcb209f4
y.create.l HWIO_A2_FRAG0_HDR_LEN_ADDR A:0xfcb209f8
y.create.l HWIO_A2_FRAG1_HDR_LEN_ADDR A:0xfcb209fc
y.create.l HWIO_A2_FRAG0_QUEUE_START_ADDR_ADDR A:0xfcb20a08
y.create.l HWIO_A2_FRAG1_QUEUE_START_ADDR_ADDR A:0xfcb20a0c
y.create.l HWIO_A2_FRAG0_QUEUE_WR_PTR_ADDR A:0xfcb20aa0
y.create.l HWIO_A2_FRAG1_QUEUE_WR_PTR_ADDR A:0xfcb20aa4
y.create.l HWIO_A2_FRAG0_QUEUE_RD_PTR_ADDR A:0xfcb20aa8
y.create.l HWIO_A2_FRAG1_QUEUE_RD_PTR_ADDR A:0xfcb20aac
y.create.l HWIO_A2_FRAG0_RD_PTR_INIT_EN_ADDR A:0xfcb20acc
y.create.l HWIO_A2_FRAG1_RD_PTR_INIT_EN_ADDR A:0xfcb20ad0
y.create.l HWIO_A2_TIMER0_CFG_ADDR A:0xfcb20a10
y.create.l HWIO_A2_TIMER1_CFG_ADDR A:0xfcb20a14
y.create.l HWIO_A2_TIMER2_CFG_ADDR A:0xfcb20a18
y.create.l HWIO_A2_TIMER3_CFG_ADDR A:0xfcb20a1c
y.create.l HWIO_A2_TIMER0_CMD_ADDR A:0xfcb20a20
y.create.l HWIO_A2_TIMER1_CMD_ADDR A:0xfcb20a24
y.create.l HWIO_A2_TIMER2_CMD_ADDR A:0xfcb20a28
y.create.l HWIO_A2_TIMER3_CMD_ADDR A:0xfcb20a2c
y.create.l HWIO_A2_TIMER0_PERIOD_ADDR A:0xfcb20a40
y.create.l HWIO_A2_TIMER1_PERIOD_ADDR A:0xfcb20a44
y.create.l HWIO_A2_TIMER2_PERIOD_ADDR A:0xfcb20a48
y.create.l HWIO_A2_TIMER3_PERIOD_ADDR A:0xfcb20a4c
y.create.l HWIO_A2_TIMER0_STATUS_ADDR A:0xfcb20a50
y.create.l HWIO_A2_TIMER1_STATUS_ADDR A:0xfcb20a54
y.create.l HWIO_A2_TIMER2_STATUS_ADDR A:0xfcb20a58
y.create.l HWIO_A2_TIMER3_STATUS_ADDR A:0xfcb20a5c
y.create.l HWIO_A2_PER_DL_CFG_ADDR A:0xfcb20a70
y.create.l HWIO_A2_PER0_UL_CFG_ADDR A:0xfcb20a74
y.create.l HWIO_A2_PER1_UL_CFG_ADDR A:0xfcb20a78
y.create.l HWIO_A2_PER2_UL_CFG_ADDR A:0xfcb20a7c
y.create.l HWIO_A2_DL_PHY_DEC_TRBLK_THRESHOLD_ADDR A:0xfcb20a90
y.create.l HWIO_A2_DL_PHY_CFG_ADDR A:0xfcb20a94
y.create.l HWIO_A2_HW_THRD_EN_ADDR A:0xfcb20a98
y.create.l HWIO_A2_UL_PHY_CFG_ADDR A:0xfcb20a9c
y.create.l HWIO_A2_LTE_DLPHY_CMD_ADDR_ADDR A:0xfcb20ab0
y.create.l HWIO_A2_IP_FILT_FRAG_ADDR_ADDR A:0xfcb20ab4
y.create.l HWIO_A2_MCDMA_DMA_IN_ADDR_ADDR A:0xfcb20ab8
y.create.l HWIO_A2_MCDMA_DMA_OUT_ADDR_ADDR A:0xfcb20abc
y.create.l HWIO_A2_MCDMA_TASK_ADDR_ADDR A:0xfcb20ac0
y.create.l HWIO_A2_MCDMA_BAM_NDP_ADDR_ADDR A:0xfcb20ac4
y.create.l HWIO_A2_DECOB_PREFETCH_ADDR_ADDR A:0xfcb20ac8
y.create.l HWIO_A2_MCDMA_OST_BRST_ADDR A:0xfcb20ad4
y.create.l HWIO_A2_MCDMA_MAX_BRST_SIZE_ADDR A:0xfcb20ad8
y.create.l HWIO_A2_HW_CLK_CTL_ADDR A:0xfcb20ae0
y.create.l HWIO_A2_CLK_EN_CTL_ADDR A:0xfcb20ae4
y.create.l HWIO_A2_CLK_STATUS_ADDR A:0xfcb20ae8
y.create.l HWIO_A2_UL_PER_1ST_PKT_INT_EN_ADDR A:0xfcb20aec
y.create.l HWIO_A2_DBG_LINK_RD_ADDR A:0xfcb20af0
y.create.l HWIO_A2_DBG_FRAG0_LEN_ADDR A:0xfcb20af8
y.create.l HWIO_A2_DBG_FRAG1_LEN_ADDR A:0xfcb20afc
y.create.l HWIO_A2_DBG_FRAG2_LEN_ADDR A:0xfcb20b00
y.create.l HWIO_A2_DBG_FRAG3_LEN_ADDR A:0xfcb20b04
y.create.l HWIO_A2_DBG_FRAG4_LEN_ADDR A:0xfcb20b08
y.create.l HWIO_A2_DBG_FRAG0_ADDR_CUR_ADDR A:0xfcb20b0c
y.create.l HWIO_A2_DBG_FRAG1_ADDR_CUR_ADDR A:0xfcb20b10
y.create.l HWIO_A2_DBG_FRAG2_ADDR_CUR_ADDR A:0xfcb20b14
y.create.l HWIO_A2_DBG_FRAG3_ADDR_CUR_ADDR A:0xfcb20b18
y.create.l HWIO_A2_DBG_FRAG4_ADDR_CUR_ADDR A:0xfcb20b1c
y.create.l HWIO_A2_DBG_FRAG0_ADDR_NXT_ADDR A:0xfcb20b20
y.create.l HWIO_A2_DBG_FRAG1_ADDR_NXT_ADDR A:0xfcb20b24
y.create.l HWIO_A2_DBG_FRAG2_ADDR_NXT_ADDR A:0xfcb20b28
y.create.l HWIO_A2_DBG_FRAG3_ADDR_NXT_ADDR A:0xfcb20b2c
y.create.l HWIO_A2_DBG_FRAG4_ADDR_NXT_ADDR A:0xfcb20b30
y.create.l HWIO_A2_DBG_FRAG0_PTR_ADDR A:0xfcb20b34
y.create.l HWIO_A2_DBG_FRAG1_PTR_ADDR A:0xfcb20b38
y.create.l HWIO_A2_DBG_FRAG2_PTR_ADDR A:0xfcb20b3c
y.create.l HWIO_A2_DBG_FRAG3_PTR_ADDR A:0xfcb20b40
y.create.l HWIO_A2_DBG_FRAG4_PTR_ADDR A:0xfcb20b44
y.create.l HWIO_A2_DBG_TRBLK_LENGTH_ADDR A:0xfcb20b60
y.create.l HWIO_A2_DBG_TRBLK_START_ADDR_ADDR A:0xfcb20b64
y.create.l HWIO_A2_DBG_TRBLK_SW_INFO0_ADDR A:0xfcb20b68
y.create.l HWIO_A2_DBG_TRBLK_SW_INFO1_ADDR A:0xfcb20b6c
y.create.l HWIO_A2_DBG_TRBLK_TRIGGER_ADDR A:0xfcb20b70
y.create.l HWIO_A2_DBG_TRBLK_STATUS_ADDR A:0xfcb20b74
y.create.l HWIO_A2_DBG_STRM_ID_ADDR A:0xfcb20b80
y.create.l HWIO_A2_DBG_DMA_SRC_ADDR A:0xfcb20b84
y.create.l HWIO_A2_DBG_DMA_DST_ADDR A:0xfcb20b8c
y.create.l HWIO_A2_DBG_DMA_CTL_ADDR A:0xfcb20b90
y.create.l HWIO_A2_DBG_TASK_FETCHER_ADDR A:0xfcb20b94
y.create.l HWIO_A2_DBG_DL0_BAM_ADDR A:0xfcb20b98
y.create.l HWIO_A2_DBG_DL1_BAM_ADDR A:0xfcb20b9c
y.create.l HWIO_A2_DBG_DL2_BAM_ADDR A:0xfcb20ba0
y.create.l HWIO_A2_DBG_UL0_BAM_ADDR A:0xfcb20ba4
y.create.l HWIO_A2_DBG_UL1_BAM_ADDR A:0xfcb20ba8
y.create.l HWIO_A2_DBG_UL2_BAM_ADDR A:0xfcb20bac
y.create.l HWIO_A2_DBG_FRM_ADDR A:0xfcb20bb0
y.create.l HWIO_A2_DBG_DFRM_ADDR A:0xfcb20bb4
y.create.l HWIO_A2_DBG_CIPH_ADDR A:0xfcb20bb8
y.create.l HWIO_A2_DBG_IPF_ADDR A:0xfcb20bbc
y.create.l HWIO_A2_DBG_MIU0_ADDR A:0xfcb20bc0
y.create.l HWIO_A2_DBG_MIU1_ADDR A:0xfcb20bc4
y.create.l HWIO_A2_DBG_MIU2_ADDR A:0xfcb20bc8
y.create.l HWIO_A2_DBG_MIU3_ADDR A:0xfcb20bcc
y.create.l HWIO_A2_DBG_TASK_WORD_ADDR A:0xfcb20bd0
y.create.l HWIO_DBG_RESET_ADDR A:0xfcb20c00
y.create.l HWIO_DBG_ENABLE_ADDR A:0xfcb20c04
y.create.l HWIO_DBG_LOG_STATUS_ADDR A:0xfcb20c08
y.create.l HWIO_DBG_MUX_MASK_0_ADDR A:0xfcb20c0c
y.create.l HWIO_DBG_MUX_MASK_1_ADDR A:0xfcb20c10
y.create.l HWIO_DBG_MUX_MASK_2_ADDR A:0xfcb20c14
y.create.l HWIO_DBG_MUX_MASK_3_ADDR A:0xfcb20c18
y.create.l HWIO_DBG_MUX_MASK_4_ADDR A:0xfcb20c1c
y.create.l HWIO_DBG_MUX_MASK_5_ADDR A:0xfcb20c20
y.create.l HWIO_DBG_MUX_MASK_6_ADDR A:0xfcb20c24
y.create.l HWIO_DBG_MUX_MASK_7_ADDR A:0xfcb20c28
y.create.l HWIO_DBG_MUX_MASK_8_ADDR A:0xfcb20c2c
y.create.l HWIO_DBG_MUX_MASK_9_ADDR A:0xfcb20c30
y.create.l HWIO_DBG_PORT_MUX_ADDR A:0xfcb20c4c
y.create.l HWIO_DBG_ERR_IRQ_MASK0_ADDR A:0xfcb20c50
y.create.l HWIO_DBG_ERR_IRQ_MASK1_ADDR A:0xfcb20c54
y.create.l HWIO_DBG_SW_LOG_ADDR A:0xfcb20c58
y.create.l HWIO_DBG_DATA_DST_ADDR A:0xfcb20c5c
y.create.l HWIO_DBG_START_ADDR_ADDR A:0xfcb20c60
y.create.l HWIO_DBG_EXT_MEM_CNT_VAL_ADDR A:0xfcb20c64
y.create.l HWIO_DBG_SHRD_START_ADDR_ADDR A:0xfcb20c68
y.create.l HWIO_DBG_SHRD_END_ADDR_ADDR A:0xfcb20c6c
y.create.l HWIO_DBG_MAX_OST_BURSTS_ADDR A:0xfcb20c70
y.create.l HWIO_DBG_ERR_IRQ_EN0_ADDR A:0xfcb20c74
y.create.l HWIO_DBG_ERR_IRQ_EN1_ADDR A:0xfcb20c78
y.create.l HWIO_DBG_ERR_IRQ_CLR0_ADDR A:0xfcb20c7c
y.create.l HWIO_DBG_ERR_IRQ_CLR1_ADDR A:0xfcb20c80
y.create.l HWIO_DBG_ERR_IRQ_STATUS0_ADDR A:0xfcb20c84
y.create.l HWIO_DBG_ERR_IRQ_STATUS1_ADDR A:0xfcb20c88
y.create.l HWIO_MTC_BRDG_MCDMA_RD_ENABLE_ADDR A:0xfcb2100c
y.create.l HWIO_MTC_BRDG_MCDMA_WR_ENABLE_ADDR A:0xfcb21010
y.create.l HWIO_MTC_BRDG_A2_RD_ENABLE_ADDR A:0xfcb21014
y.create.l HWIO_MTC_BRDG_CTL_ADDR A:0xfcb21000
y.create.l HWIO_MTC_BRDG_STATUS_ADDR A:0xfcb21004
y.create.l HWIO_MTC_BRDG_CLEAR_ADDR A:0xfcb21008
y.create.l HWIO_A2_SHRD_MEM_BASE_MIN_ADDR A:0xfcb22000
y.create.l HWIO_A2_SHRD_MEM_BASE_MAX_ADDR A:0xfcb2367c
y.create.l HWIO_MCDMA_TS_STATUS_WORD0_ADDR A:0xfcb24000
y.create.l HWIO_MCDMA_TS_VBUF_CFG_WORD0_ADDR A:0xfcb24100
y.create.l HWIO_MCDMA_TS_VBUF_CFG_WORD1_ADDR A:0xfcb24104
y.create.l HWIO_MCDMA_TS_DMA_CH0_WORD0_ADDR A:0xfcb24200
y.create.l HWIO_MCDMA_TS_DMA_CH0_WORD1_ADDR A:0xfcb24204
y.create.l HWIO_MCDMA_TS_DMA_CH0_WORD2_ADDR A:0xfcb24208
y.create.l HWIO_MCDMA_TS_DMA_CH1_WORD0_ADDR A:0xfcb24300
y.create.l HWIO_MCDMA_TS_DMA_CH1_WORD1_ADDR A:0xfcb24304
y.create.l HWIO_MCDMA_TS_DMA_CH1_WORD2_ADDR A:0xfcb24308
y.create.l HWIO_MCDMA_TS_DMA_CH2_WORD0_ADDR A:0xfcb24400
y.create.l HWIO_MCDMA_TS_DMA_CH2_WORD1_ADDR A:0xfcb24404
y.create.l HWIO_MCDMA_TS_DMA_CH2_WORD2_ADDR A:0xfcb24408
y.create.l HWIO_MCDMA_TS_DMA_CH3_WORD0_ADDR A:0xfcb24500
y.create.l HWIO_MCDMA_TS_DMA_CH3_WORD1_ADDR A:0xfcb24504
y.create.l HWIO_MCDMA_TS_DMA_CH3_WORD2_ADDR A:0xfcb24508
y.create.l HWIO_DBG_STATUS_WORD0_ADDR A:0xfcb24800
y.create.l HWIO_DBG_TASK_WORD0_ADDR A:0xfcb24900
y.create.l HWIO_DBG_TASK_WORD1_ADDR A:0xfcb24904
y.create.l HWIO_O_STMR_RESET_ADDR A:0xfcb28000
y.create.l HWIO_O_STMR_ST_EVENT_CTL_ADDR A:0xfcb28004
y.create.l HWIO_O_STMR_FCW_ADDR A:0xfcb28008
y.create.l HWIO_O_STMR_MASK_CTL_ADDR A:0xfcb2800c
y.create.l HWIO_O_STMR_ENABLE_ADDR A:0xfcb28010
y.create.l HWIO_O_STMR_TIMER_CMD_ADDR A:0xfcb28014
y.create.l HWIO_O_STMR_MSTMR_ADDR A:0xfcb28018
y.create.l HWIO_O_STMR_MSTMR_PHASE_ADDR A:0xfcb28098
y.create.l HWIO_O_STMR_MSTMR_LD_VALUE_ADDR A:0xfcb2801c
y.create.l HWIO_O_STMR_MSTMR_WRAP_ADDR A:0xfcb28020
y.create.l HWIO_O_STMR_STROBE_CTL_0_ADDR A:0xfcb28024
y.create.l HWIO_O_STMR_STROBE_CTL_1_ADDR A:0xfcb28028
y.create.l HWIO_O_STMR_STROBE_CTL_2_ADDR A:0xfcb2802c
y.create.l HWIO_O_STMR_STROBE_CTL_3_ADDR A:0xfcb28030
y.create.l HWIO_O_STMR_STROBE_CTL_4_ADDR A:0xfcb28034
y.create.l HWIO_O_STMR_STROBE_CTL_5_ADDR A:0xfcb28038
y.create.l HWIO_O_STMR_STROBE_CTL_6_ADDR A:0xfcb2803c
y.create.l HWIO_O_STMR_STROBE_CTL_7_ADDR A:0xfcb28040
y.create.l HWIO_O_STMR_STROBE_CTL_8_ADDR A:0xfcb28044
y.create.l HWIO_O_STMR_STROBE_CTL_9_ADDR A:0xfcb28048
y.create.l HWIO_O_STMR_INT0_STATUS_ADDR A:0xfcb28064
y.create.l HWIO_O_STMR_INT0_CLR_ADDR A:0xfcb28068
y.create.l HWIO_O_STMR_INT1_STATUS_ADDR A:0xfcb2806c
y.create.l HWIO_O_STMR_INT1_CLR_ADDR A:0xfcb28070
y.create.l HWIO_O_STMR_STATUS_DUMP_CMD_ADDR A:0xfcb28074
y.create.l HWIO_O_STMR_MSTMR_STATUS_ADDR A:0xfcb28078
y.create.l HWIO_O_STMR_MSTMR_PHASE_STATUS_ADDR A:0xfcb2807c
y.create.l HWIO_TDS_STMR_ENABLE_ADDR A:0xfcb28400
y.create.l HWIO_TDS_STMR_STATUS_ADDR A:0xfcb28404
y.create.l HWIO_TDS_STMR_FCW_CTL_ADDR A:0xfcb28408
y.create.l HWIO_TDS_STMR_RESET_ADDR A:0xfcb2840c
y.create.l HWIO_TDS_STMR_ST_EVENT_CMD_ADDR A:0xfcb28410
y.create.l HWIO_TDS_STMR_ST_EVENT_TIME_ADDR A:0xfcb28414
y.create.l HWIO_TDS_STMR_WALLTIME_COUNT_ADDR A:0xfcb28418
y.create.l HWIO_TDS_STMR_COMMON_PHASE_ADDR A:0xfcb2841c
y.create.l HWIO_TDS_STMR_WALLTIME_CMD_ADDR A:0xfcb28420
y.create.l HWIO_TDS_STMR_WALL_TIME_MODIFIER_ADDR A:0xfcb28424
y.create.l HWIO_TDS_STMR_WALLTIME_INT_EVENT_0_ADDR A:0xfcb28428
y.create.l HWIO_TDS_STMR_WALLTIME_INT_EVENT_1_ADDR A:0xfcb2842c
y.create.l HWIO_TDS_STMR_WALLTIME_INT_EVENT_2_ADDR A:0xfcb28430
y.create.l HWIO_TDS_STMR_WALLTIME_INT_EVENT_3_ADDR A:0xfcb28434
y.create.l HWIO_TDS_STMR_WALLTIME_INT_EVENT_4_ADDR A:0xfcb28438
y.create.l HWIO_TDS_STMR_WALLTIME_INT_EVENT_5_ADDR A:0xfcb2843c
y.create.l HWIO_TDS_STMR_WALLTIME_INT_EVENT_6_ADDR A:0xfcb28440
y.create.l HWIO_TDS_STMR_WALLTIME_INT_EVENT_7_ADDR A:0xfcb28444
y.create.l HWIO_TDS_STMR_WALLTIME_INT_CMD_ADDR A:0xfcb28448
y.create.l HWIO_TDS_STMR_WALLTIME_INT_STATUS_ADDR A:0xfcb2844c
y.create.l HWIO_TDS_STMR_RXTIME_COUNT_ADDR A:0xfcb28450
y.create.l HWIO_TDS_STMR_RXTIME_CMD_ADDR A:0xfcb28454
y.create.l HWIO_TDS_STMR_RX_TIME_MODIFIER_ADDR A:0xfcb28458
y.create.l HWIO_TDS_STMR_RXTIME_INT_EVENT_0_ADDR A:0xfcb2845c
y.create.l HWIO_TDS_STMR_RXTIME_INT_EVENT_1_ADDR A:0xfcb28460
y.create.l HWIO_TDS_STMR_RXTIME_INT_EVENT_2_ADDR A:0xfcb28464
y.create.l HWIO_TDS_STMR_RXTIME_INT_EVENT_3_ADDR A:0xfcb28468
y.create.l HWIO_TDS_STMR_RXTIME_INT_EVENT_4_ADDR A:0xfcb2846c
y.create.l HWIO_TDS_STMR_RXTIME_INT_EVENT_5_ADDR A:0xfcb28470
y.create.l HWIO_TDS_STMR_RXTIME_INT_EVENT_6_ADDR A:0xfcb28474
y.create.l HWIO_TDS_STMR_RXTIME_INT_EVENT_7_ADDR A:0xfcb28478
y.create.l HWIO_TDS_STMR_RXTIME_INT_EVENT_8_ADDR A:0xfcb2847c
y.create.l HWIO_TDS_STMR_RXTIME_INT_EVENT_9_ADDR A:0xfcb28480
y.create.l HWIO_TDS_STMR_RXTIME_INT_STATUS_ADDR A:0xfcb2849c
y.create.l HWIO_TDS_STMR_RXTIME_INT_CMD_ADDR A:0xfcb284a0
y.create.l HWIO_TDS_STMR_STATUS_DUMP_CMD_ADDR A:0xfcb284a4
y.create.l HWIO_TDS_STMR_WALLTIME_COUNT_STATUS_ADDR A:0xfcb284a8
y.create.l HWIO_TDS_STMR_COMMON_PHASE_STATUS_ADDR A:0xfcb284ac
y.create.l HWIO_TDS_STMR_RXTIME_COUNT_STATUS_ADDR A:0xfcb284b0
y.create.l HWIO_TDS_STMR_TIME_SYNC_CTL_ADDR A:0xfcb284b4
y.create.l HWIO_VFR_EVENT_ADDR A:0xfcb284e8
y.create.l HWIO_UNIV_STMR_RESET_ADDR A:0xfcb28800
y.create.l HWIO_UNIV_STMR_ENABLE_ADDR A:0xfcb28804
y.create.l HWIO_UNIV_STMR_MSTMR_ADDR A:0xfcb28808
y.create.l HWIO_UNIV_STMR_SYNC_CMD_ADDR A:0xfcb2880c
y.create.l HWIO_UNIV_STMR_MODIFIER_ADJ_ADDR A:0xfcb28810
y.create.l HWIO_UNIV_STMR_STATUS_ADDR A:0xfcb28814
y.create.l HWIO_SYS_ONLINE_CTRL0_ADDR A:0xfcb28818
y.create.l HWIO_SYS_ONLINE_CTRL1_ADDR A:0xfcb2881c
y.create.l HWIO_SYS_ONLINE_CMD0_ADDR A:0xfcb28820
y.create.l HWIO_SYS_ONLINE_CMD1_ADDR A:0xfcb28824
y.create.l HWIO_SYS_ONLINE_TIME0_ADDR A:0xfcb28828
y.create.l HWIO_SYS_ONLINE_TIME1_ADDR A:0xfcb2882c
y.create.l HWIO_SYS_ONLINE_STATUS_ADDR A:0xfcb28830
y.create.l HWIO_UNIV_STMR_STATUS_DUMP_CMD_ADDR A:0xfcb28834
y.create.l HWIO_UNIV_STMR_TIME_STATUS_RD_ADDR A:0xfcb28838
y.create.l HWIO_O_STMR_TIME_STATUS_RD_ADDR A:0xfcb2883c
y.create.l HWIO_O_STMR_PHASE_STATUS_RD_ADDR A:0xfcb28840
y.create.l HWIO_RTC_1X_TIME_STATUS_RD_ADDR A:0xfcb28844
y.create.l HWIO_TX_1X_TIME_STATUS_RD_ADDR A:0xfcb28848
y.create.l HWIO_RTC_1X_PHASE_STATUS_RD_ADDR A:0xfcb2884c
y.create.l HWIO_RTC_HDR_TIME_STATUS_RD_ADDR A:0xfcb28850
y.create.l HWIO_RTC_HDR_PHASE_STATUS_RD_ADDR A:0xfcb28854
y.create.l HWIO_GSM_TIME_STATUS_RD_ADDR A:0xfcb28858
y.create.l HWIO_GSM_PHASE_STATUS_RD_ADDR A:0xfcb2885c
y.create.l HWIO_UMTS_STMR_TIME_STATUS_RD_ADDR A:0xfcb28860
y.create.l HWIO_UMTS_TX_TIME_STATUS_RD_ADDR A:0xfcb28864
y.create.l HWIO_UMTS_STMR_PHASE_STATUS_RD_ADDR A:0xfcb28868
y.create.l HWIO_TDS_WALLTIME_STATUS_RD_ADDR A:0xfcb2886c
y.create.l HWIO_TDS_RXTIME_STATUS_RD_ADDR A:0xfcb28870
y.create.l HWIO_TDS_PHASE_STATUS_RD_ADDR A:0xfcb28874
y.create.l HWIO_RXFE_C0_TRIG_CMD_ADDR A:0xfcb28878
y.create.l HWIO_RXFE_C1_TRIG_CMD_ADDR A:0xfcb2887c
y.create.l HWIO_RXFE_C2_TRIG_CMD_ADDR A:0xfcb28880
y.create.l HWIO_RXFE_C3_TRIG_CMD_ADDR A:0xfcb28884
y.create.l HWIO_RXFE_C0_TRIG_VAL_ADDR A:0xfcb28888
y.create.l HWIO_RXFE_C1_TRIG_VAL_ADDR A:0xfcb2888c
y.create.l HWIO_RXFE_C2_TRIG_VAL_ADDR A:0xfcb28890
y.create.l HWIO_RXFE_C3_TRIG_VAL_ADDR A:0xfcb28894
y.create.l HWIO_RXFE_TRIG_STATUS_ADDR A:0xfcb28898
y.create.l HWIO_RXFE_C0_TRIG_RD_ADDR A:0xfcb2889c
y.create.l HWIO_RXFE_C1_TRIG_RD_ADDR A:0xfcb288a0
y.create.l HWIO_RXFE_C2_TRIG_RD_ADDR A:0xfcb288a4
y.create.l HWIO_RXFE_C3_TRIG_RD_ADDR A:0xfcb288a8
y.create.l HWIO_TX_C0_CTRL_SEL_ADDR A:0xfcb288ac
y.create.l HWIO_TX_C1_CTRL_SEL_ADDR A:0xfcb288b0
y.create.l HWIO_TX_C0_TRIG_CMD_ADDR A:0xfcb288b4
y.create.l HWIO_TX_C1_TRIG_CMD_ADDR A:0xfcb288b8
y.create.l HWIO_TX_C0_TRIG_VAL_ADDR A:0xfcb288bc
y.create.l HWIO_TX_C1_TRIG_VAL_ADDR A:0xfcb288c0
y.create.l HWIO_TX_TRIG_STATUS_ADDR A:0xfcb288c4
y.create.l HWIO_TX_C0_TRIG_RD_ADDR A:0xfcb288c8
y.create.l HWIO_TX_C1_TRIG_RD_ADDR A:0xfcb288cc
y.create.l HWIO_UNIV_STMR_TX_SYNC_TIME0_ADDR A:0xfcb288d0
y.create.l HWIO_UNIV_STMR_TX_SYNC_TIME1_ADDR A:0xfcb288d4
y.create.l HWIO_UNIV_STMR_TRIG_CTRL_ADDR A:0xfcb288d8
y.create.l HWIO_UNIV_STMR_TRIG_MASK_ADDR A:0xfcb288dc
y.create.l HWIO_VFR_SEL_ADDR A:0xfcb288e0
y.create.l HWIO_UNIV_STMR_SPARE_ADDR A:0xfcb288e4
y.create.l HWIO_SYS_SLEEP_STATUS_ADDR A:0xfcb288e8
y.create.l HWIO_UNIV_STMR_LD_CMD_ADDR A:0xfcb288ec
y.create.l HWIO_UNIV_STMR_MODIFIER_LD_ADDR A:0xfcb288f0
y.create.l HWIO_UMTS_STMR_ENABLE_ADDR A:0xfcb29000
y.create.l HWIO_UMTS_STMR_STATUS_ADDR A:0xfcb29004
y.create.l HWIO_STMR_FCW_CTL_ADDR A:0xfcb29008
y.create.l HWIO_STMR_RESET_ADDR A:0xfcb2900c
y.create.l HWIO_STMR_ST_EVENT_CTL_ADDR A:0xfcb29010
y.create.l HWIO_STMR_TIME_CMD_PRI_ADDR A:0xfcb29014
y.create.l HWIO_STMR_WALL_TIME_MODIFIER_ADDR A:0xfcb29018
y.create.l HWIO_STMR_STATUS_DUMP_CMD_PRI_ADDR A:0xfcb2901c
y.create.l HWIO_STMR_REF_COUNT_STATUS_PRI_ADDR A:0xfcb29020
y.create.l HWIO_STMR_TX_TIME_STATUS_PRI_ADDR A:0xfcb29024
y.create.l HWIO_STMR_C0_COUNT_STATUS_ADDR A:0xfcb29028
y.create.l HWIO_STMR_C1_COUNT_STATUS_ADDR A:0xfcb2902c
y.create.l HWIO_STMR_C2_COUNT_STATUS_ADDR A:0xfcb29030
y.create.l HWIO_STMR_PHASE_PRI_ADDR A:0xfcb29038
y.create.l HWIO_STMR_REF_COUNT_ADDR A:0xfcb2903c
y.create.l HWIO_STMR_REF_PHASE_ADDR A:0xfcb29318
y.create.l HWIO_STMR_COMBINER_COUNT0_PRI_ADDR A:0xfcb29040
y.create.l HWIO_STMR_COMBINER_COUNT1_PRI_ADDR A:0xfcb29044
y.create.l HWIO_STMR_COMBINER_COUNT2_PRI_ADDR A:0xfcb29048
y.create.l HWIO_STMR_CFN_COUNT0_ADDR A:0xfcb29050
y.create.l HWIO_STMR_CFN_COUNT1_ADDR A:0xfcb29054
y.create.l HWIO_STMR_CFN_COUNT2_ADDR A:0xfcb29058
y.create.l HWIO_STMR_TIME_SYNC_CTL_ADDR A:0xfcb29060
y.create.l HWIO_STMR_CN_MODIFIER_ON_LINE_ADDR A:0xfcb29064
y.create.l HWIO_STMR_MISC_CTL_ADDR A:0xfcb29068
y.create.l HWIO_STMR_TX_10MS_INT_OFFSET_ADDR A:0xfcb2906c
y.create.l HWIO_STMR_PROG_INT0_STATUS_ADDR A:0xfcb29070
y.create.l HWIO_STMR_PROG_INT1_STATUS_ADDR A:0xfcb29074
y.create.l HWIO_STMR_PROG_INT2_STATUS_ADDR A:0xfcb29078
y.create.l HWIO_STMR_PROG_INT0_CMD_ADDR A:0xfcb29080
y.create.l HWIO_STMR_PROG_INT1_CMD_ADDR A:0xfcb29084
y.create.l HWIO_STMR_PROG_INT2_CMD_ADDR A:0xfcb29088
y.create.l HWIO_STMR_PROG_INT0_CTL_ADDR A:0xfcb29090
y.create.l HWIO_STMR_PROG_INT1_CTL_ADDR A:0xfcb29094
y.create.l HWIO_STMR_PROG_INT2_CTL_ADDR A:0xfcb29098
y.create.l HWIO_STMR_INT0_EVENT_0_ADDR A:0xfcb290a0
y.create.l HWIO_STMR_INT0_EVENT_1_ADDR A:0xfcb290a4
y.create.l HWIO_STMR_INT0_EVENT_2_ADDR A:0xfcb290a8
y.create.l HWIO_STMR_INT0_EVENT_3_ADDR A:0xfcb290ac
y.create.l HWIO_STMR_INT0_EVENT_4_ADDR A:0xfcb290b0
y.create.l HWIO_STMR_INT0_EVENT_5_ADDR A:0xfcb290b4
y.create.l HWIO_STMR_INT0_EVENT_6_ADDR A:0xfcb290b8
y.create.l HWIO_STMR_INT0_EVENT_7_ADDR A:0xfcb290bc
y.create.l HWIO_STMR_INT0_EVENT_8_ADDR A:0xfcb290c0
y.create.l HWIO_STMR_INT0_EVENT_9_ADDR A:0xfcb290c4
y.create.l HWIO_STMR_INT1_EVENT_0_ADDR A:0xfcb290e0
y.create.l HWIO_STMR_INT1_EVENT_1_ADDR A:0xfcb290e4
y.create.l HWIO_STMR_INT1_EVENT_2_ADDR A:0xfcb290e8
y.create.l HWIO_STMR_INT1_EVENT_3_ADDR A:0xfcb290ec
y.create.l HWIO_STMR_INT1_EVENT_4_ADDR A:0xfcb290f0
y.create.l HWIO_STMR_INT1_EVENT_5_ADDR A:0xfcb290f4
y.create.l HWIO_STMR_INT1_EVENT_6_ADDR A:0xfcb290f8
y.create.l HWIO_STMR_INT1_EVENT_7_ADDR A:0xfcb290fc
y.create.l HWIO_STMR_INT1_EVENT_8_ADDR A:0xfcb29100
y.create.l HWIO_STMR_INT1_EVENT_9_ADDR A:0xfcb29104
y.create.l HWIO_STMR_INT2_EVENT_0_ADDR A:0xfcb29120
y.create.l HWIO_STMR_INT2_EVENT_1_ADDR A:0xfcb29124
y.create.l HWIO_STMR_INT2_EVENT_2_ADDR A:0xfcb29128
y.create.l HWIO_STMR_INT2_EVENT_3_ADDR A:0xfcb2912c
y.create.l HWIO_STMR_INT2_EVENT_4_ADDR A:0xfcb29130
y.create.l HWIO_STMR_INT2_EVENT_5_ADDR A:0xfcb29134
y.create.l HWIO_STMR_INT2_EVENT_6_ADDR A:0xfcb29138
y.create.l HWIO_STMR_INT2_EVENT_7_ADDR A:0xfcb2913c
y.create.l HWIO_STMR_INT2_EVENT_8_ADDR A:0xfcb29140
y.create.l HWIO_STMR_INT2_EVENT_9_ADDR A:0xfcb29144
y.create.l HWIO_STMR_TIME_CMD_SNP_ADDR A:0xfcb291a0
y.create.l HWIO_STMR_TX_TARGET_REF_COUNT_ADDR A:0xfcb291ac
y.create.l HWIO_STMR_TX_TIME_MODIFIER_ADDR A:0xfcb291b0
y.create.l HWIO_STMR_COMBINER_CMD_SNP_ADDR A:0xfcb291b4
y.create.l HWIO_STMR_C0_TARGET_REF_COUNT_ADDR A:0xfcb291b8
y.create.l HWIO_STMR_C1_TARGET_REF_COUNT_ADDR A:0xfcb291bc
y.create.l HWIO_STMR_C2_TARGET_REF_COUNT_ADDR A:0xfcb291c0
y.create.l HWIO_STMR_CFN0_MODIFIER_ADDR A:0xfcb29308
y.create.l HWIO_STMR_CFN1_MODIFIER_ADDR A:0xfcb2930c
y.create.l HWIO_STMR_CFN2_MODIFIER_ADDR A:0xfcb29310
y.create.l HWIO_STMR_C0_MODIFIER_ADDR A:0xfcb291c8
y.create.l HWIO_STMR_C1_MODIFIER_ADDR A:0xfcb291cc
y.create.l HWIO_STMR_C2_MODIFIER_ADDR A:0xfcb291d0
y.create.l HWIO_STMR_STATUS_DUMP_CMD_SNP_ADDR A:0xfcb291d8
y.create.l HWIO_STMR_TX_TIME_STATUS_SNP_ADDR A:0xfcb291dc
y.create.l HWIO_STMR_REF_COUNT_STATUS_SNP_ADDR A:0xfcb291e0
y.create.l HWIO_STMR_PHASE_SNP_ADDR A:0xfcb291e8
y.create.l HWIO_STMR_TX_TIME_SNP_ADDR A:0xfcb291ec
y.create.l HWIO_STMR_PROG_SNP_INT0_STATUS_ADDR A:0xfcb291f4
y.create.l HWIO_STMR_PROG_SNP_INT1_STATUS_ADDR A:0xfcb291f8
y.create.l HWIO_STMR_PROG_SNP_INT0_CMD_ADDR A:0xfcb29200
y.create.l HWIO_STMR_PROG_SNP_INT1_CMD_ADDR A:0xfcb29204
y.create.l HWIO_STMR_PROG_SNP_INT0_SET_ADDR A:0xfcb2920c
y.create.l HWIO_STMR_PROG_SNP_INT1_SET_ADDR A:0xfcb29210
y.create.l HWIO_STMR_PROG_SNP_INT0_CTL_ADDR A:0xfcb29218
y.create.l HWIO_STMR_PROG_SNP_INT1_CTL_ADDR A:0xfcb2921c
y.create.l HWIO_STMR_SNP_INT0_EVENT_0_ADDR A:0xfcb29224
y.create.l HWIO_STMR_SNP_INT0_EVENT_1_ADDR A:0xfcb29228
y.create.l HWIO_STMR_SNP_INT0_EVENT_2_ADDR A:0xfcb2922c
y.create.l HWIO_STMR_SNP_INT0_EVENT_3_ADDR A:0xfcb29230
y.create.l HWIO_STMR_SNP_INT0_EVENT_4_ADDR A:0xfcb29234
y.create.l HWIO_STMR_SNP_INT0_EVENT_5_ADDR A:0xfcb29238
y.create.l HWIO_STMR_SNP_INT0_EVENT_6_ADDR A:0xfcb2923c
y.create.l HWIO_STMR_SNP_INT0_EVENT_7_ADDR A:0xfcb29240
y.create.l HWIO_STMR_SNP_INT1_EVENT_0_ADDR A:0xfcb29264
y.create.l HWIO_STMR_SNP_INT1_EVENT_1_ADDR A:0xfcb29268
y.create.l HWIO_STMR_SNP_INT1_EVENT_2_ADDR A:0xfcb2926c
y.create.l HWIO_STMR_SNP_INT1_EVENT_3_ADDR A:0xfcb29270
y.create.l HWIO_CDMA_RTC_ENABLE_ADDR A:0xfcb29800
y.create.l HWIO_RTC_FCW_CTL_ADDR A:0xfcb29804
y.create.l HWIO_RTC_CNT_1X_ADDR A:0xfcb29808
y.create.l HWIO_RTC_PHASE_ADDR A:0xfcb2994c
y.create.l HWIO_RTC_SLEEP_ADDR A:0xfcb2980c
y.create.l HWIO_RTC_OFFSET_ADDR A:0xfcb29810
y.create.l HWIO_RTC_LOAD_ADDR A:0xfcb29814
y.create.l HWIO_RTC_GP_COMPARE1_ADDR A:0xfcb29818
y.create.l HWIO_RTC_GP_COMPARE2_ADDR A:0xfcb2981c
y.create.l HWIO_CDMA_RTC_SYNC_ADDR A:0xfcb29820
y.create.l HWIO_CDMA_PHASE_SYNC_ADDR A:0xfcb29824
y.create.l HWIO_RTC_DIFF_1XHDR_ADDR A:0xfcb29830
y.create.l HWIO_RTC_CTL_ADDR A:0xfcb29834
y.create.l HWIO_RTC_TTRANS_CTL_1XHDR_ADDR A:0xfcb29848
y.create.l HWIO_RTC_DUMP_STATUS_1XHDR_ADDR A:0xfcb2984c
y.create.l HWIO_RTC_TTRANS_TRIG_1X_ADDR A:0xfcb29850
y.create.l HWIO_RTC_TTRANS_TRIG_HDR_ADDR A:0xfcb29854
y.create.l HWIO_RTC_DUMP_1X_ADDR A:0xfcb29858
y.create.l HWIO_RTC_DUMP_HDR_ADDR A:0xfcb2985c
y.create.l HWIO_PHASE_DUMP_1X_ADDR A:0xfcb29860
y.create.l HWIO_PHASE_DUMP_HDR_ADDR A:0xfcb29864
y.create.l HWIO_HDR_RTC_ENABLE_ADDR A:0xfcb29868
y.create.l HWIO_HDR_RTC_FCW_CTL_ADDR A:0xfcb2986c
y.create.l HWIO_HDR_RTC_CNT_ADDR A:0xfcb29870
y.create.l HWIO_HDR_RTC_PHASE_ADDR A:0xfcb29950
y.create.l HWIO_HDR_RTC_SLEEP_ADDR A:0xfcb29954
y.create.l HWIO_HDR_RTC_ADJ_ADDR A:0xfcb29874
y.create.l HWIO_HDR_RTC_MODIFIER_ADDR A:0xfcb29878
y.create.l HWIO_HDR_TX_COMPARE_CNT_ADDR A:0xfcb2987c
y.create.l HWIO_HDR_TX_CAPTURE_CNT_ADDR A:0xfcb29880
y.create.l HWIO_HDR_RX_COMPARE_CNT_ADDR A:0xfcb29884
y.create.l HWIO_HDR_RX_CAPTURE_CNT_ADDR A:0xfcb29888
y.create.l HWIO_HDR_MODTIME_REF_ADDR A:0xfcb2988c
y.create.l HWIO_HDR_MPTIME_REF_ADDR A:0xfcb29890
y.create.l HWIO_RTC_REVMOD_FRM_CNT_OFFSET_CTL_ADDR A:0xfcb29894
y.create.l HWIO_RTC_REVMOD_FRM_CNT_OFFSET_ADDR A:0xfcb29898
y.create.l HWIO_RTC_REVMOD_FRAME_INT_OFFSET_ADDR A:0xfcb2989c
y.create.l HWIO_RTC_REVMOD_TX_TIME_LATCH_ADDR A:0xfcb298a0
y.create.l HWIO_RTC_REVMOD_TX_TIME_RD_ADDR A:0xfcb298a4
y.create.l HWIO_RTC_REVMOD_TX_PHASE_RD_ADDR A:0xfcb298a8
y.create.l HWIO_RTC_REVMOD_TX_SYS_TIME_ADDR A:0xfcb29948
y.create.l HWIO_RTC_REVMOD_TIME_STAMP_CTL_ADDR A:0xfcb298b4
y.create.l HWIO_RTC_REVMOD_TIME_STAMP2_ADDR A:0xfcb298b8
y.create.l HWIO_RTC_REVMOD_TIME_STAMP_ADDR A:0xfcb298bc
y.create.l HWIO_RTC_MOD_LOAD_STMR_UPDATE_CTL_ADDR A:0xfcb298c0
y.create.l HWIO_RTC_MOD_TEST_POINT_DIN_ADDR A:0xfcb298c4
y.create.l HWIO_RTC_MOD_TEST_POINT_SEL_ADDR A:0xfcb298c8
y.create.l HWIO_RTC_MOD_STMR_CMD_ADDR A:0xfcb298cc
y.create.l HWIO_RTC_MOD_ADVRET_CMD_ADDR A:0xfcb298d0
y.create.l HWIO_RTC_MOD_STMR_MODIFIER_1_ADDR A:0xfcb298d4
y.create.l HWIO_RTC_MOD_STMR_MODIFIER_0_ADDR A:0xfcb298d8
y.create.l HWIO_RTC_MOD_TX_SYS_TIME_ADDR A:0xfcb298dc
y.create.l HWIO_RTC_MOD_TX_TIME_LATCH_ADDR A:0xfcb298e0
y.create.l HWIO_RTC_MOD_TX_TIME_RD_ADDR A:0xfcb298e4
y.create.l HWIO_RTC_MOD_TX_PHASE_RD_ADDR A:0xfcb298e8
y.create.l HWIO_RTC_MOD_TX_TIME_DUMP_ADDR A:0xfcb298f8
y.create.l HWIO_RTC_MOD_SLOT_IRQ_OFFSET_ADDR A:0xfcb298fc
y.create.l HWIO_RTC_MOD_SLOT_IRQ_ENABLE_ADDR A:0xfcb29900
y.create.l HWIO_RTC_TX_PCG_INT_ENABLE_ADDR A:0xfcb29904
y.create.l HWIO_RTC_TX_PCG_INT_CLEAR_ADDR A:0xfcb29908
y.create.l HWIO_RTC_TX_PCG_INT_STATUS_ADDR A:0xfcb2990c
y.create.l HWIO_RTC_TX_PCG_INT_OFFSET_ADDR A:0xfcb29910
y.create.l HWIO_RTC_MOD_SYM_IRQ_CTL_ADDR A:0xfcb29914
y.create.l HWIO_RTC_TX_1_25MS_INT_OFFSET_ADDR A:0xfcb2991c
y.create.l HWIO_RTC_MOD_SDO_MODE_ADDR A:0xfcb29938
y.create.l HWIO_RTC_MOD_SDO_CNTR_RESET_ADDR A:0xfcb2993c
y.create.l HWIO_RTC_MOD_DSP_SDO_RATE_ADDR A:0xfcb29940
y.create.l HWIO_RTC_MOD_SDO_SLOT_OFFSET_ADDR A:0xfcb29944
y.create.l HWIO_G_STMR_RESET_ADDR A:0xfcb29c00
y.create.l HWIO_G_STMR_ENABLE_ADDR A:0xfcb29c04
y.create.l HWIO_G_STMR_FCW_CTL_ADDR A:0xfcb29c08
y.create.l HWIO_G_STMR_DCO_PHASE_ADDR A:0xfcb29c0c
y.create.l HWIO_G_STMR_TIME_RD_ADDR A:0xfcb29c10
y.create.l HWIO_G_STMR_SW_IRQ_CONFIG_RW_ADDR A:0xfcb29c14
y.create.l HWIO_G_STMR_TIME_TC_VALUE_ADDR A:0xfcb29c18
y.create.l HWIO_G_STMR_TIME_ORIDE_TC_CMD_ADDR A:0xfcb29c1c
y.create.l HWIO_G_STMR_TIME_ORIDE_TC_RD_ADDR A:0xfcb29c20
y.create.l HWIO_G_STMR_VFR_IRQ_FRAME_ALIGN_CMD_ADDR A:0xfcb29c24
y.create.l HWIO_G_STMR_VFR_IRQ_FRAME_ALIGN_RD_ADDR A:0xfcb29c28
y.create.l HWIO_G_STMR_GEN_GO_TO_SLEEP_CMD_ADDR A:0xfcb29c2c
y.create.l HWIO_G_STMR_SLEEP_STATUS_RD_ADDR A:0xfcb29c30
y.create.l HWIO_G_STMR_TIME_SYNC_CTL_ADDR A:0xfcb29c34
y.create.l HWIO_G_STMR_TIME_ON_LINE_ADDR A:0xfcb29c38
y.create.l HWIO_G_STMR_FW_IRQ0_CONFIG_RW_ADDR A:0xfcb29c3c
y.create.l HWIO_G_STMR_FW_IRQ1_CONFIG_RW_ADDR A:0xfcb29c40
y.create.l HWIO_G_STMR_FW_IRQ2_CONFIG_RW_ADDR A:0xfcb29c44
y.create.l HWIO_G_STMR_FW_IRQ3_CONFIG_RW_ADDR A:0xfcb29c48
y.create.l HWIO_G_STMR_FW_IRQ4_CONFIG_RW_ADDR A:0xfcb29c4c
y.create.l HWIO_G_STMR_FW_IRQ5_CONFIG_RW_ADDR A:0xfcb29c50
y.create.l HWIO_G_STMR_FW_IRQ6_CONFIG_RW_ADDR A:0xfcb29c54
y.create.l HWIO_G_STMR_FW_IRQ7_CONFIG_RW_ADDR A:0xfcb29c58
y.create.l HWIO_G_STMR_FW_IRQ_ENA_ADDR A:0xfcb29c5c
y.create.l HWIO_G_STMR_FW_IRQ_STATUS_RD_ADDR A:0xfcb29c60
y.create.l HWIO_G_STMR_FW_IRQ_CLEAR_CMD_ADDR A:0xfcb29c64
y.create.l HWIO_OCIMEM_HW_VERSION_ADDR A:0xfc488000
y.create.l HWIO_OCIMEM_HW_PROFILE_ADDR A:0xfc488004
y.create.l HWIO_OCIMEM_GEN_CTL_ADDR A:0xfc488008
y.create.l HWIO_OCIMEM_GEN_STAT_ADDR A:0xfc48800c
y.create.l HWIO_OCIMEM_INTC_CLR_ADDR A:0xfc488010
y.create.l HWIO_OCIMEM_INTC_MASK_ADDR A:0xfc488014
y.create.l HWIO_OCIMEM_INTC_STAT_ADDR A:0xfc488018
y.create.l HWIO_OCIMEM_OSW_STATUS_ADDR A:0xfc48801c
y.create.l HWIO_OCIMEM_PSCGC_TIMERS_ADDR A:0xfc488034
y.create.l HWIO_OCIMEM_PSCGC_STAT_ADDR A:0xfc488038
y.create.l HWIO_OCIMEM_PSCGC_M0_M7_CTL_ADDR A:0xfc48803c
y.create.l HWIO_OCIMEM_ERR_ADDRESS_ADDR A:0xfc488060
y.create.l HWIO_OCIMEM_AXI_ERR_SYNDROME_ADDR A:0xfc488064
y.create.l HWIO_OCIMEM_DEBUG_CTL_ADDR A:0xfc488068
y.create.l HWIO_OCIMEM_APU_XPU_SCR_ADDR A:0xfc48a000
y.create.l HWIO_OCIMEM_APU_XPU_SWDR_ADDR A:0xfc48a004
y.create.l HWIO_OCIMEM_APU_XPU_SEAR0_ADDR A:0xfc48a040
y.create.l HWIO_OCIMEM_APU_XPU_SESR_ADDR A:0xfc48a048
y.create.l HWIO_OCIMEM_APU_XPU_SESRRESTORE_ADDR A:0xfc48a04c
y.create.l HWIO_OCIMEM_APU_XPU_SESYNR0_ADDR A:0xfc48a050
y.create.l HWIO_OCIMEM_APU_XPU_SESYNR1_ADDR A:0xfc48a054
y.create.l HWIO_OCIMEM_APU_XPU_SESYNR2_ADDR A:0xfc48a058
y.create.l HWIO_OCIMEM_APU_XPU_MCR_ADDR A:0xfc48a100
y.create.l HWIO_OCIMEM_APU_XPU_MEAR0_ADDR A:0xfc48a140
y.create.l HWIO_OCIMEM_APU_XPU_MESR_ADDR A:0xfc48a148
y.create.l HWIO_OCIMEM_APU_XPU_MESRRESTORE_ADDR A:0xfc48a14c
y.create.l HWIO_OCIMEM_APU_XPU_MESYNR0_ADDR A:0xfc48a150
y.create.l HWIO_OCIMEM_APU_XPU_MESYNR1_ADDR A:0xfc48a154
y.create.l HWIO_OCIMEM_APU_XPU_MESYNR2_ADDR A:0xfc48a158
y.create.l HWIO_OCIMEM_APU_XPU_CR_ADDR A:0xfc48a080
y.create.l HWIO_OCIMEM_APU_XPU_RPU_ACR0_ADDR A:0xfc48a0a0
y.create.l HWIO_OCIMEM_APU_XPU_EAR0_ADDR A:0xfc48a0c0
y.create.l HWIO_OCIMEM_APU_XPU_ESR_ADDR A:0xfc48a0c8
y.create.l HWIO_OCIMEM_APU_XPU_ESRRESTORE_ADDR A:0xfc48a0cc
y.create.l HWIO_OCIMEM_APU_XPU_ESYNR0_ADDR A:0xfc48a0d0
y.create.l HWIO_OCIMEM_APU_XPU_ESYNR1_ADDR A:0xfc48a0d4
y.create.l HWIO_OCIMEM_APU_XPU_ESYNR2_ADDR A:0xfc48a0d8
y.create.l HWIO_OCIMEM_APU_XPU_IDR0_ADDR A:0xfc48a074
y.create.l HWIO_OCIMEM_APU_XPU_IDR1_ADDR A:0xfc48a078
y.create.l HWIO_OCIMEM_APU_XPU_REV_ADDR A:0xfc48a07c
y.create.l HWIO_OCIMEM_APU_XPU_RG0_RACR0_ADDR A:0xfc48a200
y.create.l HWIO_OCIMEM_APU_XPU_RG1_RACR0_ADDR A:0xfc48a280
y.create.l HWIO_OCIMEM_APU_XPU_RG0_WACR0_ADDR A:0xfc48a220
y.create.l HWIO_OCIMEM_APU_XPU_RG1_WACR0_ADDR A:0xfc48a2a0
y.create.l HWIO_OCIMEM_APU_XPU_RG0_SCR_ADDR A:0xfc48a250
y.create.l HWIO_OCIMEM_APU_XPU_RG1_SCR_ADDR A:0xfc48a2d0
y.create.l HWIO_OCIMEM_APU_XPU_RG0_MCR_ADDR A:0xfc48a254
y.create.l HWIO_OCIMEM_APU_XPU_RG1_MCR_ADDR A:0xfc48a2d4
y.create.l HWIO_OCIMEM_MPU_XPU_SCR_ADDR A:0xfc48b000
y.create.l HWIO_OCIMEM_MPU_XPU_SWDR_ADDR A:0xfc48b004
y.create.l HWIO_OCIMEM_MPU_XPU_PRTN_RACR_SSHADOW_ADDR A:0xfc48b008
y.create.l HWIO_OCIMEM_MPU_XPU_PRTN_WACR_SSHADOW_ADDR A:0xfc48b00c
y.create.l HWIO_OCIMEM_MPU_XPU_PRTN_START_SSHADOW0_ADDR A:0xfc48b010
y.create.l HWIO_OCIMEM_MPU_XPU_PRTN_END_SSHADOW0_ADDR A:0xfc48b018
y.create.l HWIO_OCIMEM_MPU_XPU_SEAR0_ADDR A:0xfc48b040
y.create.l HWIO_OCIMEM_MPU_XPU_SESR_ADDR A:0xfc48b048
y.create.l HWIO_OCIMEM_MPU_XPU_SESRRESTORE_ADDR A:0xfc48b04c
y.create.l HWIO_OCIMEM_MPU_XPU_SESYNR0_ADDR A:0xfc48b050
y.create.l HWIO_OCIMEM_MPU_XPU_SESYNR1_ADDR A:0xfc48b054
y.create.l HWIO_OCIMEM_MPU_XPU_SESYNR2_ADDR A:0xfc48b058
y.create.l HWIO_OCIMEM_MPU_XPU_MCR_ADDR A:0xfc48b100
y.create.l HWIO_OCIMEM_MPU_XPU_MEAR0_ADDR A:0xfc48b140
y.create.l HWIO_OCIMEM_MPU_XPU_MESR_ADDR A:0xfc48b148
y.create.l HWIO_OCIMEM_MPU_XPU_MESRRESTORE_ADDR A:0xfc48b14c
y.create.l HWIO_OCIMEM_MPU_XPU_MESYNR0_ADDR A:0xfc48b150
y.create.l HWIO_OCIMEM_MPU_XPU_MESYNR1_ADDR A:0xfc48b154
y.create.l HWIO_OCIMEM_MPU_XPU_MESYNR2_ADDR A:0xfc48b158
y.create.l HWIO_OCIMEM_MPU_XPU_CR_ADDR A:0xfc48b080
y.create.l HWIO_OCIMEM_MPU_XPU_PRTN_RACR_SHADOW_ADDR A:0xfc48b088
y.create.l HWIO_OCIMEM_MPU_XPU_PRTN_WACR_SHADOW_ADDR A:0xfc48b08c
y.create.l HWIO_OCIMEM_MPU_XPU_PRTN_START_SHADOW0_ADDR A:0xfc48b090
y.create.l HWIO_OCIMEM_MPU_XPU_PRTN_END_SHADOW0_ADDR A:0xfc48b098
y.create.l HWIO_OCIMEM_MPU_XPU_RPU_ACR0_ADDR A:0xfc48b0a0
y.create.l HWIO_OCIMEM_MPU_XPU_EAR0_ADDR A:0xfc48b0c0
y.create.l HWIO_OCIMEM_MPU_XPU_ESR_ADDR A:0xfc48b0c8
y.create.l HWIO_OCIMEM_MPU_XPU_ESRRESTORE_ADDR A:0xfc48b0cc
y.create.l HWIO_OCIMEM_MPU_XPU_ESYNR0_ADDR A:0xfc48b0d0
y.create.l HWIO_OCIMEM_MPU_XPU_ESYNR1_ADDR A:0xfc48b0d4
y.create.l HWIO_OCIMEM_MPU_XPU_ESYNR2_ADDR A:0xfc48b0d8
y.create.l HWIO_OCIMEM_MPU_XPU_UMR_RACR_ADDR A:0xfc48b0e0
y.create.l HWIO_OCIMEM_MPU_XPU_UMR_WACR_ADDR A:0xfc48b0e4
y.create.l HWIO_OCIMEM_MPU_XPU_IDR0_ADDR A:0xfc48b074
y.create.l HWIO_OCIMEM_MPU_XPU_IDR1_ADDR A:0xfc48b078
y.create.l HWIO_OCIMEM_MPU_XPU_REV_ADDR A:0xfc48b07c
y.create.l HWIO_OCIMEM_MPU_XPU_PRT0_RACR0_ADDR A:0xfc48b200
y.create.l HWIO_OCIMEM_MPU_XPU_PRT1_RACR0_ADDR A:0xfc48b280
y.create.l HWIO_OCIMEM_MPU_XPU_PRT2_RACR0_ADDR A:0xfc48b300
y.create.l HWIO_OCIMEM_MPU_XPU_PRT3_RACR0_ADDR A:0xfc48b380
y.create.l HWIO_OCIMEM_MPU_XPU_PRT4_RACR0_ADDR A:0xfc48b400
y.create.l HWIO_OCIMEM_MPU_XPU_PRT5_RACR0_ADDR A:0xfc48b480
y.create.l HWIO_OCIMEM_MPU_XPU_PRT6_RACR0_ADDR A:0xfc48b500
y.create.l HWIO_OCIMEM_MPU_XPU_PRT7_RACR0_ADDR A:0xfc48b580
y.create.l HWIO_OCIMEM_MPU_XPU_PRT0_WACR0_ADDR A:0xfc48b220
y.create.l HWIO_OCIMEM_MPU_XPU_PRT1_WACR0_ADDR A:0xfc48b2a0
y.create.l HWIO_OCIMEM_MPU_XPU_PRT2_WACR0_ADDR A:0xfc48b320
y.create.l HWIO_OCIMEM_MPU_XPU_PRT3_WACR0_ADDR A:0xfc48b3a0
y.create.l HWIO_OCIMEM_MPU_XPU_PRT4_WACR0_ADDR A:0xfc48b420
y.create.l HWIO_OCIMEM_MPU_XPU_PRT5_WACR0_ADDR A:0xfc48b4a0
y.create.l HWIO_OCIMEM_MPU_XPU_PRT6_WACR0_ADDR A:0xfc48b520
y.create.l HWIO_OCIMEM_MPU_XPU_PRT7_WACR0_ADDR A:0xfc48b5a0
y.create.l HWIO_OCIMEM_MPU_XPU_PRT0_START0_ADDR A:0xfc48b240
y.create.l HWIO_OCIMEM_MPU_XPU_PRT1_START0_ADDR A:0xfc48b2c0
y.create.l HWIO_OCIMEM_MPU_XPU_PRT2_START0_ADDR A:0xfc48b340
y.create.l HWIO_OCIMEM_MPU_XPU_PRT3_START0_ADDR A:0xfc48b3c0
y.create.l HWIO_OCIMEM_MPU_XPU_PRT4_START0_ADDR A:0xfc48b440
y.create.l HWIO_OCIMEM_MPU_XPU_PRT5_START0_ADDR A:0xfc48b4c0
y.create.l HWIO_OCIMEM_MPU_XPU_PRT6_START0_ADDR A:0xfc48b540
y.create.l HWIO_OCIMEM_MPU_XPU_PRT7_START0_ADDR A:0xfc48b5c0
y.create.l HWIO_OCIMEM_MPU_XPU_PRT0_END0_ADDR A:0xfc48b248
y.create.l HWIO_OCIMEM_MPU_XPU_PRT1_END0_ADDR A:0xfc48b2c8
y.create.l HWIO_OCIMEM_MPU_XPU_PRT2_END0_ADDR A:0xfc48b348
y.create.l HWIO_OCIMEM_MPU_XPU_PRT3_END0_ADDR A:0xfc48b3c8
y.create.l HWIO_OCIMEM_MPU_XPU_PRT4_END0_ADDR A:0xfc48b448
y.create.l HWIO_OCIMEM_MPU_XPU_PRT5_END0_ADDR A:0xfc48b4c8
y.create.l HWIO_OCIMEM_MPU_XPU_PRT6_END0_ADDR A:0xfc48b548
y.create.l HWIO_OCIMEM_MPU_XPU_PRT7_END0_ADDR A:0xfc48b5c8
y.create.l HWIO_OCIMEM_MPU_XPU_PRT0_SCR_ADDR A:0xfc48b250
y.create.l HWIO_OCIMEM_MPU_XPU_PRT1_SCR_ADDR A:0xfc48b2d0
y.create.l HWIO_OCIMEM_MPU_XPU_PRT2_SCR_ADDR A:0xfc48b350
y.create.l HWIO_OCIMEM_MPU_XPU_PRT3_SCR_ADDR A:0xfc48b3d0
y.create.l HWIO_OCIMEM_MPU_XPU_PRT4_SCR_ADDR A:0xfc48b450
y.create.l HWIO_OCIMEM_MPU_XPU_PRT5_SCR_ADDR A:0xfc48b4d0
y.create.l HWIO_OCIMEM_MPU_XPU_PRT6_SCR_ADDR A:0xfc48b550
y.create.l HWIO_OCIMEM_MPU_XPU_PRT7_SCR_ADDR A:0xfc48b5d0
y.create.l HWIO_OCIMEM_MPU_XPU_PRT0_MCR_ADDR A:0xfc48b254
y.create.l HWIO_OCIMEM_MPU_XPU_PRT1_MCR_ADDR A:0xfc48b2d4
y.create.l HWIO_OCIMEM_MPU_XPU_PRT2_MCR_ADDR A:0xfc48b354
y.create.l HWIO_OCIMEM_MPU_XPU_PRT3_MCR_ADDR A:0xfc48b3d4
y.create.l HWIO_OCIMEM_MPU_XPU_PRT4_MCR_ADDR A:0xfc48b454
y.create.l HWIO_OCIMEM_MPU_XPU_PRT5_MCR_ADDR A:0xfc48b4d4
y.create.l HWIO_OCIMEM_MPU_XPU_PRT6_MCR_ADDR A:0xfc48b554
y.create.l HWIO_OCIMEM_MPU_XPU_PRT7_MCR_ADDR A:0xfc48b5d4
y.create.l HWIO_OCIMEM_MPU_XPU_PRT0_CNTL0_ADDR A:0xfc48b258
y.create.l HWIO_OCIMEM_MPU_XPU_PRT1_CNTL0_ADDR A:0xfc48b2d8
y.create.l HWIO_OCIMEM_MPU_XPU_PRT2_CNTL0_ADDR A:0xfc48b358
y.create.l HWIO_OCIMEM_MPU_XPU_PRT3_CNTL0_ADDR A:0xfc48b3d8
y.create.l HWIO_OCIMEM_MPU_XPU_PRT4_CNTL0_ADDR A:0xfc48b458
y.create.l HWIO_OCIMEM_MPU_XPU_PRT5_CNTL0_ADDR A:0xfc48b4d8
y.create.l HWIO_OCIMEM_MPU_XPU_PRT6_CNTL0_ADDR A:0xfc48b558
y.create.l HWIO_OCIMEM_MPU_XPU_PRT7_CNTL0_ADDR A:0xfc48b5d8
y.create.l HWIO_OCIMEM_MPU_XPU_PRT0_CNTL1_ADDR A:0xfc48b25c
y.create.l HWIO_OCIMEM_MPU_XPU_PRT1_CNTL1_ADDR A:0xfc48b2dc
y.create.l HWIO_OCIMEM_MPU_XPU_PRT2_CNTL1_ADDR A:0xfc48b35c
y.create.l HWIO_OCIMEM_MPU_XPU_PRT3_CNTL1_ADDR A:0xfc48b3dc
y.create.l HWIO_OCIMEM_MPU_XPU_PRT4_CNTL1_ADDR A:0xfc48b45c
y.create.l HWIO_OCIMEM_MPU_XPU_PRT5_CNTL1_ADDR A:0xfc48b4dc
y.create.l HWIO_OCIMEM_MPU_XPU_PRT6_CNTL1_ADDR A:0xfc48b55c
y.create.l HWIO_OCIMEM_MPU_XPU_PRT7_CNTL1_ADDR A:0xfc48b5dc
y.create.l HWIO_PNOC_OBS_ID_COREID_ADDR A:0xfc468000
y.create.l HWIO_PNOC_OBS_ID_REVISIONID_ADDR A:0xfc468004
y.create.l HWIO_PNOC_OBS_ERRCTL_ADDR A:0xfc468008
y.create.l HWIO_PNOC_OBS_ERRSTATUS_ADDR A:0xfc46800c
y.create.l HWIO_PNOC_OBS_ERRLOG0_ADDR A:0xfc468010
y.create.l HWIO_PNOC_OBS_ERRLOG1_ADDR A:0xfc468014
y.create.l HWIO_PNOC_OBS_ERRLOG2_ADDR A:0xfc468018
y.create.l HWIO_PNOC_OBS_ERRLOG5_ADDR A:0xfc468024
y.create.l HWIO_PNOC_OBS_DBG_ID_COREID_ADDR A:0xfc468080
y.create.l HWIO_PNOC_OBS_DBG_ID_REVISIONID_ADDR A:0xfc468084
y.create.l HWIO_PNOC_OBS_DBG_ATBID_ADDR A:0xfc468088
y.create.l HWIO_PNOC_QHM0_TFILT_ID_COREID_ADDR A:0xfc469000
y.create.l HWIO_PNOC_QHM0_TFILT_ID_REVISIONID_ADDR A:0xfc469004
y.create.l HWIO_PNOC_QHM0_TFILT_MODE_ADDR A:0xfc469008
y.create.l HWIO_PNOC_QHM0_TFILT_ADDRBASE_LOW_ADDR A:0xfc46900c
y.create.l HWIO_PNOC_QHM0_TFILT_ADDRWINDOWSIZE_ADDR A:0xfc469014
y.create.l HWIO_PNOC_QHM0_TFILT_SRCIDBASE_ADDR A:0xfc469018
y.create.l HWIO_PNOC_QHM0_TFILT_SRCIDMASK_ADDR A:0xfc46901c
y.create.l HWIO_PNOC_QHM0_TFILT_OPCODE_ADDR A:0xfc469020
y.create.l HWIO_PNOC_QHM1_TFILT_ID_COREID_ADDR A:0xfc469180
y.create.l HWIO_PNOC_QHM1_TFILT_ID_REVISIONID_ADDR A:0xfc469184
y.create.l HWIO_PNOC_QHM1_TFILT_MODE_ADDR A:0xfc469188
y.create.l HWIO_PNOC_QHM1_TFILT_ADDRBASE_LOW_ADDR A:0xfc46918c
y.create.l HWIO_PNOC_QHM1_TFILT_ADDRWINDOWSIZE_ADDR A:0xfc469194
y.create.l HWIO_PNOC_QHM1_TFILT_SRCIDBASE_ADDR A:0xfc469198
y.create.l HWIO_PNOC_QHM1_TFILT_SRCIDMASK_ADDR A:0xfc46919c
y.create.l HWIO_PNOC_QHM1_TFILT_OPCODE_ADDR A:0xfc4691a0
y.create.l HWIO_PNOC_QHM2_TFILT_ID_COREID_ADDR A:0xfc469200
y.create.l HWIO_PNOC_QHM2_TFILT_ID_REVISIONID_ADDR A:0xfc469204
y.create.l HWIO_PNOC_QHM2_TFILT_MODE_ADDR A:0xfc469208
y.create.l HWIO_PNOC_QHM2_TFILT_ADDRBASE_LOW_ADDR A:0xfc46920c
y.create.l HWIO_PNOC_QHM2_TFILT_ADDRWINDOWSIZE_ADDR A:0xfc469214
y.create.l HWIO_PNOC_QHM2_TFILT_SRCIDBASE_ADDR A:0xfc469218
y.create.l HWIO_PNOC_QHM2_TFILT_SRCIDMASK_ADDR A:0xfc46921c
y.create.l HWIO_PNOC_QHM2_TFILT_OPCODE_ADDR A:0xfc469220
y.create.l HWIO_PNOC_QHM3_TFILT_ID_COREID_ADDR A:0xfc469280
y.create.l HWIO_PNOC_QHM3_TFILT_ID_REVISIONID_ADDR A:0xfc469284
y.create.l HWIO_PNOC_QHM3_TFILT_MODE_ADDR A:0xfc469288
y.create.l HWIO_PNOC_QHM3_TFILT_ADDRBASE_LOW_ADDR A:0xfc46928c
y.create.l HWIO_PNOC_QHM3_TFILT_ADDRWINDOWSIZE_ADDR A:0xfc469294
y.create.l HWIO_PNOC_QHM3_TFILT_SRCIDBASE_ADDR A:0xfc469298
y.create.l HWIO_PNOC_QHM3_TFILT_SRCIDMASK_ADDR A:0xfc46929c
y.create.l HWIO_PNOC_QHM3_TFILT_OPCODE_ADDR A:0xfc4692a0
y.create.l HWIO_PNOC_TPRB_TPROF_ID_COREID_ADDR A:0xfc469300
y.create.l HWIO_PNOC_TPRB_TPROF_ID_REVISIONID_ADDR A:0xfc469304
y.create.l HWIO_PNOC_TPRB_TPROF_EN_ADDR A:0xfc469308
y.create.l HWIO_PNOC_TPRB_TPROF_MODE_ADDR A:0xfc46930c
y.create.l HWIO_PNOC_TPRB_TPROF_OBSERVEDSEL_0_ADDR A:0xfc469310
y.create.l HWIO_PNOC_TPRB_TPROF_OBSERVEDSEL_1_ADDR A:0xfc469314
y.create.l HWIO_PNOC_TPRB_TPROF_NTENURELINES_0_ADDR A:0xfc469320
y.create.l HWIO_PNOC_TPRB_TPROF_THRESHOLDS_0_0_ADDR A:0xfc46932c
y.create.l HWIO_PNOC_TPRB_TPROF_THRESHOLDS_0_1_ADDR A:0xfc469330
y.create.l HWIO_PNOC_TPRB_TPROF_THRESHOLDS_0_2_ADDR A:0xfc469334
y.create.l HWIO_PNOC_TPRB_TPROF_THRESHOLDS_1_0_ADDR A:0xfc46933c
y.create.l HWIO_PNOC_TPRB_TPROF_THRESHOLDS_1_1_ADDR A:0xfc469340
y.create.l HWIO_PNOC_TPRB_TPROF_THRESHOLDS_1_2_ADDR A:0xfc469344
y.create.l HWIO_PNOC_TPRB_TPROF_OVERFLOWSTATUS_ADDR A:0xfc46936c
y.create.l HWIO_PNOC_TPRB_TPROF_OVERFLOWRESET_ADDR A:0xfc469370
y.create.l HWIO_PNOC_TPRB_TPROF_PENDINGEVENTMODE_ADDR A:0xfc469374
y.create.l HWIO_PNOC_TPRB_TPROF_PRESCALER_ADDR A:0xfc469378
y.create.l HWIO_PNOC_TPRB_SPROF_ID_COREID_ADDR A:0xfc469400
y.create.l HWIO_PNOC_TPRB_SPROF_ID_REVISIONID_ADDR A:0xfc469404
y.create.l HWIO_PNOC_TPRB_SPROF_MAINCTL_ADDR A:0xfc469408
y.create.l HWIO_PNOC_TPRB_SPROF_CFGCTL_ADDR A:0xfc46940c
y.create.l HWIO_PNOC_TPRB_SPROF_STATPERIOD_ADDR A:0xfc469424
y.create.l HWIO_PNOC_TPRB_SPROF_STATGO_ADDR A:0xfc469428
y.create.l HWIO_PNOC_TPRB_SPROF_STATALARMMIN_ADDR A:0xfc46942c
y.create.l HWIO_PNOC_TPRB_SPROF_STATALARMMAX_ADDR A:0xfc469430
y.create.l HWIO_PNOC_TPRB_SPROF_STATALARMSTATUS_ADDR A:0xfc469434
y.create.l HWIO_PNOC_TPRB_SPROF_STATALARMCLR_ADDR A:0xfc469438
y.create.l HWIO_PNOC_TPRB_SPROF_COUNTERS_0_SRC_ADDR A:0xfc469538
y.create.l HWIO_PNOC_TPRB_SPROF_COUNTERS_0_ALARMMODE_ADDR A:0xfc46953c
y.create.l HWIO_PNOC_TPRB_SPROF_COUNTERS_0_VAL_ADDR A:0xfc469540
y.create.l HWIO_PNOC_TPRB_SPROF_COUNTERS_1_SRC_ADDR A:0xfc46954c
y.create.l HWIO_PNOC_TPRB_SPROF_COUNTERS_1_ALARMMODE_ADDR A:0xfc469550
y.create.l HWIO_PNOC_TPRB_SPROF_COUNTERS_1_VAL_ADDR A:0xfc469554
y.create.l HWIO_PNOC_TPRB_SPROF_COUNTERS_2_SRC_ADDR A:0xfc469560
y.create.l HWIO_PNOC_TPRB_SPROF_COUNTERS_2_ALARMMODE_ADDR A:0xfc469564
y.create.l HWIO_PNOC_TPRB_SPROF_COUNTERS_2_VAL_ADDR A:0xfc469568
y.create.l HWIO_PNOC_TPRB_SPROF_COUNTERS_3_SRC_ADDR A:0xfc469574
y.create.l HWIO_PNOC_TPRB_SPROF_COUNTERS_3_ALARMMODE_ADDR A:0xfc469578
y.create.l HWIO_PNOC_TPRB_SPROF_COUNTERS_3_VAL_ADDR A:0xfc46957c
y.create.l HWIO_PNOC_TPRB_SPROF_COUNTERS_4_SRC_ADDR A:0xfc469588
y.create.l HWIO_PNOC_TPRB_SPROF_COUNTERS_4_ALARMMODE_ADDR A:0xfc46958c
y.create.l HWIO_PNOC_TPRB_SPROF_COUNTERS_4_VAL_ADDR A:0xfc469590
y.create.l HWIO_PNOC_TPRB_SPROF_COUNTERS_5_SRC_ADDR A:0xfc46959c
y.create.l HWIO_PNOC_TPRB_SPROF_COUNTERS_5_ALARMMODE_ADDR A:0xfc4695a0
y.create.l HWIO_PNOC_TPRB_SPROF_COUNTERS_5_VAL_ADDR A:0xfc4695a4
y.create.l HWIO_PNOC_TPRB_SPROF_COUNTERS_6_SRC_ADDR A:0xfc4695b0
y.create.l HWIO_PNOC_TPRB_SPROF_COUNTERS_6_ALARMMODE_ADDR A:0xfc4695b4
y.create.l HWIO_PNOC_TPRB_SPROF_COUNTERS_6_VAL_ADDR A:0xfc4695b8
y.create.l HWIO_PNOC_TPRB_SPROF_COUNTERS_7_SRC_ADDR A:0xfc4695c4
y.create.l HWIO_PNOC_TPRB_SPROF_COUNTERS_7_ALARMMODE_ADDR A:0xfc4695c8
y.create.l HWIO_PNOC_TPRB_SPROF_COUNTERS_7_VAL_ADDR A:0xfc4695cc
y.create.l HWIO_PNOC_TPRB_SPROF_COUNTERS_8_SRC_ADDR A:0xfc4695d8
y.create.l HWIO_PNOC_TPRB_SPROF_COUNTERS_8_ALARMMODE_ADDR A:0xfc4695dc
y.create.l HWIO_PNOC_TPRB_SPROF_COUNTERS_8_VAL_ADDR A:0xfc4695e0
y.create.l HWIO_PNOC_TPRB_SPROF_COUNTERS_9_SRC_ADDR A:0xfc4695ec
y.create.l HWIO_PNOC_TPRB_SPROF_COUNTERS_9_ALARMMODE_ADDR A:0xfc4695f0
y.create.l HWIO_PNOC_TPRB_SPROF_COUNTERS_9_VAL_ADDR A:0xfc4695f4
y.create.l HWIO_PNOC_TPRB_SPROF_COUNTERS_10_SRC_ADDR A:0xfc469600
y.create.l HWIO_PNOC_TPRB_SPROF_COUNTERS_10_ALARMMODE_ADDR A:0xfc469604
y.create.l HWIO_PNOC_TPRB_SPROF_COUNTERS_10_VAL_ADDR A:0xfc469608
y.create.l HWIO_PNOC_TPRB_SPROF_COUNTERS_11_SRC_ADDR A:0xfc469614
y.create.l HWIO_PNOC_TPRB_SPROF_COUNTERS_11_ALARMMODE_ADDR A:0xfc469618
y.create.l HWIO_PNOC_TPRB_SPROF_COUNTERS_11_VAL_ADDR A:0xfc46961c
y.create.l HWIO_PNOC_TPRB_SPROF_COUNTERS_12_SRC_ADDR A:0xfc469628
y.create.l HWIO_PNOC_TPRB_SPROF_COUNTERS_12_ALARMMODE_ADDR A:0xfc46962c
y.create.l HWIO_PNOC_TPRB_SPROF_COUNTERS_12_VAL_ADDR A:0xfc469630
y.create.l HWIO_PNOC_TPRB_SPROF_COUNTERS_13_SRC_ADDR A:0xfc46963c
y.create.l HWIO_PNOC_TPRB_SPROF_COUNTERS_13_ALARMMODE_ADDR A:0xfc469640
y.create.l HWIO_PNOC_TPRB_SPROF_COUNTERS_13_VAL_ADDR A:0xfc469644
y.create.l HWIO_PNOC_TPRB_SPROF_COUNTERS_14_SRC_ADDR A:0xfc469650
y.create.l HWIO_PNOC_TPRB_SPROF_COUNTERS_14_ALARMMODE_ADDR A:0xfc469654
y.create.l HWIO_PNOC_TPRB_SPROF_COUNTERS_14_VAL_ADDR A:0xfc469658
y.create.l HWIO_PNOC_TPRB_SPROF_COUNTERS_15_SRC_ADDR A:0xfc469664
y.create.l HWIO_PNOC_TPRB_SPROF_COUNTERS_15_ALARMMODE_ADDR A:0xfc469668
y.create.l HWIO_PNOC_TPRB_SPROF_COUNTERS_15_VAL_ADDR A:0xfc46966c
y.create.l HWIO_PNOC_EPRB_SPROF_ID_COREID_ADDR A:0xfc469800
y.create.l HWIO_PNOC_EPRB_SPROF_ID_REVISIONID_ADDR A:0xfc469804
y.create.l HWIO_PNOC_EPRB_SPROF_MAINCTL_ADDR A:0xfc469808
y.create.l HWIO_PNOC_EPRB_SPROF_CFGCTL_ADDR A:0xfc46980c
y.create.l HWIO_PNOC_EPRB_SPROF_FILTERLUT_ADDR A:0xfc469814
y.create.l HWIO_PNOC_EPRB_SPROF_TRACEALARMEN_ADDR A:0xfc469818
y.create.l HWIO_PNOC_EPRB_SPROF_TRACEALARMSTATUS_ADDR A:0xfc46981c
y.create.l HWIO_PNOC_EPRB_SPROF_TRACEALARMCLR_ADDR A:0xfc469820
y.create.l HWIO_PNOC_EPRB_SPROF_STATPERIOD_ADDR A:0xfc469824
y.create.l HWIO_PNOC_EPRB_SPROF_STATGO_ADDR A:0xfc469828
y.create.l HWIO_PNOC_EPRB_SPROF_STATALARMMIN_ADDR A:0xfc46982c
y.create.l HWIO_PNOC_EPRB_SPROF_STATALARMMAX_ADDR A:0xfc469830
y.create.l HWIO_PNOC_EPRB_SPROF_STATALARMSTATUS_ADDR A:0xfc469834
y.create.l HWIO_PNOC_EPRB_SPROF_STATALARMCLR_ADDR A:0xfc469838
y.create.l HWIO_PNOC_EPRB_SPROF_FILTERS_0_ROUTEIDBASE_ADDR A:0xfc469844
y.create.l HWIO_PNOC_EPRB_SPROF_FILTERS_0_ROUTEIDMASK_ADDR A:0xfc469848
y.create.l HWIO_PNOC_EPRB_SPROF_FILTERS_0_ADDRBASE_LOW_ADDR A:0xfc46984c
y.create.l HWIO_PNOC_EPRB_SPROF_FILTERS_0_WINDOWSIZE_ADDR A:0xfc469854
y.create.l HWIO_PNOC_EPRB_SPROF_FILTERS_0_OPCODE_ADDR A:0xfc469860
y.create.l HWIO_PNOC_EPRB_SPROF_FILTERS_0_STATUS_ADDR A:0xfc469864
y.create.l HWIO_PNOC_EPRB_SPROF_FILTERS_0_LENGTH_ADDR A:0xfc469868
y.create.l HWIO_PNOC_EPRB_SPROF_FILTERS_0_URGENCY_ADDR A:0xfc46986c
y.create.l HWIO_PNOC_EPRB_SPROF_FILTERS_1_ROUTEIDBASE_ADDR A:0xfc469880
y.create.l HWIO_PNOC_EPRB_SPROF_FILTERS_1_ROUTEIDMASK_ADDR A:0xfc469884
y.create.l HWIO_PNOC_EPRB_SPROF_FILTERS_1_ADDRBASE_LOW_ADDR A:0xfc469888
y.create.l HWIO_PNOC_EPRB_SPROF_FILTERS_1_WINDOWSIZE_ADDR A:0xfc469890
y.create.l HWIO_PNOC_EPRB_SPROF_FILTERS_1_OPCODE_ADDR A:0xfc46989c
y.create.l HWIO_PNOC_EPRB_SPROF_FILTERS_1_STATUS_ADDR A:0xfc4698a0
y.create.l HWIO_PNOC_EPRB_SPROF_FILTERS_1_LENGTH_ADDR A:0xfc4698a4
y.create.l HWIO_PNOC_EPRB_SPROF_FILTERS_1_URGENCY_ADDR A:0xfc4698a8
y.create.l HWIO_PNOC_EPRB_SPROF_COUNTERS_0_SRC_ADDR A:0xfc469938
y.create.l HWIO_PNOC_EPRB_SPROF_COUNTERS_0_ALARMMODE_ADDR A:0xfc46993c
y.create.l HWIO_PNOC_EPRB_SPROF_COUNTERS_0_VAL_ADDR A:0xfc469940
y.create.l HWIO_PNOC_EPRB_SPROF_COUNTERS_1_SRC_ADDR A:0xfc46994c
y.create.l HWIO_PNOC_EPRB_SPROF_COUNTERS_1_ALARMMODE_ADDR A:0xfc469950
y.create.l HWIO_PNOC_EPRB_SPROF_COUNTERS_1_VAL_ADDR A:0xfc469954
y.create.l HWIO_PNOC_EPRB_SPROF_COUNTERS_2_SRC_ADDR A:0xfc469960
y.create.l HWIO_PNOC_EPRB_SPROF_COUNTERS_2_ALARMMODE_ADDR A:0xfc469964
y.create.l HWIO_PNOC_EPRB_SPROF_COUNTERS_2_VAL_ADDR A:0xfc469968
y.create.l HWIO_PNOC_EPRB_SPROF_COUNTERS_3_SRC_ADDR A:0xfc469974
y.create.l HWIO_PNOC_EPRB_SPROF_COUNTERS_3_ALARMMODE_ADDR A:0xfc469978
y.create.l HWIO_PNOC_EPRB_SPROF_COUNTERS_3_VAL_ADDR A:0xfc46997c
y.create.l HWIO_PNOC_EPRB_SPROF_COUNTERS_4_SRC_ADDR A:0xfc469988
y.create.l HWIO_PNOC_EPRB_SPROF_COUNTERS_4_ALARMMODE_ADDR A:0xfc46998c
y.create.l HWIO_PNOC_EPRB_SPROF_COUNTERS_4_VAL_ADDR A:0xfc469990
y.create.l HWIO_PNOC_EPRB_SPROF_COUNTERS_5_SRC_ADDR A:0xfc46999c
y.create.l HWIO_PNOC_EPRB_SPROF_COUNTERS_5_ALARMMODE_ADDR A:0xfc4699a0
y.create.l HWIO_PNOC_EPRB_SPROF_COUNTERS_5_VAL_ADDR A:0xfc4699a4
y.create.l HWIO_PNOC_EPRB_SPROF_COUNTERS_6_SRC_ADDR A:0xfc4699b0
y.create.l HWIO_PNOC_EPRB_SPROF_COUNTERS_6_ALARMMODE_ADDR A:0xfc4699b4
y.create.l HWIO_PNOC_EPRB_SPROF_COUNTERS_6_VAL_ADDR A:0xfc4699b8
y.create.l HWIO_PNOC_EPRB_SPROF_COUNTERS_7_SRC_ADDR A:0xfc4699c4
y.create.l HWIO_PNOC_EPRB_SPROF_COUNTERS_7_ALARMMODE_ADDR A:0xfc4699c8
y.create.l HWIO_PNOC_EPRB_SPROF_COUNTERS_7_VAL_ADDR A:0xfc4699cc
y.create.l HWIO_PMIC_ARB_SPMI_GENI_CLK_CTRL_ADDR A:0xfc4ca000
y.create.l HWIO_PMIC_ARB_SPMI_GENI_HW_VERSION_ADDR A:0xfc4ca004
y.create.l HWIO_PMIC_ARB_SPMI_GENI_FW_REVISION_ADDR A:0xfc4ca008
y.create.l HWIO_PMIC_ARB_SPMI_GENI_FORCE_DEFAULT_REG_ADDR A:0xfc4ca00c
y.create.l HWIO_PMIC_ARB_SPMI_GENI_OUTPUT_CTRL_ADDR A:0xfc4ca010
y.create.l HWIO_PMIC_ARB_SPMI_GENI_CGC_CTRL_ADDR A:0xfc4ca014
y.create.l HWIO_PMIC_ARB_SPMI_GENI_CHAR_CFG_ADDR A:0xfc4ca018
y.create.l HWIO_PMIC_ARB_SPMI_GENI_CHAR_DATA_0_ADDR A:0xfc4ca01c
y.create.l HWIO_PMIC_ARB_SPMI_GENI_CHAR_DATA_1_ADDR A:0xfc4ca020
y.create.l HWIO_PMIC_ARB_SPMI_GENI_CTRL_ADDR A:0xfc4ca024
y.create.l HWIO_PMIC_ARB_SPMI_GENI_STATUS_ADDR A:0xfc4ca028
y.create.l HWIO_PMIC_ARB_SPMI_GENI_TEST_BUS_CTRL_ADDR A:0xfc4ca02c
y.create.l HWIO_PMIC_ARB_SPMI_GENI_CFG_REG0_ADDR A:0xfc4ca100
y.create.l HWIO_PMIC_ARB_SPMI_GENI_CFG_REG1_ADDR A:0xfc4ca104
y.create.l HWIO_PMIC_ARB_SPMI_GENI_CFG_REG2_ADDR A:0xfc4ca108
y.create.l HWIO_PMIC_ARB_SPMI_GENI_CFG_REG3_ADDR A:0xfc4ca10c
y.create.l HWIO_PMIC_ARB_SPMI_GENI_CFG_REG4_ADDR A:0xfc4ca110
y.create.l HWIO_PMIC_ARB_SPMI_GENI_CFG_REG5_ADDR A:0xfc4ca114
y.create.l HWIO_PMIC_ARB_SPMI_GENI_CFG_REG6_ADDR A:0xfc4ca118
y.create.l HWIO_PMIC_ARB_SPMI_GENI_CFG_REG7_ADDR A:0xfc4ca11c
y.create.l HWIO_PMIC_ARB_SPMI_GENI_CFG_REG8_ADDR A:0xfc4ca120
y.create.l HWIO_PMIC_ARB_SPMI_GENI_CFG_REG9_ADDR A:0xfc4ca124
y.create.l HWIO_PMIC_ARB_SPMI_GENI_CFG_REG10_ADDR A:0xfc4ca128
y.create.l HWIO_PMIC_ARB_SPMI_GENI_CFG_REG11_ADDR A:0xfc4ca12c
y.create.l HWIO_PMIC_ARB_SPMI_GENI_CFG_REG12_ADDR A:0xfc4ca130
y.create.l HWIO_PMIC_ARB_SPMI_GENI_CFG_REG13_ADDR A:0xfc4ca134
y.create.l HWIO_PMIC_ARB_SPMI_GENI_CFG_REG14_ADDR A:0xfc4ca138
y.create.l HWIO_PMIC_ARB_SPMI_GENI_CFG_REG15_ADDR A:0xfc4ca13c
y.create.l HWIO_PMIC_ARB_SPMI_GENI_CFG_REG16_ADDR A:0xfc4ca140
y.create.l HWIO_PMIC_ARB_SPMI_GENI_CFG_REG17_ADDR A:0xfc4ca144
y.create.l HWIO_PMIC_ARB_SPMI_GENI_CFG_REG18_ADDR A:0xfc4ca148
y.create.l HWIO_PMIC_ARB_SPMI_GENI_CFG_RAM0_ADDR A:0xfc4ca200
y.create.l HWIO_PMIC_ARB_SPMI_GENI_CFG_RAM1_ADDR A:0xfc4ca204
y.create.l HWIO_PMIC_ARB_SPMI_GENI_CFG_RAM2_ADDR A:0xfc4ca208
y.create.l HWIO_PMIC_ARB_SPMI_GENI_CFG_RAM3_ADDR A:0xfc4ca20c
y.create.l HWIO_PMIC_ARB_SPMI_GENI_CFG_RAM4_ADDR A:0xfc4ca210
y.create.l HWIO_PMIC_ARB_SPMI_GENI_CFG_RAM5_ADDR A:0xfc4ca214
y.create.l HWIO_PMIC_ARB_SPMI_GENI_CFG_RAM6_ADDR A:0xfc4ca218
y.create.l HWIO_PMIC_ARB_SPMI_GENI_CFG_RAM7_ADDR A:0xfc4ca21c
y.create.l HWIO_PMIC_ARB_SPMI_GENI_CFG_RAM8_ADDR A:0xfc4ca220
y.create.l HWIO_PMIC_ARB_SPMI_GENI_CFG_RAM9_ADDR A:0xfc4ca224
y.create.l HWIO_PMIC_ARB_SPMI_PERIPH0_2OWNER_TABLE_REG_ADDR A:0xfc4ca700
y.create.l HWIO_PMIC_ARB_SPMI_PERIPH1_2OWNER_TABLE_REG_ADDR A:0xfc4ca704
y.create.l HWIO_PMIC_ARB_SPMI_PERIPH2_2OWNER_TABLE_REG_ADDR A:0xfc4ca708
y.create.l HWIO_PMIC_ARB_SPMI_PERIPH3_2OWNER_TABLE_REG_ADDR A:0xfc4ca70c
y.create.l HWIO_PMIC_ARB_SPMI_PERIPH4_2OWNER_TABLE_REG_ADDR A:0xfc4ca710
y.create.l HWIO_PMIC_ARB_SPMI_PERIPH5_2OWNER_TABLE_REG_ADDR A:0xfc4ca714
y.create.l HWIO_PMIC_ARB_SPMI_PERIPH6_2OWNER_TABLE_REG_ADDR A:0xfc4ca718
y.create.l HWIO_PMIC_ARB_SPMI_PERIPH7_2OWNER_TABLE_REG_ADDR A:0xfc4ca71c
y.create.l HWIO_PMIC_ARB_SPMI_PERIPH8_2OWNER_TABLE_REG_ADDR A:0xfc4ca720
y.create.l HWIO_PMIC_ARB_SPMI_PERIPH9_2OWNER_TABLE_REG_ADDR A:0xfc4ca724
y.create.l HWIO_PMIC_ARB_SPMI_MAPPING_TABLE_REG0_ADDR A:0xfc4cab00
y.create.l HWIO_PMIC_ARB_SPMI_MAPPING_TABLE_REG1_ADDR A:0xfc4cab04
y.create.l HWIO_PMIC_ARB_SPMI_MAPPING_TABLE_REG2_ADDR A:0xfc4cab08
y.create.l HWIO_PMIC_ARB_SPMI_MAPPING_TABLE_REG3_ADDR A:0xfc4cab0c
y.create.l HWIO_PMIC_ARB_SPMI_MAPPING_TABLE_REG4_ADDR A:0xfc4cab10
y.create.l HWIO_PMIC_ARB_SPMI_MAPPING_TABLE_REG5_ADDR A:0xfc4cab14
y.create.l HWIO_PMIC_ARB_SPMI_MAPPING_TABLE_REG6_ADDR A:0xfc4cab18
y.create.l HWIO_PMIC_ARB_SPMI_MAPPING_TABLE_REG7_ADDR A:0xfc4cab1c
y.create.l HWIO_PMIC_ARB_SPMI_MAPPING_TABLE_REG8_ADDR A:0xfc4cab20
y.create.l HWIO_PMIC_ARB_SPMI_MAPPING_TABLE_REG9_ADDR A:0xfc4cab24
y.create.l HWIO_PMIC_ARB_SPMI_MID_REG_ADDR A:0xfc4caf00
y.create.l HWIO_PMIC_ARB_SPMI_CFG_REG_ADDR A:0xfc4caf04
y.create.l HWIO_PMIC_ARB_SPMI_SEC_DISABLE_REG_ADDR A:0xfc4caf08
y.create.l HWIO_PMIC_ARB_SPMI_HW_VERSION_ADDR A:0xfc4caf0c
y.create.l HWIO_PMIC_ARB_SPMI_CGC_CTRL_ADDR A:0xfc4caf10
y.create.l HWIO_PMIC_ARB_SPMI_MWB_ENABLE_REG_ADDR A:0xfc4caf14
y.create.l HWIO_PMIC_ARB_SPMI_PROTOCOL_IRQ_STATUS_ADDR A:0xfc4caf20
y.create.l HWIO_PMIC_ARB_SPMI_PROTOCOL_IRQ_ENABLE_ADDR A:0xfc4caf24
y.create.l HWIO_PMIC_ARB_SPMI_PROTOCOL_IRQ_CLEAR_ADDR A:0xfc4caf28
y.create.l HWIO_PMIC_ARB_SPMI_PROTOCOL_IRQ_EN_SET_ADDR A:0xfc4caf2c
y.create.l HWIO_PMIC_ARB_SPMI_PROTOCOL_IRQ_EN_CLEAR_ADDR A:0xfc4caf30
y.create.l HWIO_PMIC_ARB_SPMI_CHAR_CFG_ADDR A:0xfc4caf40
y.create.l HWIO_PMIC_ARB_SPMI_CHAR_DATA_0_ADDR A:0xfc4caf44
y.create.l HWIO_PMIC_ARB_SPMI_CHAR_DATA_1_ADDR A:0xfc4caf48
y.create.l HWIO_PMIC_ARB_SPMI_TEST_BUS_CTRL_ADDR A:0xfc4caf4c
y.create.l HWIO_PMIC_ARB_SPMI_HW_SW_EVENTS_CTRL_ADDR A:0xfc4caf50
y.create.l HWIO_PMIC_ARB_SPMI_XPU_SCR_ADDR A:0xfc4c0000
y.create.l HWIO_PMIC_ARB_SPMI_XPU_SWDR_ADDR A:0xfc4c0004
y.create.l HWIO_PMIC_ARB_SPMI_XPU_SEAR0_ADDR A:0xfc4c0040
y.create.l HWIO_PMIC_ARB_SPMI_XPU_SESR_ADDR A:0xfc4c0048
y.create.l HWIO_PMIC_ARB_SPMI_XPU_SESRRESTORE_ADDR A:0xfc4c004c
y.create.l HWIO_PMIC_ARB_SPMI_XPU_SESYNR0_ADDR A:0xfc4c0050
y.create.l HWIO_PMIC_ARB_SPMI_XPU_SESYNR1_ADDR A:0xfc4c0054
y.create.l HWIO_PMIC_ARB_SPMI_XPU_SESYNR2_ADDR A:0xfc4c0058
y.create.l HWIO_PMIC_ARB_SPMI_XPU_MCR_ADDR A:0xfc4c0100
y.create.l HWIO_PMIC_ARB_SPMI_XPU_MEAR0_ADDR A:0xfc4c0140
y.create.l HWIO_PMIC_ARB_SPMI_XPU_MESR_ADDR A:0xfc4c0148
y.create.l HWIO_PMIC_ARB_SPMI_XPU_MESRRESTORE_ADDR A:0xfc4c014c
y.create.l HWIO_PMIC_ARB_SPMI_XPU_MESYNR0_ADDR A:0xfc4c0150
y.create.l HWIO_PMIC_ARB_SPMI_XPU_MESYNR1_ADDR A:0xfc4c0154
y.create.l HWIO_PMIC_ARB_SPMI_XPU_MESYNR2_ADDR A:0xfc4c0158
y.create.l HWIO_PMIC_ARB_SPMI_XPU_CR_ADDR A:0xfc4c0080
y.create.l HWIO_PMIC_ARB_SPMI_XPU_RPU_ACR0_ADDR A:0xfc4c00a0
y.create.l HWIO_PMIC_ARB_SPMI_XPU_EAR0_ADDR A:0xfc4c00c0
y.create.l HWIO_PMIC_ARB_SPMI_XPU_ESR_ADDR A:0xfc4c00c8
y.create.l HWIO_PMIC_ARB_SPMI_XPU_ESRRESTORE_ADDR A:0xfc4c00cc
y.create.l HWIO_PMIC_ARB_SPMI_XPU_ESYNR0_ADDR A:0xfc4c00d0
y.create.l HWIO_PMIC_ARB_SPMI_XPU_ESYNR1_ADDR A:0xfc4c00d4
y.create.l HWIO_PMIC_ARB_SPMI_XPU_ESYNR2_ADDR A:0xfc4c00d8
y.create.l HWIO_PMIC_ARB_SPMI_XPU_IDR0_ADDR A:0xfc4c0074
y.create.l HWIO_PMIC_ARB_SPMI_XPU_IDR1_ADDR A:0xfc4c0078
y.create.l HWIO_PMIC_ARB_SPMI_XPU_REV_ADDR A:0xfc4c007c
y.create.l HWIO_PMIC_ARB_SPMI_XPU_RG0_RACR0_ADDR A:0xfc4c0200
y.create.l HWIO_PMIC_ARB_SPMI_XPU_RG1_RACR0_ADDR A:0xfc4c0280
y.create.l HWIO_PMIC_ARB_SPMI_XPU_RG2_RACR0_ADDR A:0xfc4c0300
y.create.l HWIO_PMIC_ARB_SPMI_XPU_RG3_RACR0_ADDR A:0xfc4c0380
y.create.l HWIO_PMIC_ARB_SPMI_XPU_RG4_RACR0_ADDR A:0xfc4c0400
y.create.l HWIO_PMIC_ARB_SPMI_XPU_RG5_RACR0_ADDR A:0xfc4c0480
y.create.l HWIO_PMIC_ARB_SPMI_XPU_RG6_RACR0_ADDR A:0xfc4c0500
y.create.l HWIO_PMIC_ARB_SPMI_XPU_RG7_RACR0_ADDR A:0xfc4c0580
y.create.l HWIO_PMIC_ARB_SPMI_XPU_RG8_RACR0_ADDR A:0xfc4c0600
y.create.l HWIO_PMIC_ARB_SPMI_XPU_RG9_RACR0_ADDR A:0xfc4c0680
y.create.l HWIO_PMIC_ARB_SPMI_XPU_RG0_SCR_ADDR A:0xfc4c0250
y.create.l HWIO_PMIC_ARB_SPMI_XPU_RG1_SCR_ADDR A:0xfc4c02d0
y.create.l HWIO_PMIC_ARB_SPMI_XPU_RG2_SCR_ADDR A:0xfc4c0350
y.create.l HWIO_PMIC_ARB_SPMI_XPU_RG3_SCR_ADDR A:0xfc4c03d0
y.create.l HWIO_PMIC_ARB_SPMI_XPU_RG4_SCR_ADDR A:0xfc4c0450
y.create.l HWIO_PMIC_ARB_SPMI_XPU_RG5_SCR_ADDR A:0xfc4c04d0
y.create.l HWIO_PMIC_ARB_SPMI_XPU_RG6_SCR_ADDR A:0xfc4c0550
y.create.l HWIO_PMIC_ARB_SPMI_XPU_RG7_SCR_ADDR A:0xfc4c05d0
y.create.l HWIO_PMIC_ARB_SPMI_XPU_RG8_SCR_ADDR A:0xfc4c0650
y.create.l HWIO_PMIC_ARB_SPMI_XPU_RG9_SCR_ADDR A:0xfc4c06d0
y.create.l HWIO_PMIC_ARB_SPMI_XPU_RG0_MCR_ADDR A:0xfc4c0254
y.create.l HWIO_PMIC_ARB_SPMI_XPU_RG1_MCR_ADDR A:0xfc4c02d4
y.create.l HWIO_PMIC_ARB_SPMI_XPU_RG2_MCR_ADDR A:0xfc4c0354
y.create.l HWIO_PMIC_ARB_SPMI_XPU_RG3_MCR_ADDR A:0xfc4c03d4
y.create.l HWIO_PMIC_ARB_SPMI_XPU_RG4_MCR_ADDR A:0xfc4c0454
y.create.l HWIO_PMIC_ARB_SPMI_XPU_RG5_MCR_ADDR A:0xfc4c04d4
y.create.l HWIO_PMIC_ARB_SPMI_XPU_RG6_MCR_ADDR A:0xfc4c0554
y.create.l HWIO_PMIC_ARB_SPMI_XPU_RG7_MCR_ADDR A:0xfc4c05d4
y.create.l HWIO_PMIC_ARB_SPMI_XPU_RG8_MCR_ADDR A:0xfc4c0654
y.create.l HWIO_PMIC_ARB_SPMI_XPU_RG9_MCR_ADDR A:0xfc4c06d4
y.create.l HWIO_PMIC_ARB_SPMI_PIC_OWNER0_ACC_STATUS0_ADDR A:0xfc4cb000
y.create.l HWIO_PMIC_ARB_SPMI_PIC_OWNER0_ACC_STATUS1_ADDR A:0xfc4cb004
y.create.l HWIO_PMIC_ARB_SPMI_PIC_OWNER0_ACC_STATUS2_ADDR A:0xfc4cb008
y.create.l HWIO_PMIC_ARB_SPMI_PIC_OWNER0_ACC_STATUS3_ADDR A:0xfc4cb00c
y.create.l HWIO_PMIC_ARB_SPMI_PIC_OWNER1_ACC_STATUS0_ADDR A:0xfc4cb020
y.create.l HWIO_PMIC_ARB_SPMI_PIC_OWNER1_ACC_STATUS1_ADDR A:0xfc4cb024
y.create.l HWIO_PMIC_ARB_SPMI_PIC_OWNER1_ACC_STATUS2_ADDR A:0xfc4cb028
y.create.l HWIO_PMIC_ARB_SPMI_PIC_OWNER1_ACC_STATUS3_ADDR A:0xfc4cb02c
y.create.l HWIO_PMIC_ARB_SPMI_PIC_OWNER2_ACC_STATUS0_ADDR A:0xfc4cb040
y.create.l HWIO_PMIC_ARB_SPMI_PIC_OWNER2_ACC_STATUS1_ADDR A:0xfc4cb044
y.create.l HWIO_PMIC_ARB_SPMI_PIC_OWNER2_ACC_STATUS2_ADDR A:0xfc4cb048
y.create.l HWIO_PMIC_ARB_SPMI_PIC_OWNER2_ACC_STATUS3_ADDR A:0xfc4cb04c
y.create.l HWIO_PMIC_ARB_SPMI_PIC_OWNER3_ACC_STATUS0_ADDR A:0xfc4cb060
y.create.l HWIO_PMIC_ARB_SPMI_PIC_OWNER3_ACC_STATUS1_ADDR A:0xfc4cb064
y.create.l HWIO_PMIC_ARB_SPMI_PIC_OWNER3_ACC_STATUS2_ADDR A:0xfc4cb068
y.create.l HWIO_PMIC_ARB_SPMI_PIC_OWNER3_ACC_STATUS3_ADDR A:0xfc4cb06c
y.create.l HWIO_PMIC_ARB_SPMI_PIC_OWNER4_ACC_STATUS0_ADDR A:0xfc4cb080
y.create.l HWIO_PMIC_ARB_SPMI_PIC_OWNER4_ACC_STATUS1_ADDR A:0xfc4cb084
y.create.l HWIO_PMIC_ARB_SPMI_PIC_OWNER4_ACC_STATUS2_ADDR A:0xfc4cb088
y.create.l HWIO_PMIC_ARB_SPMI_PIC_OWNER4_ACC_STATUS3_ADDR A:0xfc4cb08c
y.create.l HWIO_PMIC_ARB_SPMI_PIC_OWNER5_ACC_STATUS0_ADDR A:0xfc4cb0a0
y.create.l HWIO_PMIC_ARB_SPMI_PIC_OWNER5_ACC_STATUS1_ADDR A:0xfc4cb0a4
y.create.l HWIO_PMIC_ARB_SPMI_PIC_OWNER5_ACC_STATUS2_ADDR A:0xfc4cb0a8
y.create.l HWIO_PMIC_ARB_SPMI_PIC_OWNER5_ACC_STATUS3_ADDR A:0xfc4cb0ac
y.create.l HWIO_PMIC_ARB_SPMI_PIC_ACC_ENABLE0_ADDR A:0xfc4cb200
y.create.l HWIO_PMIC_ARB_SPMI_PIC_ACC_ENABLE1_ADDR A:0xfc4cb204
y.create.l HWIO_PMIC_ARB_SPMI_PIC_ACC_ENABLE2_ADDR A:0xfc4cb208
y.create.l HWIO_PMIC_ARB_SPMI_PIC_ACC_ENABLE3_ADDR A:0xfc4cb20c
y.create.l HWIO_PMIC_ARB_SPMI_PIC_ACC_ENABLE4_ADDR A:0xfc4cb210
y.create.l HWIO_PMIC_ARB_SPMI_PIC_ACC_ENABLE5_ADDR A:0xfc4cb214
y.create.l HWIO_PMIC_ARB_SPMI_PIC_ACC_ENABLE6_ADDR A:0xfc4cb218
y.create.l HWIO_PMIC_ARB_SPMI_PIC_ACC_ENABLE7_ADDR A:0xfc4cb21c
y.create.l HWIO_PMIC_ARB_SPMI_PIC_ACC_ENABLE8_ADDR A:0xfc4cb220
y.create.l HWIO_PMIC_ARB_SPMI_PIC_ACC_ENABLE9_ADDR A:0xfc4cb224
y.create.l HWIO_PMIC_ARB_SPMI_PIC_IRQ_STATUS0_ADDR A:0xfc4cb600
y.create.l HWIO_PMIC_ARB_SPMI_PIC_IRQ_STATUS1_ADDR A:0xfc4cb604
y.create.l HWIO_PMIC_ARB_SPMI_PIC_IRQ_STATUS2_ADDR A:0xfc4cb608
y.create.l HWIO_PMIC_ARB_SPMI_PIC_IRQ_STATUS3_ADDR A:0xfc4cb60c
y.create.l HWIO_PMIC_ARB_SPMI_PIC_IRQ_STATUS4_ADDR A:0xfc4cb610
y.create.l HWIO_PMIC_ARB_SPMI_PIC_IRQ_STATUS5_ADDR A:0xfc4cb614
y.create.l HWIO_PMIC_ARB_SPMI_PIC_IRQ_STATUS6_ADDR A:0xfc4cb618
y.create.l HWIO_PMIC_ARB_SPMI_PIC_IRQ_STATUS7_ADDR A:0xfc4cb61c
y.create.l HWIO_PMIC_ARB_SPMI_PIC_IRQ_STATUS8_ADDR A:0xfc4cb620
y.create.l HWIO_PMIC_ARB_SPMI_PIC_IRQ_STATUS9_ADDR A:0xfc4cb624
y.create.l HWIO_PMIC_ARB_SPMI_PIC_IRQ_CLEAR0_ADDR A:0xfc4cba00
y.create.l HWIO_PMIC_ARB_SPMI_PIC_IRQ_CLEAR1_ADDR A:0xfc4cba04
y.create.l HWIO_PMIC_ARB_SPMI_PIC_IRQ_CLEAR2_ADDR A:0xfc4cba08
y.create.l HWIO_PMIC_ARB_SPMI_PIC_IRQ_CLEAR3_ADDR A:0xfc4cba0c
y.create.l HWIO_PMIC_ARB_SPMI_PIC_IRQ_CLEAR4_ADDR A:0xfc4cba10
y.create.l HWIO_PMIC_ARB_SPMI_PIC_IRQ_CLEAR5_ADDR A:0xfc4cba14
y.create.l HWIO_PMIC_ARB_SPMI_PIC_IRQ_CLEAR6_ADDR A:0xfc4cba18
y.create.l HWIO_PMIC_ARB_SPMI_PIC_IRQ_CLEAR7_ADDR A:0xfc4cba1c
y.create.l HWIO_PMIC_ARB_SPMI_PIC_IRQ_CLEAR8_ADDR A:0xfc4cba20
y.create.l HWIO_PMIC_ARB_SPMI_PIC_IRQ_CLEAR9_ADDR A:0xfc4cba24
y.create.l HWIO_PMIC_ARB_XPU_SCR_ADDR A:0xfc4ce000
y.create.l HWIO_PMIC_ARB_XPU_SWDR_ADDR A:0xfc4ce004
y.create.l HWIO_PMIC_ARB_XPU_SEAR0_ADDR A:0xfc4ce040
y.create.l HWIO_PMIC_ARB_XPU_SESR_ADDR A:0xfc4ce048
y.create.l HWIO_PMIC_ARB_XPU_SESRRESTORE_ADDR A:0xfc4ce04c
y.create.l HWIO_PMIC_ARB_XPU_SESYNR0_ADDR A:0xfc4ce050
y.create.l HWIO_PMIC_ARB_XPU_SESYNR1_ADDR A:0xfc4ce054
y.create.l HWIO_PMIC_ARB_XPU_SESYNR2_ADDR A:0xfc4ce058
y.create.l HWIO_PMIC_ARB_XPU_MCR_ADDR A:0xfc4ce100
y.create.l HWIO_PMIC_ARB_XPU_MEAR0_ADDR A:0xfc4ce140
y.create.l HWIO_PMIC_ARB_XPU_MESR_ADDR A:0xfc4ce148
y.create.l HWIO_PMIC_ARB_XPU_MESRRESTORE_ADDR A:0xfc4ce14c
y.create.l HWIO_PMIC_ARB_XPU_MESYNR0_ADDR A:0xfc4ce150
y.create.l HWIO_PMIC_ARB_XPU_MESYNR1_ADDR A:0xfc4ce154
y.create.l HWIO_PMIC_ARB_XPU_MESYNR2_ADDR A:0xfc4ce158
y.create.l HWIO_PMIC_ARB_XPU_CR_ADDR A:0xfc4ce080
y.create.l HWIO_PMIC_ARB_XPU_RPU_ACR0_ADDR A:0xfc4ce0a0
y.create.l HWIO_PMIC_ARB_XPU_EAR0_ADDR A:0xfc4ce0c0
y.create.l HWIO_PMIC_ARB_XPU_ESR_ADDR A:0xfc4ce0c8
y.create.l HWIO_PMIC_ARB_XPU_ESRRESTORE_ADDR A:0xfc4ce0cc
y.create.l HWIO_PMIC_ARB_XPU_ESYNR0_ADDR A:0xfc4ce0d0
y.create.l HWIO_PMIC_ARB_XPU_ESYNR1_ADDR A:0xfc4ce0d4
y.create.l HWIO_PMIC_ARB_XPU_ESYNR2_ADDR A:0xfc4ce0d8
y.create.l HWIO_PMIC_ARB_XPU_IDR0_ADDR A:0xfc4ce074
y.create.l HWIO_PMIC_ARB_XPU_IDR1_ADDR A:0xfc4ce078
y.create.l HWIO_PMIC_ARB_XPU_REV_ADDR A:0xfc4ce07c
y.create.l HWIO_PMIC_ARB_XPU_RG0_RACR0_ADDR A:0xfc4ce200
y.create.l HWIO_PMIC_ARB_XPU_RG1_RACR0_ADDR A:0xfc4ce280
y.create.l HWIO_PMIC_ARB_XPU_RG2_RACR0_ADDR A:0xfc4ce300
y.create.l HWIO_PMIC_ARB_XPU_RG3_RACR0_ADDR A:0xfc4ce380
y.create.l HWIO_PMIC_ARB_XPU_RG4_RACR0_ADDR A:0xfc4ce400
y.create.l HWIO_PMIC_ARB_XPU_RG5_RACR0_ADDR A:0xfc4ce480
y.create.l HWIO_PMIC_ARB_XPU_RG6_RACR0_ADDR A:0xfc4ce500
y.create.l HWIO_PMIC_ARB_XPU_RG7_RACR0_ADDR A:0xfc4ce580
y.create.l HWIO_PMIC_ARB_XPU_RG0_SCR_ADDR A:0xfc4ce250
y.create.l HWIO_PMIC_ARB_XPU_RG1_SCR_ADDR A:0xfc4ce2d0
y.create.l HWIO_PMIC_ARB_XPU_RG2_SCR_ADDR A:0xfc4ce350
y.create.l HWIO_PMIC_ARB_XPU_RG3_SCR_ADDR A:0xfc4ce3d0
y.create.l HWIO_PMIC_ARB_XPU_RG4_SCR_ADDR A:0xfc4ce450
y.create.l HWIO_PMIC_ARB_XPU_RG5_SCR_ADDR A:0xfc4ce4d0
y.create.l HWIO_PMIC_ARB_XPU_RG6_SCR_ADDR A:0xfc4ce550
y.create.l HWIO_PMIC_ARB_XPU_RG7_SCR_ADDR A:0xfc4ce5d0
y.create.l HWIO_PMIC_ARB_XPU_RG0_MCR_ADDR A:0xfc4ce254
y.create.l HWIO_PMIC_ARB_XPU_RG1_MCR_ADDR A:0xfc4ce2d4
y.create.l HWIO_PMIC_ARB_XPU_RG2_MCR_ADDR A:0xfc4ce354
y.create.l HWIO_PMIC_ARB_XPU_RG3_MCR_ADDR A:0xfc4ce3d4
y.create.l HWIO_PMIC_ARB_XPU_RG4_MCR_ADDR A:0xfc4ce454
y.create.l HWIO_PMIC_ARB_XPU_RG5_MCR_ADDR A:0xfc4ce4d4
y.create.l HWIO_PMIC_ARB_XPU_RG6_MCR_ADDR A:0xfc4ce554
y.create.l HWIO_PMIC_ARB_XPU_RG7_MCR_ADDR A:0xfc4ce5d4
y.create.l HWIO_PMIC_ARB_HW_VERSION_ADDR A:0xfc4cf000
y.create.l HWIO_PMIC_ARB_MISC_CONFIG_ADDR A:0xfc4cf004
y.create.l HWIO_PMIC_ARB_PVC_INTF_CTL_ADDR A:0xfc4cf008
y.create.l HWIO_PMIC_ARB_PVC_INTF_STATUS_ADDR A:0xfc4cf00c
y.create.l HWIO_PMIC_ARB_PRIORITIES0_ADDR A:0xfc4cf100
y.create.l HWIO_PMIC_ARB_PRIORITIES1_ADDR A:0xfc4cf104
y.create.l HWIO_PMIC_ARB_PRIORITIES2_ADDR A:0xfc4cf108
y.create.l HWIO_PMIC_ARB_PRIORITIES3_ADDR A:0xfc4cf10c
y.create.l HWIO_PMIC_ARB_PRIORITIES4_ADDR A:0xfc4cf110
y.create.l HWIO_PMIC_ARB_PRIORITIES5_ADDR A:0xfc4cf114
y.create.l HWIO_PMIC_ARB_PRIORITIES6_ADDR A:0xfc4cf118
y.create.l HWIO_PMIC_ARB_PRIORITIES7_ADDR A:0xfc4cf11c
y.create.l HWIO_PMIC_ARB_PRIORITIES8_ADDR A:0xfc4cf120
y.create.l HWIO_PMIC_ARB_PRIORITIES9_ADDR A:0xfc4cf124
y.create.l HWIO_PMIC_ARB_PVC_PORT0_CTL_ADDR A:0xfc4cf200
y.create.l HWIO_PMIC_ARB_PVC_PORT1_CTL_ADDR A:0xfc4cf204
y.create.l HWIO_PMIC_ARB_PVC_PORT2_CTL_ADDR A:0xfc4cf208
y.create.l HWIO_PMIC_ARB_PVC_PORT3_CTL_ADDR A:0xfc4cf20c
y.create.l HWIO_PMIC_ARB_PVC_PORT4_CTL_ADDR A:0xfc4cf210
y.create.l HWIO_PMIC_ARB_PVC_PORT5_CTL_ADDR A:0xfc4cf214
y.create.l HWIO_PMIC_ARB_PVC_PORT6_CTL_ADDR A:0xfc4cf218
y.create.l HWIO_PMIC_ARB_PVC_PORT7_CTL_ADDR A:0xfc4cf21c
y.create.l HWIO_PMIC_ARB_PVC_PORT8_CTL_ADDR A:0xfc4cf220
y.create.l HWIO_PMIC_ARB_PVC_PORT0_STATUS_ADDR A:0xfc4cf280
y.create.l HWIO_PMIC_ARB_PVC_PORT1_STATUS_ADDR A:0xfc4cf284
y.create.l HWIO_PMIC_ARB_PVC_PORT2_STATUS_ADDR A:0xfc4cf288
y.create.l HWIO_PMIC_ARB_PVC_PORT3_STATUS_ADDR A:0xfc4cf28c
y.create.l HWIO_PMIC_ARB_PVC_PORT4_STATUS_ADDR A:0xfc4cf290
y.create.l HWIO_PMIC_ARB_PVC_PORT5_STATUS_ADDR A:0xfc4cf294
y.create.l HWIO_PMIC_ARB_PVC_PORT6_STATUS_ADDR A:0xfc4cf298
y.create.l HWIO_PMIC_ARB_PVC_PORT7_STATUS_ADDR A:0xfc4cf29c
y.create.l HWIO_PMIC_ARB_PVC_PORT8_STATUS_ADDR A:0xfc4cf2a0
y.create.l HWIO_PMIC_ARB_PVC0_ADDR0_ADDR A:0xfc4cf400
y.create.l HWIO_PMIC_ARB_PVC0_ADDR1_ADDR A:0xfc4cf404
y.create.l HWIO_PMIC_ARB_PVC0_ADDR2_ADDR A:0xfc4cf408
y.create.l HWIO_PMIC_ARB_PVC0_ADDR3_ADDR A:0xfc4cf40c
y.create.l HWIO_PMIC_ARB_PVC1_ADDR0_ADDR A:0xfc4cf420
y.create.l HWIO_PMIC_ARB_PVC1_ADDR1_ADDR A:0xfc4cf424
y.create.l HWIO_PMIC_ARB_PVC1_ADDR2_ADDR A:0xfc4cf428
y.create.l HWIO_PMIC_ARB_PVC1_ADDR3_ADDR A:0xfc4cf42c
y.create.l HWIO_PMIC_ARB_PVC2_ADDR0_ADDR A:0xfc4cf440
y.create.l HWIO_PMIC_ARB_PVC2_ADDR1_ADDR A:0xfc4cf444
y.create.l HWIO_PMIC_ARB_PVC2_ADDR2_ADDR A:0xfc4cf448
y.create.l HWIO_PMIC_ARB_PVC2_ADDR3_ADDR A:0xfc4cf44c
y.create.l HWIO_PMIC_ARB_PVC3_ADDR0_ADDR A:0xfc4cf460
y.create.l HWIO_PMIC_ARB_PVC3_ADDR1_ADDR A:0xfc4cf464
y.create.l HWIO_PMIC_ARB_PVC3_ADDR2_ADDR A:0xfc4cf468
y.create.l HWIO_PMIC_ARB_PVC3_ADDR3_ADDR A:0xfc4cf46c
y.create.l HWIO_PMIC_ARB_PVC4_ADDR0_ADDR A:0xfc4cf480
y.create.l HWIO_PMIC_ARB_PVC4_ADDR1_ADDR A:0xfc4cf484
y.create.l HWIO_PMIC_ARB_PVC4_ADDR2_ADDR A:0xfc4cf488
y.create.l HWIO_PMIC_ARB_PVC4_ADDR3_ADDR A:0xfc4cf48c
y.create.l HWIO_PMIC_ARB_PVC5_ADDR0_ADDR A:0xfc4cf4a0
y.create.l HWIO_PMIC_ARB_PVC5_ADDR1_ADDR A:0xfc4cf4a4
y.create.l HWIO_PMIC_ARB_PVC5_ADDR2_ADDR A:0xfc4cf4a8
y.create.l HWIO_PMIC_ARB_PVC5_ADDR3_ADDR A:0xfc4cf4ac
y.create.l HWIO_PMIC_ARB_PVC6_ADDR0_ADDR A:0xfc4cf4c0
y.create.l HWIO_PMIC_ARB_PVC6_ADDR1_ADDR A:0xfc4cf4c4
y.create.l HWIO_PMIC_ARB_PVC6_ADDR2_ADDR A:0xfc4cf4c8
y.create.l HWIO_PMIC_ARB_PVC6_ADDR3_ADDR A:0xfc4cf4cc
y.create.l HWIO_PMIC_ARB_PVC7_ADDR0_ADDR A:0xfc4cf4e0
y.create.l HWIO_PMIC_ARB_PVC7_ADDR1_ADDR A:0xfc4cf4e4
y.create.l HWIO_PMIC_ARB_PVC7_ADDR2_ADDR A:0xfc4cf4e8
y.create.l HWIO_PMIC_ARB_PVC7_ADDR3_ADDR A:0xfc4cf4ec
y.create.l HWIO_PMIC_ARB_PVC8_ADDR0_ADDR A:0xfc4cf500
y.create.l HWIO_PMIC_ARB_PVC8_ADDR1_ADDR A:0xfc4cf504
y.create.l HWIO_PMIC_ARB_PVC8_ADDR2_ADDR A:0xfc4cf508
y.create.l HWIO_PMIC_ARB_PVC8_ADDR3_ADDR A:0xfc4cf50c
y.create.l HWIO_PMIC_ARB_CHNL0_CMD_ADDR A:0xfc4cf800
y.create.l HWIO_PMIC_ARB_CHNL1_CMD_ADDR A:0xfc4cf880
y.create.l HWIO_PMIC_ARB_CHNL2_CMD_ADDR A:0xfc4cf900
y.create.l HWIO_PMIC_ARB_CHNL3_CMD_ADDR A:0xfc4cf980
y.create.l HWIO_PMIC_ARB_CHNL4_CMD_ADDR A:0xfc4cfa00
y.create.l HWIO_PMIC_ARB_CHNL5_CMD_ADDR A:0xfc4cfa80
y.create.l HWIO_PMIC_ARB_CHNL0_CONFIG_ADDR A:0xfc4cf804
y.create.l HWIO_PMIC_ARB_CHNL1_CONFIG_ADDR A:0xfc4cf884
y.create.l HWIO_PMIC_ARB_CHNL2_CONFIG_ADDR A:0xfc4cf904
y.create.l HWIO_PMIC_ARB_CHNL3_CONFIG_ADDR A:0xfc4cf984
y.create.l HWIO_PMIC_ARB_CHNL4_CONFIG_ADDR A:0xfc4cfa04
y.create.l HWIO_PMIC_ARB_CHNL5_CONFIG_ADDR A:0xfc4cfa84
y.create.l HWIO_PMIC_ARB_CHNL0_STATUS_ADDR A:0xfc4cf808
y.create.l HWIO_PMIC_ARB_CHNL1_STATUS_ADDR A:0xfc4cf888
y.create.l HWIO_PMIC_ARB_CHNL2_STATUS_ADDR A:0xfc4cf908
y.create.l HWIO_PMIC_ARB_CHNL3_STATUS_ADDR A:0xfc4cf988
y.create.l HWIO_PMIC_ARB_CHNL4_STATUS_ADDR A:0xfc4cfa08
y.create.l HWIO_PMIC_ARB_CHNL5_STATUS_ADDR A:0xfc4cfa88
y.create.l HWIO_PMIC_ARB_CHNL0_WDATA0_ADDR A:0xfc4cf810
y.create.l HWIO_PMIC_ARB_CHNL1_WDATA0_ADDR A:0xfc4cf890
y.create.l HWIO_PMIC_ARB_CHNL2_WDATA0_ADDR A:0xfc4cf910
y.create.l HWIO_PMIC_ARB_CHNL3_WDATA0_ADDR A:0xfc4cf990
y.create.l HWIO_PMIC_ARB_CHNL4_WDATA0_ADDR A:0xfc4cfa10
y.create.l HWIO_PMIC_ARB_CHNL5_WDATA0_ADDR A:0xfc4cfa90
y.create.l HWIO_PMIC_ARB_CHNL0_WDATA1_ADDR A:0xfc4cf814
y.create.l HWIO_PMIC_ARB_CHNL1_WDATA1_ADDR A:0xfc4cf894
y.create.l HWIO_PMIC_ARB_CHNL2_WDATA1_ADDR A:0xfc4cf914
y.create.l HWIO_PMIC_ARB_CHNL3_WDATA1_ADDR A:0xfc4cf994
y.create.l HWIO_PMIC_ARB_CHNL4_WDATA1_ADDR A:0xfc4cfa14
y.create.l HWIO_PMIC_ARB_CHNL5_WDATA1_ADDR A:0xfc4cfa94
y.create.l HWIO_PMIC_ARB_CHNL0_RDATA0_ADDR A:0xfc4cf818
y.create.l HWIO_PMIC_ARB_CHNL1_RDATA0_ADDR A:0xfc4cf898
y.create.l HWIO_PMIC_ARB_CHNL2_RDATA0_ADDR A:0xfc4cf918
y.create.l HWIO_PMIC_ARB_CHNL3_RDATA0_ADDR A:0xfc4cf998
y.create.l HWIO_PMIC_ARB_CHNL4_RDATA0_ADDR A:0xfc4cfa18
y.create.l HWIO_PMIC_ARB_CHNL5_RDATA0_ADDR A:0xfc4cfa98
y.create.l HWIO_PMIC_ARB_CHNL0_RDATA1_ADDR A:0xfc4cf81c
y.create.l HWIO_PMIC_ARB_CHNL1_RDATA1_ADDR A:0xfc4cf89c
y.create.l HWIO_PMIC_ARB_CHNL2_RDATA1_ADDR A:0xfc4cf91c
y.create.l HWIO_PMIC_ARB_CHNL3_RDATA1_ADDR A:0xfc4cf99c
y.create.l HWIO_PMIC_ARB_CHNL4_RDATA1_ADDR A:0xfc4cfa1c
y.create.l HWIO_PMIC_ARB_CHNL5_RDATA1_ADDR A:0xfc4cfa9c
y.create.l HWIO_PMIC_ARB_CHNL0_RDATA2_ADDR A:0xfc4cf820
y.create.l HWIO_PMIC_ARB_CHNL1_RDATA2_ADDR A:0xfc4cf8a0
y.create.l HWIO_PMIC_ARB_CHNL2_RDATA2_ADDR A:0xfc4cf920
y.create.l HWIO_PMIC_ARB_CHNL3_RDATA2_ADDR A:0xfc4cf9a0
y.create.l HWIO_PMIC_ARB_CHNL4_RDATA2_ADDR A:0xfc4cfa20
y.create.l HWIO_PMIC_ARB_CHNL5_RDATA2_ADDR A:0xfc4cfaa0
y.create.l HWIO_QDSS_VMIDDAP_VMIDMT_SCR0_ADDR A:0xfc376000
y.create.l HWIO_QDSS_VMIDDAP_VMIDMT_SCR1_ADDR A:0xfc376004
y.create.l HWIO_QDSS_VMIDDAP_VMIDMT_SCR2_ADDR A:0xfc376008
y.create.l HWIO_QDSS_VMIDDAP_VMIDMT_SACR_ADDR A:0xfc376010
y.create.l HWIO_QDSS_VMIDDAP_VMIDMT_SIDR0_ADDR A:0xfc376020
y.create.l HWIO_QDSS_VMIDDAP_VMIDMT_SIDR1_ADDR A:0xfc376024
y.create.l HWIO_QDSS_VMIDDAP_VMIDMT_SIDR2_ADDR A:0xfc376028
y.create.l HWIO_QDSS_VMIDDAP_VMIDMT_SIDR4_ADDR A:0xfc376030
y.create.l HWIO_QDSS_VMIDDAP_VMIDMT_SIDR5_ADDR A:0xfc376034
y.create.l HWIO_QDSS_VMIDDAP_VMIDMT_SIDR7_ADDR A:0xfc37603c
y.create.l HWIO_QDSS_VMIDDAP_VMIDMT_SGFAR0_ADDR A:0xfc376040
y.create.l HWIO_QDSS_VMIDDAP_VMIDMT_SGFSR_ADDR A:0xfc376048
y.create.l HWIO_QDSS_VMIDDAP_VMIDMT_SGFSRRESTORE_ADDR A:0xfc37604c
y.create.l HWIO_QDSS_VMIDDAP_VMIDMT_SGFSYNDR0_ADDR A:0xfc376050
y.create.l HWIO_QDSS_VMIDDAP_VMIDMT_SGFSYNDR1_ADDR A:0xfc376054
y.create.l HWIO_QDSS_VMIDDAP_VMIDMT_SGFSYNDR2_ADDR A:0xfc376058
y.create.l HWIO_QDSS_VMIDDAP_VMIDMT_VMIDMTSCR0_ADDR A:0xfc376090
y.create.l HWIO_QDSS_VMIDDAP_VMIDMT_CR0_ADDR A:0xfc376000
y.create.l HWIO_QDSS_VMIDDAP_VMIDMT_CR2_ADDR A:0xfc376008
y.create.l HWIO_QDSS_VMIDDAP_VMIDMT_ACR_ADDR A:0xfc376010
y.create.l HWIO_QDSS_VMIDDAP_VMIDMT_IDR0_ADDR A:0xfc376020
y.create.l HWIO_QDSS_VMIDDAP_VMIDMT_IDR1_ADDR A:0xfc376024
y.create.l HWIO_QDSS_VMIDDAP_VMIDMT_IDR2_ADDR A:0xfc376028
y.create.l HWIO_QDSS_VMIDDAP_VMIDMT_IDR4_ADDR A:0xfc376030
y.create.l HWIO_QDSS_VMIDDAP_VMIDMT_IDR5_ADDR A:0xfc376034
y.create.l HWIO_QDSS_VMIDDAP_VMIDMT_IDR7_ADDR A:0xfc37603c
y.create.l HWIO_QDSS_VMIDDAP_VMIDMT_GFAR0_ADDR A:0xfc376040
y.create.l HWIO_QDSS_VMIDDAP_VMIDMT_GFSR_ADDR A:0xfc376048
y.create.l HWIO_QDSS_VMIDDAP_VMIDMT_GFSRRESTORE_ADDR A:0xfc37604c
y.create.l HWIO_QDSS_VMIDDAP_VMIDMT_GFSYNDR0_ADDR A:0xfc376050
y.create.l HWIO_QDSS_VMIDDAP_VMIDMT_GFSYNDR1_ADDR A:0xfc376054
y.create.l HWIO_QDSS_VMIDDAP_VMIDMT_GFSYNDR2_ADDR A:0xfc376058
y.create.l HWIO_QDSS_VMIDDAP_VMIDMT_VMIDMTCR0_ADDR A:0xfc376090
y.create.l HWIO_QDSS_VMIDDAP_VMIDMT_VMIDMTACR_ADDR A:0xfc37609c
y.create.l HWIO_QDSS_VMIDDAP_VMIDMT_NSCR0_ADDR A:0xfc376400
y.create.l HWIO_QDSS_VMIDDAP_VMIDMT_NSCR2_ADDR A:0xfc376408
y.create.l HWIO_QDSS_VMIDDAP_VMIDMT_NSACR_ADDR A:0xfc376410
y.create.l HWIO_QDSS_VMIDDAP_VMIDMT_NSGFAR0_ADDR A:0xfc376440
y.create.l HWIO_QDSS_VMIDDAP_VMIDMT_NSGFSR_ADDR A:0xfc376448
y.create.l HWIO_QDSS_VMIDDAP_VMIDMT_NSGFSRRESTORE_ADDR A:0xfc37644c
y.create.l HWIO_QDSS_VMIDDAP_VMIDMT_NSGFSYNDR0_ADDR A:0xfc376450
y.create.l HWIO_QDSS_VMIDDAP_VMIDMT_NSGFSYNDR1_ADDR A:0xfc376454
y.create.l HWIO_QDSS_VMIDDAP_VMIDMT_NSGFSYNDR2_ADDR A:0xfc376458
y.create.l HWIO_QDSS_VMIDDAP_VMIDMT_NSVMIDMTCR0_ADDR A:0xfc376490
y.create.l HWIO_QDSS_VMIDDAP_VMIDMT_SSDR0_ADDR A:0xfc376080
y.create.l HWIO_QDSS_VMIDDAP_VMIDMT_S2VR0_ADDR A:0xfc376c00
y.create.l HWIO_QDSS_VMIDDAP_VMIDMT_S2VR1_ADDR A:0xfc376c04
y.create.l HWIO_QDSS_VMIDDAP_VMIDMT_AS2VR0_ADDR A:0xfc376e00
y.create.l HWIO_QDSS_VMIDDAP_VMIDMT_AS2VR1_ADDR A:0xfc376e04
y.create.l HWIO_QDSS_VMIDETR_VMIDMT_SCR0_ADDR A:0xfc377000
y.create.l HWIO_QDSS_VMIDETR_VMIDMT_SCR1_ADDR A:0xfc377004
y.create.l HWIO_QDSS_VMIDETR_VMIDMT_SCR2_ADDR A:0xfc377008
y.create.l HWIO_QDSS_VMIDETR_VMIDMT_SACR_ADDR A:0xfc377010
y.create.l HWIO_QDSS_VMIDETR_VMIDMT_SIDR0_ADDR A:0xfc377020
y.create.l HWIO_QDSS_VMIDETR_VMIDMT_SIDR1_ADDR A:0xfc377024
y.create.l HWIO_QDSS_VMIDETR_VMIDMT_SIDR2_ADDR A:0xfc377028
y.create.l HWIO_QDSS_VMIDETR_VMIDMT_SIDR4_ADDR A:0xfc377030
y.create.l HWIO_QDSS_VMIDETR_VMIDMT_SIDR5_ADDR A:0xfc377034
y.create.l HWIO_QDSS_VMIDETR_VMIDMT_SIDR7_ADDR A:0xfc37703c
y.create.l HWIO_QDSS_VMIDETR_VMIDMT_SGFAR0_ADDR A:0xfc377040
y.create.l HWIO_QDSS_VMIDETR_VMIDMT_SGFSR_ADDR A:0xfc377048
y.create.l HWIO_QDSS_VMIDETR_VMIDMT_SGFSRRESTORE_ADDR A:0xfc37704c
y.create.l HWIO_QDSS_VMIDETR_VMIDMT_SGFSYNDR0_ADDR A:0xfc377050
y.create.l HWIO_QDSS_VMIDETR_VMIDMT_SGFSYNDR1_ADDR A:0xfc377054
y.create.l HWIO_QDSS_VMIDETR_VMIDMT_SGFSYNDR2_ADDR A:0xfc377058
y.create.l HWIO_QDSS_VMIDETR_VMIDMT_VMIDMTSCR0_ADDR A:0xfc377090
y.create.l HWIO_QDSS_VMIDETR_VMIDMT_CR0_ADDR A:0xfc377000
y.create.l HWIO_QDSS_VMIDETR_VMIDMT_CR2_ADDR A:0xfc377008
y.create.l HWIO_QDSS_VMIDETR_VMIDMT_ACR_ADDR A:0xfc377010
y.create.l HWIO_QDSS_VMIDETR_VMIDMT_IDR0_ADDR A:0xfc377020
y.create.l HWIO_QDSS_VMIDETR_VMIDMT_IDR1_ADDR A:0xfc377024
y.create.l HWIO_QDSS_VMIDETR_VMIDMT_IDR2_ADDR A:0xfc377028
y.create.l HWIO_QDSS_VMIDETR_VMIDMT_IDR4_ADDR A:0xfc377030
y.create.l HWIO_QDSS_VMIDETR_VMIDMT_IDR5_ADDR A:0xfc377034
y.create.l HWIO_QDSS_VMIDETR_VMIDMT_IDR7_ADDR A:0xfc37703c
y.create.l HWIO_QDSS_VMIDETR_VMIDMT_GFAR0_ADDR A:0xfc377040
y.create.l HWIO_QDSS_VMIDETR_VMIDMT_GFSR_ADDR A:0xfc377048
y.create.l HWIO_QDSS_VMIDETR_VMIDMT_GFSRRESTORE_ADDR A:0xfc37704c
y.create.l HWIO_QDSS_VMIDETR_VMIDMT_GFSYNDR0_ADDR A:0xfc377050
y.create.l HWIO_QDSS_VMIDETR_VMIDMT_GFSYNDR1_ADDR A:0xfc377054
y.create.l HWIO_QDSS_VMIDETR_VMIDMT_GFSYNDR2_ADDR A:0xfc377058
y.create.l HWIO_QDSS_VMIDETR_VMIDMT_VMIDMTCR0_ADDR A:0xfc377090
y.create.l HWIO_QDSS_VMIDETR_VMIDMT_VMIDMTACR_ADDR A:0xfc37709c
y.create.l HWIO_QDSS_VMIDETR_VMIDMT_NSCR0_ADDR A:0xfc377400
y.create.l HWIO_QDSS_VMIDETR_VMIDMT_NSCR2_ADDR A:0xfc377408
y.create.l HWIO_QDSS_VMIDETR_VMIDMT_NSACR_ADDR A:0xfc377410
y.create.l HWIO_QDSS_VMIDETR_VMIDMT_NSGFAR0_ADDR A:0xfc377440
y.create.l HWIO_QDSS_VMIDETR_VMIDMT_NSGFSR_ADDR A:0xfc377448
y.create.l HWIO_QDSS_VMIDETR_VMIDMT_NSGFSRRESTORE_ADDR A:0xfc37744c
y.create.l HWIO_QDSS_VMIDETR_VMIDMT_NSGFSYNDR0_ADDR A:0xfc377450
y.create.l HWIO_QDSS_VMIDETR_VMIDMT_NSGFSYNDR1_ADDR A:0xfc377454
y.create.l HWIO_QDSS_VMIDETR_VMIDMT_NSGFSYNDR2_ADDR A:0xfc377458
y.create.l HWIO_QDSS_VMIDETR_VMIDMT_NSVMIDMTCR0_ADDR A:0xfc377490
y.create.l HWIO_QDSS_VMIDETR_VMIDMT_SSDR0_ADDR A:0xfc377080
y.create.l HWIO_QDSS_VMIDETR_VMIDMT_S2VR0_ADDR A:0xfc377c00
y.create.l HWIO_QDSS_VMIDETR_VMIDMT_S2VR1_ADDR A:0xfc377c04
y.create.l HWIO_QDSS_VMIDETR_VMIDMT_AS2VR0_ADDR A:0xfc377e00
y.create.l HWIO_QDSS_VMIDETR_VMIDMT_AS2VR1_ADDR A:0xfc377e04
y.create.l HWIO_QDSS_NDPBAM_BAM_CTRL_ADDR A:0xfc37c000
y.create.l HWIO_QDSS_NDPBAM_BAM_REVISION_ADDR A:0xfc37c004
y.create.l HWIO_QDSS_NDPBAM_BAM_SW_VERSION_ADDR A:0xfc37c080
y.create.l HWIO_QDSS_NDPBAM_BAM_NUM_PIPES_ADDR A:0xfc37c03c
y.create.l HWIO_QDSS_NDPBAM_BAM_TIMER_ADDR A:0xfc37c040
y.create.l HWIO_QDSS_NDPBAM_BAM_TIMER_CTRL_ADDR A:0xfc37c044
y.create.l HWIO_QDSS_NDPBAM_BAM_DESC_CNT_TRSHLD_ADDR A:0xfc37c008
y.create.l HWIO_QDSS_NDPBAM_BAM_IRQ_SRCS_ADDR A:0xfc37c00c
y.create.l HWIO_QDSS_NDPBAM_BAM_IRQ_SRCS_MSK_ADDR A:0xfc37c010
y.create.l HWIO_QDSS_NDPBAM_BAM_IRQ_SRCS_UNMASKED_ADDR A:0xfc37c030
y.create.l HWIO_QDSS_NDPBAM_BAM_IRQ_STTS_ADDR A:0xfc37c014
y.create.l HWIO_QDSS_NDPBAM_BAM_IRQ_CLR_ADDR A:0xfc37c018
y.create.l HWIO_QDSS_NDPBAM_BAM_IRQ_EN_ADDR A:0xfc37c01c
y.create.l HWIO_QDSS_NDPBAM_BAM_AHB_MASTER_ERR_CTRLS_ADDR A:0xfc37c024
y.create.l HWIO_QDSS_NDPBAM_BAM_AHB_MASTER_ERR_ADDR_ADDR A:0xfc37c028
y.create.l HWIO_QDSS_NDPBAM_BAM_AHB_MASTER_ERR_DATA_ADDR A:0xfc37c02c
y.create.l HWIO_QDSS_NDPBAM_BAM_TRUST_REG_ADDR A:0xfc37c070
y.create.l HWIO_QDSS_NDPBAM_BAM_TEST_BUS_SEL_ADDR A:0xfc37c074
y.create.l HWIO_QDSS_NDPBAM_BAM_TEST_BUS_REG_ADDR A:0xfc37c078
y.create.l HWIO_QDSS_NDPBAM_BAM_CNFG_BITS_ADDR A:0xfc37c07c
y.create.l HWIO_QDSS_NDPBAM_BAM_IRQ_SRCS_EE0_ADDR A:0xfc37c800
y.create.l HWIO_QDSS_NDPBAM_BAM_IRQ_SRCS_EE1_ADDR A:0xfc37c880
y.create.l HWIO_QDSS_NDPBAM_BAM_IRQ_SRCS_EE2_ADDR A:0xfc37c900
y.create.l HWIO_QDSS_NDPBAM_BAM_IRQ_SRCS_EE3_ADDR A:0xfc37c980
y.create.l HWIO_QDSS_NDPBAM_BAM_IRQ_SRCS_EE4_ADDR A:0xfc37ca00
y.create.l HWIO_QDSS_NDPBAM_BAM_IRQ_SRCS_EE5_ADDR A:0xfc37ca80
y.create.l HWIO_QDSS_NDPBAM_BAM_IRQ_SRCS_EE6_ADDR A:0xfc37cb00
y.create.l HWIO_QDSS_NDPBAM_BAM_IRQ_SRCS_EE7_ADDR A:0xfc37cb80
y.create.l HWIO_QDSS_NDPBAM_BAM_IRQ_SRCS_MSK_EE0_ADDR A:0xfc37c804
y.create.l HWIO_QDSS_NDPBAM_BAM_IRQ_SRCS_MSK_EE1_ADDR A:0xfc37c884
y.create.l HWIO_QDSS_NDPBAM_BAM_IRQ_SRCS_MSK_EE2_ADDR A:0xfc37c904
y.create.l HWIO_QDSS_NDPBAM_BAM_IRQ_SRCS_MSK_EE3_ADDR A:0xfc37c984
y.create.l HWIO_QDSS_NDPBAM_BAM_IRQ_SRCS_MSK_EE4_ADDR A:0xfc37ca04
y.create.l HWIO_QDSS_NDPBAM_BAM_IRQ_SRCS_MSK_EE5_ADDR A:0xfc37ca84
y.create.l HWIO_QDSS_NDPBAM_BAM_IRQ_SRCS_MSK_EE6_ADDR A:0xfc37cb04
y.create.l HWIO_QDSS_NDPBAM_BAM_IRQ_SRCS_MSK_EE7_ADDR A:0xfc37cb84
y.create.l HWIO_QDSS_NDPBAM_BAM_IRQ_SRCS_UNMASKED_EE0_ADDR A:0xfc37c808
y.create.l HWIO_QDSS_NDPBAM_BAM_IRQ_SRCS_UNMASKED_EE1_ADDR A:0xfc37c888
y.create.l HWIO_QDSS_NDPBAM_BAM_IRQ_SRCS_UNMASKED_EE2_ADDR A:0xfc37c908
y.create.l HWIO_QDSS_NDPBAM_BAM_IRQ_SRCS_UNMASKED_EE3_ADDR A:0xfc37c988
y.create.l HWIO_QDSS_NDPBAM_BAM_IRQ_SRCS_UNMASKED_EE4_ADDR A:0xfc37ca08
y.create.l HWIO_QDSS_NDPBAM_BAM_IRQ_SRCS_UNMASKED_EE5_ADDR A:0xfc37ca88
y.create.l HWIO_QDSS_NDPBAM_BAM_IRQ_SRCS_UNMASKED_EE6_ADDR A:0xfc37cb08
y.create.l HWIO_QDSS_NDPBAM_BAM_IRQ_SRCS_UNMASKED_EE7_ADDR A:0xfc37cb88
y.create.l HWIO_QDSS_NDPBAM_BAM_P_CTRL0_ADDR A:0xfc37d000
y.create.l HWIO_QDSS_NDPBAM_BAM_P_CTRL1_ADDR A:0xfc37e000
y.create.l HWIO_QDSS_NDPBAM_BAM_P_RST0_ADDR A:0xfc37d004
y.create.l HWIO_QDSS_NDPBAM_BAM_P_RST1_ADDR A:0xfc37e004
y.create.l HWIO_QDSS_NDPBAM_BAM_P_HALT0_ADDR A:0xfc37d008
y.create.l HWIO_QDSS_NDPBAM_BAM_P_HALT1_ADDR A:0xfc37e008
y.create.l HWIO_QDSS_NDPBAM_BAM_P_TRUST_REG0_ADDR A:0xfc37d030
y.create.l HWIO_QDSS_NDPBAM_BAM_P_TRUST_REG1_ADDR A:0xfc37e030
y.create.l HWIO_QDSS_NDPBAM_BAM_P_IRQ_STTS0_ADDR A:0xfc37d010
y.create.l HWIO_QDSS_NDPBAM_BAM_P_IRQ_STTS1_ADDR A:0xfc37e010
y.create.l HWIO_QDSS_NDPBAM_BAM_P_IRQ_CLR0_ADDR A:0xfc37d014
y.create.l HWIO_QDSS_NDPBAM_BAM_P_IRQ_CLR1_ADDR A:0xfc37e014
y.create.l HWIO_QDSS_NDPBAM_BAM_P_IRQ_EN0_ADDR A:0xfc37d018
y.create.l HWIO_QDSS_NDPBAM_BAM_P_IRQ_EN1_ADDR A:0xfc37e018
y.create.l HWIO_QDSS_NDPBAM_BAM_P_TIMER0_ADDR A:0xfc37d01c
y.create.l HWIO_QDSS_NDPBAM_BAM_P_TIMER1_ADDR A:0xfc37e01c
y.create.l HWIO_QDSS_NDPBAM_BAM_P_TIMER_CTRL0_ADDR A:0xfc37d020
y.create.l HWIO_QDSS_NDPBAM_BAM_P_TIMER_CTRL1_ADDR A:0xfc37e020
y.create.l HWIO_QDSS_NDPBAM_BAM_P_PRDCR_SDBND0_ADDR A:0xfc37d024
y.create.l HWIO_QDSS_NDPBAM_BAM_P_PRDCR_SDBND1_ADDR A:0xfc37e024
y.create.l HWIO_QDSS_NDPBAM_BAM_P_CNSMR_SDBND0_ADDR A:0xfc37d028
y.create.l HWIO_QDSS_NDPBAM_BAM_P_CNSMR_SDBND1_ADDR A:0xfc37e028
y.create.l HWIO_QDSS_NDPBAM_BAM_P_EVNT_DEST_ADDR0_ADDR A:0xfc37d82c
y.create.l HWIO_QDSS_NDPBAM_BAM_P_EVNT_DEST_ADDR1_ADDR A:0xfc37e82c
y.create.l HWIO_QDSS_NDPBAM_BAM_P_EVNT_REG0_ADDR A:0xfc37d818
y.create.l HWIO_QDSS_NDPBAM_BAM_P_EVNT_REG1_ADDR A:0xfc37e818
y.create.l HWIO_QDSS_NDPBAM_BAM_P_SW_OFSTS0_ADDR A:0xfc37d800
y.create.l HWIO_QDSS_NDPBAM_BAM_P_SW_OFSTS1_ADDR A:0xfc37e800
y.create.l HWIO_QDSS_NDPBAM_BAM_P_DATA_FIFO_ADDR0_ADDR A:0xfc37d824
y.create.l HWIO_QDSS_NDPBAM_BAM_P_DATA_FIFO_ADDR1_ADDR A:0xfc37e824
y.create.l HWIO_QDSS_NDPBAM_BAM_P_DESC_FIFO_ADDR0_ADDR A:0xfc37d81c
y.create.l HWIO_QDSS_NDPBAM_BAM_P_DESC_FIFO_ADDR1_ADDR A:0xfc37e81c
y.create.l HWIO_QDSS_NDPBAM_BAM_P_EVNT_GEN_TRSHLD0_ADDR A:0xfc37d828
y.create.l HWIO_QDSS_NDPBAM_BAM_P_EVNT_GEN_TRSHLD1_ADDR A:0xfc37e828
y.create.l HWIO_QDSS_NDPBAM_BAM_P_FIFO_SIZES0_ADDR A:0xfc37d820
y.create.l HWIO_QDSS_NDPBAM_BAM_P_FIFO_SIZES1_ADDR A:0xfc37e820
y.create.l HWIO_QDSS_NDPBAM_BAM_P_RETR_CNTXT_0_ADDR A:0xfc37d834
y.create.l HWIO_QDSS_NDPBAM_BAM_P_RETR_CNTXT_1_ADDR A:0xfc37e834
y.create.l HWIO_QDSS_NDPBAM_BAM_P_SI_CNTXT_0_ADDR A:0xfc37d838
y.create.l HWIO_QDSS_NDPBAM_BAM_P_SI_CNTXT_1_ADDR A:0xfc37e838
y.create.l HWIO_QDSS_NDPBAM_BAM_P_DF_CNTXT_0_ADDR A:0xfc37d830
y.create.l HWIO_QDSS_NDPBAM_BAM_P_DF_CNTXT_1_ADDR A:0xfc37e830
y.create.l HWIO_QDSS_NDPBAM_BAM_P_AU_PSM_CNTXT_1_0_ADDR A:0xfc37d804
y.create.l HWIO_QDSS_NDPBAM_BAM_P_AU_PSM_CNTXT_1_1_ADDR A:0xfc37e804
y.create.l HWIO_QDSS_NDPBAM_BAM_P_PSM_CNTXT_2_0_ADDR A:0xfc37d808
y.create.l HWIO_QDSS_NDPBAM_BAM_P_PSM_CNTXT_2_1_ADDR A:0xfc37e808
y.create.l HWIO_QDSS_NDPBAM_BAM_P_PSM_CNTXT_3_0_ADDR A:0xfc37d80c
y.create.l HWIO_QDSS_NDPBAM_BAM_P_PSM_CNTXT_3_1_ADDR A:0xfc37e80c
y.create.l HWIO_QDSS_NDPBAM_BAM_P_PSM_CNTXT_4_0_ADDR A:0xfc37d810
y.create.l HWIO_QDSS_NDPBAM_BAM_P_PSM_CNTXT_4_1_ADDR A:0xfc37e810
y.create.l HWIO_QDSS_NDPBAM_BAM_P_PSM_CNTXT_5_0_ADDR A:0xfc37d814
y.create.l HWIO_QDSS_NDPBAM_BAM_P_PSM_CNTXT_5_1_ADDR A:0xfc37e814
y.create.l HWIO_QDSS_SECONDARY_ROM_WORD_ADDR A:0xfc300000
y.create.l HWIO_QDSS_DAPROM_PERIPHERAL_ID4_ADDR A:0xfc300fd0
y.create.l HWIO_QDSS_DAPROM_PERIPHERAL_ID5_ADDR A:0xfc300fd4
y.create.l HWIO_QDSS_DAPROM_PERIPHERAL_ID6_ADDR A:0xfc300fd8
y.create.l HWIO_QDSS_DAPROM_PERIPHERAL_ID7_ADDR A:0xfc300fdc
y.create.l HWIO_QDSS_DAPROM_PERIPHERAL_ID0_ADDR A:0xfc300fe0
y.create.l HWIO_QDSS_DAPROM_PERIPHERAL_ID1_ADDR A:0xfc300fe4
y.create.l HWIO_QDSS_DAPROM_PERIPHERAL_ID2_ADDR A:0xfc300fe8
y.create.l HWIO_QDSS_DAPROM_PERIPHERAL_ID3_ADDR A:0xfc300fec
y.create.l HWIO_QDSS_DAPROM_COMPONENT_ID0_ADDR A:0xfc300ff0
y.create.l HWIO_QDSS_DAPROM_COMPONENT_ID1_ADDR A:0xfc300ff4
y.create.l HWIO_QDSS_DAPROM_COMPONENT_ID2_ADDR A:0xfc300ff8
y.create.l HWIO_QDSS_DAPROM_COMPONENT_ID3_ADDR A:0xfc300ffc
y.create.l HWIO_QDSS_SEC_DAPROM_CORESIGHT_CSR_ROM_WORD_ADDR A:0xfc301000
y.create.l HWIO_QDSS_SEC_DAPROM_ETBETF_ROM_WORD_ADDR A:0xfc301004
y.create.l HWIO_QDSS_SEC_DAPROM_CTI0_ROM_WORD_ADDR A:0xfc301008
y.create.l HWIO_QDSS_SEC_DAPROM_CTI1_ROM_WORD_ADDR A:0xfc30100c
y.create.l HWIO_QDSS_SEC_DAPROM_CTI2_ROM_WORD_ADDR A:0xfc301010
y.create.l HWIO_QDSS_SEC_DAPROM_CTI3_ROM_WORD_ADDR A:0xfc301014
y.create.l HWIO_QDSS_SEC_DAPROM_CTI4_ROM_WORD_ADDR A:0xfc301018
y.create.l HWIO_QDSS_SEC_DAPROM_CTI5_ROM_WORD_ADDR A:0xfc30101c
y.create.l HWIO_QDSS_SEC_DAPROM_CTI6_ROM_WORD_ADDR A:0xfc301020
y.create.l HWIO_QDSS_SEC_DAPROM_CTI7_ROM_WORD_ADDR A:0xfc301024
y.create.l HWIO_QDSS_SEC_DAPROM_CTI8_ROM_WORD_ADDR A:0xfc301028
y.create.l HWIO_QDSS_SEC_DAPROM_TPIU_ROM_WORD_ADDR A:0xfc30102c
y.create.l HWIO_QDSS_SEC_DAPROM_TFUN0_ROM_WORD_ADDR A:0xfc301030
y.create.l HWIO_QDSS_SEC_DAPROM_TFUN1_ROM_WORD_ADDR A:0xfc301034
y.create.l HWIO_QDSS_SEC_DAPROM_TFUN2_ROM_WORD_ADDR A:0xfc301038
y.create.l HWIO_QDSS_SEC_DAPROM_TREPL_ROM_WORD_ADDR A:0xfc30103c
y.create.l HWIO_QDSS_SEC_DAPROM_STM_ROM_WORD_ADDR A:0xfc301040
y.create.l HWIO_QDSS_SEC_DAPROM_ETR_ROM_WORD_ADDR A:0xfc301044
y.create.l HWIO_QDSS_SEC_DAPROM_KRAIT0_DBG_ROM_WORD_ADDR A:0xfc301048
y.create.l HWIO_QDSS_SEC_DAPROM_KRAIT0_PM_ROM_WORD_ADDR A:0xfc30104c
y.create.l HWIO_QDSS_SEC_DAPROM_KRAIT1_DBG_ROM_WORD_ADDR A:0xfc301050
y.create.l HWIO_QDSS_SEC_DAPROM_KRAIT1_PM_ROM_WORD_ADDR A:0xfc301054
y.create.l HWIO_QDSS_SEC_DAPROM_KRAIT2_DBG_ROM_WORD_ADDR A:0xfc301058
y.create.l HWIO_QDSS_SEC_DAPROM_KRAIT2_PM_ROM_WORD_ADDR A:0xfc30105c
y.create.l HWIO_QDSS_SEC_DAPROM_KRAIT3_DBG_ROM_WORD_ADDR A:0xfc301060
y.create.l HWIO_QDSS_SEC_DAPROM_KRAIT3_PM_ROM_WORD_ADDR A:0xfc301064
y.create.l HWIO_QDSS_SEC_DAPROM_KRAIT0_PFT_ROM_WORD_ADDR A:0xfc301068
y.create.l HWIO_QDSS_SEC_DAPROM_KRAIT1_PFT_ROM_WORD_ADDR A:0xfc30106c
y.create.l HWIO_QDSS_SEC_DAPROM_KRAIT2_PFT_ROM_WORD_ADDR A:0xfc301070
y.create.l HWIO_QDSS_SEC_DAPROM_KRAIT3_PFT_ROM_WORD_ADDR A:0xfc301074
y.create.l HWIO_QDSS_SEC_DAPROM_KRAIT_L2_CTI_ROM_WORD_ADDR A:0xfc301078
y.create.l HWIO_QDSS_SEC_DAPROM_KRAIT0_CTI_ROM_WORD_ADDR A:0xfc30107c
y.create.l HWIO_QDSS_SEC_DAPROM_KRAIT1_CTI_ROM_WORD_ADDR A:0xfc301080
y.create.l HWIO_QDSS_SEC_DAPROM_KRAIT2_CTI_ROM_WORD_ADDR A:0xfc301084
y.create.l HWIO_QDSS_SEC_DAPROM_KRAIT3_CTI_ROM_WORD_ADDR A:0xfc301088
y.create.l HWIO_QDSS_SEC_DAPROM_KRAIT_TFUN_ROM_WORD_ADDR A:0xfc30108c
y.create.l HWIO_QDSS_SEC_DAPROM_VENUS1_CTI_ROM_WORD_ADDR A:0xfc301090
y.create.l HWIO_QDSS_SEC_DAPROM_PRONTO_ETM_ROM_WORD_ADDR A:0xfc301094
y.create.l HWIO_QDSS_SEC_DAPROM_PRONTO_CTI_ROM_WORD_ADDR A:0xfc301098
y.create.l HWIO_QDSS_SEC_DAPROM_MODEMQ6_CTI_ROM_WORD_ADDR A:0xfc30109c
y.create.l HWIO_QDSS_SEC_DAPROM_LPAQ6_CTI_ROM_WORD_ADDR A:0xfc3010a0
y.create.l HWIO_QDSS_SEC_DAPROM_RPMCM3_CTI_ROM_WORD_ADDR A:0xfc3010a4
y.create.l HWIO_QDSS_SEC_DAPROM_MMSS_TFUN_ROM_WORD_ADDR A:0xfc3010a8
y.create.l HWIO_QDSS_SEC_DAPROM_SECONDARY_ROM_ITCTL_ADDR A:0xfc301f00
y.create.l HWIO_QDSS_SEC_DAPROM_SECONDARY_ROM_CLAIMSET_ADDR A:0xfc301fa0
y.create.l HWIO_QDSS_SEC_DAPROM_SECONDARY_ROM_CLAIMCLR_ADDR A:0xfc301fa4
y.create.l HWIO_QDSS_SEC_DAPROM_SECONDARY_ROM_LOCKACCESS_ADDR A:0xfc301fb0
y.create.l HWIO_QDSS_SEC_DAPROM_SECONDARY_ROM_LOCKSTATUS_ADDR A:0xfc301fb4
y.create.l HWIO_QDSS_SEC_DAPROM_SECONDARY_ROM_AUTHSTATUS_ADDR A:0xfc301fb8
y.create.l HWIO_QDSS_SEC_DAPROM_SECONDARY_ROM_DEVICEID_ADDR A:0xfc301fc8
y.create.l HWIO_QDSS_SEC_DAPROM_SECONDARY_ROM_DEVICETYPE_ADDR A:0xfc301fcc
y.create.l HWIO_QDSS_SEC_DAPROM_SECONDARY_ROM_PERIPHERAL_ID4_ADDR A:0xfc301fd0
y.create.l HWIO_QDSS_SEC_DAPROM_SECONDARY_ROM_PERIPHERAL_ID5_ADDR A:0xfc301fd4
y.create.l HWIO_QDSS_SEC_DAPROM_SECONDARY_ROM_PERIPHERAL_ID6_ADDR A:0xfc301fd8
y.create.l HWIO_QDSS_SEC_DAPROM_SECONDARY_ROM_PERIPHERAL_ID7_ADDR A:0xfc301fdc
y.create.l HWIO_QDSS_SEC_DAPROM_SECONDARY_ROM_PERIPHERAL_ID0_ADDR A:0xfc301fe0
y.create.l HWIO_QDSS_SEC_DAPROM_SECONDARY_ROM_PERIPHERAL_ID1_ADDR A:0xfc301fe4
y.create.l HWIO_QDSS_SEC_DAPROM_SECONDARY_ROM_PERIPHERAL_ID2_ADDR A:0xfc301fe8
y.create.l HWIO_QDSS_SEC_DAPROM_SECONDARY_ROM_PERIPHERAL_ID3_ADDR A:0xfc301fec
y.create.l HWIO_QDSS_SEC_DAPROM_SECONDARY_ROM_COMPONENT_ID0_ADDR A:0xfc301ff0
y.create.l HWIO_QDSS_SEC_DAPROM_SECONDARY_ROM_COMPONENT_ID1_ADDR A:0xfc301ff4
y.create.l HWIO_QDSS_SEC_DAPROM_SECONDARY_ROM_COMPONENT_ID2_ADDR A:0xfc301ff8
y.create.l HWIO_QDSS_SEC_DAPROM_SECONDARY_ROM_COMPONENT_ID3_ADDR A:0xfc301ffc
y.create.l HWIO_QDSS_CS_QDSSCSR_SWDBGPWRCTRL_ADDR A:0xfc302000
y.create.l HWIO_QDSS_CS_QDSSCSR_SWDBGPWRACK_ADDR A:0xfc302004
y.create.l HWIO_QDSS_CS_QDSSCSR_SWSPADREG0_ADDR A:0xfc302008
y.create.l HWIO_QDSS_CS_QDSSCSR_SWSPADREG1_ADDR A:0xfc30200c
y.create.l HWIO_QDSS_CS_QDSSCSR_STMTRANSCTRL_ADDR A:0xfc302010
y.create.l HWIO_QDSS_CS_QDSSCSR_STMAWIDCTRL_ADDR A:0xfc302014
y.create.l HWIO_QDSS_CS_QDSSCSR_STMCHNOFST0_ADDR A:0xfc302018
y.create.l HWIO_QDSS_CS_QDSSCSR_STMCHNOFST1_ADDR A:0xfc30201c
y.create.l HWIO_QDSS_CS_QDSSCSR_STMEXTHWCTRL0_ADDR A:0xfc302020
y.create.l HWIO_QDSS_CS_QDSSCSR_STMEXTHWCTRL1_ADDR A:0xfc302024
y.create.l HWIO_QDSS_CS_QDSSCSR_STMEXTHWCTRL2_ADDR A:0xfc302028
y.create.l HWIO_QDSS_CS_QDSSCSR_STMEXTHWCTRL3_ADDR A:0xfc30202c
y.create.l HWIO_QDSS_CS_QDSSCSR_USBBAMCTRL_ADDR A:0xfc302030
y.create.l HWIO_QDSS_CS_QDSSCSR_USBFLSHCTRL_ADDR A:0xfc302034
y.create.l HWIO_QDSS_CS_QDSSCSR_TIMESTAMPCTRL_ADDR A:0xfc302038
y.create.l HWIO_QDSS_CS_QDSSCSR_AOTIMEVAL0_ADDR A:0xfc30203c
y.create.l HWIO_QDSS_CS_QDSSCSR_AOTIMEVAL1_ADDR A:0xfc302040
y.create.l HWIO_QDSS_CS_QDSSCSR_QDSSTIMEVAL0_ADDR A:0xfc302044
y.create.l HWIO_QDSS_CS_QDSSCSR_QDSSTIMEVAL1_ADDR A:0xfc302048
y.create.l HWIO_QDSS_CS_QDSSCSR_QDSSTIMELOAD0_ADDR A:0xfc30204c
y.create.l HWIO_QDSS_CS_QDSSCSR_QDSSTIMELOAD1_ADDR A:0xfc302050
y.create.l HWIO_QDSS_CS_QDSSCSR_DAPMSAVAL_ADDR A:0xfc302054
y.create.l HWIO_QDSS_CS_QDSSCSR_QDSSCLKVOTE_ADDR A:0xfc302058
y.create.l HWIO_QDSS_CS_QDSSCSR_QDSSCLKIPI_ADDR A:0xfc30205c
y.create.l HWIO_QDSS_CS_QDSSCSR_QDSSPWRREQIGNORE_ADDR A:0xfc302060
y.create.l HWIO_QDSS_CS_QDSSCSR_QDSSSPARE_ADDR A:0xfc302064
y.create.l HWIO_QDSS_CS_QDSSCSR_IPCAT_ADDR A:0xfc302068
y.create.l HWIO_QDSS_CS_QDSSCSR_ITCTL_ADDR A:0xfc302f00
y.create.l HWIO_QDSS_CS_QDSSCSR_CLAIMSET_ADDR A:0xfc302fa0
y.create.l HWIO_QDSS_CS_QDSSCSR_CLAIMCLR_ADDR A:0xfc302fa4
y.create.l HWIO_QDSS_CS_QDSSCSR_LOCKACCESS_ADDR A:0xfc302fb0
y.create.l HWIO_QDSS_CS_QDSSCSR_LOCKSTATUS_ADDR A:0xfc302fb4
y.create.l HWIO_QDSS_CS_QDSSCSR_AUTHSTATUS_ADDR A:0xfc302fb8
y.create.l HWIO_QDSS_CS_QDSSCSR_DEVICEID_ADDR A:0xfc302fc8
y.create.l HWIO_QDSS_CS_QDSSCSR_DEVICETYPE_ADDR A:0xfc302fcc
y.create.l HWIO_QDSS_CS_QDSSCSR_PERIPHID4_ADDR A:0xfc302fd0
y.create.l HWIO_QDSS_CS_QDSSCSR_PERIPHID5_ADDR A:0xfc302fd4
y.create.l HWIO_QDSS_CS_QDSSCSR_PERIPHID6_ADDR A:0xfc302fd8
y.create.l HWIO_QDSS_CS_QDSSCSR_PERIPHID7_ADDR A:0xfc302fdc
y.create.l HWIO_QDSS_CS_QDSSCSR_PERIPHID0_ADDR A:0xfc302fe0
y.create.l HWIO_QDSS_CS_QDSSCSR_PERIPHID1_ADDR A:0xfc302fe4
y.create.l HWIO_QDSS_CS_QDSSCSR_PERIPHID2_ADDR A:0xfc302fe8
y.create.l HWIO_QDSS_CS_QDSSCSR_PERIPHID3_ADDR A:0xfc302fec
y.create.l HWIO_QDSS_CS_QDSSCSR_COMPID0_ADDR A:0xfc302ff0
y.create.l HWIO_QDSS_CS_QDSSCSR_COMPID1_ADDR A:0xfc302ff4
y.create.l HWIO_QDSS_CS_QDSSCSR_COMPID2_ADDR A:0xfc302ff8
y.create.l HWIO_QDSS_CS_QDSSCSR_COMPID3_ADDR A:0xfc302ffc
y.create.l HWIO_QDSS_ETFETB_RSZ_ADDR A:0xfc307004
y.create.l HWIO_QDSS_ETFETB_STS_ADDR A:0xfc30700c
y.create.l HWIO_QDSS_ETFETB_RRD_ADDR A:0xfc307010
y.create.l HWIO_QDSS_ETFETB_RRP_ADDR A:0xfc307014
y.create.l HWIO_QDSS_ETFETB_RWP_ADDR A:0xfc307018
y.create.l HWIO_QDSS_ETFETB_TRG_ADDR A:0xfc30701c
y.create.l HWIO_QDSS_ETFETB_CTL_ADDR A:0xfc307020
y.create.l HWIO_QDSS_ETFETB_RWD_ADDR A:0xfc307024
y.create.l HWIO_QDSS_ETFETB_MODE_ADDR A:0xfc307028
y.create.l HWIO_QDSS_ETFETB_LBUFLEVEL_ADDR A:0xfc30702c
y.create.l HWIO_QDSS_ETFETB_CBUFLEVEL_ADDR A:0xfc307030
y.create.l HWIO_QDSS_ETFETB_BUFWM_ADDR A:0xfc307034
y.create.l HWIO_QDSS_ETFETB_FFSR_ADDR A:0xfc307300
y.create.l HWIO_QDSS_ETFETB_FFCR_ADDR A:0xfc307304
y.create.l HWIO_QDSS_ETFETB_PSCR_ADDR A:0xfc307308
y.create.l HWIO_QDSS_ETFETB_ITATBMDATA0_ADDR A:0xfc307ed0
y.create.l HWIO_QDSS_ETFETB_ITATBMCTR2_ADDR A:0xfc307ed4
y.create.l HWIO_QDSS_ETFETB_ITATBMCTR1_ADDR A:0xfc307ed8
y.create.l HWIO_QDSS_ETFETB_ITATBMCTR0_ADDR A:0xfc307edc
y.create.l HWIO_QDSS_ETFETB_ITMISCOP0_ADDR A:0xfc307ee0
y.create.l HWIO_QDSS_ETFETB_ITTRFLIN_ADDR A:0xfc307ee8
y.create.l HWIO_QDSS_ETFETB_ITATBDATA0_ADDR A:0xfc307eec
y.create.l HWIO_QDSS_ETFETB_ITATBCTR2_ADDR A:0xfc307ef0
y.create.l HWIO_QDSS_ETFETB_ITATBCTR1_ADDR A:0xfc307ef4
y.create.l HWIO_QDSS_ETFETB_ITATBCTR0_ADDR A:0xfc307ef8
y.create.l HWIO_QDSS_ETFETB_ITCTRL_ADDR A:0xfc307f00
y.create.l HWIO_QDSS_ETFETB_CLAIMSET_ADDR A:0xfc307fa0
y.create.l HWIO_QDSS_ETFETB_CLAIMCLR_ADDR A:0xfc307fa4
y.create.l HWIO_QDSS_ETFETB_LAR_ADDR A:0xfc307fb0
y.create.l HWIO_QDSS_ETFETB_LSR_ADDR A:0xfc307fb4
y.create.l HWIO_QDSS_ETFETB_AUTHSTATUS_ADDR A:0xfc307fb8
y.create.l HWIO_QDSS_ETFETB_DEVID_ADDR A:0xfc307fc8
y.create.l HWIO_QDSS_ETFETB_DEVTYPE_ADDR A:0xfc307fcc
y.create.l HWIO_QDSS_ETFETB_PERIPHID0_ADDR A:0xfc307fe0
y.create.l HWIO_QDSS_ETFETB_PERIPHID1_ADDR A:0xfc307fe4
y.create.l HWIO_QDSS_ETFETB_PERIPHID2_ADDR A:0xfc307fe8
y.create.l HWIO_QDSS_ETFETB_PERIPHID3_ADDR A:0xfc307fec
y.create.l HWIO_QDSS_ETFETB_PERIPHID4_ADDR A:0xfc307fd0
y.create.l HWIO_QDSS_ETFETB_PERIPHID5_ADDR A:0xfc307fd4
y.create.l HWIO_QDSS_ETFETB_PERIPHID6_ADDR A:0xfc307fd8
y.create.l HWIO_QDSS_ETFETB_PERIPHID7_ADDR A:0xfc307fdc
y.create.l HWIO_QDSS_ETFETB_COMPID0_ADDR A:0xfc307ff0
y.create.l HWIO_QDSS_ETFETB_COMPID1_ADDR A:0xfc307ff4
y.create.l HWIO_QDSS_ETFETB_COMPID2_ADDR A:0xfc307ff8
y.create.l HWIO_QDSS_ETFETB_COMPID3_ADDR A:0xfc307ffc
y.create.l HWIO_QDSS_CTI0_CTICONTROL_ADDR A:0xfc308000
y.create.l HWIO_QDSS_CTI0_CTIINTACK_ADDR A:0xfc308010
y.create.l HWIO_QDSS_CTI0_CTIAPPSET_ADDR A:0xfc308014
y.create.l HWIO_QDSS_CTI0_CTIAPPCLEAR_ADDR A:0xfc308018
y.create.l HWIO_QDSS_CTI0_CTIAPPPULSE_ADDR A:0xfc30801c
y.create.l HWIO_QDSS_CTI0_CTIINEN0_ADDR A:0xfc308020
y.create.l HWIO_QDSS_CTI0_CTIINEN1_ADDR A:0xfc308024
y.create.l HWIO_QDSS_CTI0_CTIINEN2_ADDR A:0xfc308028
y.create.l HWIO_QDSS_CTI0_CTIINEN3_ADDR A:0xfc30802c
y.create.l HWIO_QDSS_CTI0_CTIINEN4_ADDR A:0xfc308030
y.create.l HWIO_QDSS_CTI0_CTIINEN5_ADDR A:0xfc308034
y.create.l HWIO_QDSS_CTI0_CTIINEN6_ADDR A:0xfc308038
y.create.l HWIO_QDSS_CTI0_CTIINEN7_ADDR A:0xfc30803c
y.create.l HWIO_QDSS_CTI0_CTIOUTEN0_ADDR A:0xfc3080a0
y.create.l HWIO_QDSS_CTI0_CTIOUTEN1_ADDR A:0xfc3080a4
y.create.l HWIO_QDSS_CTI0_CTIOUTEN2_ADDR A:0xfc3080a8
y.create.l HWIO_QDSS_CTI0_CTIOUTEN3_ADDR A:0xfc3080ac
y.create.l HWIO_QDSS_CTI0_CTIOUTEN4_ADDR A:0xfc3080b0
y.create.l HWIO_QDSS_CTI0_CTIOUTEN5_ADDR A:0xfc3080b4
y.create.l HWIO_QDSS_CTI0_CTIOUTEN6_ADDR A:0xfc3080b8
y.create.l HWIO_QDSS_CTI0_CTIOUTEN7_ADDR A:0xfc3080bc
y.create.l HWIO_QDSS_CTI0_CTITRIGINSTATUS_ADDR A:0xfc308130
y.create.l HWIO_QDSS_CTI0_CTITRIGOUTSTATUS_ADDR A:0xfc308134
y.create.l HWIO_QDSS_CTI0_CTICHINSTATUS_ADDR A:0xfc308138
y.create.l HWIO_QDSS_CTI0_CTICHOUTSTATUS_ADDR A:0xfc30813c
y.create.l HWIO_QDSS_CTI0_CTIGATE_ADDR A:0xfc308140
y.create.l HWIO_QDSS_CTI0_ASICCTL_ADDR A:0xfc308144
y.create.l HWIO_QDSS_CTI0_ITCHINACK_ADDR A:0xfc308edc
y.create.l HWIO_QDSS_CTI0_ITTRIGINACK_ADDR A:0xfc308ee0
y.create.l HWIO_QDSS_CTI0_ITCHOUT_ADDR A:0xfc308ee4
y.create.l HWIO_QDSS_CTI0_ITTRIGOUT_ADDR A:0xfc308ee8
y.create.l HWIO_QDSS_CTI0_ITCHOUTACK_ADDR A:0xfc308eec
y.create.l HWIO_QDSS_CTI0_ITTRIGOUTACK_ADDR A:0xfc308ef0
y.create.l HWIO_QDSS_CTI0_ITCHIN_ADDR A:0xfc308ef4
y.create.l HWIO_QDSS_CTI0_ITTRIGIN_ADDR A:0xfc308ef8
y.create.l HWIO_QDSS_CTI0_ITCTRL_ADDR A:0xfc308f00
y.create.l HWIO_QDSS_CTI0_CLAIMSET_ADDR A:0xfc308fa0
y.create.l HWIO_QDSS_CTI0_CLAIMCLR_ADDR A:0xfc308fa4
y.create.l HWIO_QDSS_CTI0_LAR_ADDR A:0xfc308fb0
y.create.l HWIO_QDSS_CTI0_LSR_ADDR A:0xfc308fb4
y.create.l HWIO_QDSS_CTI0_AUTHSTATUS_ADDR A:0xfc308fb8
y.create.l HWIO_QDSS_CTI0_DEVID_ADDR A:0xfc308fc8
y.create.l HWIO_QDSS_CTI0_DEVTYPE_ADDR A:0xfc308fcc
y.create.l HWIO_QDSS_CTI0_PERIPHID0_ADDR A:0xfc308fe0
y.create.l HWIO_QDSS_CTI0_PERIPHID1_ADDR A:0xfc308fe4
y.create.l HWIO_QDSS_CTI0_PERIPHID2_ADDR A:0xfc308fe8
y.create.l HWIO_QDSS_CTI0_PERIPHID3_ADDR A:0xfc308fec
y.create.l HWIO_QDSS_CTI0_PERIPHID4_ADDR A:0xfc308fd0
y.create.l HWIO_QDSS_CTI0_PERIPHID5_ADDR A:0xfc308fd4
y.create.l HWIO_QDSS_CTI0_PERIPHID6_ADDR A:0xfc308fd8
y.create.l HWIO_QDSS_CTI0_PERIPHID7_ADDR A:0xfc308fdc
y.create.l HWIO_QDSS_CTI0_COMPID0_ADDR A:0xfc308ff0
y.create.l HWIO_QDSS_CTI0_COMPID1_ADDR A:0xfc308ff4
y.create.l HWIO_QDSS_CTI0_COMPID2_ADDR A:0xfc308ff8
y.create.l HWIO_QDSS_CTI0_COMPID3_ADDR A:0xfc308ffc
y.create.l HWIO_QDSS_CTI1_CTICONTROL_ADDR A:0xfc309000
y.create.l HWIO_QDSS_CTI1_CTIINTACK_ADDR A:0xfc309010
y.create.l HWIO_QDSS_CTI1_CTIAPPSET_ADDR A:0xfc309014
y.create.l HWIO_QDSS_CTI1_CTIAPPCLEAR_ADDR A:0xfc309018
y.create.l HWIO_QDSS_CTI1_CTIAPPPULSE_ADDR A:0xfc30901c
y.create.l HWIO_QDSS_CTI1_CTIINEN0_ADDR A:0xfc309020
y.create.l HWIO_QDSS_CTI1_CTIINEN1_ADDR A:0xfc309024
y.create.l HWIO_QDSS_CTI1_CTIINEN2_ADDR A:0xfc309028
y.create.l HWIO_QDSS_CTI1_CTIINEN3_ADDR A:0xfc30902c
y.create.l HWIO_QDSS_CTI1_CTIINEN4_ADDR A:0xfc309030
y.create.l HWIO_QDSS_CTI1_CTIINEN5_ADDR A:0xfc309034
y.create.l HWIO_QDSS_CTI1_CTIINEN6_ADDR A:0xfc309038
y.create.l HWIO_QDSS_CTI1_CTIINEN7_ADDR A:0xfc30903c
y.create.l HWIO_QDSS_CTI1_CTIOUTEN0_ADDR A:0xfc3090a0
y.create.l HWIO_QDSS_CTI1_CTIOUTEN1_ADDR A:0xfc3090a4
y.create.l HWIO_QDSS_CTI1_CTIOUTEN2_ADDR A:0xfc3090a8
y.create.l HWIO_QDSS_CTI1_CTIOUTEN3_ADDR A:0xfc3090ac
y.create.l HWIO_QDSS_CTI1_CTIOUTEN4_ADDR A:0xfc3090b0
y.create.l HWIO_QDSS_CTI1_CTIOUTEN5_ADDR A:0xfc3090b4
y.create.l HWIO_QDSS_CTI1_CTIOUTEN6_ADDR A:0xfc3090b8
y.create.l HWIO_QDSS_CTI1_CTIOUTEN7_ADDR A:0xfc3090bc
y.create.l HWIO_QDSS_CTI1_CTITRIGINSTATUS_ADDR A:0xfc309130
y.create.l HWIO_QDSS_CTI1_CTITRIGOUTSTATUS_ADDR A:0xfc309134
y.create.l HWIO_QDSS_CTI1_CTICHINSTATUS_ADDR A:0xfc309138
y.create.l HWIO_QDSS_CTI1_CTICHOUTSTATUS_ADDR A:0xfc30913c
y.create.l HWIO_QDSS_CTI1_CTIGATE_ADDR A:0xfc309140
y.create.l HWIO_QDSS_CTI1_ASICCTL_ADDR A:0xfc309144
y.create.l HWIO_QDSS_CTI1_ITCHINACK_ADDR A:0xfc309edc
y.create.l HWIO_QDSS_CTI1_ITTRIGINACK_ADDR A:0xfc309ee0
y.create.l HWIO_QDSS_CTI1_ITCHOUT_ADDR A:0xfc309ee4
y.create.l HWIO_QDSS_CTI1_ITTRIGOUT_ADDR A:0xfc309ee8
y.create.l HWIO_QDSS_CTI1_ITCHOUTACK_ADDR A:0xfc309eec
y.create.l HWIO_QDSS_CTI1_ITTRIGOUTACK_ADDR A:0xfc309ef0
y.create.l HWIO_QDSS_CTI1_ITCHIN_ADDR A:0xfc309ef4
y.create.l HWIO_QDSS_CTI1_ITTRIGIN_ADDR A:0xfc309ef8
y.create.l HWIO_QDSS_CTI1_ITCTRL_ADDR A:0xfc309f00
y.create.l HWIO_QDSS_CTI1_CLAIMSET_ADDR A:0xfc309fa0
y.create.l HWIO_QDSS_CTI1_CLAIMCLR_ADDR A:0xfc309fa4
y.create.l HWIO_QDSS_CTI1_LAR_ADDR A:0xfc309fb0
y.create.l HWIO_QDSS_CTI1_LSR_ADDR A:0xfc309fb4
y.create.l HWIO_QDSS_CTI1_AUTHSTATUS_ADDR A:0xfc309fb8
y.create.l HWIO_QDSS_CTI1_DEVID_ADDR A:0xfc309fc8
y.create.l HWIO_QDSS_CTI1_DEVTYPE_ADDR A:0xfc309fcc
y.create.l HWIO_QDSS_CTI1_PERIPHID0_ADDR A:0xfc309fe0
y.create.l HWIO_QDSS_CTI1_PERIPHID1_ADDR A:0xfc309fe4
y.create.l HWIO_QDSS_CTI1_PERIPHID2_ADDR A:0xfc309fe8
y.create.l HWIO_QDSS_CTI1_PERIPHID3_ADDR A:0xfc309fec
y.create.l HWIO_QDSS_CTI1_PERIPHID4_ADDR A:0xfc309fd0
y.create.l HWIO_QDSS_CTI1_PERIPHID5_ADDR A:0xfc309fd4
y.create.l HWIO_QDSS_CTI1_PERIPHID6_ADDR A:0xfc309fd8
y.create.l HWIO_QDSS_CTI1_PERIPHID7_ADDR A:0xfc309fdc
y.create.l HWIO_QDSS_CTI1_COMPID0_ADDR A:0xfc309ff0
y.create.l HWIO_QDSS_CTI1_COMPID1_ADDR A:0xfc309ff4
y.create.l HWIO_QDSS_CTI1_COMPID2_ADDR A:0xfc309ff8
y.create.l HWIO_QDSS_CTI1_COMPID3_ADDR A:0xfc309ffc
y.create.l HWIO_QDSS_CTI2_CTICONTROL_ADDR A:0xfc30a000
y.create.l HWIO_QDSS_CTI2_CTIINTACK_ADDR A:0xfc30a010
y.create.l HWIO_QDSS_CTI2_CTIAPPSET_ADDR A:0xfc30a014
y.create.l HWIO_QDSS_CTI2_CTIAPPCLEAR_ADDR A:0xfc30a018
y.create.l HWIO_QDSS_CTI2_CTIAPPPULSE_ADDR A:0xfc30a01c
y.create.l HWIO_QDSS_CTI2_CTIINEN0_ADDR A:0xfc30a020
y.create.l HWIO_QDSS_CTI2_CTIINEN1_ADDR A:0xfc30a024
y.create.l HWIO_QDSS_CTI2_CTIINEN2_ADDR A:0xfc30a028
y.create.l HWIO_QDSS_CTI2_CTIINEN3_ADDR A:0xfc30a02c
y.create.l HWIO_QDSS_CTI2_CTIINEN4_ADDR A:0xfc30a030
y.create.l HWIO_QDSS_CTI2_CTIINEN5_ADDR A:0xfc30a034
y.create.l HWIO_QDSS_CTI2_CTIINEN6_ADDR A:0xfc30a038
y.create.l HWIO_QDSS_CTI2_CTIINEN7_ADDR A:0xfc30a03c
y.create.l HWIO_QDSS_CTI2_CTIOUTEN0_ADDR A:0xfc30a0a0
y.create.l HWIO_QDSS_CTI2_CTIOUTEN1_ADDR A:0xfc30a0a4
y.create.l HWIO_QDSS_CTI2_CTIOUTEN2_ADDR A:0xfc30a0a8
y.create.l HWIO_QDSS_CTI2_CTIOUTEN3_ADDR A:0xfc30a0ac
y.create.l HWIO_QDSS_CTI2_CTIOUTEN4_ADDR A:0xfc30a0b0
y.create.l HWIO_QDSS_CTI2_CTIOUTEN5_ADDR A:0xfc30a0b4
y.create.l HWIO_QDSS_CTI2_CTIOUTEN6_ADDR A:0xfc30a0b8
y.create.l HWIO_QDSS_CTI2_CTIOUTEN7_ADDR A:0xfc30a0bc
y.create.l HWIO_QDSS_CTI2_CTITRIGINSTATUS_ADDR A:0xfc30a130
y.create.l HWIO_QDSS_CTI2_CTITRIGOUTSTATUS_ADDR A:0xfc30a134
y.create.l HWIO_QDSS_CTI2_CTICHINSTATUS_ADDR A:0xfc30a138
y.create.l HWIO_QDSS_CTI2_CTICHOUTSTATUS_ADDR A:0xfc30a13c
y.create.l HWIO_QDSS_CTI2_CTIGATE_ADDR A:0xfc30a140
y.create.l HWIO_QDSS_CTI2_ASICCTL_ADDR A:0xfc30a144
y.create.l HWIO_QDSS_CTI2_ITCHINACK_ADDR A:0xfc30aedc
y.create.l HWIO_QDSS_CTI2_ITTRIGINACK_ADDR A:0xfc30aee0
y.create.l HWIO_QDSS_CTI2_ITCHOUT_ADDR A:0xfc30aee4
y.create.l HWIO_QDSS_CTI2_ITTRIGOUT_ADDR A:0xfc30aee8
y.create.l HWIO_QDSS_CTI2_ITCHOUTACK_ADDR A:0xfc30aeec
y.create.l HWIO_QDSS_CTI2_ITTRIGOUTACK_ADDR A:0xfc30aef0
y.create.l HWIO_QDSS_CTI2_ITCHIN_ADDR A:0xfc30aef4
y.create.l HWIO_QDSS_CTI2_ITTRIGIN_ADDR A:0xfc30aef8
y.create.l HWIO_QDSS_CTI2_ITCTRL_ADDR A:0xfc30af00
y.create.l HWIO_QDSS_CTI2_CLAIMSET_ADDR A:0xfc30afa0
y.create.l HWIO_QDSS_CTI2_CLAIMCLR_ADDR A:0xfc30afa4
y.create.l HWIO_QDSS_CTI2_LAR_ADDR A:0xfc30afb0
y.create.l HWIO_QDSS_CTI2_LSR_ADDR A:0xfc30afb4
y.create.l HWIO_QDSS_CTI2_AUTHSTATUS_ADDR A:0xfc30afb8
y.create.l HWIO_QDSS_CTI2_DEVID_ADDR A:0xfc30afc8
y.create.l HWIO_QDSS_CTI2_DEVTYPE_ADDR A:0xfc30afcc
y.create.l HWIO_QDSS_CTI2_PERIPHID0_ADDR A:0xfc30afe0
y.create.l HWIO_QDSS_CTI2_PERIPHID1_ADDR A:0xfc30afe4
y.create.l HWIO_QDSS_CTI2_PERIPHID2_ADDR A:0xfc30afe8
y.create.l HWIO_QDSS_CTI2_PERIPHID3_ADDR A:0xfc30afec
y.create.l HWIO_QDSS_CTI2_PERIPHID4_ADDR A:0xfc30afd0
y.create.l HWIO_QDSS_CTI2_PERIPHID5_ADDR A:0xfc30afd4
y.create.l HWIO_QDSS_CTI2_PERIPHID6_ADDR A:0xfc30afd8
y.create.l HWIO_QDSS_CTI2_PERIPHID7_ADDR A:0xfc30afdc
y.create.l HWIO_QDSS_CTI2_COMPID0_ADDR A:0xfc30aff0
y.create.l HWIO_QDSS_CTI2_COMPID1_ADDR A:0xfc30aff4
y.create.l HWIO_QDSS_CTI2_COMPID2_ADDR A:0xfc30aff8
y.create.l HWIO_QDSS_CTI2_COMPID3_ADDR A:0xfc30affc
y.create.l HWIO_QDSS_CTI3_CTICONTROL_ADDR A:0xfc30b000
y.create.l HWIO_QDSS_CTI3_CTIINTACK_ADDR A:0xfc30b010
y.create.l HWIO_QDSS_CTI3_CTIAPPSET_ADDR A:0xfc30b014
y.create.l HWIO_QDSS_CTI3_CTIAPPCLEAR_ADDR A:0xfc30b018
y.create.l HWIO_QDSS_CTI3_CTIAPPPULSE_ADDR A:0xfc30b01c
y.create.l HWIO_QDSS_CTI3_CTIINEN0_ADDR A:0xfc30b020
y.create.l HWIO_QDSS_CTI3_CTIINEN1_ADDR A:0xfc30b024
y.create.l HWIO_QDSS_CTI3_CTIINEN2_ADDR A:0xfc30b028
y.create.l HWIO_QDSS_CTI3_CTIINEN3_ADDR A:0xfc30b02c
y.create.l HWIO_QDSS_CTI3_CTIINEN4_ADDR A:0xfc30b030
y.create.l HWIO_QDSS_CTI3_CTIINEN5_ADDR A:0xfc30b034
y.create.l HWIO_QDSS_CTI3_CTIINEN6_ADDR A:0xfc30b038
y.create.l HWIO_QDSS_CTI3_CTIINEN7_ADDR A:0xfc30b03c
y.create.l HWIO_QDSS_CTI3_CTIOUTEN0_ADDR A:0xfc30b0a0
y.create.l HWIO_QDSS_CTI3_CTIOUTEN1_ADDR A:0xfc30b0a4
y.create.l HWIO_QDSS_CTI3_CTIOUTEN2_ADDR A:0xfc30b0a8
y.create.l HWIO_QDSS_CTI3_CTIOUTEN3_ADDR A:0xfc30b0ac
y.create.l HWIO_QDSS_CTI3_CTIOUTEN4_ADDR A:0xfc30b0b0
y.create.l HWIO_QDSS_CTI3_CTIOUTEN5_ADDR A:0xfc30b0b4
y.create.l HWIO_QDSS_CTI3_CTIOUTEN6_ADDR A:0xfc30b0b8
y.create.l HWIO_QDSS_CTI3_CTIOUTEN7_ADDR A:0xfc30b0bc
y.create.l HWIO_QDSS_CTI3_CTITRIGINSTATUS_ADDR A:0xfc30b130
y.create.l HWIO_QDSS_CTI3_CTITRIGOUTSTATUS_ADDR A:0xfc30b134
y.create.l HWIO_QDSS_CTI3_CTICHINSTATUS_ADDR A:0xfc30b138
y.create.l HWIO_QDSS_CTI3_CTICHOUTSTATUS_ADDR A:0xfc30b13c
y.create.l HWIO_QDSS_CTI3_CTIGATE_ADDR A:0xfc30b140
y.create.l HWIO_QDSS_CTI3_ASICCTL_ADDR A:0xfc30b144
y.create.l HWIO_QDSS_CTI3_ITCHINACK_ADDR A:0xfc30bedc
y.create.l HWIO_QDSS_CTI3_ITTRIGINACK_ADDR A:0xfc30bee0
y.create.l HWIO_QDSS_CTI3_ITCHOUT_ADDR A:0xfc30bee4
y.create.l HWIO_QDSS_CTI3_ITTRIGOUT_ADDR A:0xfc30bee8
y.create.l HWIO_QDSS_CTI3_ITCHOUTACK_ADDR A:0xfc30beec
y.create.l HWIO_QDSS_CTI3_ITTRIGOUTACK_ADDR A:0xfc30bef0
y.create.l HWIO_QDSS_CTI3_ITCHIN_ADDR A:0xfc30bef4
y.create.l HWIO_QDSS_CTI3_ITTRIGIN_ADDR A:0xfc30bef8
y.create.l HWIO_QDSS_CTI3_ITCTRL_ADDR A:0xfc30bf00
y.create.l HWIO_QDSS_CTI3_CLAIMSET_ADDR A:0xfc30bfa0
y.create.l HWIO_QDSS_CTI3_CLAIMCLR_ADDR A:0xfc30bfa4
y.create.l HWIO_QDSS_CTI3_LAR_ADDR A:0xfc30bfb0
y.create.l HWIO_QDSS_CTI3_LSR_ADDR A:0xfc30bfb4
y.create.l HWIO_QDSS_CTI3_AUTHSTATUS_ADDR A:0xfc30bfb8
y.create.l HWIO_QDSS_CTI3_DEVID_ADDR A:0xfc30bfc8
y.create.l HWIO_QDSS_CTI3_DEVTYPE_ADDR A:0xfc30bfcc
y.create.l HWIO_QDSS_CTI3_PERIPHID0_ADDR A:0xfc30bfe0
y.create.l HWIO_QDSS_CTI3_PERIPHID1_ADDR A:0xfc30bfe4
y.create.l HWIO_QDSS_CTI3_PERIPHID2_ADDR A:0xfc30bfe8
y.create.l HWIO_QDSS_CTI3_PERIPHID3_ADDR A:0xfc30bfec
y.create.l HWIO_QDSS_CTI3_PERIPHID4_ADDR A:0xfc30bfd0
y.create.l HWIO_QDSS_CTI3_PERIPHID5_ADDR A:0xfc30bfd4
y.create.l HWIO_QDSS_CTI3_PERIPHID6_ADDR A:0xfc30bfd8
y.create.l HWIO_QDSS_CTI3_PERIPHID7_ADDR A:0xfc30bfdc
y.create.l HWIO_QDSS_CTI3_COMPID0_ADDR A:0xfc30bff0
y.create.l HWIO_QDSS_CTI3_COMPID1_ADDR A:0xfc30bff4
y.create.l HWIO_QDSS_CTI3_COMPID2_ADDR A:0xfc30bff8
y.create.l HWIO_QDSS_CTI3_COMPID3_ADDR A:0xfc30bffc
y.create.l HWIO_QDSS_CTI4_CTICONTROL_ADDR A:0xfc30c000
y.create.l HWIO_QDSS_CTI4_CTIINTACK_ADDR A:0xfc30c010
y.create.l HWIO_QDSS_CTI4_CTIAPPSET_ADDR A:0xfc30c014
y.create.l HWIO_QDSS_CTI4_CTIAPPCLEAR_ADDR A:0xfc30c018
y.create.l HWIO_QDSS_CTI4_CTIAPPPULSE_ADDR A:0xfc30c01c
y.create.l HWIO_QDSS_CTI4_CTIINEN0_ADDR A:0xfc30c020
y.create.l HWIO_QDSS_CTI4_CTIINEN1_ADDR A:0xfc30c024
y.create.l HWIO_QDSS_CTI4_CTIINEN2_ADDR A:0xfc30c028
y.create.l HWIO_QDSS_CTI4_CTIINEN3_ADDR A:0xfc30c02c
y.create.l HWIO_QDSS_CTI4_CTIINEN4_ADDR A:0xfc30c030
y.create.l HWIO_QDSS_CTI4_CTIINEN5_ADDR A:0xfc30c034
y.create.l HWIO_QDSS_CTI4_CTIINEN6_ADDR A:0xfc30c038
y.create.l HWIO_QDSS_CTI4_CTIINEN7_ADDR A:0xfc30c03c
y.create.l HWIO_QDSS_CTI4_CTIOUTEN0_ADDR A:0xfc30c0a0
y.create.l HWIO_QDSS_CTI4_CTIOUTEN1_ADDR A:0xfc30c0a4
y.create.l HWIO_QDSS_CTI4_CTIOUTEN2_ADDR A:0xfc30c0a8
y.create.l HWIO_QDSS_CTI4_CTIOUTEN3_ADDR A:0xfc30c0ac
y.create.l HWIO_QDSS_CTI4_CTIOUTEN4_ADDR A:0xfc30c0b0
y.create.l HWIO_QDSS_CTI4_CTIOUTEN5_ADDR A:0xfc30c0b4
y.create.l HWIO_QDSS_CTI4_CTIOUTEN6_ADDR A:0xfc30c0b8
y.create.l HWIO_QDSS_CTI4_CTIOUTEN7_ADDR A:0xfc30c0bc
y.create.l HWIO_QDSS_CTI4_CTITRIGINSTATUS_ADDR A:0xfc30c130
y.create.l HWIO_QDSS_CTI4_CTITRIGOUTSTATUS_ADDR A:0xfc30c134
y.create.l HWIO_QDSS_CTI4_CTICHINSTATUS_ADDR A:0xfc30c138
y.create.l HWIO_QDSS_CTI4_CTICHOUTSTATUS_ADDR A:0xfc30c13c
y.create.l HWIO_QDSS_CTI4_CTIGATE_ADDR A:0xfc30c140
y.create.l HWIO_QDSS_CTI4_ASICCTL_ADDR A:0xfc30c144
y.create.l HWIO_QDSS_CTI4_ITCHINACK_ADDR A:0xfc30cedc
y.create.l HWIO_QDSS_CTI4_ITTRIGINACK_ADDR A:0xfc30cee0
y.create.l HWIO_QDSS_CTI4_ITCHOUT_ADDR A:0xfc30cee4
y.create.l HWIO_QDSS_CTI4_ITTRIGOUT_ADDR A:0xfc30cee8
y.create.l HWIO_QDSS_CTI4_ITCHOUTACK_ADDR A:0xfc30ceec
y.create.l HWIO_QDSS_CTI4_ITTRIGOUTACK_ADDR A:0xfc30cef0
y.create.l HWIO_QDSS_CTI4_ITCHIN_ADDR A:0xfc30cef4
y.create.l HWIO_QDSS_CTI4_ITTRIGIN_ADDR A:0xfc30cef8
y.create.l HWIO_QDSS_CTI4_ITCTRL_ADDR A:0xfc30cf00
y.create.l HWIO_QDSS_CTI4_CLAIMSET_ADDR A:0xfc30cfa0
y.create.l HWIO_QDSS_CTI4_CLAIMCLR_ADDR A:0xfc30cfa4
y.create.l HWIO_QDSS_CTI4_LAR_ADDR A:0xfc30cfb0
y.create.l HWIO_QDSS_CTI4_LSR_ADDR A:0xfc30cfb4
y.create.l HWIO_QDSS_CTI4_AUTHSTATUS_ADDR A:0xfc30cfb8
y.create.l HWIO_QDSS_CTI4_DEVID_ADDR A:0xfc30cfc8
y.create.l HWIO_QDSS_CTI4_DEVTYPE_ADDR A:0xfc30cfcc
y.create.l HWIO_QDSS_CTI4_PERIPHID0_ADDR A:0xfc30cfe0
y.create.l HWIO_QDSS_CTI4_PERIPHID1_ADDR A:0xfc30cfe4
y.create.l HWIO_QDSS_CTI4_PERIPHID2_ADDR A:0xfc30cfe8
y.create.l HWIO_QDSS_CTI4_PERIPHID3_ADDR A:0xfc30cfec
y.create.l HWIO_QDSS_CTI4_PERIPHID4_ADDR A:0xfc30cfd0
y.create.l HWIO_QDSS_CTI4_PERIPHID5_ADDR A:0xfc30cfd4
y.create.l HWIO_QDSS_CTI4_PERIPHID6_ADDR A:0xfc30cfd8
y.create.l HWIO_QDSS_CTI4_PERIPHID7_ADDR A:0xfc30cfdc
y.create.l HWIO_QDSS_CTI4_COMPID0_ADDR A:0xfc30cff0
y.create.l HWIO_QDSS_CTI4_COMPID1_ADDR A:0xfc30cff4
y.create.l HWIO_QDSS_CTI4_COMPID2_ADDR A:0xfc30cff8
y.create.l HWIO_QDSS_CTI4_COMPID3_ADDR A:0xfc30cffc
y.create.l HWIO_QDSS_CTI5_CTICONTROL_ADDR A:0xfc30d000
y.create.l HWIO_QDSS_CTI5_CTIINTACK_ADDR A:0xfc30d010
y.create.l HWIO_QDSS_CTI5_CTIAPPSET_ADDR A:0xfc30d014
y.create.l HWIO_QDSS_CTI5_CTIAPPCLEAR_ADDR A:0xfc30d018
y.create.l HWIO_QDSS_CTI5_CTIAPPPULSE_ADDR A:0xfc30d01c
y.create.l HWIO_QDSS_CTI5_CTIINEN0_ADDR A:0xfc30d020
y.create.l HWIO_QDSS_CTI5_CTIINEN1_ADDR A:0xfc30d024
y.create.l HWIO_QDSS_CTI5_CTIINEN2_ADDR A:0xfc30d028
y.create.l HWIO_QDSS_CTI5_CTIINEN3_ADDR A:0xfc30d02c
y.create.l HWIO_QDSS_CTI5_CTIINEN4_ADDR A:0xfc30d030
y.create.l HWIO_QDSS_CTI5_CTIINEN5_ADDR A:0xfc30d034
y.create.l HWIO_QDSS_CTI5_CTIINEN6_ADDR A:0xfc30d038
y.create.l HWIO_QDSS_CTI5_CTIINEN7_ADDR A:0xfc30d03c
y.create.l HWIO_QDSS_CTI5_CTIOUTEN0_ADDR A:0xfc30d0a0
y.create.l HWIO_QDSS_CTI5_CTIOUTEN1_ADDR A:0xfc30d0a4
y.create.l HWIO_QDSS_CTI5_CTIOUTEN2_ADDR A:0xfc30d0a8
y.create.l HWIO_QDSS_CTI5_CTIOUTEN3_ADDR A:0xfc30d0ac
y.create.l HWIO_QDSS_CTI5_CTIOUTEN4_ADDR A:0xfc30d0b0
y.create.l HWIO_QDSS_CTI5_CTIOUTEN5_ADDR A:0xfc30d0b4
y.create.l HWIO_QDSS_CTI5_CTIOUTEN6_ADDR A:0xfc30d0b8
y.create.l HWIO_QDSS_CTI5_CTIOUTEN7_ADDR A:0xfc30d0bc
y.create.l HWIO_QDSS_CTI5_CTITRIGINSTATUS_ADDR A:0xfc30d130
y.create.l HWIO_QDSS_CTI5_CTITRIGOUTSTATUS_ADDR A:0xfc30d134
y.create.l HWIO_QDSS_CTI5_CTICHINSTATUS_ADDR A:0xfc30d138
y.create.l HWIO_QDSS_CTI5_CTICHOUTSTATUS_ADDR A:0xfc30d13c
y.create.l HWIO_QDSS_CTI5_CTIGATE_ADDR A:0xfc30d140
y.create.l HWIO_QDSS_CTI5_ASICCTL_ADDR A:0xfc30d144
y.create.l HWIO_QDSS_CTI5_ITCHINACK_ADDR A:0xfc30dedc
y.create.l HWIO_QDSS_CTI5_ITTRIGINACK_ADDR A:0xfc30dee0
y.create.l HWIO_QDSS_CTI5_ITCHOUT_ADDR A:0xfc30dee4
y.create.l HWIO_QDSS_CTI5_ITTRIGOUT_ADDR A:0xfc30dee8
y.create.l HWIO_QDSS_CTI5_ITCHOUTACK_ADDR A:0xfc30deec
y.create.l HWIO_QDSS_CTI5_ITTRIGOUTACK_ADDR A:0xfc30def0
y.create.l HWIO_QDSS_CTI5_ITCHIN_ADDR A:0xfc30def4
y.create.l HWIO_QDSS_CTI5_ITTRIGIN_ADDR A:0xfc30def8
y.create.l HWIO_QDSS_CTI5_ITCTRL_ADDR A:0xfc30df00
y.create.l HWIO_QDSS_CTI5_CLAIMSET_ADDR A:0xfc30dfa0
y.create.l HWIO_QDSS_CTI5_CLAIMCLR_ADDR A:0xfc30dfa4
y.create.l HWIO_QDSS_CTI5_LAR_ADDR A:0xfc30dfb0
y.create.l HWIO_QDSS_CTI5_LSR_ADDR A:0xfc30dfb4
y.create.l HWIO_QDSS_CTI5_AUTHSTATUS_ADDR A:0xfc30dfb8
y.create.l HWIO_QDSS_CTI5_DEVID_ADDR A:0xfc30dfc8
y.create.l HWIO_QDSS_CTI5_DEVTYPE_ADDR A:0xfc30dfcc
y.create.l HWIO_QDSS_CTI5_PERIPHID0_ADDR A:0xfc30dfe0
y.create.l HWIO_QDSS_CTI5_PERIPHID1_ADDR A:0xfc30dfe4
y.create.l HWIO_QDSS_CTI5_PERIPHID2_ADDR A:0xfc30dfe8
y.create.l HWIO_QDSS_CTI5_PERIPHID3_ADDR A:0xfc30dfec
y.create.l HWIO_QDSS_CTI5_PERIPHID4_ADDR A:0xfc30dfd0
y.create.l HWIO_QDSS_CTI5_PERIPHID5_ADDR A:0xfc30dfd4
y.create.l HWIO_QDSS_CTI5_PERIPHID6_ADDR A:0xfc30dfd8
y.create.l HWIO_QDSS_CTI5_PERIPHID7_ADDR A:0xfc30dfdc
y.create.l HWIO_QDSS_CTI5_COMPID0_ADDR A:0xfc30dff0
y.create.l HWIO_QDSS_CTI5_COMPID1_ADDR A:0xfc30dff4
y.create.l HWIO_QDSS_CTI5_COMPID2_ADDR A:0xfc30dff8
y.create.l HWIO_QDSS_CTI5_COMPID3_ADDR A:0xfc30dffc
y.create.l HWIO_QDSS_CTI6_CTICONTROL_ADDR A:0xfc30e000
y.create.l HWIO_QDSS_CTI6_CTIINTACK_ADDR A:0xfc30e010
y.create.l HWIO_QDSS_CTI6_CTIAPPSET_ADDR A:0xfc30e014
y.create.l HWIO_QDSS_CTI6_CTIAPPCLEAR_ADDR A:0xfc30e018
y.create.l HWIO_QDSS_CTI6_CTIAPPPULSE_ADDR A:0xfc30e01c
y.create.l HWIO_QDSS_CTI6_CTIINEN0_ADDR A:0xfc30e020
y.create.l HWIO_QDSS_CTI6_CTIINEN1_ADDR A:0xfc30e024
y.create.l HWIO_QDSS_CTI6_CTIINEN2_ADDR A:0xfc30e028
y.create.l HWIO_QDSS_CTI6_CTIINEN3_ADDR A:0xfc30e02c
y.create.l HWIO_QDSS_CTI6_CTIINEN4_ADDR A:0xfc30e030
y.create.l HWIO_QDSS_CTI6_CTIINEN5_ADDR A:0xfc30e034
y.create.l HWIO_QDSS_CTI6_CTIINEN6_ADDR A:0xfc30e038
y.create.l HWIO_QDSS_CTI6_CTIINEN7_ADDR A:0xfc30e03c
y.create.l HWIO_QDSS_CTI6_CTIOUTEN0_ADDR A:0xfc30e0a0
y.create.l HWIO_QDSS_CTI6_CTIOUTEN1_ADDR A:0xfc30e0a4
y.create.l HWIO_QDSS_CTI6_CTIOUTEN2_ADDR A:0xfc30e0a8
y.create.l HWIO_QDSS_CTI6_CTIOUTEN3_ADDR A:0xfc30e0ac
y.create.l HWIO_QDSS_CTI6_CTIOUTEN4_ADDR A:0xfc30e0b0
y.create.l HWIO_QDSS_CTI6_CTIOUTEN5_ADDR A:0xfc30e0b4
y.create.l HWIO_QDSS_CTI6_CTIOUTEN6_ADDR A:0xfc30e0b8
y.create.l HWIO_QDSS_CTI6_CTIOUTEN7_ADDR A:0xfc30e0bc
y.create.l HWIO_QDSS_CTI6_CTITRIGINSTATUS_ADDR A:0xfc30e130
y.create.l HWIO_QDSS_CTI6_CTITRIGOUTSTATUS_ADDR A:0xfc30e134
y.create.l HWIO_QDSS_CTI6_CTICHINSTATUS_ADDR A:0xfc30e138
y.create.l HWIO_QDSS_CTI6_CTICHOUTSTATUS_ADDR A:0xfc30e13c
y.create.l HWIO_QDSS_CTI6_CTIGATE_ADDR A:0xfc30e140
y.create.l HWIO_QDSS_CTI6_ASICCTL_ADDR A:0xfc30e144
y.create.l HWIO_QDSS_CTI6_ITCHINACK_ADDR A:0xfc30eedc
y.create.l HWIO_QDSS_CTI6_ITTRIGINACK_ADDR A:0xfc30eee0
y.create.l HWIO_QDSS_CTI6_ITCHOUT_ADDR A:0xfc30eee4
y.create.l HWIO_QDSS_CTI6_ITTRIGOUT_ADDR A:0xfc30eee8
y.create.l HWIO_QDSS_CTI6_ITCHOUTACK_ADDR A:0xfc30eeec
y.create.l HWIO_QDSS_CTI6_ITTRIGOUTACK_ADDR A:0xfc30eef0
y.create.l HWIO_QDSS_CTI6_ITCHIN_ADDR A:0xfc30eef4
y.create.l HWIO_QDSS_CTI6_ITTRIGIN_ADDR A:0xfc30eef8
y.create.l HWIO_QDSS_CTI6_ITCTRL_ADDR A:0xfc30ef00
y.create.l HWIO_QDSS_CTI6_CLAIMSET_ADDR A:0xfc30efa0
y.create.l HWIO_QDSS_CTI6_CLAIMCLR_ADDR A:0xfc30efa4
y.create.l HWIO_QDSS_CTI6_LAR_ADDR A:0xfc30efb0
y.create.l HWIO_QDSS_CTI6_LSR_ADDR A:0xfc30efb4
y.create.l HWIO_QDSS_CTI6_AUTHSTATUS_ADDR A:0xfc30efb8
y.create.l HWIO_QDSS_CTI6_DEVID_ADDR A:0xfc30efc8
y.create.l HWIO_QDSS_CTI6_DEVTYPE_ADDR A:0xfc30efcc
y.create.l HWIO_QDSS_CTI6_PERIPHID0_ADDR A:0xfc30efe0
y.create.l HWIO_QDSS_CTI6_PERIPHID1_ADDR A:0xfc30efe4
y.create.l HWIO_QDSS_CTI6_PERIPHID2_ADDR A:0xfc30efe8
y.create.l HWIO_QDSS_CTI6_PERIPHID3_ADDR A:0xfc30efec
y.create.l HWIO_QDSS_CTI6_PERIPHID4_ADDR A:0xfc30efd0
y.create.l HWIO_QDSS_CTI6_PERIPHID5_ADDR A:0xfc30efd4
y.create.l HWIO_QDSS_CTI6_PERIPHID6_ADDR A:0xfc30efd8
y.create.l HWIO_QDSS_CTI6_PERIPHID7_ADDR A:0xfc30efdc
y.create.l HWIO_QDSS_CTI6_COMPID0_ADDR A:0xfc30eff0
y.create.l HWIO_QDSS_CTI6_COMPID1_ADDR A:0xfc30eff4
y.create.l HWIO_QDSS_CTI6_COMPID2_ADDR A:0xfc30eff8
y.create.l HWIO_QDSS_CTI6_COMPID3_ADDR A:0xfc30effc
y.create.l HWIO_QDSS_CTI7_CTICONTROL_ADDR A:0xfc30f000
y.create.l HWIO_QDSS_CTI7_CTIINTACK_ADDR A:0xfc30f010
y.create.l HWIO_QDSS_CTI7_CTIAPPSET_ADDR A:0xfc30f014
y.create.l HWIO_QDSS_CTI7_CTIAPPCLEAR_ADDR A:0xfc30f018
y.create.l HWIO_QDSS_CTI7_CTIAPPPULSE_ADDR A:0xfc30f01c
y.create.l HWIO_QDSS_CTI7_CTIINEN0_ADDR A:0xfc30f020
y.create.l HWIO_QDSS_CTI7_CTIINEN1_ADDR A:0xfc30f024
y.create.l HWIO_QDSS_CTI7_CTIINEN2_ADDR A:0xfc30f028
y.create.l HWIO_QDSS_CTI7_CTIINEN3_ADDR A:0xfc30f02c
y.create.l HWIO_QDSS_CTI7_CTIINEN4_ADDR A:0xfc30f030
y.create.l HWIO_QDSS_CTI7_CTIINEN5_ADDR A:0xfc30f034
y.create.l HWIO_QDSS_CTI7_CTIINEN6_ADDR A:0xfc30f038
y.create.l HWIO_QDSS_CTI7_CTIINEN7_ADDR A:0xfc30f03c
y.create.l HWIO_QDSS_CTI7_CTIOUTEN0_ADDR A:0xfc30f0a0
y.create.l HWIO_QDSS_CTI7_CTIOUTEN1_ADDR A:0xfc30f0a4
y.create.l HWIO_QDSS_CTI7_CTIOUTEN2_ADDR A:0xfc30f0a8
y.create.l HWIO_QDSS_CTI7_CTIOUTEN3_ADDR A:0xfc30f0ac
y.create.l HWIO_QDSS_CTI7_CTIOUTEN4_ADDR A:0xfc30f0b0
y.create.l HWIO_QDSS_CTI7_CTIOUTEN5_ADDR A:0xfc30f0b4
y.create.l HWIO_QDSS_CTI7_CTIOUTEN6_ADDR A:0xfc30f0b8
y.create.l HWIO_QDSS_CTI7_CTIOUTEN7_ADDR A:0xfc30f0bc
y.create.l HWIO_QDSS_CTI7_CTITRIGINSTATUS_ADDR A:0xfc30f130
y.create.l HWIO_QDSS_CTI7_CTITRIGOUTSTATUS_ADDR A:0xfc30f134
y.create.l HWIO_QDSS_CTI7_CTICHINSTATUS_ADDR A:0xfc30f138
y.create.l HWIO_QDSS_CTI7_CTICHOUTSTATUS_ADDR A:0xfc30f13c
y.create.l HWIO_QDSS_CTI7_CTIGATE_ADDR A:0xfc30f140
y.create.l HWIO_QDSS_CTI7_ASICCTL_ADDR A:0xfc30f144
y.create.l HWIO_QDSS_CTI7_ITCHINACK_ADDR A:0xfc30fedc
y.create.l HWIO_QDSS_CTI7_ITTRIGINACK_ADDR A:0xfc30fee0
y.create.l HWIO_QDSS_CTI7_ITCHOUT_ADDR A:0xfc30fee4
y.create.l HWIO_QDSS_CTI7_ITTRIGOUT_ADDR A:0xfc30fee8
y.create.l HWIO_QDSS_CTI7_ITCHOUTACK_ADDR A:0xfc30feec
y.create.l HWIO_QDSS_CTI7_ITTRIGOUTACK_ADDR A:0xfc30fef0
y.create.l HWIO_QDSS_CTI7_ITCHIN_ADDR A:0xfc30fef4
y.create.l HWIO_QDSS_CTI7_ITTRIGIN_ADDR A:0xfc30fef8
y.create.l HWIO_QDSS_CTI7_ITCTRL_ADDR A:0xfc30ff00
y.create.l HWIO_QDSS_CTI7_CLAIMSET_ADDR A:0xfc30ffa0
y.create.l HWIO_QDSS_CTI7_CLAIMCLR_ADDR A:0xfc30ffa4
y.create.l HWIO_QDSS_CTI7_LAR_ADDR A:0xfc30ffb0
y.create.l HWIO_QDSS_CTI7_LSR_ADDR A:0xfc30ffb4
y.create.l HWIO_QDSS_CTI7_AUTHSTATUS_ADDR A:0xfc30ffb8
y.create.l HWIO_QDSS_CTI7_DEVID_ADDR A:0xfc30ffc8
y.create.l HWIO_QDSS_CTI7_DEVTYPE_ADDR A:0xfc30ffcc
y.create.l HWIO_QDSS_CTI7_PERIPHID0_ADDR A:0xfc30ffe0
y.create.l HWIO_QDSS_CTI7_PERIPHID1_ADDR A:0xfc30ffe4
y.create.l HWIO_QDSS_CTI7_PERIPHID2_ADDR A:0xfc30ffe8
y.create.l HWIO_QDSS_CTI7_PERIPHID3_ADDR A:0xfc30ffec
y.create.l HWIO_QDSS_CTI7_PERIPHID4_ADDR A:0xfc30ffd0
y.create.l HWIO_QDSS_CTI7_PERIPHID5_ADDR A:0xfc30ffd4
y.create.l HWIO_QDSS_CTI7_PERIPHID6_ADDR A:0xfc30ffd8
y.create.l HWIO_QDSS_CTI7_PERIPHID7_ADDR A:0xfc30ffdc
y.create.l HWIO_QDSS_CTI7_COMPID0_ADDR A:0xfc30fff0
y.create.l HWIO_QDSS_CTI7_COMPID1_ADDR A:0xfc30fff4
y.create.l HWIO_QDSS_CTI7_COMPID2_ADDR A:0xfc30fff8
y.create.l HWIO_QDSS_CTI7_COMPID3_ADDR A:0xfc30fffc
y.create.l HWIO_QDSS_CTI8_CTICONTROL_ADDR A:0xfc310000
y.create.l HWIO_QDSS_CTI8_CTIINTACK_ADDR A:0xfc310010
y.create.l HWIO_QDSS_CTI8_CTIAPPSET_ADDR A:0xfc310014
y.create.l HWIO_QDSS_CTI8_CTIAPPCLEAR_ADDR A:0xfc310018
y.create.l HWIO_QDSS_CTI8_CTIAPPPULSE_ADDR A:0xfc31001c
y.create.l HWIO_QDSS_CTI8_CTIINEN0_ADDR A:0xfc310020
y.create.l HWIO_QDSS_CTI8_CTIINEN1_ADDR A:0xfc310024
y.create.l HWIO_QDSS_CTI8_CTIINEN2_ADDR A:0xfc310028
y.create.l HWIO_QDSS_CTI8_CTIINEN3_ADDR A:0xfc31002c
y.create.l HWIO_QDSS_CTI8_CTIINEN4_ADDR A:0xfc310030
y.create.l HWIO_QDSS_CTI8_CTIINEN5_ADDR A:0xfc310034
y.create.l HWIO_QDSS_CTI8_CTIINEN6_ADDR A:0xfc310038
y.create.l HWIO_QDSS_CTI8_CTIINEN7_ADDR A:0xfc31003c
y.create.l HWIO_QDSS_CTI8_CTIOUTEN0_ADDR A:0xfc3100a0
y.create.l HWIO_QDSS_CTI8_CTIOUTEN1_ADDR A:0xfc3100a4
y.create.l HWIO_QDSS_CTI8_CTIOUTEN2_ADDR A:0xfc3100a8
y.create.l HWIO_QDSS_CTI8_CTIOUTEN3_ADDR A:0xfc3100ac
y.create.l HWIO_QDSS_CTI8_CTIOUTEN4_ADDR A:0xfc3100b0
y.create.l HWIO_QDSS_CTI8_CTIOUTEN5_ADDR A:0xfc3100b4
y.create.l HWIO_QDSS_CTI8_CTIOUTEN6_ADDR A:0xfc3100b8
y.create.l HWIO_QDSS_CTI8_CTIOUTEN7_ADDR A:0xfc3100bc
y.create.l HWIO_QDSS_CTI8_CTITRIGINSTATUS_ADDR A:0xfc310130
y.create.l HWIO_QDSS_CTI8_CTITRIGOUTSTATUS_ADDR A:0xfc310134
y.create.l HWIO_QDSS_CTI8_CTICHINSTATUS_ADDR A:0xfc310138
y.create.l HWIO_QDSS_CTI8_CTICHOUTSTATUS_ADDR A:0xfc31013c
y.create.l HWIO_QDSS_CTI8_CTIGATE_ADDR A:0xfc310140
y.create.l HWIO_QDSS_CTI8_ASICCTL_ADDR A:0xfc310144
y.create.l HWIO_QDSS_CTI8_ITCHINACK_ADDR A:0xfc310edc
y.create.l HWIO_QDSS_CTI8_ITTRIGINACK_ADDR A:0xfc310ee0
y.create.l HWIO_QDSS_CTI8_ITCHOUT_ADDR A:0xfc310ee4
y.create.l HWIO_QDSS_CTI8_ITTRIGOUT_ADDR A:0xfc310ee8
y.create.l HWIO_QDSS_CTI8_ITCHOUTACK_ADDR A:0xfc310eec
y.create.l HWIO_QDSS_CTI8_ITTRIGOUTACK_ADDR A:0xfc310ef0
y.create.l HWIO_QDSS_CTI8_ITCHIN_ADDR A:0xfc310ef4
y.create.l HWIO_QDSS_CTI8_ITTRIGIN_ADDR A:0xfc310ef8
y.create.l HWIO_QDSS_CTI8_ITCTRL_ADDR A:0xfc310f00
y.create.l HWIO_QDSS_CTI8_CLAIMSET_ADDR A:0xfc310fa0
y.create.l HWIO_QDSS_CTI8_CLAIMCLR_ADDR A:0xfc310fa4
y.create.l HWIO_QDSS_CTI8_LAR_ADDR A:0xfc310fb0
y.create.l HWIO_QDSS_CTI8_LSR_ADDR A:0xfc310fb4
y.create.l HWIO_QDSS_CTI8_AUTHSTATUS_ADDR A:0xfc310fb8
y.create.l HWIO_QDSS_CTI8_DEVID_ADDR A:0xfc310fc8
y.create.l HWIO_QDSS_CTI8_DEVTYPE_ADDR A:0xfc310fcc
y.create.l HWIO_QDSS_CTI8_PERIPHID0_ADDR A:0xfc310fe0
y.create.l HWIO_QDSS_CTI8_PERIPHID1_ADDR A:0xfc310fe4
y.create.l HWIO_QDSS_CTI8_PERIPHID2_ADDR A:0xfc310fe8
y.create.l HWIO_QDSS_CTI8_PERIPHID3_ADDR A:0xfc310fec
y.create.l HWIO_QDSS_CTI8_PERIPHID4_ADDR A:0xfc310fd0
y.create.l HWIO_QDSS_CTI8_PERIPHID5_ADDR A:0xfc310fd4
y.create.l HWIO_QDSS_CTI8_PERIPHID6_ADDR A:0xfc310fd8
y.create.l HWIO_QDSS_CTI8_PERIPHID7_ADDR A:0xfc310fdc
y.create.l HWIO_QDSS_CTI8_COMPID0_ADDR A:0xfc310ff0
y.create.l HWIO_QDSS_CTI8_COMPID1_ADDR A:0xfc310ff4
y.create.l HWIO_QDSS_CTI8_COMPID2_ADDR A:0xfc310ff8
y.create.l HWIO_QDSS_CTI8_COMPID3_ADDR A:0xfc310ffc
y.create.l HWIO_QDSS_CSTPIU_SUPPORTED_PORT_SIZES_ADDR A:0xfc318000
y.create.l HWIO_QDSS_CSTPIU_CURRENT_PORT_SIZE_ADDR A:0xfc318004
y.create.l HWIO_QDSS_CSTPIU_SUPPORTED_TRIGGER_MODES_ADDR A:0xfc318100
y.create.l HWIO_QDSS_CSTPIU_TRIGGER_COUNTER_VALUE_ADDR A:0xfc318104
y.create.l HWIO_QDSS_CSTPIU_TRIGGER_MULTIPLIER_ADDR A:0xfc318108
y.create.l HWIO_QDSS_CSTPIU_SUPPORTED_TEST_PATTERN_MODES_ADDR A:0xfc318200
y.create.l HWIO_QDSS_CSTPIU_CURRENT_TEST_PATTERN_MODE_ADDR A:0xfc318204
y.create.l HWIO_QDSS_CSTPIU_TPRCR_ADDR A:0xfc318208
y.create.l HWIO_QDSS_CSTPIU_FFSR_ADDR A:0xfc318300
y.create.l HWIO_QDSS_CSTPIU_FFCR_ADDR A:0xfc318304
y.create.l HWIO_QDSS_CSTPIU_FSCR_ADDR A:0xfc318308
y.create.l HWIO_QDSS_CSTPIU_EXTCTL_IN_PORT_ADDR A:0xfc318400
y.create.l HWIO_QDSS_CSTPIU_EXTCTL_OUT_PORT_ADDR A:0xfc318404
y.create.l HWIO_QDSS_CSTPIU_ITTRFLINACK_ADDR A:0xfc318ee4
y.create.l HWIO_QDSS_CSTPIU_ITTRFLIN_ADDR A:0xfc318ee8
y.create.l HWIO_QDSS_CSTPIU_ITATBDATA0_ADDR A:0xfc318eec
y.create.l HWIO_QDSS_CSTPIU_ITATBCTR2_ADDR A:0xfc318ef0
y.create.l HWIO_QDSS_CSTPIU_ITATBCTR1_ADDR A:0xfc318ef4
y.create.l HWIO_QDSS_CSTPIU_ITATBCTR0_ADDR A:0xfc318ef8
y.create.l HWIO_QDSS_CSTPIU_ITCTRL_ADDR A:0xfc318f00
y.create.l HWIO_QDSS_CSTPIU_CLAIMSET_ADDR A:0xfc318fa0
y.create.l HWIO_QDSS_CSTPIU_CLAIMCLR_ADDR A:0xfc318fa4
y.create.l HWIO_QDSS_CSTPIU_LAR_ADDR A:0xfc318fb0
y.create.l HWIO_QDSS_CSTPIU_LSR_ADDR A:0xfc318fb4
y.create.l HWIO_QDSS_CSTPIU_AUTHSTATUS_ADDR A:0xfc318fb8
y.create.l HWIO_QDSS_CSTPIU_DEVID_ADDR A:0xfc318fc8
y.create.l HWIO_QDSS_CSTPIU_DEVTYPE_ADDR A:0xfc318fcc
y.create.l HWIO_QDSS_CSTPIU_PERIPHID0_ADDR A:0xfc318fe0
y.create.l HWIO_QDSS_CSTPIU_PERIPHID1_ADDR A:0xfc318fe4
y.create.l HWIO_QDSS_CSTPIU_PERIPHID2_ADDR A:0xfc318fe8
y.create.l HWIO_QDSS_CSTPIU_PERIPHID3_ADDR A:0xfc318fec
y.create.l HWIO_QDSS_CSTPIU_PERIPHID4_ADDR A:0xfc318fd0
y.create.l HWIO_QDSS_CSTPIU_PERIPHID5_ADDR A:0xfc318fd4
y.create.l HWIO_QDSS_CSTPIU_PERIPHID6_ADDR A:0xfc318fd8
y.create.l HWIO_QDSS_CSTPIU_PERIPHID7_ADDR A:0xfc318fdc
y.create.l HWIO_QDSS_CSTPIU_COMPID0_ADDR A:0xfc318ff0
y.create.l HWIO_QDSS_CSTPIU_COMPID1_ADDR A:0xfc318ff4
y.create.l HWIO_QDSS_CSTPIU_COMPID2_ADDR A:0xfc318ff8
y.create.l HWIO_QDSS_CSTPIU_COMPID3_ADDR A:0xfc318ffc
y.create.l HWIO_QDSS_IN_FUN0_CTRL_REG_ADDR A:0xfc319000
y.create.l HWIO_QDSS_IN_FUN0_PRIORITY_CTRL_REG_ADDR A:0xfc319004
y.create.l HWIO_QDSS_IN_FUN0_ITATBDATA0_ADDR A:0xfc319eec
y.create.l HWIO_QDSS_IN_FUN0_ITATBCTR2_ADDR A:0xfc319ef0
y.create.l HWIO_QDSS_IN_FUN0_ITATBCTR1_ADDR A:0xfc319ef4
y.create.l HWIO_QDSS_IN_FUN0_ITATBCTR0_ADDR A:0xfc319ef8
y.create.l HWIO_QDSS_IN_FUN0_ITCTRL_ADDR A:0xfc319f00
y.create.l HWIO_QDSS_IN_FUN0_CLAIMSET_ADDR A:0xfc319fa0
y.create.l HWIO_QDSS_IN_FUN0_CLAIMCLR_ADDR A:0xfc319fa4
y.create.l HWIO_QDSS_IN_FUN0_LOCKACCESS_ADDR A:0xfc319fb0
y.create.l HWIO_QDSS_IN_FUN0_LOCKSTATUS_ADDR A:0xfc319fb4
y.create.l HWIO_QDSS_IN_FUN0_AUTHSTATUS_ADDR A:0xfc319fb8
y.create.l HWIO_QDSS_IN_FUN0_DEVID_ADDR A:0xfc319fc8
y.create.l HWIO_QDSS_IN_FUN0_DEVTYPE_ADDR A:0xfc319fcc
y.create.l HWIO_QDSS_IN_FUN0_PERIPHID0_ADDR A:0xfc319fe0
y.create.l HWIO_QDSS_IN_FUN0_PERIPHID1_ADDR A:0xfc319fe4
y.create.l HWIO_QDSS_IN_FUN0_PERIPHID2_ADDR A:0xfc319fe8
y.create.l HWIO_QDSS_IN_FUN0_PERIPHID3_ADDR A:0xfc319fec
y.create.l HWIO_QDSS_IN_FUN0_PERIPHID4_ADDR A:0xfc319fd0
y.create.l HWIO_QDSS_IN_FUN0_PERIPHID5_ADDR A:0xfc319fd4
y.create.l HWIO_QDSS_IN_FUN0_PERIPHID6_ADDR A:0xfc319fd8
y.create.l HWIO_QDSS_IN_FUN0_PERIPHID7_ADDR A:0xfc319fdc
y.create.l HWIO_QDSS_IN_FUN0_COMPID0_ADDR A:0xfc319ff0
y.create.l HWIO_QDSS_IN_FUN0_COMPID1_ADDR A:0xfc319ff4
y.create.l HWIO_QDSS_IN_FUN0_COMPID2_ADDR A:0xfc319ff8
y.create.l HWIO_QDSS_IN_FUN0_COMPID3_ADDR A:0xfc319ffc
y.create.l HWIO_QDSS_IN_FUN1_CTRL_REG_ADDR A:0xfc31a000
y.create.l HWIO_QDSS_IN_FUN1_PRIORITY_CTRL_REG_ADDR A:0xfc31a004
y.create.l HWIO_QDSS_IN_FUN1_ITATBDATA0_ADDR A:0xfc31aeec
y.create.l HWIO_QDSS_IN_FUN1_ITATBCTR2_ADDR A:0xfc31aef0
y.create.l HWIO_QDSS_IN_FUN1_ITATBCTR1_ADDR A:0xfc31aef4
y.create.l HWIO_QDSS_IN_FUN1_ITATBCTR0_ADDR A:0xfc31aef8
y.create.l HWIO_QDSS_IN_FUN1_ITCTRL_ADDR A:0xfc31af00
y.create.l HWIO_QDSS_IN_FUN1_CLAIMSET_ADDR A:0xfc31afa0
y.create.l HWIO_QDSS_IN_FUN1_CLAIMCLR_ADDR A:0xfc31afa4
y.create.l HWIO_QDSS_IN_FUN1_LOCKACCESS_ADDR A:0xfc31afb0
y.create.l HWIO_QDSS_IN_FUN1_LOCKSTATUS_ADDR A:0xfc31afb4
y.create.l HWIO_QDSS_IN_FUN1_AUTHSTATUS_ADDR A:0xfc31afb8
y.create.l HWIO_QDSS_IN_FUN1_DEVID_ADDR A:0xfc31afc8
y.create.l HWIO_QDSS_IN_FUN1_DEVTYPE_ADDR A:0xfc31afcc
y.create.l HWIO_QDSS_IN_FUN1_PERIPHID0_ADDR A:0xfc31afe0
y.create.l HWIO_QDSS_IN_FUN1_PERIPHID1_ADDR A:0xfc31afe4
y.create.l HWIO_QDSS_IN_FUN1_PERIPHID2_ADDR A:0xfc31afe8
y.create.l HWIO_QDSS_IN_FUN1_PERIPHID3_ADDR A:0xfc31afec
y.create.l HWIO_QDSS_IN_FUN1_PERIPHID4_ADDR A:0xfc31afd0
y.create.l HWIO_QDSS_IN_FUN1_PERIPHID5_ADDR A:0xfc31afd4
y.create.l HWIO_QDSS_IN_FUN1_PERIPHID6_ADDR A:0xfc31afd8
y.create.l HWIO_QDSS_IN_FUN1_PERIPHID7_ADDR A:0xfc31afdc
y.create.l HWIO_QDSS_IN_FUN1_COMPID0_ADDR A:0xfc31aff0
y.create.l HWIO_QDSS_IN_FUN1_COMPID1_ADDR A:0xfc31aff4
y.create.l HWIO_QDSS_IN_FUN1_COMPID2_ADDR A:0xfc31aff8
y.create.l HWIO_QDSS_IN_FUN1_COMPID3_ADDR A:0xfc31affc
y.create.l HWIO_QDSS_MERG_FUN_CTRL_REG_ADDR A:0xfc31b000
y.create.l HWIO_QDSS_MERG_FUN_PRIORITY_CTRL_REG_ADDR A:0xfc31b004
y.create.l HWIO_QDSS_MERG_FUN_ITATBDATA0_ADDR A:0xfc31beec
y.create.l HWIO_QDSS_MERG_FUN_ITATBCTR2_ADDR A:0xfc31bef0
y.create.l HWIO_QDSS_MERG_FUN_ITATBCTR1_ADDR A:0xfc31bef4
y.create.l HWIO_QDSS_MERG_FUN_ITATBCTR0_ADDR A:0xfc31bef8
y.create.l HWIO_QDSS_MERG_FUN_ITCTRL_ADDR A:0xfc31bf00
y.create.l HWIO_QDSS_MERG_FUN_CLAIMSET_ADDR A:0xfc31bfa0
y.create.l HWIO_QDSS_MERG_FUN_CLAIMCLR_ADDR A:0xfc31bfa4
y.create.l HWIO_QDSS_MERG_FUN_LOCKACCESS_ADDR A:0xfc31bfb0
y.create.l HWIO_QDSS_MERG_FUN_LOCKSTATUS_ADDR A:0xfc31bfb4
y.create.l HWIO_QDSS_MERG_FUN_AUTHSTATUS_ADDR A:0xfc31bfb8
y.create.l HWIO_QDSS_MERG_FUN_DEVID_ADDR A:0xfc31bfc8
y.create.l HWIO_QDSS_MERG_FUN_DEVTYPE_ADDR A:0xfc31bfcc
y.create.l HWIO_QDSS_MERG_FUN_PERIPHID0_ADDR A:0xfc31bfe0
y.create.l HWIO_QDSS_MERG_FUN_PERIPHID1_ADDR A:0xfc31bfe4
y.create.l HWIO_QDSS_MERG_FUN_PERIPHID2_ADDR A:0xfc31bfe8
y.create.l HWIO_QDSS_MERG_FUN_PERIPHID3_ADDR A:0xfc31bfec
y.create.l HWIO_QDSS_MERG_FUN_PERIPHID4_ADDR A:0xfc31bfd0
y.create.l HWIO_QDSS_MERG_FUN_PERIPHID5_ADDR A:0xfc31bfd4
y.create.l HWIO_QDSS_MERG_FUN_PERIPHID6_ADDR A:0xfc31bfd8
y.create.l HWIO_QDSS_MERG_FUN_PERIPHID7_ADDR A:0xfc31bfdc
y.create.l HWIO_QDSS_MERG_FUN_COMPID0_ADDR A:0xfc31bff0
y.create.l HWIO_QDSS_MERG_FUN_COMPID1_ADDR A:0xfc31bff4
y.create.l HWIO_QDSS_MERG_FUN_COMPID2_ADDR A:0xfc31bff8
y.create.l HWIO_QDSS_MERG_FUN_COMPID3_ADDR A:0xfc31bffc
y.create.l HWIO_QDSS_REPL64_IDFILTER0_ADDR A:0xfc31c000
y.create.l HWIO_QDSS_REPL64_IDFILTER1_ADDR A:0xfc31c004
y.create.l HWIO_QDSS_REPL64_ITATBCTR0_ADDR A:0xfc31cefc
y.create.l HWIO_QDSS_REPL64_ITATBCTR1_ADDR A:0xfc31cef8
y.create.l HWIO_QDSS_REPL64_ITCTRL_ADDR A:0xfc31cf00
y.create.l HWIO_QDSS_REPL64_CLAIMSET_ADDR A:0xfc31cfa0
y.create.l HWIO_QDSS_REPL64_CLAIMCLR_ADDR A:0xfc31cfa4
y.create.l HWIO_QDSS_REPL64_LAR_ADDR A:0xfc31cfb0
y.create.l HWIO_QDSS_REPL64_LSR_ADDR A:0xfc31cfb4
y.create.l HWIO_QDSS_REPL64_AUTHSTATUS_ADDR A:0xfc31cfb8
y.create.l HWIO_QDSS_REPL64_DEVID_ADDR A:0xfc31cfc8
y.create.l HWIO_QDSS_REPL64_DEVTYPE_ADDR A:0xfc31cfcc
y.create.l HWIO_QDSS_REPL64_PIDR0_ADDR A:0xfc31cfe0
y.create.l HWIO_QDSS_REPL64_PIDR1_ADDR A:0xfc31cfe4
y.create.l HWIO_QDSS_REPL64_PIDR2_ADDR A:0xfc31cfe8
y.create.l HWIO_QDSS_REPL64_PIDR3_ADDR A:0xfc31cfec
y.create.l HWIO_QDSS_REPL64_PIDR4_ADDR A:0xfc31cfd0
y.create.l HWIO_QDSS_REPL64_PIDR5_ADDR A:0xfc31cfd4
y.create.l HWIO_QDSS_REPL64_PIDR6_ADDR A:0xfc31cfd8
y.create.l HWIO_QDSS_REPL64_PIDR7_ADDR A:0xfc31cfdc
y.create.l HWIO_QDSS_REPL64_CIDR0_ADDR A:0xfc31cff0
y.create.l HWIO_QDSS_REPL64_CIDR1_ADDR A:0xfc31cff4
y.create.l HWIO_QDSS_REPL64_CIDR2_ADDR A:0xfc31cff8
y.create.l HWIO_QDSS_REPL64_CIDR3_ADDR A:0xfc31cffc
y.create.l HWIO_QDSS_STMDMASTARTR_ADDR A:0xfc321c04
y.create.l HWIO_QDSS_STMDMASTOPR_ADDR A:0xfc321c08
y.create.l HWIO_QDSS_STMDMASTATR_ADDR A:0xfc321c0c
y.create.l HWIO_QDSS_STMDMACTLR_ADDR A:0xfc321c10
y.create.l HWIO_QDSS_STMDMAIDR_ADDR A:0xfc321cfc
y.create.l HWIO_QDSS_STMHEER_ADDR A:0xfc321d00
y.create.l HWIO_QDSS_STMHETER_ADDR A:0xfc321d20
y.create.l HWIO_QDSS_STMHEMCR_ADDR A:0xfc321d64
y.create.l HWIO_QDSS_STMHEMASTR_ADDR A:0xfc321df4
y.create.l HWIO_QDSS_STMHEFEAT1R_ADDR A:0xfc321df8
y.create.l HWIO_QDSS_STMHEIDR_ADDR A:0xfc321dfc
y.create.l HWIO_QDSS_STMSPER_ADDR A:0xfc321e00
y.create.l HWIO_QDSS_STMSPTER_ADDR A:0xfc321e20
y.create.l HWIO_QDSS_STMSPSCR_ADDR A:0xfc321e60
y.create.l HWIO_QDSS_STMSPMSCR_ADDR A:0xfc321e64
y.create.l HWIO_QDSS_STMSPOVERRIDER_ADDR A:0xfc321e68
y.create.l HWIO_QDSS_STMSPMOVERRIDER_ADDR A:0xfc321e6c
y.create.l HWIO_QDSS_STMSPTRIGCSR_ADDR A:0xfc321e70
y.create.l HWIO_QDSS_STMTCSR_ADDR A:0xfc321e80
y.create.l HWIO_QDSS_STMTSSTIMR_ADDR A:0xfc321e84
y.create.l HWIO_QDSS_STMTSFREQR_ADDR A:0xfc321e8c
y.create.l HWIO_QDSS_STMSYNCR_ADDR A:0xfc321e90
y.create.l HWIO_QDSS_STMAUXCR_ADDR A:0xfc321e94
y.create.l HWIO_QDSS_STMSPFEAT1R_ADDR A:0xfc321ea0
y.create.l HWIO_QDSS_STMSPFEAT2R_ADDR A:0xfc321ea4
y.create.l HWIO_QDSS_STMSPFEAT3R_ADDR A:0xfc321ea8
y.create.l HWIO_QDSS_STMITTRIGGER_ADDR A:0xfc321ee8
y.create.l HWIO_QDSS_STMITATBDATA0_ADDR A:0xfc321eec
y.create.l HWIO_QDSS_STMITATBCTR2_ADDR A:0xfc321ef0
y.create.l HWIO_QDSS_STMITATBID_ADDR A:0xfc321ef4
y.create.l HWIO_QDSS_STMITATBCTR0_ADDR A:0xfc321ef8
y.create.l HWIO_QDSS_STMITCTRL_ADDR A:0xfc321f00
y.create.l HWIO_QDSS_STMCLAIMSET_ADDR A:0xfc321fa0
y.create.l HWIO_QDSS_STMCLAIMCLR_ADDR A:0xfc321fa4
y.create.l HWIO_QDSS_STMLAR_ADDR A:0xfc321fb0
y.create.l HWIO_QDSS_STMLSR_ADDR A:0xfc321fb4
y.create.l HWIO_QDSS_STMAUTHSTATUS_ADDR A:0xfc321fb8
y.create.l HWIO_QDSS_STMDEVID_ADDR A:0xfc321fc8
y.create.l HWIO_QDSS_STMDEVTYPE_ADDR A:0xfc321fcc
y.create.l HWIO_QDSS_STMPIDR0_ADDR A:0xfc321fe0
y.create.l HWIO_QDSS_STMPIDR1_ADDR A:0xfc321fe4
y.create.l HWIO_QDSS_STMPIDR2_ADDR A:0xfc321fe8
y.create.l HWIO_QDSS_STMPIDR3_ADDR A:0xfc321fec
y.create.l HWIO_QDSS_STMPIDR4_ADDR A:0xfc321fd0
y.create.l HWIO_QDSS_STMPIDR5_ADDR A:0xfc321fd4
y.create.l HWIO_QDSS_STMPIDR6_ADDR A:0xfc321fd8
y.create.l HWIO_QDSS_STMPIDR7_ADDR A:0xfc321fdc
y.create.l HWIO_QDSS_STMCIDR0_ADDR A:0xfc321ff0
y.create.l HWIO_QDSS_STMCIDR1_ADDR A:0xfc321ff4
y.create.l HWIO_QDSS_STMCIDR2_ADDR A:0xfc321ff8
y.create.l HWIO_QDSS_STMCIDR3_ADDR A:0xfc321ffc
y.create.l HWIO_QDSS_ETR_RSZ_ADDR A:0xfc322004
y.create.l HWIO_QDSS_ETR_STS_ADDR A:0xfc32200c
y.create.l HWIO_QDSS_ETR_RRD_ADDR A:0xfc322010
y.create.l HWIO_QDSS_ETR_RRP_ADDR A:0xfc322014
y.create.l HWIO_QDSS_ETR_RWP_ADDR A:0xfc322018
y.create.l HWIO_QDSS_ETR_TRG_ADDR A:0xfc32201c
y.create.l HWIO_QDSS_ETR_CTL_ADDR A:0xfc322020
y.create.l HWIO_QDSS_ETR_RWD_ADDR A:0xfc322024
y.create.l HWIO_QDSS_ETR_MODE_ADDR A:0xfc322028
y.create.l HWIO_QDSS_ETR_LBUFLEVEL_ADDR A:0xfc32202c
y.create.l HWIO_QDSS_ETR_CBUFLEVEL_ADDR A:0xfc322030
y.create.l HWIO_QDSS_ETR_BUFWM_ADDR A:0xfc322034
y.create.l HWIO_QDSS_ETR_RRPHI_ADDR A:0xfc322038
y.create.l HWIO_QDSS_ETR_RWPHI_ADDR A:0xfc32203c
y.create.l HWIO_QDSS_ETR_AXICTL_ADDR A:0xfc322110
y.create.l HWIO_QDSS_ETR_DBALO_ADDR A:0xfc322118
y.create.l HWIO_QDSS_ETR_DBAHI_ADDR A:0xfc32211c
y.create.l HWIO_QDSS_ETR_FFSR_ADDR A:0xfc322300
y.create.l HWIO_QDSS_ETR_FFCR_ADDR A:0xfc322304
y.create.l HWIO_QDSS_ETR_PSCR_ADDR A:0xfc322308
y.create.l HWIO_QDSS_ETR_ITMISCOP0_ADDR A:0xfc322ee0
y.create.l HWIO_QDSS_ETR_ITTRFLIN_ADDR A:0xfc322ee8
y.create.l HWIO_QDSS_ETR_ITATBDATA0_ADDR A:0xfc322eec
y.create.l HWIO_QDSS_ETR_ITATBCTR2_ADDR A:0xfc322ef0
y.create.l HWIO_QDSS_ETR_ITATBCTR1_ADDR A:0xfc322ef4
y.create.l HWIO_QDSS_ETR_ITATBCTR0_ADDR A:0xfc322ef8
y.create.l HWIO_QDSS_ETR_ITCTRL_ADDR A:0xfc322f00
y.create.l HWIO_QDSS_ETR_CLAIMSET_ADDR A:0xfc322fa0
y.create.l HWIO_QDSS_ETR_CLAIMCLR_ADDR A:0xfc322fa4
y.create.l HWIO_QDSS_ETR_LAR_ADDR A:0xfc322fb0
y.create.l HWIO_QDSS_ETR_LSR_ADDR A:0xfc322fb4
y.create.l HWIO_QDSS_ETR_AUTHSTATUS_ADDR A:0xfc322fb8
y.create.l HWIO_QDSS_ETR_DEVID_ADDR A:0xfc322fc8
y.create.l HWIO_QDSS_ETR_DEVTYPE_ADDR A:0xfc322fcc
y.create.l HWIO_QDSS_ETR_PERIPHID0_ADDR A:0xfc322fe0
y.create.l HWIO_QDSS_ETR_PERIPHID1_ADDR A:0xfc322fe4
y.create.l HWIO_QDSS_ETR_PERIPHID2_ADDR A:0xfc322fe8
y.create.l HWIO_QDSS_ETR_PERIPHID3_ADDR A:0xfc322fec
y.create.l HWIO_QDSS_ETR_PERIPHID4_ADDR A:0xfc322fd0
y.create.l HWIO_QDSS_ETR_PERIPHID5_ADDR A:0xfc322fd4
y.create.l HWIO_QDSS_ETR_PERIPHID6_ADDR A:0xfc322fd8
y.create.l HWIO_QDSS_ETR_PERIPHID7_ADDR A:0xfc322fdc
y.create.l HWIO_QDSS_ETR_COMPID0_ADDR A:0xfc322ff0
y.create.l HWIO_QDSS_ETR_COMPID1_ADDR A:0xfc322ff4
y.create.l HWIO_QDSS_ETR_COMPID2_ADDR A:0xfc322ff8
y.create.l HWIO_QDSS_ETR_COMPID3_ADDR A:0xfc322ffc
y.create.l HWIO_RBCPR_VERSION_ADDR A:0xfc44f000
y.create.l HWIO_RBCPR_SENSOR_MASK0_ADDR A:0xfc44f020
y.create.l HWIO_RBCPR_SENSOR_MASK1_ADDR A:0xfc44f024
y.create.l HWIO_RBCPR_SENSOR_MASK2_ADDR A:0xfc44f028
y.create.l HWIO_RBCPR_SENSOR_MASK3_ADDR A:0xfc44f02c
y.create.l HWIO_RBCPR_SENSOR_BYPASS0_ADDR A:0xfc44f030
y.create.l HWIO_RBCPR_SENSOR_BYPASS1_ADDR A:0xfc44f034
y.create.l HWIO_RBCPR_SENSOR_BYPASS2_ADDR A:0xfc44f038
y.create.l HWIO_RBCPR_SENSOR_BYPASS3_ADDR A:0xfc44f03c
y.create.l HWIO_RBIF_PMIC_ADDR_ADDR A:0xfc44f040
y.create.l HWIO_RBCPR_TIMER_INTERVAL_ADDR A:0xfc44f044
y.create.l HWIO_RBIF_LIMIT_ADDR A:0xfc44f048
y.create.l HWIO_RBIF_TIMER_ADJUST_ADDR A:0xfc44f04c
y.create.l HWIO_RBCPR_GCNT_TARGET0_ADDR A:0xfc44f060
y.create.l HWIO_RBCPR_GCNT_TARGET1_ADDR A:0xfc44f064
y.create.l HWIO_RBCPR_GCNT_TARGET2_ADDR A:0xfc44f068
y.create.l HWIO_RBCPR_GCNT_TARGET3_ADDR A:0xfc44f06c
y.create.l HWIO_RBCPR_GCNT_TARGET4_ADDR A:0xfc44f070
y.create.l HWIO_RBCPR_GCNT_TARGET5_ADDR A:0xfc44f074
y.create.l HWIO_RBCPR_GCNT_TARGET6_ADDR A:0xfc44f078
y.create.l HWIO_RBCPR_GCNT_TARGET7_ADDR A:0xfc44f07c
y.create.l HWIO_RBCPR_STEP_QUOT_ADDR A:0xfc44f080
y.create.l HWIO_RBCPR_CTL_ADDR A:0xfc44f090
y.create.l HWIO_RBIF_SW_VLEVEL_ADDR A:0xfc44f094
y.create.l HWIO_RBIF_CONT_ACK_CMD_ADDR A:0xfc44f098
y.create.l HWIO_RBIF_CONT_NACK_CMD_ADDR A:0xfc44f09c
y.create.l HWIO_RBCPR_RESULT_0_ADDR A:0xfc44f0a0
y.create.l HWIO_RBCPR_RESULT_1_ADDR A:0xfc44f0a4
y.create.l HWIO_RBIF_IRQ_EN_0_ADDR A:0xfc44f100
y.create.l HWIO_RBIF_IRQ_EN_1_ADDR A:0xfc44f104
y.create.l HWIO_RBIF_IRQ_EN_2_ADDR A:0xfc44f108
y.create.l HWIO_RBIF_IRQ_CLEAR_ADDR A:0xfc44f110
y.create.l HWIO_RBIF_IRQ_STATUS_ADDR A:0xfc44f114
y.create.l HWIO_RBCPR_QUOT_AVG_ADDR A:0xfc44f118
y.create.l HWIO_RBCPR_DEBUG0_ADDR A:0xfc44f11c
y.create.l HWIO_RBCPR_DEBUG1_ADDR A:0xfc44f120
y.create.l HWIO_RBCPR_DEBUG2_ADDR A:0xfc44f124
y.create.l HWIO_RBCPR_BIST_MINMAX_ADDR A:0xfc44f128
y.create.l HWIO_RBCPR_BIST_RESULT_ADDR A:0xfc44f12c
y.create.l HWIO_RBCPR_BIST_FAIL_MAP0_ADDR A:0xfc44f130
y.create.l HWIO_RBCPR_BIST_FAIL_MAP1_ADDR A:0xfc44f134
y.create.l HWIO_RBCPR_BIST_FAIL_MAP2_ADDR A:0xfc44f138
y.create.l HWIO_RBCPR_BIST_FAIL_MAP3_ADDR A:0xfc44f13c
y.create.l HWIO_RBCPR_LOG_0_ADDR A:0xfc44f140
y.create.l HWIO_RBCPR_LOG_1_ADDR A:0xfc44f144
y.create.l HWIO_RBCPR_LOG_2_ADDR A:0xfc44f148
y.create.l HWIO_RBCPR_LOG_3_ADDR A:0xfc44f14c
y.create.l HWIO_RBCPR_LOG_4_ADDR A:0xfc44f150
y.create.l HWIO_RBCPR_LOG_5_ADDR A:0xfc44f154
y.create.l HWIO_RBCPR_LOG_6_ADDR A:0xfc44f158
y.create.l HWIO_RBCPR_LOG_7_ADDR A:0xfc44f15c
y.create.l HWIO_RPM_HW_VERSION_ADDR A:0xfc180000
y.create.l HWIO_RPM_WFI_CONFIG_ADDR A:0xfc180004
y.create.l HWIO_RPM_TIMERS_CLK_OFF_CTL_ADDR A:0xfc180008
y.create.l HWIO_RPM_IPC_ADDR A:0xfc18000c
y.create.l HWIO_RPM_GPO_WDATA_ADDR A:0xfc180010
y.create.l HWIO_RPM_GPO_WDSET_ADDR A:0xfc180014
y.create.l HWIO_RPM_GPO_WDCLR_ADDR A:0xfc180018
y.create.l HWIO_RPM_SLAVES_CLK_GATING_ADDR A:0xfc18001c
y.create.l HWIO_RPM_BOOTROM_REMAP_ADDR_ADDR A:0xfc180020
y.create.l HWIO_RPM_SYSIF_REMAP_ADDR0_ADDR A:0xfc180024
y.create.l HWIO_RPM_SYSIF_REMAP_ADDR1_ADDR A:0xfc180028
y.create.l HWIO_RPM_SYSIF_REMAP_ADDR2_ADDR A:0xfc18002c
y.create.l HWIO_RPM_INTR_POLARITY_0_ADDR A:0xfc180030
y.create.l HWIO_RPM_INTR_POLARITY_1_ADDR A:0xfc180034
y.create.l HWIO_RPM_INTR_EDG_LVL_0_ADDR A:0xfc180038
y.create.l HWIO_RPM_INTR_EDG_LVL_1_ADDR A:0xfc18003c
y.create.l HWIO_RPM_WDOG_RESET_ADDR A:0xfc180040
y.create.l HWIO_RPM_WDOG_CTRL_ADDR A:0xfc180044
y.create.l HWIO_RPM_WDOG_STATUS_ADDR A:0xfc180048
y.create.l HWIO_RPM_WDOG_BARK_TIME_ADDR A:0xfc18004c
y.create.l HWIO_RPM_WDOG_BITE_TIME_ADDR A:0xfc180050
y.create.l HWIO_RPM_WDOG_TEST_LOAD_ADDR A:0xfc180054
y.create.l HWIO_RPM_WDOG_TEST_ADDR A:0xfc180058
y.create.l HWIO_RPM_TEST_BUS_SEL_ADDR A:0xfc18005c
y.create.l HWIO_RPM_QTMR_AC_CNTFRQ_ADDR A:0xfc182000
y.create.l HWIO_RPM_QTMR_AC_CNTSR_ADDR A:0xfc182004
y.create.l HWIO_RPM_QTMR_AC_CNTTID_ADDR A:0xfc182008
y.create.l HWIO_RPM_QTMR_AC_CNTACR_0_ADDR A:0xfc182040
y.create.l HWIO_RPM_QTMR_AC_CNTACR_1_ADDR A:0xfc182044
y.create.l HWIO_RPM_QTMR_AC_CNTVOFF_LO_0_ADDR A:0xfc182080
y.create.l HWIO_RPM_QTMR_AC_CNTVOFF_LO_1_ADDR A:0xfc182088
y.create.l HWIO_RPM_QTMR_AC_CNTVOFF_HI_0_ADDR A:0xfc182084
y.create.l HWIO_RPM_QTMR_AC_CNTVOFF_HI_1_ADDR A:0xfc18208c
y.create.l HWIO_RPM_QTMR_AC_VERSION_ADDR A:0xfc182fd0
y.create.l HWIO_RPM_F0_QTMR_V1_CNTPCT_LO_ADDR A:0xfc183000
y.create.l HWIO_RPM_F0_QTMR_V1_CNTPCT_HI_ADDR A:0xfc183004
y.create.l HWIO_RPM_F0_QTMR_V1_CNTVCT_LO_ADDR A:0xfc183008
y.create.l HWIO_RPM_F0_QTMR_V1_CNTVCT_HI_ADDR A:0xfc18300c
y.create.l HWIO_RPM_F0_QTMR_V1_CNTFRQ_ADDR A:0xfc183010
y.create.l HWIO_RPM_F0_QTMR_V1_CNTPL0ACR_ADDR A:0xfc183014
y.create.l HWIO_RPM_F0_QTMR_V1_CNTVOFF_LO_ADDR A:0xfc183018
y.create.l HWIO_RPM_F0_QTMR_V1_CNTVOFF_HI_ADDR A:0xfc18301c
y.create.l HWIO_RPM_F0_QTMR_V1_CNTP_CVAL_LO_ADDR A:0xfc183020
y.create.l HWIO_RPM_F0_QTMR_V1_CNTP_CVAL_HI_ADDR A:0xfc183024
y.create.l HWIO_RPM_F0_QTMR_V1_CNTP_TVAL_ADDR A:0xfc183028
y.create.l HWIO_RPM_F0_QTMR_V1_CNTP_CTL_ADDR A:0xfc18302c
y.create.l HWIO_RPM_F0_QTMR_V1_CNTV_CVAL_LO_ADDR A:0xfc183030
y.create.l HWIO_RPM_F0_QTMR_V1_CNTV_CVAL_HI_ADDR A:0xfc183034
y.create.l HWIO_RPM_F0_QTMR_V1_CNTV_TVAL_ADDR A:0xfc183038
y.create.l HWIO_RPM_F0_QTMR_V1_CNTV_CTL_ADDR A:0xfc18303c
y.create.l HWIO_RPM_F0_QTMR_V1_VERSION_ADDR A:0xfc183fd0
y.create.l HWIO_RPM_F1_QTMR_V1_CNTPCT_LO_ADDR A:0xfc184000
y.create.l HWIO_RPM_F1_QTMR_V1_CNTPCT_HI_ADDR A:0xfc184004
y.create.l HWIO_RPM_F1_QTMR_V1_CNTVCT_LO_ADDR A:0xfc184008
y.create.l HWIO_RPM_F1_QTMR_V1_CNTVCT_HI_ADDR A:0xfc18400c
y.create.l HWIO_RPM_F1_QTMR_V1_CNTFRQ_ADDR A:0xfc184010
y.create.l HWIO_RPM_F1_QTMR_V1_CNTPL0ACR_ADDR A:0xfc184014
y.create.l HWIO_RPM_F1_QTMR_V1_CNTVOFF_LO_ADDR A:0xfc184018
y.create.l HWIO_RPM_F1_QTMR_V1_CNTVOFF_HI_ADDR A:0xfc18401c
y.create.l HWIO_RPM_F1_QTMR_V1_CNTP_CVAL_LO_ADDR A:0xfc184020
y.create.l HWIO_RPM_F1_QTMR_V1_CNTP_CVAL_HI_ADDR A:0xfc184024
y.create.l HWIO_RPM_F1_QTMR_V1_CNTP_TVAL_ADDR A:0xfc184028
y.create.l HWIO_RPM_F1_QTMR_V1_CNTP_CTL_ADDR A:0xfc18402c
y.create.l HWIO_RPM_F1_QTMR_V1_CNTV_CVAL_LO_ADDR A:0xfc184030
y.create.l HWIO_RPM_F1_QTMR_V1_CNTV_CVAL_HI_ADDR A:0xfc184034
y.create.l HWIO_RPM_F1_QTMR_V1_CNTV_TVAL_ADDR A:0xfc184038
y.create.l HWIO_RPM_F1_QTMR_V1_CNTV_CTL_ADDR A:0xfc18403c
y.create.l HWIO_RPM_F1_QTMR_V1_VERSION_ADDR A:0xfc184fd0
y.create.l HWIO_RPM_MPU_XPU_SCR_ADDR A:0xfc186000
y.create.l HWIO_RPM_MPU_XPU_SWDR_ADDR A:0xfc186004
y.create.l HWIO_RPM_MPU_XPU_PRTN_RACR_SSHADOW_ADDR A:0xfc186008
y.create.l HWIO_RPM_MPU_XPU_PRTN_START_SSHADOW0_ADDR A:0xfc186010
y.create.l HWIO_RPM_MPU_XPU_PRTN_END_SSHADOW0_ADDR A:0xfc186018
y.create.l HWIO_RPM_MPU_XPU_SEAR0_ADDR A:0xfc186040
y.create.l HWIO_RPM_MPU_XPU_SESR_ADDR A:0xfc186048
y.create.l HWIO_RPM_MPU_XPU_SESRRESTORE_ADDR A:0xfc18604c
y.create.l HWIO_RPM_MPU_XPU_SESYNR0_ADDR A:0xfc186050
y.create.l HWIO_RPM_MPU_XPU_SESYNR1_ADDR A:0xfc186054
y.create.l HWIO_RPM_MPU_XPU_SESYNR2_ADDR A:0xfc186058
y.create.l HWIO_RPM_MPU_XPU_MCR_ADDR A:0xfc186100
y.create.l HWIO_RPM_MPU_XPU_MEAR0_ADDR A:0xfc186140
y.create.l HWIO_RPM_MPU_XPU_MESR_ADDR A:0xfc186148
y.create.l HWIO_RPM_MPU_XPU_MESRRESTORE_ADDR A:0xfc18614c
y.create.l HWIO_RPM_MPU_XPU_MESYNR0_ADDR A:0xfc186150
y.create.l HWIO_RPM_MPU_XPU_MESYNR1_ADDR A:0xfc186154
y.create.l HWIO_RPM_MPU_XPU_MESYNR2_ADDR A:0xfc186158
y.create.l HWIO_RPM_MPU_XPU_CR_ADDR A:0xfc186080
y.create.l HWIO_RPM_MPU_XPU_PRTN_RACR_SHADOW_ADDR A:0xfc186088
y.create.l HWIO_RPM_MPU_XPU_PRTN_START_SHADOW0_ADDR A:0xfc186090
y.create.l HWIO_RPM_MPU_XPU_PRTN_END_SHADOW0_ADDR A:0xfc186098
y.create.l HWIO_RPM_MPU_XPU_RPU_ACR0_ADDR A:0xfc1860a0
y.create.l HWIO_RPM_MPU_XPU_EAR0_ADDR A:0xfc1860c0
y.create.l HWIO_RPM_MPU_XPU_ESR_ADDR A:0xfc1860c8
y.create.l HWIO_RPM_MPU_XPU_ESRRESTORE_ADDR A:0xfc1860cc
y.create.l HWIO_RPM_MPU_XPU_ESYNR0_ADDR A:0xfc1860d0
y.create.l HWIO_RPM_MPU_XPU_ESYNR1_ADDR A:0xfc1860d4
y.create.l HWIO_RPM_MPU_XPU_ESYNR2_ADDR A:0xfc1860d8
y.create.l HWIO_RPM_MPU_XPU_UMR_RACR_ADDR A:0xfc1860e0
y.create.l HWIO_RPM_MPU_XPU_UMR_WACR_ADDR A:0xfc1860e4
y.create.l HWIO_RPM_MPU_XPU_IDR0_ADDR A:0xfc186074
y.create.l HWIO_RPM_MPU_XPU_IDR1_ADDR A:0xfc186078
y.create.l HWIO_RPM_MPU_XPU_REV_ADDR A:0xfc18607c
y.create.l HWIO_RPM_MPU_XPU_PRT0_RACR0_ADDR A:0xfc186200
y.create.l HWIO_RPM_MPU_XPU_PRT1_RACR0_ADDR A:0xfc186280
y.create.l HWIO_RPM_MPU_XPU_PRT2_RACR0_ADDR A:0xfc186300
y.create.l HWIO_RPM_MPU_XPU_PRT3_RACR0_ADDR A:0xfc186380
y.create.l HWIO_RPM_MPU_XPU_PRT4_RACR0_ADDR A:0xfc186400
y.create.l HWIO_RPM_MPU_XPU_PRT5_RACR0_ADDR A:0xfc186480
y.create.l HWIO_RPM_MPU_XPU_PRT0_START0_ADDR A:0xfc186240
y.create.l HWIO_RPM_MPU_XPU_PRT1_START0_ADDR A:0xfc1862c0
y.create.l HWIO_RPM_MPU_XPU_PRT2_START0_ADDR A:0xfc186340
y.create.l HWIO_RPM_MPU_XPU_PRT3_START0_ADDR A:0xfc1863c0
y.create.l HWIO_RPM_MPU_XPU_PRT4_START0_ADDR A:0xfc186440
y.create.l HWIO_RPM_MPU_XPU_PRT5_START0_ADDR A:0xfc1864c0
y.create.l HWIO_RPM_MPU_XPU_PRT0_END0_ADDR A:0xfc186248
y.create.l HWIO_RPM_MPU_XPU_PRT1_END0_ADDR A:0xfc1862c8
y.create.l HWIO_RPM_MPU_XPU_PRT2_END0_ADDR A:0xfc186348
y.create.l HWIO_RPM_MPU_XPU_PRT3_END0_ADDR A:0xfc1863c8
y.create.l HWIO_RPM_MPU_XPU_PRT4_END0_ADDR A:0xfc186448
y.create.l HWIO_RPM_MPU_XPU_PRT5_END0_ADDR A:0xfc1864c8
y.create.l HWIO_RPM_MPU_XPU_PRT0_SCR_ADDR A:0xfc186250
y.create.l HWIO_RPM_MPU_XPU_PRT1_SCR_ADDR A:0xfc1862d0
y.create.l HWIO_RPM_MPU_XPU_PRT2_SCR_ADDR A:0xfc186350
y.create.l HWIO_RPM_MPU_XPU_PRT3_SCR_ADDR A:0xfc1863d0
y.create.l HWIO_RPM_MPU_XPU_PRT4_SCR_ADDR A:0xfc186450
y.create.l HWIO_RPM_MPU_XPU_PRT5_SCR_ADDR A:0xfc1864d0
y.create.l HWIO_RPM_MPU_XPU_PRT0_MCR_ADDR A:0xfc186254
y.create.l HWIO_RPM_MPU_XPU_PRT1_MCR_ADDR A:0xfc1862d4
y.create.l HWIO_RPM_MPU_XPU_PRT2_MCR_ADDR A:0xfc186354
y.create.l HWIO_RPM_MPU_XPU_PRT3_MCR_ADDR A:0xfc1863d4
y.create.l HWIO_RPM_MPU_XPU_PRT4_MCR_ADDR A:0xfc186454
y.create.l HWIO_RPM_MPU_XPU_PRT5_MCR_ADDR A:0xfc1864d4
y.create.l HWIO_RPM_MPU_XPU_PRT0_TRANS_COMM_ADDR A:0xfc18625c
y.create.l HWIO_RPM_MPU_XPU_PRT1_TRANS_COMM_ADDR A:0xfc1862dc
y.create.l HWIO_RPM_MPU_XPU_PRT2_TRANS_COMM_ADDR A:0xfc18635c
y.create.l HWIO_RPM_MPU_XPU_PRT3_TRANS_COMM_ADDR A:0xfc1863dc
y.create.l HWIO_RPM_MPU_XPU_PRT4_TRANS_COMM_ADDR A:0xfc18645c
y.create.l HWIO_RPM_MPU_XPU_PRT5_TRANS_COMM_ADDR A:0xfc1864dc
y.create.l HWIO_RPM_APU_XPU_SCR_ADDR A:0xfc187000
y.create.l HWIO_RPM_APU_XPU_SWDR_ADDR A:0xfc187004
y.create.l HWIO_RPM_APU_XPU_SEAR0_ADDR A:0xfc187040
y.create.l HWIO_RPM_APU_XPU_SESR_ADDR A:0xfc187048
y.create.l HWIO_RPM_APU_XPU_SESRRESTORE_ADDR A:0xfc18704c
y.create.l HWIO_RPM_APU_XPU_SESYNR0_ADDR A:0xfc187050
y.create.l HWIO_RPM_APU_XPU_SESYNR1_ADDR A:0xfc187054
y.create.l HWIO_RPM_APU_XPU_SESYNR2_ADDR A:0xfc187058
y.create.l HWIO_RPM_APU_XPU_MCR_ADDR A:0xfc187100
y.create.l HWIO_RPM_APU_XPU_MEAR0_ADDR A:0xfc187140
y.create.l HWIO_RPM_APU_XPU_MESR_ADDR A:0xfc187148
y.create.l HWIO_RPM_APU_XPU_MESRRESTORE_ADDR A:0xfc18714c
y.create.l HWIO_RPM_APU_XPU_MESYNR0_ADDR A:0xfc187150
y.create.l HWIO_RPM_APU_XPU_MESYNR1_ADDR A:0xfc187154
y.create.l HWIO_RPM_APU_XPU_MESYNR2_ADDR A:0xfc187158
y.create.l HWIO_RPM_APU_XPU_CR_ADDR A:0xfc187080
y.create.l HWIO_RPM_APU_XPU_RPU_ACR0_ADDR A:0xfc1870a0
y.create.l HWIO_RPM_APU_XPU_EAR0_ADDR A:0xfc1870c0
y.create.l HWIO_RPM_APU_XPU_ESR_ADDR A:0xfc1870c8
y.create.l HWIO_RPM_APU_XPU_ESRRESTORE_ADDR A:0xfc1870cc
y.create.l HWIO_RPM_APU_XPU_ESYNR0_ADDR A:0xfc1870d0
y.create.l HWIO_RPM_APU_XPU_ESYNR1_ADDR A:0xfc1870d4
y.create.l HWIO_RPM_APU_XPU_ESYNR2_ADDR A:0xfc1870d8
y.create.l HWIO_RPM_APU_XPU_IDR0_ADDR A:0xfc187074
y.create.l HWIO_RPM_APU_XPU_IDR1_ADDR A:0xfc187078
y.create.l HWIO_RPM_APU_XPU_REV_ADDR A:0xfc18707c
y.create.l HWIO_RPM_APU_XPU_RG0_RACR0_ADDR A:0xfc187200
y.create.l HWIO_RPM_APU_XPU_RG0_WACR0_ADDR A:0xfc187220
y.create.l HWIO_RPM_APU_XPU_RG0_SCR_ADDR A:0xfc187250
y.create.l HWIO_RPM_APU_XPU_RG0_MCR_ADDR A:0xfc187254
y.create.l HWIO_RPM_VMIDMT_SCR0_ADDR A:0xfc188000
y.create.l HWIO_RPM_VMIDMT_SCR1_ADDR A:0xfc188004
y.create.l HWIO_RPM_VMIDMT_SCR2_ADDR A:0xfc188008
y.create.l HWIO_RPM_VMIDMT_SACR_ADDR A:0xfc188010
y.create.l HWIO_RPM_VMIDMT_SIDR0_ADDR A:0xfc188020
y.create.l HWIO_RPM_VMIDMT_SIDR1_ADDR A:0xfc188024
y.create.l HWIO_RPM_VMIDMT_SIDR2_ADDR A:0xfc188028
y.create.l HWIO_RPM_VMIDMT_SIDR4_ADDR A:0xfc188030
y.create.l HWIO_RPM_VMIDMT_SIDR5_ADDR A:0xfc188034
y.create.l HWIO_RPM_VMIDMT_SIDR7_ADDR A:0xfc18803c
y.create.l HWIO_RPM_VMIDMT_SGFAR0_ADDR A:0xfc188040
y.create.l HWIO_RPM_VMIDMT_SGFSR_ADDR A:0xfc188048
y.create.l HWIO_RPM_VMIDMT_SGFSRRESTORE_ADDR A:0xfc18804c
y.create.l HWIO_RPM_VMIDMT_SGFSYNDR0_ADDR A:0xfc188050
y.create.l HWIO_RPM_VMIDMT_SGFSYNDR1_ADDR A:0xfc188054
y.create.l HWIO_RPM_VMIDMT_SGFSYNDR2_ADDR A:0xfc188058
y.create.l HWIO_RPM_VMIDMT_VMIDMTSCR0_ADDR A:0xfc188090
y.create.l HWIO_RPM_VMIDMT_CR0_ADDR A:0xfc188000
y.create.l HWIO_RPM_VMIDMT_CR2_ADDR A:0xfc188008
y.create.l HWIO_RPM_VMIDMT_ACR_ADDR A:0xfc188010
y.create.l HWIO_RPM_VMIDMT_IDR0_ADDR A:0xfc188020
y.create.l HWIO_RPM_VMIDMT_IDR1_ADDR A:0xfc188024
y.create.l HWIO_RPM_VMIDMT_IDR2_ADDR A:0xfc188028
y.create.l HWIO_RPM_VMIDMT_IDR4_ADDR A:0xfc188030
y.create.l HWIO_RPM_VMIDMT_IDR5_ADDR A:0xfc188034
y.create.l HWIO_RPM_VMIDMT_IDR7_ADDR A:0xfc18803c
y.create.l HWIO_RPM_VMIDMT_GFAR0_ADDR A:0xfc188040
y.create.l HWIO_RPM_VMIDMT_GFSR_ADDR A:0xfc188048
y.create.l HWIO_RPM_VMIDMT_GFSRRESTORE_ADDR A:0xfc18804c
y.create.l HWIO_RPM_VMIDMT_GFSYNDR0_ADDR A:0xfc188050
y.create.l HWIO_RPM_VMIDMT_GFSYNDR1_ADDR A:0xfc188054
y.create.l HWIO_RPM_VMIDMT_GFSYNDR2_ADDR A:0xfc188058
y.create.l HWIO_RPM_VMIDMT_VMIDMTCR0_ADDR A:0xfc188090
y.create.l HWIO_RPM_VMIDMT_VMIDMTACR_ADDR A:0xfc18809c
y.create.l HWIO_RPM_VMIDMT_NSCR0_ADDR A:0xfc188400
y.create.l HWIO_RPM_VMIDMT_NSCR2_ADDR A:0xfc188408
y.create.l HWIO_RPM_VMIDMT_NSACR_ADDR A:0xfc188410
y.create.l HWIO_RPM_VMIDMT_NSGFAR0_ADDR A:0xfc188440
y.create.l HWIO_RPM_VMIDMT_NSGFSR_ADDR A:0xfc188448
y.create.l HWIO_RPM_VMIDMT_NSGFSRRESTORE_ADDR A:0xfc18844c
y.create.l HWIO_RPM_VMIDMT_NSGFSYNDR0_ADDR A:0xfc188450
y.create.l HWIO_RPM_VMIDMT_NSGFSYNDR1_ADDR A:0xfc188454
y.create.l HWIO_RPM_VMIDMT_NSGFSYNDR2_ADDR A:0xfc188458
y.create.l HWIO_RPM_VMIDMT_NSVMIDMTCR0_ADDR A:0xfc188490
y.create.l HWIO_RPM_VMIDMT_SSDR0_ADDR A:0xfc188080
y.create.l HWIO_RPM_VMIDMT_MSDR0_ADDR A:0xfc188480
y.create.l HWIO_RPM_VMIDMT_MCR_ADDR A:0xfc188494
y.create.l HWIO_RPM_VMIDMT_S2VR0_ADDR A:0xfc188c00
y.create.l HWIO_RPM_VMIDMT_AS2VR0_ADDR A:0xfc188e00
y.create.l HWIO_RPM_MSG_RAM_XPU_SCR_ADDR A:0xfc420000
y.create.l HWIO_RPM_MSG_RAM_XPU_SWDR_ADDR A:0xfc420004
y.create.l HWIO_RPM_MSG_RAM_XPU_SEAR0_ADDR A:0xfc420040
y.create.l HWIO_RPM_MSG_RAM_XPU_SESR_ADDR A:0xfc420048
y.create.l HWIO_RPM_MSG_RAM_XPU_SESRRESTORE_ADDR A:0xfc42004c
y.create.l HWIO_RPM_MSG_RAM_XPU_SESYNR0_ADDR A:0xfc420050
y.create.l HWIO_RPM_MSG_RAM_XPU_SESYNR1_ADDR A:0xfc420054
y.create.l HWIO_RPM_MSG_RAM_XPU_SESYNR2_ADDR A:0xfc420058
y.create.l HWIO_RPM_MSG_RAM_XPU_MCR_ADDR A:0xfc420100
y.create.l HWIO_RPM_MSG_RAM_XPU_MEAR0_ADDR A:0xfc420140
y.create.l HWIO_RPM_MSG_RAM_XPU_MESR_ADDR A:0xfc420148
y.create.l HWIO_RPM_MSG_RAM_XPU_MESRRESTORE_ADDR A:0xfc42014c
y.create.l HWIO_RPM_MSG_RAM_XPU_MESYNR0_ADDR A:0xfc420150
y.create.l HWIO_RPM_MSG_RAM_XPU_MESYNR1_ADDR A:0xfc420154
y.create.l HWIO_RPM_MSG_RAM_XPU_MESYNR2_ADDR A:0xfc420158
y.create.l HWIO_RPM_MSG_RAM_XPU_CR_ADDR A:0xfc420080
y.create.l HWIO_RPM_MSG_RAM_XPU_RPU_ACR0_ADDR A:0xfc4200a0
y.create.l HWIO_RPM_MSG_RAM_XPU_EAR0_ADDR A:0xfc4200c0
y.create.l HWIO_RPM_MSG_RAM_XPU_ESR_ADDR A:0xfc4200c8
y.create.l HWIO_RPM_MSG_RAM_XPU_ESRRESTORE_ADDR A:0xfc4200cc
y.create.l HWIO_RPM_MSG_RAM_XPU_ESYNR0_ADDR A:0xfc4200d0
y.create.l HWIO_RPM_MSG_RAM_XPU_ESYNR1_ADDR A:0xfc4200d4
y.create.l HWIO_RPM_MSG_RAM_XPU_ESYNR2_ADDR A:0xfc4200d8
y.create.l HWIO_RPM_MSG_RAM_XPU_IDR0_ADDR A:0xfc420074
y.create.l HWIO_RPM_MSG_RAM_XPU_IDR1_ADDR A:0xfc420078
y.create.l HWIO_RPM_MSG_RAM_XPU_REV_ADDR A:0xfc42007c
y.create.l HWIO_RPM_MSG_RAM_XPU_RG0_RACR0_ADDR A:0xfc420200
y.create.l HWIO_RPM_MSG_RAM_XPU_RG1_RACR0_ADDR A:0xfc420280
y.create.l HWIO_RPM_MSG_RAM_XPU_RG2_RACR0_ADDR A:0xfc420300
y.create.l HWIO_RPM_MSG_RAM_XPU_RG3_RACR0_ADDR A:0xfc420380
y.create.l HWIO_RPM_MSG_RAM_XPU_RG4_RACR0_ADDR A:0xfc420400
y.create.l HWIO_RPM_MSG_RAM_XPU_RG5_RACR0_ADDR A:0xfc420480
y.create.l HWIO_RPM_MSG_RAM_XPU_RG6_RACR0_ADDR A:0xfc420500
y.create.l HWIO_RPM_MSG_RAM_XPU_RG7_RACR0_ADDR A:0xfc420580
y.create.l HWIO_RPM_MSG_RAM_XPU_RG8_RACR0_ADDR A:0xfc420600
y.create.l HWIO_RPM_MSG_RAM_XPU_RG9_RACR0_ADDR A:0xfc420680
y.create.l HWIO_RPM_MSG_RAM_XPU_RG0_SCR_ADDR A:0xfc420250
y.create.l HWIO_RPM_MSG_RAM_XPU_RG1_SCR_ADDR A:0xfc4202d0
y.create.l HWIO_RPM_MSG_RAM_XPU_RG2_SCR_ADDR A:0xfc420350
y.create.l HWIO_RPM_MSG_RAM_XPU_RG3_SCR_ADDR A:0xfc4203d0
y.create.l HWIO_RPM_MSG_RAM_XPU_RG4_SCR_ADDR A:0xfc420450
y.create.l HWIO_RPM_MSG_RAM_XPU_RG5_SCR_ADDR A:0xfc4204d0
y.create.l HWIO_RPM_MSG_RAM_XPU_RG6_SCR_ADDR A:0xfc420550
y.create.l HWIO_RPM_MSG_RAM_XPU_RG7_SCR_ADDR A:0xfc4205d0
y.create.l HWIO_RPM_MSG_RAM_XPU_RG8_SCR_ADDR A:0xfc420650
y.create.l HWIO_RPM_MSG_RAM_XPU_RG9_SCR_ADDR A:0xfc4206d0
y.create.l HWIO_RPM_MSG_RAM_XPU_RG0_MCR_ADDR A:0xfc420254
y.create.l HWIO_RPM_MSG_RAM_XPU_RG1_MCR_ADDR A:0xfc4202d4
y.create.l HWIO_RPM_MSG_RAM_XPU_RG2_MCR_ADDR A:0xfc420354
y.create.l HWIO_RPM_MSG_RAM_XPU_RG3_MCR_ADDR A:0xfc4203d4
y.create.l HWIO_RPM_MSG_RAM_XPU_RG4_MCR_ADDR A:0xfc420454
y.create.l HWIO_RPM_MSG_RAM_XPU_RG5_MCR_ADDR A:0xfc4204d4
y.create.l HWIO_RPM_MSG_RAM_XPU_RG6_MCR_ADDR A:0xfc420554
y.create.l HWIO_RPM_MSG_RAM_XPU_RG7_MCR_ADDR A:0xfc4205d4
y.create.l HWIO_RPM_MSG_RAM_XPU_RG8_MCR_ADDR A:0xfc420654
y.create.l HWIO_RPM_MSG_RAM_XPU_RG9_MCR_ADDR A:0xfc4206d4
y.create.l HWIO_QFPROM_RAW_ACC_PRIVATE0_ADDR A:0xfc4b8000
y.create.l HWIO_QFPROM_RAW_ACC_PRIVATE1_ADDR A:0xfc4b8004
y.create.l HWIO_QFPROM_RAW_ACC_PRIVATE2_ADDR A:0xfc4b8008
y.create.l HWIO_QFPROM_RAW_ACC_PRIVATE3_ADDR A:0xfc4b800c
y.create.l HWIO_QFPROM_RAW_ACC_PRIVATE4_ADDR A:0xfc4b8010
y.create.l HWIO_QFPROM_RAW_ACC_PRIVATE5_ADDR A:0xfc4b8014
y.create.l HWIO_QFPROM_RAW_ACC_PRIVATE6_ADDR A:0xfc4b8018
y.create.l HWIO_QFPROM_RAW_ACC_PRIVATE7_ADDR A:0xfc4b801c
y.create.l HWIO_QFPROM_RAW_ACC_PRIVATE8_ADDR A:0xfc4b8020
y.create.l HWIO_QFPROM_RAW_ACC_PRIVATE9_ADDR A:0xfc4b8024
y.create.l HWIO_QFPROM_RAW_JTAG_ID_LSB_ADDR A:0xfc4b80a0
y.create.l HWIO_QFPROM_RAW_JTAG_ID_MSB_ADDR A:0xfc4b80a4
y.create.l HWIO_QFPROM_RAW_RD_WR_PERM_LSB_ADDR A:0xfc4b80a8
y.create.l HWIO_QFPROM_RAW_RD_WR_PERM_MSB_ADDR A:0xfc4b80ac
y.create.l HWIO_QFPROM_RAW_PTE_LSB_ADDR A:0xfc4b80b0
y.create.l HWIO_QFPROM_RAW_PTE_MSB_ADDR A:0xfc4b80b4
y.create.l HWIO_QFPROM_RAW_AP_ANTI_ROLLBACK_ROW0_LSB_ADDR A:0xfc4b80b8
y.create.l HWIO_QFPROM_RAW_AP_ANTI_ROLLBACK_ROW0_MSB_ADDR A:0xfc4b80bc
y.create.l HWIO_QFPROM_RAW_AP_ANTI_ROLLBACK_ROW1_LSB_ADDR A:0xfc4b80c0
y.create.l HWIO_QFPROM_RAW_AP_ANTI_ROLLBACK_ROW1_MSB_ADDR A:0xfc4b80c4
y.create.l HWIO_QFPROM_RAW_MSA_ANTI_ROLLBACK_LSB_ADDR A:0xfc4b80c8
y.create.l HWIO_QFPROM_RAW_MSA_ANTI_ROLLBACK_MSB_ADDR A:0xfc4b80cc
y.create.l HWIO_QFPROM_RAW_IMEI_ESN0_LSB_ADDR A:0xfc4b80d0
y.create.l HWIO_QFPROM_RAW_IMEI_ESN0_MSB_ADDR A:0xfc4b80d4
y.create.l HWIO_QFPROM_RAW_IMEI_ESN1_LSB_ADDR A:0xfc4b80d8
y.create.l HWIO_QFPROM_RAW_IMEI_ESN1_MSB_ADDR A:0xfc4b80dc
y.create.l HWIO_QFPROM_RAW_IMEI_ESN2_LSB_ADDR A:0xfc4b80e0
y.create.l HWIO_QFPROM_RAW_IMEI_ESN2_MSB_ADDR A:0xfc4b80e4
y.create.l HWIO_QFPROM_RAW_OEM_CONFIG_ROW0_LSB_ADDR A:0xfc4b80e8
y.create.l HWIO_QFPROM_RAW_OEM_CONFIG_ROW0_MSB_ADDR A:0xfc4b80ec
y.create.l HWIO_QFPROM_RAW_OEM_CONFIG_ROW1_LSB_ADDR A:0xfc4b80f0
y.create.l HWIO_QFPROM_RAW_OEM_CONFIG_ROW1_MSB_ADDR A:0xfc4b80f4
y.create.l HWIO_QFPROM_RAW_FEAT_CONFIG_ROW0_LSB_ADDR A:0xfc4b80f8
y.create.l HWIO_QFPROM_RAW_FEAT_CONFIG_ROW0_MSB_ADDR A:0xfc4b80fc
y.create.l HWIO_QFPROM_RAW_FEAT_CONFIG_ROW1_LSB_ADDR A:0xfc4b8100
y.create.l HWIO_QFPROM_RAW_FEAT_CONFIG_ROW1_MSB_ADDR A:0xfc4b8104
y.create.l HWIO_QFPROM_RAW_FEAT_CONFIG_ROW2_LSB_ADDR A:0xfc4b8108
y.create.l HWIO_QFPROM_RAW_FEAT_CONFIG_ROW2_MSB_ADDR A:0xfc4b810c
y.create.l HWIO_QFPROM_RAW_FEAT_CONFIG_ROW3_LSB_ADDR A:0xfc4b8110
y.create.l HWIO_QFPROM_RAW_FEAT_CONFIG_ROW3_MSB_ADDR A:0xfc4b8114
y.create.l HWIO_QFPROM_RAW_MEM_REDUN0_ADDR A:0xfc4b8118
y.create.l HWIO_QFPROM_RAW_MEM_REDUN1_ADDR A:0xfc4b811c
y.create.l HWIO_QFPROM_RAW_MEM_REDUN2_ADDR A:0xfc4b8120
y.create.l HWIO_QFPROM_RAW_MEM_REDUN3_ADDR A:0xfc4b8124
y.create.l HWIO_QFPROM_RAW_MEM_REDUN4_ADDR A:0xfc4b8128
y.create.l HWIO_QFPROM_RAW_MEM_REDUN5_ADDR A:0xfc4b812c
y.create.l HWIO_QFPROM_RAW_MEM_REDUN6_ADDR A:0xfc4b8130
y.create.l HWIO_QFPROM_RAW_MEM_REDUN7_ADDR A:0xfc4b8134
y.create.l HWIO_QFPROM_RAW_MEM_REDUN8_ADDR A:0xfc4b8138
y.create.l HWIO_QFPROM_RAW_MEM_REDUN9_ADDR A:0xfc4b813c
y.create.l HWIO_QFPROM_RAW_DEBUG_KEY_LSB_ADDR A:0xfc4b81a8
y.create.l HWIO_QFPROM_RAW_DEBUG_KEY_MSB_ADDR A:0xfc4b81ac
y.create.l HWIO_QFPROM_RAW_MEM_ACCEL_ROW0_LSB_ADDR A:0xfc4b81b0
y.create.l HWIO_QFPROM_RAW_MEM_ACCEL_ROW0_MSB_ADDR A:0xfc4b81b4
y.create.l HWIO_QFPROM_RAW_MEM_ACCEL_ROW1_LSB_ADDR A:0xfc4b81b8
y.create.l HWIO_QFPROM_RAW_MEM_ACCEL_ROW1_MSB_ADDR A:0xfc4b81bc
y.create.l HWIO_QFPROM_RAW_CALIB_ROW0_LSB_ADDR A:0xfc4b81c0
y.create.l HWIO_QFPROM_RAW_CALIB_ROW0_MSB_ADDR A:0xfc4b81c4
y.create.l HWIO_QFPROM_RAW_CALIB_ROW1_LSB_ADDR A:0xfc4b81c8
y.create.l HWIO_QFPROM_RAW_CALIB_ROW1_MSB_ADDR A:0xfc4b81cc
y.create.l HWIO_QFPROM_RAW_FEC_EN_LSB_ADDR A:0xfc4b81d0
y.create.l HWIO_QFPROM_RAW_FEC_EN_MSB_ADDR A:0xfc4b81d4
y.create.l HWIO_QFPROM_RAW_INTAGLIO_GLUEBIT_LSB_ADDR A:0xfc4b81d8
y.create.l HWIO_QFPROM_RAW_INTAGLIO_GLUEBIT_MSB_ADDR A:0xfc4b81dc
y.create.l HWIO_QFPROM_RAW_CUST_KEY_ROW0_LSB_ADDR A:0xfc4b81e0
y.create.l HWIO_QFPROM_RAW_CUST_KEY_ROW1_LSB_ADDR A:0xfc4b81e8
y.create.l HWIO_QFPROM_RAW_CUST_KEY_ROW0_MSB_ADDR A:0xfc4b81e4
y.create.l HWIO_QFPROM_RAW_CUST_KEY_ROW1_MSB_ADDR A:0xfc4b81ec
y.create.l HWIO_QFPROM_RAW_SERIAL_NUM_LSB_ADDR A:0xfc4b81f0
y.create.l HWIO_QFPROM_RAW_SERIAL_NUM_MSB_ADDR A:0xfc4b81f4
y.create.l HWIO_QFPROM_RAW_SPARE_REG19_LSB_ADDR A:0xfc4b81f8
y.create.l HWIO_QFPROM_RAW_SPARE_REG19_MSB_ADDR A:0xfc4b81fc
y.create.l HWIO_QFPROM_RAW_ROM_PATCH_ROW0_LSB_ADDR A:0xfc4b8200
y.create.l HWIO_QFPROM_RAW_ROM_PATCH_ROW1_LSB_ADDR A:0xfc4b8208
y.create.l HWIO_QFPROM_RAW_ROM_PATCH_ROW2_LSB_ADDR A:0xfc4b8210
y.create.l HWIO_QFPROM_RAW_ROM_PATCH_ROW3_LSB_ADDR A:0xfc4b8218
y.create.l HWIO_QFPROM_RAW_ROM_PATCH_ROW4_LSB_ADDR A:0xfc4b8220
y.create.l HWIO_QFPROM_RAW_ROM_PATCH_ROW5_LSB_ADDR A:0xfc4b8228
y.create.l HWIO_QFPROM_RAW_ROM_PATCH_ROW6_LSB_ADDR A:0xfc4b8230
y.create.l HWIO_QFPROM_RAW_ROM_PATCH_ROW7_LSB_ADDR A:0xfc4b8238
y.create.l HWIO_QFPROM_RAW_ROM_PATCH_ROW8_LSB_ADDR A:0xfc4b8240
y.create.l HWIO_QFPROM_RAW_ROM_PATCH_ROW9_LSB_ADDR A:0xfc4b8248
y.create.l HWIO_QFPROM_RAW_ROM_PATCH_ROW0_MSB_ADDR A:0xfc4b8204
y.create.l HWIO_QFPROM_RAW_ROM_PATCH_ROW1_MSB_ADDR A:0xfc4b820c
y.create.l HWIO_QFPROM_RAW_ROM_PATCH_ROW2_MSB_ADDR A:0xfc4b8214
y.create.l HWIO_QFPROM_RAW_ROM_PATCH_ROW3_MSB_ADDR A:0xfc4b821c
y.create.l HWIO_QFPROM_RAW_ROM_PATCH_ROW4_MSB_ADDR A:0xfc4b8224
y.create.l HWIO_QFPROM_RAW_ROM_PATCH_ROW5_MSB_ADDR A:0xfc4b822c
y.create.l HWIO_QFPROM_RAW_ROM_PATCH_ROW6_MSB_ADDR A:0xfc4b8234
y.create.l HWIO_QFPROM_RAW_ROM_PATCH_ROW7_MSB_ADDR A:0xfc4b823c
y.create.l HWIO_QFPROM_RAW_ROM_PATCH_ROW8_MSB_ADDR A:0xfc4b8244
y.create.l HWIO_QFPROM_RAW_ROM_PATCH_ROW9_MSB_ADDR A:0xfc4b824c
y.create.l HWIO_QFPROM_RAW_PRI_KEY_DERIVATION_KEY_ROW0_LSB_ADDR A:0xfc4b8380
y.create.l HWIO_QFPROM_RAW_PRI_KEY_DERIVATION_KEY_ROW1_LSB_ADDR A:0xfc4b8388
y.create.l HWIO_QFPROM_RAW_PRI_KEY_DERIVATION_KEY_ROW2_LSB_ADDR A:0xfc4b8390
y.create.l HWIO_QFPROM_RAW_PRI_KEY_DERIVATION_KEY_ROW3_LSB_ADDR A:0xfc4b8398
y.create.l HWIO_QFPROM_RAW_PRI_KEY_DERIVATION_KEY_ROW0_MSB_ADDR A:0xfc4b8384
y.create.l HWIO_QFPROM_RAW_PRI_KEY_DERIVATION_KEY_ROW1_MSB_ADDR A:0xfc4b838c
y.create.l HWIO_QFPROM_RAW_PRI_KEY_DERIVATION_KEY_ROW2_MSB_ADDR A:0xfc4b8394
y.create.l HWIO_QFPROM_RAW_PRI_KEY_DERIVATION_KEY_ROW3_MSB_ADDR A:0xfc4b839c
y.create.l HWIO_QFPROM_RAW_PRI_KEY_DERIVATION_KEY_ROW4_LSB_ADDR A:0xfc4b83a0
y.create.l HWIO_QFPROM_RAW_PRI_KEY_DERIVATION_KEY_ROW4_MSB_ADDR A:0xfc4b83a4
y.create.l HWIO_QFPROM_RAW_SEC_KEY_DERIVATION_KEY_ROW0_LSB_ADDR A:0xfc4b83a8
y.create.l HWIO_QFPROM_RAW_SEC_KEY_DERIVATION_KEY_ROW1_LSB_ADDR A:0xfc4b83b0
y.create.l HWIO_QFPROM_RAW_SEC_KEY_DERIVATION_KEY_ROW2_LSB_ADDR A:0xfc4b83b8
y.create.l HWIO_QFPROM_RAW_SEC_KEY_DERIVATION_KEY_ROW3_LSB_ADDR A:0xfc4b83c0
y.create.l HWIO_QFPROM_RAW_SEC_KEY_DERIVATION_KEY_ROW0_MSB_ADDR A:0xfc4b83ac
y.create.l HWIO_QFPROM_RAW_SEC_KEY_DERIVATION_KEY_ROW1_MSB_ADDR A:0xfc4b83b4
y.create.l HWIO_QFPROM_RAW_SEC_KEY_DERIVATION_KEY_ROW2_MSB_ADDR A:0xfc4b83bc
y.create.l HWIO_QFPROM_RAW_SEC_KEY_DERIVATION_KEY_ROW3_MSB_ADDR A:0xfc4b83c4
y.create.l HWIO_QFPROM_RAW_SEC_KEY_DERIVATION_KEY_ROW4_LSB_ADDR A:0xfc4b83c8
y.create.l HWIO_QFPROM_RAW_SEC_KEY_DERIVATION_KEY_ROW4_MSB_ADDR A:0xfc4b83cc
y.create.l HWIO_QFPROM_RAW_OEM_PK_HASH_ROW0_LSB_ADDR A:0xfc4b83d0
y.create.l HWIO_QFPROM_RAW_OEM_PK_HASH_ROW1_LSB_ADDR A:0xfc4b83d8
y.create.l HWIO_QFPROM_RAW_OEM_PK_HASH_ROW2_LSB_ADDR A:0xfc4b83e0
y.create.l HWIO_QFPROM_RAW_OEM_PK_HASH_ROW3_LSB_ADDR A:0xfc4b83e8
y.create.l HWIO_QFPROM_RAW_OEM_PK_HASH_ROW0_MSB_ADDR A:0xfc4b83d4
y.create.l HWIO_QFPROM_RAW_OEM_PK_HASH_ROW1_MSB_ADDR A:0xfc4b83dc
y.create.l HWIO_QFPROM_RAW_OEM_PK_HASH_ROW2_MSB_ADDR A:0xfc4b83e4
y.create.l HWIO_QFPROM_RAW_OEM_PK_HASH_ROW3_MSB_ADDR A:0xfc4b83ec
y.create.l HWIO_QFPROM_RAW_OEM_PK_HASH_ROW4_LSB_ADDR A:0xfc4b83f0
y.create.l HWIO_QFPROM_RAW_OEM_PK_HASH_ROW4_MSB_ADDR A:0xfc4b83f4
y.create.l HWIO_QFPROM_RAW_OEM_SEC_BOOT_ROW0_LSB_ADDR A:0xfc4b83f8
y.create.l HWIO_QFPROM_RAW_OEM_SEC_BOOT_ROW1_LSB_ADDR A:0xfc4b8400
y.create.l HWIO_QFPROM_RAW_OEM_SEC_BOOT_ROW2_LSB_ADDR A:0xfc4b8408
y.create.l HWIO_QFPROM_RAW_OEM_SEC_BOOT_ROW3_LSB_ADDR A:0xfc4b8410
y.create.l HWIO_QFPROM_RAW_OEM_SEC_BOOT_ROW0_MSB_ADDR A:0xfc4b83fc
y.create.l HWIO_QFPROM_RAW_OEM_SEC_BOOT_ROW1_MSB_ADDR A:0xfc4b8404
y.create.l HWIO_QFPROM_RAW_OEM_SEC_BOOT_ROW2_MSB_ADDR A:0xfc4b840c
y.create.l HWIO_QFPROM_RAW_OEM_SEC_BOOT_ROW3_MSB_ADDR A:0xfc4b8414
y.create.l HWIO_QFPROM_RAW_QC_SEC_BOOT_ROW0_LSB_ADDR A:0xfc4b8418
y.create.l HWIO_QFPROM_RAW_QC_SEC_BOOT_ROW1_LSB_ADDR A:0xfc4b8420
y.create.l HWIO_QFPROM_RAW_QC_SEC_BOOT_ROW2_LSB_ADDR A:0xfc4b8428
y.create.l HWIO_QFPROM_RAW_QC_SEC_BOOT_ROW3_LSB_ADDR A:0xfc4b8430
y.create.l HWIO_QFPROM_RAW_QC_SEC_BOOT_ROW0_MSB_ADDR A:0xfc4b841c
y.create.l HWIO_QFPROM_RAW_QC_SEC_BOOT_ROW1_MSB_ADDR A:0xfc4b8424
y.create.l HWIO_QFPROM_RAW_QC_SEC_BOOT_ROW2_MSB_ADDR A:0xfc4b842c
y.create.l HWIO_QFPROM_RAW_QC_SEC_BOOT_ROW3_MSB_ADDR A:0xfc4b8434
y.create.l HWIO_QFPROM_RAW_USB_VID_PID_LSB_ADDR A:0xfc4b8438
y.create.l HWIO_QFPROM_RAW_USB_VID_PID_MSB_ADDR A:0xfc4b843c
y.create.l HWIO_QFPROM_RAW_SPARE_REG27_ROW0_LSB_ADDR A:0xfc4b8440
y.create.l HWIO_QFPROM_RAW_SPARE_REG27_ROW0_MSB_ADDR A:0xfc4b8444
y.create.l HWIO_QFPROM_RAW_SPARE_REG27_ROW1_LSB_ADDR A:0xfc4b8448
y.create.l HWIO_QFPROM_RAW_SPARE_REG27_ROW1_MSB_ADDR A:0xfc4b844c
y.create.l HWIO_QFPROM_RAW_SPARE_REG28_ROW0_LSB_ADDR A:0xfc4b8450
y.create.l HWIO_QFPROM_RAW_SPARE_REG28_ROW0_MSB_ADDR A:0xfc4b8454
y.create.l HWIO_QFPROM_RAW_SPARE_REG28_ROW1_LSB_ADDR A:0xfc4b8458
y.create.l HWIO_QFPROM_RAW_SPARE_REG28_ROW1_MSB_ADDR A:0xfc4b845c
y.create.l HWIO_QFPROM_RAW_SPARE_REG28_ROW2_LSB_ADDR A:0xfc4b8460
y.create.l HWIO_QFPROM_RAW_SPARE_REG28_ROW2_MSB_ADDR A:0xfc4b8464
y.create.l HWIO_QFPROM_RAW_HDCP_KSV_LSB_ADDR A:0xfc4b8468
y.create.l HWIO_QFPROM_RAW_HDCP_KSV_MSB_ADDR A:0xfc4b846c
y.create.l HWIO_QFPROM_RAW_HDCP_KEY_ROW1_LSB_ADDR A:0xfc4b8470
y.create.l HWIO_QFPROM_RAW_HDCP_KEY_ROW2_LSB_ADDR A:0xfc4b8478
y.create.l HWIO_QFPROM_RAW_HDCP_KEY_ROW3_LSB_ADDR A:0xfc4b8480
y.create.l HWIO_QFPROM_RAW_HDCP_KEY_ROW4_LSB_ADDR A:0xfc4b8488
y.create.l HWIO_QFPROM_RAW_HDCP_KEY_ROW5_LSB_ADDR A:0xfc4b8490
y.create.l HWIO_QFPROM_RAW_HDCP_KEY_ROW6_LSB_ADDR A:0xfc4b8498
y.create.l HWIO_QFPROM_RAW_HDCP_KEY_ROW7_LSB_ADDR A:0xfc4b84a0
y.create.l HWIO_QFPROM_RAW_HDCP_KEY_ROW8_LSB_ADDR A:0xfc4b84a8
y.create.l HWIO_QFPROM_RAW_HDCP_KEY_ROW9_LSB_ADDR A:0xfc4b84b0
y.create.l HWIO_QFPROM_RAW_HDCP_KEY_ROW10_LSB_ADDR A:0xfc4b84b8
y.create.l HWIO_QFPROM_RAW_HDCP_KEY_ROW1_MSB_ADDR A:0xfc4b8474
y.create.l HWIO_QFPROM_RAW_HDCP_KEY_ROW2_MSB_ADDR A:0xfc4b847c
y.create.l HWIO_QFPROM_RAW_HDCP_KEY_ROW3_MSB_ADDR A:0xfc4b8484
y.create.l HWIO_QFPROM_RAW_HDCP_KEY_ROW4_MSB_ADDR A:0xfc4b848c
y.create.l HWIO_QFPROM_RAW_HDCP_KEY_ROW5_MSB_ADDR A:0xfc4b8494
y.create.l HWIO_QFPROM_RAW_HDCP_KEY_ROW6_MSB_ADDR A:0xfc4b849c
y.create.l HWIO_QFPROM_RAW_HDCP_KEY_ROW7_MSB_ADDR A:0xfc4b84a4
y.create.l HWIO_QFPROM_RAW_HDCP_KEY_ROW8_MSB_ADDR A:0xfc4b84ac
y.create.l HWIO_QFPROM_RAW_HDCP_KEY_ROW9_MSB_ADDR A:0xfc4b84b4
y.create.l HWIO_QFPROM_RAW_HDCP_KEY_ROW10_MSB_ADDR A:0xfc4b84bc
y.create.l HWIO_QFPROM_RAW_CUST_PRIV_KEY0_ROW0_LSB_ADDR A:0xfc4b85b0
y.create.l HWIO_QFPROM_RAW_CUST_PRIV_KEY0_ROW1_LSB_ADDR A:0xfc4b85b8
y.create.l HWIO_QFPROM_RAW_CUST_PRIV_KEY0_ROW2_LSB_ADDR A:0xfc4b85c0
y.create.l HWIO_QFPROM_RAW_CUST_PRIV_KEY0_ROW3_LSB_ADDR A:0xfc4b85c8
y.create.l HWIO_QFPROM_RAW_CUST_PRIV_KEY0_ROW4_LSB_ADDR A:0xfc4b85d0
y.create.l HWIO_QFPROM_RAW_CUST_PRIV_KEY0_ROW5_LSB_ADDR A:0xfc4b85d8
y.create.l HWIO_QFPROM_RAW_CUST_PRIV_KEY0_ROW6_LSB_ADDR A:0xfc4b85e0
y.create.l HWIO_QFPROM_RAW_CUST_PRIV_KEY0_ROW7_LSB_ADDR A:0xfc4b85e8
y.create.l HWIO_QFPROM_RAW_CUST_PRIV_KEY0_ROW8_LSB_ADDR A:0xfc4b85f0
y.create.l HWIO_QFPROM_RAW_CUST_PRIV_KEY0_ROW9_LSB_ADDR A:0xfc4b85f8
y.create.l HWIO_QFPROM_RAW_CUST_PRIV_KEY0_ROW0_MSB_ADDR A:0xfc4b85b4
y.create.l HWIO_QFPROM_RAW_CUST_PRIV_KEY0_ROW1_MSB_ADDR A:0xfc4b85bc
y.create.l HWIO_QFPROM_RAW_CUST_PRIV_KEY0_ROW2_MSB_ADDR A:0xfc4b85c4
y.create.l HWIO_QFPROM_RAW_CUST_PRIV_KEY0_ROW3_MSB_ADDR A:0xfc4b85cc
y.create.l HWIO_QFPROM_RAW_CUST_PRIV_KEY0_ROW4_MSB_ADDR A:0xfc4b85d4
y.create.l HWIO_QFPROM_RAW_CUST_PRIV_KEY0_ROW5_MSB_ADDR A:0xfc4b85dc
y.create.l HWIO_QFPROM_RAW_CUST_PRIV_KEY0_ROW6_MSB_ADDR A:0xfc4b85e4
y.create.l HWIO_QFPROM_RAW_CUST_PRIV_KEY0_ROW7_MSB_ADDR A:0xfc4b85ec
y.create.l HWIO_QFPROM_RAW_CUST_PRIV_KEY0_ROW8_MSB_ADDR A:0xfc4b85f4
y.create.l HWIO_QFPROM_RAW_CUST_PRIV_KEY0_ROW9_MSB_ADDR A:0xfc4b85fc
y.create.l HWIO_QFPROM_RAW_CUST_PRIV_KEY1_ROW0_LSB_ADDR A:0xfc4b86d8
y.create.l HWIO_QFPROM_RAW_CUST_PRIV_KEY1_ROW1_LSB_ADDR A:0xfc4b86e0
y.create.l HWIO_QFPROM_RAW_CUST_PRIV_KEY1_ROW2_LSB_ADDR A:0xfc4b86e8
y.create.l HWIO_QFPROM_RAW_CUST_PRIV_KEY1_ROW3_LSB_ADDR A:0xfc4b86f0
y.create.l HWIO_QFPROM_RAW_CUST_PRIV_KEY1_ROW4_LSB_ADDR A:0xfc4b86f8
y.create.l HWIO_QFPROM_RAW_CUST_PRIV_KEY1_ROW5_LSB_ADDR A:0xfc4b8700
y.create.l HWIO_QFPROM_RAW_CUST_PRIV_KEY1_ROW6_LSB_ADDR A:0xfc4b8708
y.create.l HWIO_QFPROM_RAW_CUST_PRIV_KEY1_ROW7_LSB_ADDR A:0xfc4b8710
y.create.l HWIO_QFPROM_RAW_CUST_PRIV_KEY1_ROW8_LSB_ADDR A:0xfc4b8718
y.create.l HWIO_QFPROM_RAW_CUST_PRIV_KEY1_ROW9_LSB_ADDR A:0xfc4b8720
y.create.l HWIO_QFPROM_RAW_CUST_PRIV_KEY1_ROW0_MSB_ADDR A:0xfc4b86dc
y.create.l HWIO_QFPROM_RAW_CUST_PRIV_KEY1_ROW1_MSB_ADDR A:0xfc4b86e4
y.create.l HWIO_QFPROM_RAW_CUST_PRIV_KEY1_ROW2_MSB_ADDR A:0xfc4b86ec
y.create.l HWIO_QFPROM_RAW_CUST_PRIV_KEY1_ROW3_MSB_ADDR A:0xfc4b86f4
y.create.l HWIO_QFPROM_RAW_CUST_PRIV_KEY1_ROW4_MSB_ADDR A:0xfc4b86fc
y.create.l HWIO_QFPROM_RAW_CUST_PRIV_KEY1_ROW5_MSB_ADDR A:0xfc4b8704
y.create.l HWIO_QFPROM_RAW_CUST_PRIV_KEY1_ROW6_MSB_ADDR A:0xfc4b870c
y.create.l HWIO_QFPROM_RAW_CUST_PRIV_KEY1_ROW7_MSB_ADDR A:0xfc4b8714
y.create.l HWIO_QFPROM_RAW_CUST_PRIV_KEY1_ROW8_MSB_ADDR A:0xfc4b871c
y.create.l HWIO_QFPROM_RAW_CUST_PRIV_KEY1_ROW9_MSB_ADDR A:0xfc4b8724
y.create.l HWIO_ACC_IR_ADDR A:0xfc4ba000
y.create.l HWIO_ACC_DR_ADDR A:0xfc4ba004
y.create.l HWIO_ACC_VERID_ADDR A:0xfc4ba008
y.create.l HWIO_ACC_FEATSET0_ADDR A:0xfc4ba010
y.create.l HWIO_ACC_FEATSET1_ADDR A:0xfc4ba014
y.create.l HWIO_ACC_FEATSET2_ADDR A:0xfc4ba018
y.create.l HWIO_ACC_FEATSET3_ADDR A:0xfc4ba01c
y.create.l HWIO_ACC_FEATSET4_ADDR A:0xfc4ba020
y.create.l HWIO_ACC_FEATSET5_ADDR A:0xfc4ba024
y.create.l HWIO_ACC_FEATSET6_ADDR A:0xfc4ba028
y.create.l HWIO_ACC_FEATSET7_ADDR A:0xfc4ba02c
y.create.l HWIO_QFPROM_BLOW_TIMER_ADDR A:0xfc4ba038
y.create.l HWIO_QFPROM_TEST_CTRL_ADDR A:0xfc4ba03c
y.create.l HWIO_QFPROM_ACCEL_ADDR A:0xfc4ba040
y.create.l HWIO_ACC_STATE_ADDR A:0xfc4ba044
y.create.l HWIO_QFPROM_BLOW_STATUS_ADDR A:0xfc4ba048
y.create.l HWIO_HW_KEY_STATUS_ADDR A:0xfc4ba04c
y.create.l HWIO_QFPROM_BIST_CTRL_ADDR A:0xfc4ba050
y.create.l HWIO_QFPROM_BIST_ERROR_ADDR A:0xfc4ba054
y.create.l HWIO_QFPROM_HASH_SIGNATURE0_ADDR A:0xfc4ba060
y.create.l HWIO_QFPROM_HASH_SIGNATURE1_ADDR A:0xfc4ba064
y.create.l HWIO_QFPROM_HASH_SIGNATURE2_ADDR A:0xfc4ba068
y.create.l HWIO_QFPROM_HASH_SIGNATURE3_ADDR A:0xfc4ba06c
y.create.l HWIO_QFPROM_HASH_SIGNATURE4_ADDR A:0xfc4ba070
y.create.l HWIO_QFPROM_HASH_SIGNATURE5_ADDR A:0xfc4ba074
y.create.l HWIO_QFPROM_HASH_SIGNATURE6_ADDR A:0xfc4ba078
y.create.l HWIO_QFPROM_HASH_SIGNATURE7_ADDR A:0xfc4ba07c
y.create.l HWIO_FEC_ESR_ADDR A:0xfc4ba080
y.create.l HWIO_FEC_EAR_ADDR A:0xfc4ba084
y.create.l HWIO_RESET_JDR_STATUS_ADDR A:0xfc4ba088
y.create.l HWIO_QFPROM_ROM_ERROR_ADDR A:0xfc4ba090
y.create.l HWIO_QFPROM_CORR_ACC_PRIVATE0_ADDR A:0xfc4bc000
y.create.l HWIO_QFPROM_CORR_ACC_PRIVATE1_ADDR A:0xfc4bc004
y.create.l HWIO_QFPROM_CORR_ACC_PRIVATE2_ADDR A:0xfc4bc008
y.create.l HWIO_QFPROM_CORR_ACC_PRIVATE3_ADDR A:0xfc4bc00c
y.create.l HWIO_QFPROM_CORR_ACC_PRIVATE4_ADDR A:0xfc4bc010
y.create.l HWIO_QFPROM_CORR_ACC_PRIVATE5_ADDR A:0xfc4bc014
y.create.l HWIO_QFPROM_CORR_ACC_PRIVATE6_ADDR A:0xfc4bc018
y.create.l HWIO_QFPROM_CORR_ACC_PRIVATE7_ADDR A:0xfc4bc01c
y.create.l HWIO_QFPROM_CORR_ACC_PRIVATE8_ADDR A:0xfc4bc020
y.create.l HWIO_QFPROM_CORR_ACC_PRIVATE9_ADDR A:0xfc4bc024
y.create.l HWIO_QFPROM_CORR_JTAG_ID_LSB_ADDR A:0xfc4bc0a0
y.create.l HWIO_QFPROM_CORR_JTAG_ID_MSB_ADDR A:0xfc4bc0a4
y.create.l HWIO_QFPROM_CORR_RD_WR_PERM_LSB_ADDR A:0xfc4bc0a8
y.create.l HWIO_QFPROM_CORR_RD_WR_PERM_MSB_ADDR A:0xfc4bc0ac
y.create.l HWIO_QFPROM_CORR_PTE_LSB_ADDR A:0xfc4bc0b0
y.create.l HWIO_QFPROM_CORR_PTE_MSB_ADDR A:0xfc4bc0b4
y.create.l HWIO_QFPROM_CORR_AP_ANTI_ROLLBACK_ROW0_LSB_ADDR A:0xfc4bc0b8
y.create.l HWIO_QFPROM_CORR_AP_ANTI_ROLLBACK_ROW0_MSB_ADDR A:0xfc4bc0bc
y.create.l HWIO_QFPROM_CORR_AP_ANTI_ROLLBACK_ROW1_LSB_ADDR A:0xfc4bc0c0
y.create.l HWIO_QFPROM_CORR_AP_ANTI_ROLLBACK_ROW1_MSB_ADDR A:0xfc4bc0c4
y.create.l HWIO_QFPROM_CORR_MSA_ANTI_ROLLBACK_LSB_ADDR A:0xfc4bc0c8
y.create.l HWIO_QFPROM_CORR_MSA_ANTI_ROLLBACK_MSB_ADDR A:0xfc4bc0cc
y.create.l HWIO_QFPROM_CORR_IMEI_ESN0_LSB_ADDR A:0xfc4bc0d0
y.create.l HWIO_QFPROM_CORR_IMEI_ESN0_MSB_ADDR A:0xfc4bc0d4
y.create.l HWIO_QFPROM_CORR_IMEI_ESN1_LSB_ADDR A:0xfc4bc0d8
y.create.l HWIO_QFPROM_CORR_IMEI_ESN1_MSB_ADDR A:0xfc4bc0dc
y.create.l HWIO_QFPROM_CORR_IMEI_ESN2_LSB_ADDR A:0xfc4bc0e0
y.create.l HWIO_QFPROM_CORR_IMEI_ESN2_MSB_ADDR A:0xfc4bc0e4
y.create.l HWIO_QFPROM_CORR_OEM_CONFIG_ROW0_LSB_ADDR A:0xfc4bc0e8
y.create.l HWIO_QFPROM_CORR_OEM_CONFIG_ROW0_MSB_ADDR A:0xfc4bc0ec
y.create.l HWIO_QFPROM_CORR_OEM_CONFIG_ROW1_LSB_ADDR A:0xfc4bc0f0
y.create.l HWIO_QFPROM_CORR_OEM_CONFIG_ROW1_MSB_ADDR A:0xfc4bc0f4
y.create.l HWIO_QFPROM_CORR_FEAT_CONFIG_ROW0_LSB_ADDR A:0xfc4bc0f8
y.create.l HWIO_QFPROM_CORR_FEAT_CONFIG_ROW0_MSB_ADDR A:0xfc4bc0fc
y.create.l HWIO_QFPROM_CORR_FEAT_CONFIG_ROW1_LSB_ADDR A:0xfc4bc100
y.create.l HWIO_QFPROM_CORR_FEAT_CONFIG_ROW1_MSB_ADDR A:0xfc4bc104
y.create.l HWIO_QFPROM_CORR_FEAT_CONFIG_ROW2_LSB_ADDR A:0xfc4bc108
y.create.l HWIO_QFPROM_CORR_FEAT_CONFIG_ROW2_MSB_ADDR A:0xfc4bc10c
y.create.l HWIO_QFPROM_CORR_FEAT_CONFIG_ROW3_LSB_ADDR A:0xfc4bc110
y.create.l HWIO_QFPROM_CORR_FEAT_CONFIG_ROW3_MSB_ADDR A:0xfc4bc114
y.create.l HWIO_QFPROM_CORR_MEM_REDUN0_ADDR A:0xfc4bc118
y.create.l HWIO_QFPROM_CORR_MEM_REDUN1_ADDR A:0xfc4bc11c
y.create.l HWIO_QFPROM_CORR_MEM_REDUN2_ADDR A:0xfc4bc120
y.create.l HWIO_QFPROM_CORR_MEM_REDUN3_ADDR A:0xfc4bc124
y.create.l HWIO_QFPROM_CORR_MEM_REDUN4_ADDR A:0xfc4bc128
y.create.l HWIO_QFPROM_CORR_MEM_REDUN5_ADDR A:0xfc4bc12c
y.create.l HWIO_QFPROM_CORR_MEM_REDUN6_ADDR A:0xfc4bc130
y.create.l HWIO_QFPROM_CORR_MEM_REDUN7_ADDR A:0xfc4bc134
y.create.l HWIO_QFPROM_CORR_MEM_REDUN8_ADDR A:0xfc4bc138
y.create.l HWIO_QFPROM_CORR_MEM_REDUN9_ADDR A:0xfc4bc13c
y.create.l HWIO_QFPROM_CORR_DEBUG_KEY_LSB_ADDR A:0xfc4bc1a8
y.create.l HWIO_QFPROM_CORR_DEBUG_KEY_MSB_ADDR A:0xfc4bc1ac
y.create.l HWIO_QFPROM_CORR_MEM_ACCEL_ROW0_LSB_ADDR A:0xfc4bc1b0
y.create.l HWIO_QFPROM_CORR_MEM_ACCEL_ROW0_MSB_ADDR A:0xfc4bc1b4
y.create.l HWIO_QFPROM_CORR_MEM_ACCEL_ROW1_LSB_ADDR A:0xfc4bc1b8
y.create.l HWIO_QFPROM_CORR_MEM_ACCEL_ROW1_MSB_ADDR A:0xfc4bc1bc
y.create.l HWIO_QFPROM_CORR_CALIB_ROW0_LSB_ADDR A:0xfc4bc1c0
y.create.l HWIO_QFPROM_CORR_CALIB_ROW0_MSB_ADDR A:0xfc4bc1c4
y.create.l HWIO_QFPROM_CORR_CALIB_ROW1_LSB_ADDR A:0xfc4bc1c8
y.create.l HWIO_QFPROM_CORR_CALIB_ROW1_MSB_ADDR A:0xfc4bc1cc
y.create.l HWIO_QFPROM_CORR_FEC_EN_LSB_ADDR A:0xfc4bc1d0
y.create.l HWIO_QFPROM_CORR_FEC_EN_MSB_ADDR A:0xfc4bc1d4
y.create.l HWIO_QFPROM_CORR_INTAGLIO_GLUEBIT_LSB_ADDR A:0xfc4bc1d8
y.create.l HWIO_QFPROM_CORR_INTAGLIO_GLUEBIT_MSB_ADDR A:0xfc4bc1dc
y.create.l HWIO_QFPROM_CORR_CUST_KEY_ROW0_LSB_ADDR A:0xfc4bc1e0
y.create.l HWIO_QFPROM_CORR_CUST_KEY_ROW1_LSB_ADDR A:0xfc4bc1e8
y.create.l HWIO_QFPROM_CORR_CUST_KEY_ROW0_MSB_ADDR A:0xfc4bc1e4
y.create.l HWIO_QFPROM_CORR_CUST_KEY_ROW1_MSB_ADDR A:0xfc4bc1ec
y.create.l HWIO_QFPROM_CORR_SERIAL_NUM_LSB_ADDR A:0xfc4bc1f0
y.create.l HWIO_QFPROM_CORR_SERIAL_NUM_MSB_ADDR A:0xfc4bc1f4
y.create.l HWIO_QFPROM_CORR_SPARE_REG19_LSB_ADDR A:0xfc4bc1f8
y.create.l HWIO_QFPROM_CORR_SPARE_REG19_MSB_ADDR A:0xfc4bc1fc
y.create.l HWIO_QFPROM_CORR_ROM_PATCH_ROW0_LSB_ADDR A:0xfc4bc200
y.create.l HWIO_QFPROM_CORR_ROM_PATCH_ROW1_LSB_ADDR A:0xfc4bc208
y.create.l HWIO_QFPROM_CORR_ROM_PATCH_ROW2_LSB_ADDR A:0xfc4bc210
y.create.l HWIO_QFPROM_CORR_ROM_PATCH_ROW3_LSB_ADDR A:0xfc4bc218
y.create.l HWIO_QFPROM_CORR_ROM_PATCH_ROW4_LSB_ADDR A:0xfc4bc220
y.create.l HWIO_QFPROM_CORR_ROM_PATCH_ROW5_LSB_ADDR A:0xfc4bc228
y.create.l HWIO_QFPROM_CORR_ROM_PATCH_ROW6_LSB_ADDR A:0xfc4bc230
y.create.l HWIO_QFPROM_CORR_ROM_PATCH_ROW7_LSB_ADDR A:0xfc4bc238
y.create.l HWIO_QFPROM_CORR_ROM_PATCH_ROW8_LSB_ADDR A:0xfc4bc240
y.create.l HWIO_QFPROM_CORR_ROM_PATCH_ROW9_LSB_ADDR A:0xfc4bc248
y.create.l HWIO_QFPROM_CORR_ROM_PATCH_ROW0_MSB_ADDR A:0xfc4bc204
y.create.l HWIO_QFPROM_CORR_ROM_PATCH_ROW1_MSB_ADDR A:0xfc4bc20c
y.create.l HWIO_QFPROM_CORR_ROM_PATCH_ROW2_MSB_ADDR A:0xfc4bc214
y.create.l HWIO_QFPROM_CORR_ROM_PATCH_ROW3_MSB_ADDR A:0xfc4bc21c
y.create.l HWIO_QFPROM_CORR_ROM_PATCH_ROW4_MSB_ADDR A:0xfc4bc224
y.create.l HWIO_QFPROM_CORR_ROM_PATCH_ROW5_MSB_ADDR A:0xfc4bc22c
y.create.l HWIO_QFPROM_CORR_ROM_PATCH_ROW6_MSB_ADDR A:0xfc4bc234
y.create.l HWIO_QFPROM_CORR_ROM_PATCH_ROW7_MSB_ADDR A:0xfc4bc23c
y.create.l HWIO_QFPROM_CORR_ROM_PATCH_ROW8_MSB_ADDR A:0xfc4bc244
y.create.l HWIO_QFPROM_CORR_ROM_PATCH_ROW9_MSB_ADDR A:0xfc4bc24c
y.create.l HWIO_QFPROM_CORR_PRI_KEY_DERIVATION_KEY_ROW0_LSB_ADDR A:0xfc4bc380
y.create.l HWIO_QFPROM_CORR_PRI_KEY_DERIVATION_KEY_ROW1_LSB_ADDR A:0xfc4bc388
y.create.l HWIO_QFPROM_CORR_PRI_KEY_DERIVATION_KEY_ROW2_LSB_ADDR A:0xfc4bc390
y.create.l HWIO_QFPROM_CORR_PRI_KEY_DERIVATION_KEY_ROW3_LSB_ADDR A:0xfc4bc398
y.create.l HWIO_QFPROM_CORR_PRI_KEY_DERIVATION_KEY_ROW0_MSB_ADDR A:0xfc4bc384
y.create.l HWIO_QFPROM_CORR_PRI_KEY_DERIVATION_KEY_ROW1_MSB_ADDR A:0xfc4bc38c
y.create.l HWIO_QFPROM_CORR_PRI_KEY_DERIVATION_KEY_ROW2_MSB_ADDR A:0xfc4bc394
y.create.l HWIO_QFPROM_CORR_PRI_KEY_DERIVATION_KEY_ROW3_MSB_ADDR A:0xfc4bc39c
y.create.l HWIO_QFPROM_CORR_PRI_KEY_DERIVATION_KEY_ROW4_LSB_ADDR A:0xfc4bc3a0
y.create.l HWIO_QFPROM_CORR_PRI_KEY_DERIVATION_KEY_ROW4_MSB_ADDR A:0xfc4bc3a4
y.create.l HWIO_QFPROM_CORR_SEC_KEY_DERIVATION_KEY_ROW0_LSB_ADDR A:0xfc4bc3a8
y.create.l HWIO_QFPROM_CORR_SEC_KEY_DERIVATION_KEY_ROW1_LSB_ADDR A:0xfc4bc3b0
y.create.l HWIO_QFPROM_CORR_SEC_KEY_DERIVATION_KEY_ROW2_LSB_ADDR A:0xfc4bc3b8
y.create.l HWIO_QFPROM_CORR_SEC_KEY_DERIVATION_KEY_ROW3_LSB_ADDR A:0xfc4bc3c0
y.create.l HWIO_QFPROM_CORR_SEC_KEY_DERIVATION_KEY_ROW0_MSB_ADDR A:0xfc4bc3ac
y.create.l HWIO_QFPROM_CORR_SEC_KEY_DERIVATION_KEY_ROW1_MSB_ADDR A:0xfc4bc3b4
y.create.l HWIO_QFPROM_CORR_SEC_KEY_DERIVATION_KEY_ROW2_MSB_ADDR A:0xfc4bc3bc
y.create.l HWIO_QFPROM_CORR_SEC_KEY_DERIVATION_KEY_ROW3_MSB_ADDR A:0xfc4bc3c4
y.create.l HWIO_QFPROM_CORR_SEC_KEY_DERIVATION_KEY_ROW4_LSB_ADDR A:0xfc4bc3c8
y.create.l HWIO_QFPROM_CORR_SEC_KEY_DERIVATION_KEY_ROW4_MSB_ADDR A:0xfc4bc3cc
y.create.l HWIO_QFPROM_CORR_OEM_PK_HASH_ROW0_LSB_ADDR A:0xfc4bc3d0
y.create.l HWIO_QFPROM_CORR_OEM_PK_HASH_ROW1_LSB_ADDR A:0xfc4bc3d8
y.create.l HWIO_QFPROM_CORR_OEM_PK_HASH_ROW2_LSB_ADDR A:0xfc4bc3e0
y.create.l HWIO_QFPROM_CORR_OEM_PK_HASH_ROW3_LSB_ADDR A:0xfc4bc3e8
y.create.l HWIO_QFPROM_CORR_OEM_PK_HASH_ROW0_MSB_ADDR A:0xfc4bc3d4
y.create.l HWIO_QFPROM_CORR_OEM_PK_HASH_ROW1_MSB_ADDR A:0xfc4bc3dc
y.create.l HWIO_QFPROM_CORR_OEM_PK_HASH_ROW2_MSB_ADDR A:0xfc4bc3e4
y.create.l HWIO_QFPROM_CORR_OEM_PK_HASH_ROW3_MSB_ADDR A:0xfc4bc3ec
y.create.l HWIO_QFPROM_CORR_OEM_PK_HASH_ROW4_LSB_ADDR A:0xfc4bc3f0
y.create.l HWIO_QFPROM_CORR_OEM_PK_HASH_ROW4_MSB_ADDR A:0xfc4bc3f4
y.create.l HWIO_QFPROM_CORR_OEM_SEC_BOOT_ROW0_LSB_ADDR A:0xfc4bc3f8
y.create.l HWIO_QFPROM_CORR_OEM_SEC_BOOT_ROW1_LSB_ADDR A:0xfc4bc400
y.create.l HWIO_QFPROM_CORR_OEM_SEC_BOOT_ROW2_LSB_ADDR A:0xfc4bc408
y.create.l HWIO_QFPROM_CORR_OEM_SEC_BOOT_ROW3_LSB_ADDR A:0xfc4bc410
y.create.l HWIO_QFPROM_CORR_OEM_SEC_BOOT_ROW0_MSB_ADDR A:0xfc4bc3fc
y.create.l HWIO_QFPROM_CORR_OEM_SEC_BOOT_ROW1_MSB_ADDR A:0xfc4bc404
y.create.l HWIO_QFPROM_CORR_OEM_SEC_BOOT_ROW2_MSB_ADDR A:0xfc4bc40c
y.create.l HWIO_QFPROM_CORR_OEM_SEC_BOOT_ROW3_MSB_ADDR A:0xfc4bc414
y.create.l HWIO_QFPROM_CORR_QC_SEC_BOOT_ROW0_LSB_ADDR A:0xfc4bc418
y.create.l HWIO_QFPROM_CORR_QC_SEC_BOOT_ROW1_LSB_ADDR A:0xfc4bc420
y.create.l HWIO_QFPROM_CORR_QC_SEC_BOOT_ROW2_LSB_ADDR A:0xfc4bc428
y.create.l HWIO_QFPROM_CORR_QC_SEC_BOOT_ROW3_LSB_ADDR A:0xfc4bc430
y.create.l HWIO_QFPROM_CORR_QC_SEC_BOOT_ROW0_MSB_ADDR A:0xfc4bc41c
y.create.l HWIO_QFPROM_CORR_QC_SEC_BOOT_ROW1_MSB_ADDR A:0xfc4bc424
y.create.l HWIO_QFPROM_CORR_QC_SEC_BOOT_ROW2_MSB_ADDR A:0xfc4bc42c
y.create.l HWIO_QFPROM_CORR_QC_SEC_BOOT_ROW3_MSB_ADDR A:0xfc4bc434
y.create.l HWIO_QFPROM_CORR_USB_VID_PID_LSB_ADDR A:0xfc4bc438
y.create.l HWIO_QFPROM_CORR_USB_VID_PID_MSB_ADDR A:0xfc4bc43c
y.create.l HWIO_QFPROM_CORR_SPARE_REG27_ROW0_LSB_ADDR A:0xfc4bc440
y.create.l HWIO_QFPROM_CORR_SPARE_REG27_ROW0_MSB_ADDR A:0xfc4bc444
y.create.l HWIO_QFPROM_CORR_SPARE_REG27_ROW1_LSB_ADDR A:0xfc4bc448
y.create.l HWIO_QFPROM_CORR_SPARE_REG27_ROW1_MSB_ADDR A:0xfc4bc44c
y.create.l HWIO_QFPROM_CORR_SPARE_REG28_ROW0_LSB_ADDR A:0xfc4bc450
y.create.l HWIO_QFPROM_CORR_SPARE_REG28_ROW0_MSB_ADDR A:0xfc4bc454
y.create.l HWIO_QFPROM_CORR_SPARE_REG28_ROW1_LSB_ADDR A:0xfc4bc458
y.create.l HWIO_QFPROM_CORR_SPARE_REG28_ROW1_MSB_ADDR A:0xfc4bc45c
y.create.l HWIO_QFPROM_CORR_SPARE_REG28_ROW2_LSB_ADDR A:0xfc4bc460
y.create.l HWIO_QFPROM_CORR_SPARE_REG28_ROW2_MSB_ADDR A:0xfc4bc464
y.create.l HWIO_QFPROM_CORR_HDCP_KSV_LSB_ADDR A:0xfc4bc468
y.create.l HWIO_QFPROM_CORR_HDCP_KSV_MSB_ADDR A:0xfc4bc46c
y.create.l HWIO_QFPROM_CORR_HDCP_KEY_ROW1_LSB_ADDR A:0xfc4bc470
y.create.l HWIO_QFPROM_CORR_HDCP_KEY_ROW2_LSB_ADDR A:0xfc4bc478
y.create.l HWIO_QFPROM_CORR_HDCP_KEY_ROW3_LSB_ADDR A:0xfc4bc480
y.create.l HWIO_QFPROM_CORR_HDCP_KEY_ROW4_LSB_ADDR A:0xfc4bc488
y.create.l HWIO_QFPROM_CORR_HDCP_KEY_ROW5_LSB_ADDR A:0xfc4bc490
y.create.l HWIO_QFPROM_CORR_HDCP_KEY_ROW6_LSB_ADDR A:0xfc4bc498
y.create.l HWIO_QFPROM_CORR_HDCP_KEY_ROW7_LSB_ADDR A:0xfc4bc4a0
y.create.l HWIO_QFPROM_CORR_HDCP_KEY_ROW8_LSB_ADDR A:0xfc4bc4a8
y.create.l HWIO_QFPROM_CORR_HDCP_KEY_ROW9_LSB_ADDR A:0xfc4bc4b0
y.create.l HWIO_QFPROM_CORR_HDCP_KEY_ROW10_LSB_ADDR A:0xfc4bc4b8
y.create.l HWIO_QFPROM_CORR_HDCP_KEY_ROW1_MSB_ADDR A:0xfc4bc474
y.create.l HWIO_QFPROM_CORR_HDCP_KEY_ROW2_MSB_ADDR A:0xfc4bc47c
y.create.l HWIO_QFPROM_CORR_HDCP_KEY_ROW3_MSB_ADDR A:0xfc4bc484
y.create.l HWIO_QFPROM_CORR_HDCP_KEY_ROW4_MSB_ADDR A:0xfc4bc48c
y.create.l HWIO_QFPROM_CORR_HDCP_KEY_ROW5_MSB_ADDR A:0xfc4bc494
y.create.l HWIO_QFPROM_CORR_HDCP_KEY_ROW6_MSB_ADDR A:0xfc4bc49c
y.create.l HWIO_QFPROM_CORR_HDCP_KEY_ROW7_MSB_ADDR A:0xfc4bc4a4
y.create.l HWIO_QFPROM_CORR_HDCP_KEY_ROW8_MSB_ADDR A:0xfc4bc4ac
y.create.l HWIO_QFPROM_CORR_HDCP_KEY_ROW9_MSB_ADDR A:0xfc4bc4b4
y.create.l HWIO_QFPROM_CORR_HDCP_KEY_ROW10_MSB_ADDR A:0xfc4bc4bc
y.create.l HWIO_QFPROM_CORR_CUST_PRIV_KEY0_ROW0_LSB_ADDR A:0xfc4bc5b0
y.create.l HWIO_QFPROM_CORR_CUST_PRIV_KEY0_ROW1_LSB_ADDR A:0xfc4bc5b8
y.create.l HWIO_QFPROM_CORR_CUST_PRIV_KEY0_ROW2_LSB_ADDR A:0xfc4bc5c0
y.create.l HWIO_QFPROM_CORR_CUST_PRIV_KEY0_ROW3_LSB_ADDR A:0xfc4bc5c8
y.create.l HWIO_QFPROM_CORR_CUST_PRIV_KEY0_ROW4_LSB_ADDR A:0xfc4bc5d0
y.create.l HWIO_QFPROM_CORR_CUST_PRIV_KEY0_ROW5_LSB_ADDR A:0xfc4bc5d8
y.create.l HWIO_QFPROM_CORR_CUST_PRIV_KEY0_ROW6_LSB_ADDR A:0xfc4bc5e0
y.create.l HWIO_QFPROM_CORR_CUST_PRIV_KEY0_ROW7_LSB_ADDR A:0xfc4bc5e8
y.create.l HWIO_QFPROM_CORR_CUST_PRIV_KEY0_ROW8_LSB_ADDR A:0xfc4bc5f0
y.create.l HWIO_QFPROM_CORR_CUST_PRIV_KEY0_ROW9_LSB_ADDR A:0xfc4bc5f8
y.create.l HWIO_QFPROM_CORR_CUST_PRIV_KEY0_ROW0_MSB_ADDR A:0xfc4bc5b4
y.create.l HWIO_QFPROM_CORR_CUST_PRIV_KEY0_ROW1_MSB_ADDR A:0xfc4bc5bc
y.create.l HWIO_QFPROM_CORR_CUST_PRIV_KEY0_ROW2_MSB_ADDR A:0xfc4bc5c4
y.create.l HWIO_QFPROM_CORR_CUST_PRIV_KEY0_ROW3_MSB_ADDR A:0xfc4bc5cc
y.create.l HWIO_QFPROM_CORR_CUST_PRIV_KEY0_ROW4_MSB_ADDR A:0xfc4bc5d4
y.create.l HWIO_QFPROM_CORR_CUST_PRIV_KEY0_ROW5_MSB_ADDR A:0xfc4bc5dc
y.create.l HWIO_QFPROM_CORR_CUST_PRIV_KEY0_ROW6_MSB_ADDR A:0xfc4bc5e4
y.create.l HWIO_QFPROM_CORR_CUST_PRIV_KEY0_ROW7_MSB_ADDR A:0xfc4bc5ec
y.create.l HWIO_QFPROM_CORR_CUST_PRIV_KEY0_ROW8_MSB_ADDR A:0xfc4bc5f4
y.create.l HWIO_QFPROM_CORR_CUST_PRIV_KEY0_ROW9_MSB_ADDR A:0xfc4bc5fc
y.create.l HWIO_QFPROM_CORR_CUST_PRIV_KEY1_ROW0_LSB_ADDR A:0xfc4bc6d8
y.create.l HWIO_QFPROM_CORR_CUST_PRIV_KEY1_ROW1_LSB_ADDR A:0xfc4bc6e0
y.create.l HWIO_QFPROM_CORR_CUST_PRIV_KEY1_ROW2_LSB_ADDR A:0xfc4bc6e8
y.create.l HWIO_QFPROM_CORR_CUST_PRIV_KEY1_ROW3_LSB_ADDR A:0xfc4bc6f0
y.create.l HWIO_QFPROM_CORR_CUST_PRIV_KEY1_ROW4_LSB_ADDR A:0xfc4bc6f8
y.create.l HWIO_QFPROM_CORR_CUST_PRIV_KEY1_ROW5_LSB_ADDR A:0xfc4bc700
y.create.l HWIO_QFPROM_CORR_CUST_PRIV_KEY1_ROW6_LSB_ADDR A:0xfc4bc708
y.create.l HWIO_QFPROM_CORR_CUST_PRIV_KEY1_ROW7_LSB_ADDR A:0xfc4bc710
y.create.l HWIO_QFPROM_CORR_CUST_PRIV_KEY1_ROW8_LSB_ADDR A:0xfc4bc718
y.create.l HWIO_QFPROM_CORR_CUST_PRIV_KEY1_ROW9_LSB_ADDR A:0xfc4bc720
y.create.l HWIO_QFPROM_CORR_CUST_PRIV_KEY1_ROW0_MSB_ADDR A:0xfc4bc6dc
y.create.l HWIO_QFPROM_CORR_CUST_PRIV_KEY1_ROW1_MSB_ADDR A:0xfc4bc6e4
y.create.l HWIO_QFPROM_CORR_CUST_PRIV_KEY1_ROW2_MSB_ADDR A:0xfc4bc6ec
y.create.l HWIO_QFPROM_CORR_CUST_PRIV_KEY1_ROW3_MSB_ADDR A:0xfc4bc6f4
y.create.l HWIO_QFPROM_CORR_CUST_PRIV_KEY1_ROW4_MSB_ADDR A:0xfc4bc6fc
y.create.l HWIO_QFPROM_CORR_CUST_PRIV_KEY1_ROW5_MSB_ADDR A:0xfc4bc704
y.create.l HWIO_QFPROM_CORR_CUST_PRIV_KEY1_ROW6_MSB_ADDR A:0xfc4bc70c
y.create.l HWIO_QFPROM_CORR_CUST_PRIV_KEY1_ROW7_MSB_ADDR A:0xfc4bc714
y.create.l HWIO_QFPROM_CORR_CUST_PRIV_KEY1_ROW8_MSB_ADDR A:0xfc4bc71c
y.create.l HWIO_QFPROM_CORR_CUST_PRIV_KEY1_ROW9_MSB_ADDR A:0xfc4bc724
y.create.l HWIO_FEATURE_CONFIG0_ADDR A:0xfc4be004
y.create.l HWIO_FEATURE_CONFIG1_ADDR A:0xfc4be008
y.create.l HWIO_FEATURE_CONFIG2_ADDR A:0xfc4be00c
y.create.l HWIO_FEATURE_CONFIG3_ADDR A:0xfc4be010
y.create.l HWIO_FEATURE_CONFIG4_ADDR A:0xfc4be014
y.create.l HWIO_FEATURE_CONFIG5_ADDR A:0xfc4be018
y.create.l HWIO_FEATURE_CONFIG6_ADDR A:0xfc4be01c
y.create.l HWIO_FEATURE_CONFIG7_ADDR A:0xfc4be020
y.create.l HWIO_OEM_CONFIG0_ADDR A:0xfc4be024
y.create.l HWIO_OEM_CONFIG1_ADDR A:0xfc4be028
y.create.l HWIO_OEM_CONFIG2_ADDR A:0xfc4be02c
y.create.l HWIO_OEM_CONFIG3_ADDR A:0xfc4be030
y.create.l HWIO_BOOT_CONFIG_ADDR A:0xfc4be034
y.create.l HWIO_SECURE_BOOT1_ADDR A:0xfc4be03c
y.create.l HWIO_SECURE_BOOT2_ADDR A:0xfc4be040
y.create.l HWIO_SECURE_BOOT3_ADDR A:0xfc4be044
y.create.l HWIO_SECURE_BOOT4_ADDR A:0xfc4be048
y.create.l HWIO_SECURE_BOOT5_ADDR A:0xfc4be04c
y.create.l HWIO_SECURE_BOOT6_ADDR A:0xfc4be050
y.create.l HWIO_SECURE_BOOT7_ADDR A:0xfc4be054
y.create.l HWIO_SECURE_BOOT8_ADDR A:0xfc4be058
y.create.l HWIO_SECURE_BOOT9_ADDR A:0xfc4be05c
y.create.l HWIO_SECURE_BOOT10_ADDR A:0xfc4be060
y.create.l HWIO_OVERRIDE_0_ADDR A:0xfc4be0b0
y.create.l HWIO_OVERRIDE_1_ADDR A:0xfc4be0b4
y.create.l HWIO_OVERRIDE_2_ADDR A:0xfc4be0b8
y.create.l HWIO_OVERRIDE_3_ADDR A:0xfc4be0bc
y.create.l HWIO_OVERRIDE_4_ADDR A:0xfc4be0c0
y.create.l HWIO_CAPT_SEC_GPIO_ADDR A:0xfc4be0c4
y.create.l HWIO_APP_PROC_CFG_ADDR A:0xfc4be0c8
y.create.l HWIO_MSS_PROC_CFG_ADDR A:0xfc4be0cc
y.create.l HWIO_KDF_CFG_ADDR A:0xfc4be0d0
y.create.l HWIO_QFPROM_CLK_CTL_ADDR A:0xfc4be0d4
y.create.l HWIO_HDCP_KSV_LSB_ADDR A:0xfc4be0d8
y.create.l HWIO_HDCP_KSV_MSB_ADDR A:0xfc4be0dc
y.create.l HWIO_JTAG_ID_ADDR A:0xfc4be0e0
y.create.l HWIO_OEM_ID_ADDR A:0xfc4be0e4
y.create.l HWIO_TEST_BUS_SEL_ADDR A:0xfc4be0e8
y.create.l HWIO_SPDM_DYN_SECURE_MODE_ADDR A:0xfc4be0ec
y.create.l HWIO_BOOT_PARTITION_SELECT_ADDR A:0xfc4be0f0
y.create.l HWIO_SEC_CTRL_APU_XPU_SCR_ADDR A:0xfc4bf000
y.create.l HWIO_SEC_CTRL_APU_XPU_SWDR_ADDR A:0xfc4bf004
y.create.l HWIO_SEC_CTRL_APU_XPU_SEAR0_ADDR A:0xfc4bf040
y.create.l HWIO_SEC_CTRL_APU_XPU_SESR_ADDR A:0xfc4bf048
y.create.l HWIO_SEC_CTRL_APU_XPU_SESRRESTORE_ADDR A:0xfc4bf04c
y.create.l HWIO_SEC_CTRL_APU_XPU_SESYNR0_ADDR A:0xfc4bf050
y.create.l HWIO_SEC_CTRL_APU_XPU_SESYNR1_ADDR A:0xfc4bf054
y.create.l HWIO_SEC_CTRL_APU_XPU_SESYNR2_ADDR A:0xfc4bf058
y.create.l HWIO_SEC_CTRL_APU_XPU_MCR_ADDR A:0xfc4bf100
y.create.l HWIO_SEC_CTRL_APU_XPU_MEAR0_ADDR A:0xfc4bf140
y.create.l HWIO_SEC_CTRL_APU_XPU_MESR_ADDR A:0xfc4bf148
y.create.l HWIO_SEC_CTRL_APU_XPU_MESRRESTORE_ADDR A:0xfc4bf14c
y.create.l HWIO_SEC_CTRL_APU_XPU_MESYNR0_ADDR A:0xfc4bf150
y.create.l HWIO_SEC_CTRL_APU_XPU_MESYNR1_ADDR A:0xfc4bf154
y.create.l HWIO_SEC_CTRL_APU_XPU_MESYNR2_ADDR A:0xfc4bf158
y.create.l HWIO_SEC_CTRL_APU_XPU_CR_ADDR A:0xfc4bf080
y.create.l HWIO_SEC_CTRL_APU_XPU_RPU_ACR0_ADDR A:0xfc4bf0a0
y.create.l HWIO_SEC_CTRL_APU_XPU_EAR0_ADDR A:0xfc4bf0c0
y.create.l HWIO_SEC_CTRL_APU_XPU_ESR_ADDR A:0xfc4bf0c8
y.create.l HWIO_SEC_CTRL_APU_XPU_ESRRESTORE_ADDR A:0xfc4bf0cc
y.create.l HWIO_SEC_CTRL_APU_XPU_ESYNR0_ADDR A:0xfc4bf0d0
y.create.l HWIO_SEC_CTRL_APU_XPU_ESYNR1_ADDR A:0xfc4bf0d4
y.create.l HWIO_SEC_CTRL_APU_XPU_ESYNR2_ADDR A:0xfc4bf0d8
y.create.l HWIO_SEC_CTRL_APU_XPU_IDR0_ADDR A:0xfc4bf074
y.create.l HWIO_SEC_CTRL_APU_XPU_IDR1_ADDR A:0xfc4bf078
y.create.l HWIO_SEC_CTRL_APU_XPU_REV_ADDR A:0xfc4bf07c
y.create.l HWIO_SEC_CTRL_APU_XPU_RG0_RACR0_ADDR A:0xfc4bf200
y.create.l HWIO_SEC_CTRL_APU_XPU_RG1_RACR0_ADDR A:0xfc4bf280
y.create.l HWIO_SEC_CTRL_APU_XPU_RG2_RACR0_ADDR A:0xfc4bf300
y.create.l HWIO_SEC_CTRL_APU_XPU_RG0_WACR0_ADDR A:0xfc4bf220
y.create.l HWIO_SEC_CTRL_APU_XPU_RG1_WACR0_ADDR A:0xfc4bf2a0
y.create.l HWIO_SEC_CTRL_APU_XPU_RG2_WACR0_ADDR A:0xfc4bf320
y.create.l HWIO_SEC_CTRL_APU_XPU_RG0_SCR_ADDR A:0xfc4bf250
y.create.l HWIO_SEC_CTRL_APU_XPU_RG1_SCR_ADDR A:0xfc4bf2d0
y.create.l HWIO_SEC_CTRL_APU_XPU_RG2_SCR_ADDR A:0xfc4bf350
y.create.l HWIO_SEC_CTRL_APU_XPU_RG0_MCR_ADDR A:0xfc4bf254
y.create.l HWIO_SEC_CTRL_APU_XPU_RG1_MCR_ADDR A:0xfc4bf2d4
y.create.l HWIO_SEC_CTRL_APU_XPU_RG2_MCR_ADDR A:0xfc4bf354
y.create.l HWIO_SNOC_0_ABT_HW_VERSION_ADDR A:0xfea00000
y.create.l HWIO_SNOC_0_ABT_INST_ID_ADDR A:0xfea00004
y.create.l HWIO_SNOC_0_ABT_NUM_SLAVES_ADDR A:0xfea00008
y.create.l HWIO_SNOC_0_ABT_TIMER_LOADVAL_ADDR A:0xfea0000c
y.create.l HWIO_SNOC_0_ABT_TIMER_MODE_ADDR A:0xfea00010
y.create.l HWIO_SNOC_0_ABT_INTR_STATUS_ADDR A:0xfea00014
y.create.l HWIO_SNOC_0_ABT_INTR_CLEAR_ADDR A:0xfea00018
y.create.l HWIO_SNOC_0_ABT_INTR_ENABLE_ADDR A:0xfea0001c
y.create.l HWIO_SNOC_0_ABT_SYND_VALID_ADDR A:0xfea00020
y.create.l HWIO_SNOC_0_ABT_SYND_CLEAR_ADDR A:0xfea00024
y.create.l HWIO_SNOC_0_ABT_SYND_ID_ADDR A:0xfea00028
y.create.l HWIO_SNOC_0_ABT_SYND_ADDR0_ADDR A:0xfea0002c
y.create.l HWIO_SNOC_0_ABT_SYND_ADDR1_ADDR A:0xfea00030
y.create.l HWIO_SNOC_0_ABT_SYND_HREADY_ADDR A:0xfea00034
y.create.l HWIO_SPDM_CREG_CFG0_ADDR A:0xfc4b0000
y.create.l HWIO_SPDM_CREG_HW_INFO_ADDR A:0xfc4b0004
y.create.l HWIO_SPDM_CREG_HW_VERSION_ADDR A:0xfc4b0008
y.create.l HWIO_SPDM_CREG_MUTEX_0_ADDR A:0xfc4b0100
y.create.l HWIO_SPDM_OLEM_CFG0_ADDR A:0xfc4b1000
y.create.l HWIO_SPDM_OLEM_CFG1_ADDR A:0xfc4b1004
y.create.l HWIO_SPDM_OLEM_CFG2_ADDR A:0xfc4b1008
y.create.l HWIO_SPDM_OLEM_CFG3_ADDR A:0xfc4b100c
y.create.l HWIO_SPDM_OLEM_CFG4_ADDR A:0xfc4b1010
y.create.l HWIO_SPDM_OLEM_CFG5_ADDR A:0xfc4b1014
y.create.l HWIO_SPDM_OLEM_CFG6_ADDR A:0xfc4b1018
y.create.l HWIO_SPDM_OLEM_CYCLE_C0_OUT_ADDR A:0xfc4b1020
y.create.l HWIO_SPDM_OLEM_CYCLE_C1_OUT_ADDR A:0xfc4b1024
y.create.l HWIO_SPDM_OLEM_CYCLE_C2_OUT_ADDR A:0xfc4b1028
y.create.l HWIO_SPDM_OLEM_CYCLE_C3_OUT_ADDR A:0xfc4b102c
y.create.l HWIO_SPDM_OLEM_CYCLE_C4_OUT_ADDR A:0xfc4b1030
y.create.l HWIO_SPDM_OLEM_CYCLE_C5_OUT_ADDR A:0xfc4b1034
y.create.l HWIO_SPDM_OLEM_CYCLE_C6_OUT_ADDR A:0xfc4b1038
y.create.l HWIO_SPDM_OLEM_CYCLE_C7_OUT_ADDR A:0xfc4b103c
y.create.l HWIO_SPDM_OLEM_CYCLE_C8_OUT_ADDR A:0xfc4b1040
y.create.l HWIO_SPDM_OLEM_CYCLE_C9_OUT_ADDR A:0xfc4b1044
y.create.l HWIO_SPDM_OLEM_EVENT_C0_OUT_ADDR A:0xfc4b10a0
y.create.l HWIO_SPDM_OLEM_EVENT_C1_OUT_ADDR A:0xfc4b10a4
y.create.l HWIO_SPDM_OLEM_EVENT_C2_OUT_ADDR A:0xfc4b10a8
y.create.l HWIO_SPDM_OLEM_EVENT_C3_OUT_ADDR A:0xfc4b10ac
y.create.l HWIO_SPDM_OLEM_EVENT_C4_OUT_ADDR A:0xfc4b10b0
y.create.l HWIO_SPDM_OLEM_EVENT_C5_OUT_ADDR A:0xfc4b10b4
y.create.l HWIO_SPDM_OLEM_EVENT_C6_OUT_ADDR A:0xfc4b10b8
y.create.l HWIO_SPDM_OLEM_EVENT_C7_OUT_ADDR A:0xfc4b10bc
y.create.l HWIO_SPDM_OLEM_EVENT_C8_OUT_ADDR A:0xfc4b10c0
y.create.l HWIO_SPDM_OLEM_EVENT_C9_OUT_ADDR A:0xfc4b10c4
y.create.l HWIO_SPDM_OLEM_MULTIBIT_C0_OUT_ADDR A:0xfc4b1120
y.create.l HWIO_SPDM_OLEM_MULTIBIT_C1_OUT_ADDR A:0xfc4b1124
y.create.l HWIO_SPDM_OLEM_MULTIBIT_C2_OUT_ADDR A:0xfc4b1128
y.create.l HWIO_SPDM_OLEM_MULTIBIT_C3_OUT_ADDR A:0xfc4b112c
y.create.l HWIO_SPDM_OLEM_MULTIBIT_C4_OUT_ADDR A:0xfc4b1130
y.create.l HWIO_SPDM_OLEM_MULTIBIT_C5_OUT_ADDR A:0xfc4b1134
y.create.l HWIO_SPDM_OLEM_MULTIBIT_C6_OUT_ADDR A:0xfc4b1138
y.create.l HWIO_SPDM_OLEM_MULTIBIT_C7_OUT_ADDR A:0xfc4b113c
y.create.l HWIO_SPDM_RT_LOW_THRESH_STATUS_ADDR A:0xfc4b2000
y.create.l HWIO_SPDM_RT_HIGH_THRESH_STATUS_ADDR A:0xfc4b2004
y.create.l HWIO_SPDM_RT_LOW_IRQ_EN_0_ADDR A:0xfc4b2010
y.create.l HWIO_SPDM_RT_LOW_IRQ_EN_1_ADDR A:0xfc4b2014
y.create.l HWIO_SPDM_RT_LOW_IRQ_EN_2_ADDR A:0xfc4b2018
y.create.l HWIO_SPDM_RT_LOW_IRQ_EN_3_ADDR A:0xfc4b201c
y.create.l HWIO_SPDM_RT_HIGH_IRQ_EN_0_ADDR A:0xfc4b2020
y.create.l HWIO_SPDM_RT_HIGH_IRQ_EN_1_ADDR A:0xfc4b2024
y.create.l HWIO_SPDM_RT_HIGH_IRQ_EN_2_ADDR A:0xfc4b2028
y.create.l HWIO_SPDM_RT_HIGH_IRQ_EN_3_ADDR A:0xfc4b202c
y.create.l HWIO_SPDM_RT_IRQ_TIMER_0_ADDR A:0xfc4b2030
y.create.l HWIO_SPDM_RT_IRQ_TIMER_1_ADDR A:0xfc4b2034
y.create.l HWIO_SPDM_RT_IRQ_TIMER_2_ADDR A:0xfc4b2038
y.create.l HWIO_SPDM_RT_IRQ_TIMER_3_ADDR A:0xfc4b203c
y.create.l HWIO_SPDM_RT_DIAG_MUX_SEL_ADDR A:0xfc4b2040
y.create.l HWIO_SPDM_RT_MON_EN_ADDR A:0xfc4b2050
y.create.l HWIO_SPDM_RT_MON_EN_SET_ADDR A:0xfc4b2054
y.create.l HWIO_SPDM_RT_MON_EN_CLEAR_ADDR A:0xfc4b2058
y.create.l HWIO_SPDM_RT_MON_RST_ADDR A:0xfc4b2060
y.create.l HWIO_SPDM_RT_MON_RST_SET_ADDR A:0xfc4b2064
y.create.l HWIO_SPDM_RT_MON_RST_CLEAR_ADDR A:0xfc4b2068
y.create.l HWIO_SPDM_RT_MON_CFG_0_ADDR A:0xfc4b2100
y.create.l HWIO_SPDM_RT_MON_CFG_1_ADDR A:0xfc4b2110
y.create.l HWIO_SPDM_RT_MON_CFG_2_ADDR A:0xfc4b2120
y.create.l HWIO_SPDM_RT_MON_CFG_3_ADDR A:0xfc4b2130
y.create.l HWIO_SPDM_RT_MON_CFG_4_ADDR A:0xfc4b2140
y.create.l HWIO_SPDM_RT_MON_CFG_5_ADDR A:0xfc4b2150
y.create.l HWIO_SPDM_RT_MON_CFG_6_ADDR A:0xfc4b2160
y.create.l HWIO_SPDM_RT_MON_CFG_7_ADDR A:0xfc4b2170
y.create.l HWIO_SPDM_RT_MON_CFG_8_ADDR A:0xfc4b2180
y.create.l HWIO_SPDM_RT_MON_CFG_9_ADDR A:0xfc4b2190
y.create.l HWIO_SPDM_RT_THRESH_CFG_0_ADDR A:0xfc4b2104
y.create.l HWIO_SPDM_RT_THRESH_CFG_1_ADDR A:0xfc4b2114
y.create.l HWIO_SPDM_RT_THRESH_CFG_2_ADDR A:0xfc4b2124
y.create.l HWIO_SPDM_RT_THRESH_CFG_3_ADDR A:0xfc4b2134
y.create.l HWIO_SPDM_RT_THRESH_CFG_4_ADDR A:0xfc4b2144
y.create.l HWIO_SPDM_RT_THRESH_CFG_5_ADDR A:0xfc4b2154
y.create.l HWIO_SPDM_RT_THRESH_CFG_6_ADDR A:0xfc4b2164
y.create.l HWIO_SPDM_RT_THRESH_CFG_7_ADDR A:0xfc4b2174
y.create.l HWIO_SPDM_RT_THRESH_CFG_8_ADDR A:0xfc4b2184
y.create.l HWIO_SPDM_RT_THRESH_CFG_9_ADDR A:0xfc4b2194
y.create.l HWIO_SPDM_RT_MON_STATUS_0_ADDR A:0xfc4b2108
y.create.l HWIO_SPDM_RT_MON_STATUS_1_ADDR A:0xfc4b2118
y.create.l HWIO_SPDM_RT_MON_STATUS_2_ADDR A:0xfc4b2128
y.create.l HWIO_SPDM_RT_MON_STATUS_3_ADDR A:0xfc4b2138
y.create.l HWIO_SPDM_RT_MON_STATUS_4_ADDR A:0xfc4b2148
y.create.l HWIO_SPDM_RT_MON_STATUS_5_ADDR A:0xfc4b2158
y.create.l HWIO_SPDM_RT_MON_STATUS_6_ADDR A:0xfc4b2168
y.create.l HWIO_SPDM_RT_MON_STATUS_7_ADDR A:0xfc4b2178
y.create.l HWIO_SPDM_RT_MON_STATUS_8_ADDR A:0xfc4b2188
y.create.l HWIO_SPDM_RT_MON_STATUS_9_ADDR A:0xfc4b2198
y.create.l HWIO_SPDM_XPU_SCR_ADDR A:0xfc4b3000
y.create.l HWIO_SPDM_XPU_SWDR_ADDR A:0xfc4b3004
y.create.l HWIO_SPDM_XPU_SEAR0_ADDR A:0xfc4b3040
y.create.l HWIO_SPDM_XPU_SESR_ADDR A:0xfc4b3048
y.create.l HWIO_SPDM_XPU_SESRRESTORE_ADDR A:0xfc4b304c
y.create.l HWIO_SPDM_XPU_SESYNR0_ADDR A:0xfc4b3050
y.create.l HWIO_SPDM_XPU_SESYNR1_ADDR A:0xfc4b3054
y.create.l HWIO_SPDM_XPU_SESYNR2_ADDR A:0xfc4b3058
y.create.l HWIO_SPDM_XPU_MCR_ADDR A:0xfc4b3100
y.create.l HWIO_SPDM_XPU_MEAR0_ADDR A:0xfc4b3140
y.create.l HWIO_SPDM_XPU_MESR_ADDR A:0xfc4b3148
y.create.l HWIO_SPDM_XPU_MESRRESTORE_ADDR A:0xfc4b314c
y.create.l HWIO_SPDM_XPU_MESYNR0_ADDR A:0xfc4b3150
y.create.l HWIO_SPDM_XPU_MESYNR1_ADDR A:0xfc4b3154
y.create.l HWIO_SPDM_XPU_MESYNR2_ADDR A:0xfc4b3158
y.create.l HWIO_SPDM_XPU_CR_ADDR A:0xfc4b3080
y.create.l HWIO_SPDM_XPU_RPU_ACR0_ADDR A:0xfc4b30a0
y.create.l HWIO_SPDM_XPU_EAR0_ADDR A:0xfc4b30c0
y.create.l HWIO_SPDM_XPU_ESR_ADDR A:0xfc4b30c8
y.create.l HWIO_SPDM_XPU_ESRRESTORE_ADDR A:0xfc4b30cc
y.create.l HWIO_SPDM_XPU_ESYNR0_ADDR A:0xfc4b30d0
y.create.l HWIO_SPDM_XPU_ESYNR1_ADDR A:0xfc4b30d4
y.create.l HWIO_SPDM_XPU_ESYNR2_ADDR A:0xfc4b30d8
y.create.l HWIO_SPDM_XPU_IDR0_ADDR A:0xfc4b3074
y.create.l HWIO_SPDM_XPU_IDR1_ADDR A:0xfc4b3078
y.create.l HWIO_SPDM_XPU_REV_ADDR A:0xfc4b307c
y.create.l HWIO_SPDM_XPU_RG0_RACR0_ADDR A:0xfc4b3200
y.create.l HWIO_SPDM_XPU_RG0_SCR_ADDR A:0xfc4b3250
y.create.l HWIO_SPDM_XPU_RG0_MCR_ADDR A:0xfc4b3254
y.create.l HWIO_SPDM_SREG_CFG0_ADDR A:0xfc4b4000
y.create.l HWIO_SPDM_SREG_CFG1_ADDR A:0xfc4b4004
y.create.l HWIO_SPDM_SREG_MUTEX_0_ADDR A:0xfc4b4100
y.create.l HWIO_SPDM_VMIDMT_SCR0_ADDR A:0xfc4b5000
y.create.l HWIO_SPDM_VMIDMT_SCR1_ADDR A:0xfc4b5004
y.create.l HWIO_SPDM_VMIDMT_SCR2_ADDR A:0xfc4b5008
y.create.l HWIO_SPDM_VMIDMT_SACR_ADDR A:0xfc4b5010
y.create.l HWIO_SPDM_VMIDMT_SIDR0_ADDR A:0xfc4b5020
y.create.l HWIO_SPDM_VMIDMT_SIDR1_ADDR A:0xfc4b5024
y.create.l HWIO_SPDM_VMIDMT_SIDR2_ADDR A:0xfc4b5028
y.create.l HWIO_SPDM_VMIDMT_SIDR4_ADDR A:0xfc4b5030
y.create.l HWIO_SPDM_VMIDMT_SIDR5_ADDR A:0xfc4b5034
y.create.l HWIO_SPDM_VMIDMT_SIDR7_ADDR A:0xfc4b503c
y.create.l HWIO_SPDM_VMIDMT_SGFAR0_ADDR A:0xfc4b5040
y.create.l HWIO_SPDM_VMIDMT_SGFSR_ADDR A:0xfc4b5048
y.create.l HWIO_SPDM_VMIDMT_SGFSRRESTORE_ADDR A:0xfc4b504c
y.create.l HWIO_SPDM_VMIDMT_SGFSYNDR0_ADDR A:0xfc4b5050
y.create.l HWIO_SPDM_VMIDMT_SGFSYNDR1_ADDR A:0xfc4b5054
y.create.l HWIO_SPDM_VMIDMT_SGFSYNDR2_ADDR A:0xfc4b5058
y.create.l HWIO_SPDM_VMIDMT_VMIDMTSCR0_ADDR A:0xfc4b5090
y.create.l HWIO_SPDM_VMIDMT_CR0_ADDR A:0xfc4b5000
y.create.l HWIO_SPDM_VMIDMT_CR2_ADDR A:0xfc4b5008
y.create.l HWIO_SPDM_VMIDMT_ACR_ADDR A:0xfc4b5010
y.create.l HWIO_SPDM_VMIDMT_IDR0_ADDR A:0xfc4b5020
y.create.l HWIO_SPDM_VMIDMT_IDR1_ADDR A:0xfc4b5024
y.create.l HWIO_SPDM_VMIDMT_IDR2_ADDR A:0xfc4b5028
y.create.l HWIO_SPDM_VMIDMT_IDR4_ADDR A:0xfc4b5030
y.create.l HWIO_SPDM_VMIDMT_IDR5_ADDR A:0xfc4b5034
y.create.l HWIO_SPDM_VMIDMT_IDR7_ADDR A:0xfc4b503c
y.create.l HWIO_SPDM_VMIDMT_GFAR0_ADDR A:0xfc4b5040
y.create.l HWIO_SPDM_VMIDMT_GFSR_ADDR A:0xfc4b5048
y.create.l HWIO_SPDM_VMIDMT_GFSRRESTORE_ADDR A:0xfc4b504c
y.create.l HWIO_SPDM_VMIDMT_GFSYNDR0_ADDR A:0xfc4b5050
y.create.l HWIO_SPDM_VMIDMT_GFSYNDR1_ADDR A:0xfc4b5054
y.create.l HWIO_SPDM_VMIDMT_GFSYNDR2_ADDR A:0xfc4b5058
y.create.l HWIO_SPDM_VMIDMT_VMIDMTCR0_ADDR A:0xfc4b5090
y.create.l HWIO_SPDM_VMIDMT_VMIDMTACR_ADDR A:0xfc4b509c
y.create.l HWIO_SPDM_VMIDMT_NSCR0_ADDR A:0xfc4b5400
y.create.l HWIO_SPDM_VMIDMT_NSCR2_ADDR A:0xfc4b5408
y.create.l HWIO_SPDM_VMIDMT_NSACR_ADDR A:0xfc4b5410
y.create.l HWIO_SPDM_VMIDMT_NSGFAR0_ADDR A:0xfc4b5440
y.create.l HWIO_SPDM_VMIDMT_NSGFSR_ADDR A:0xfc4b5448
y.create.l HWIO_SPDM_VMIDMT_NSGFSRRESTORE_ADDR A:0xfc4b544c
y.create.l HWIO_SPDM_VMIDMT_NSGFSYNDR0_ADDR A:0xfc4b5450
y.create.l HWIO_SPDM_VMIDMT_NSGFSYNDR1_ADDR A:0xfc4b5454
y.create.l HWIO_SPDM_VMIDMT_NSGFSYNDR2_ADDR A:0xfc4b5458
y.create.l HWIO_SPDM_VMIDMT_NSVMIDMTCR0_ADDR A:0xfc4b5490
y.create.l HWIO_SPDM_VMIDMT_SSDR0_ADDR A:0xfc4b5080
y.create.l HWIO_SPDM_VMIDMT_S2VR0_ADDR A:0xfc4b5c00
y.create.l HWIO_SPDM_VMIDMT_AS2VR0_ADDR A:0xfc4b5e00
y.create.l HWIO_SNOC_OBS_ID_COREID_ADDR A:0xfc460000
y.create.l HWIO_SNOC_OBS_ID_REVISIONID_ADDR A:0xfc460004
y.create.l HWIO_SNOC_OBS_ERRCTL_ADDR A:0xfc460008
y.create.l HWIO_SNOC_OBS_ERRSTATUS_ADDR A:0xfc46000c
y.create.l HWIO_SNOC_OBS_ERRLOG0_ADDR A:0xfc460010
y.create.l HWIO_SNOC_OBS_ERRLOG1_ADDR A:0xfc460014
y.create.l HWIO_SNOC_OBS_ERRLOG2_ADDR A:0xfc460018
y.create.l HWIO_SNOC_OBS_ERRLOG3_ADDR A:0xfc46001c
y.create.l HWIO_SNOC_OBS_ERRLOG5_ADDR A:0xfc460024
y.create.l HWIO_SNOC_OBS_DBG_ID_COREID_ADDR A:0xfc460080
y.create.l HWIO_SNOC_OBS_DBG_ID_REVISIONID_ADDR A:0xfc460084
y.create.l HWIO_SNOC_OBS_DBG_ATBID_ADDR A:0xfc460088
y.create.l HWIO_SNOC_QHM_LPASS_TFILT_ID_COREID_ADDR A:0xfc461000
y.create.l HWIO_SNOC_QHM_LPASS_TFILT_ID_REVISIONID_ADDR A:0xfc461004
y.create.l HWIO_SNOC_QHM_LPASS_TFILT_MODE_ADDR A:0xfc461008
y.create.l HWIO_SNOC_QHM_LPASS_TFILT_ADDRBASE_LOW_ADDR A:0xfc46100c
y.create.l HWIO_SNOC_QHM_LPASS_TFILT_ADDRWINDOWSIZE_ADDR A:0xfc461014
y.create.l HWIO_SNOC_QHM_LPASS_TFILT_SRCIDBASE_ADDR A:0xfc461018
y.create.l HWIO_SNOC_QHM_LPASS_TFILT_SRCIDMASK_ADDR A:0xfc46101c
y.create.l HWIO_SNOC_QHM_LPASS_TFILT_OPCODE_ADDR A:0xfc461020
y.create.l HWIO_SNOC_QDSS_BAM_TFILT_ID_COREID_ADDR A:0xfc461080
y.create.l HWIO_SNOC_QDSS_BAM_TFILT_ID_REVISIONID_ADDR A:0xfc461084
y.create.l HWIO_SNOC_QDSS_BAM_TFILT_MODE_ADDR A:0xfc461088
y.create.l HWIO_SNOC_QDSS_BAM_TFILT_ADDRBASE_LOW_ADDR A:0xfc46108c
y.create.l HWIO_SNOC_QDSS_BAM_TFILT_ADDRWINDOWSIZE_ADDR A:0xfc461094
y.create.l HWIO_SNOC_QDSS_BAM_TFILT_SRCIDBASE_ADDR A:0xfc461098
y.create.l HWIO_SNOC_QDSS_BAM_TFILT_SRCIDMASK_ADDR A:0xfc46109c
y.create.l HWIO_SNOC_QDSS_BAM_TFILT_OPCODE_ADDR A:0xfc4610a0
y.create.l HWIO_SNOC_CRYPTO0_TFILT_ID_COREID_ADDR A:0xfc461100
y.create.l HWIO_SNOC_CRYPTO0_TFILT_ID_REVISIONID_ADDR A:0xfc461104
y.create.l HWIO_SNOC_CRYPTO0_TFILT_MODE_ADDR A:0xfc461108
y.create.l HWIO_SNOC_CRYPTO0_TFILT_ADDRBASE_LOW_ADDR A:0xfc46110c
y.create.l HWIO_SNOC_CRYPTO0_TFILT_ADDRBASE_HIGH_ADDR A:0xfc461110
y.create.l HWIO_SNOC_CRYPTO0_TFILT_ADDRWINDOWSIZE_ADDR A:0xfc461114
y.create.l HWIO_SNOC_CRYPTO0_TFILT_SRCIDBASE_ADDR A:0xfc461118
y.create.l HWIO_SNOC_CRYPTO0_TFILT_SRCIDMASK_ADDR A:0xfc46111c
y.create.l HWIO_SNOC_CRYPTO0_TFILT_OPCODE_ADDR A:0xfc461120
y.create.l HWIO_SNOC_QXM_LPASS_TFILT_ID_COREID_ADDR A:0xfc461200
y.create.l HWIO_SNOC_QXM_LPASS_TFILT_ID_REVISIONID_ADDR A:0xfc461204
y.create.l HWIO_SNOC_QXM_LPASS_TFILT_MODE_ADDR A:0xfc461208
y.create.l HWIO_SNOC_QXM_LPASS_TFILT_ADDRBASE_LOW_ADDR A:0xfc46120c
y.create.l HWIO_SNOC_QXM_LPASS_TFILT_ADDRBASE_HIGH_ADDR A:0xfc461210
y.create.l HWIO_SNOC_QXM_LPASS_TFILT_ADDRWINDOWSIZE_ADDR A:0xfc461214
y.create.l HWIO_SNOC_QXM_LPASS_TFILT_SRCIDBASE_ADDR A:0xfc461218
y.create.l HWIO_SNOC_QXM_LPASS_TFILT_SRCIDMASK_ADDR A:0xfc46121c
y.create.l HWIO_SNOC_QXM_LPASS_TFILT_OPCODE_ADDR A:0xfc461220
y.create.l HWIO_SNOC_MSS_TFILT_ID_COREID_ADDR A:0xfc461280
y.create.l HWIO_SNOC_MSS_TFILT_ID_REVISIONID_ADDR A:0xfc461284
y.create.l HWIO_SNOC_MSS_TFILT_MODE_ADDR A:0xfc461288
y.create.l HWIO_SNOC_MSS_TFILT_ADDRBASE_LOW_ADDR A:0xfc46128c
y.create.l HWIO_SNOC_MSS_TFILT_ADDRBASE_HIGH_ADDR A:0xfc461290
y.create.l HWIO_SNOC_MSS_TFILT_ADDRWINDOWSIZE_ADDR A:0xfc461294
y.create.l HWIO_SNOC_MSS_TFILT_SRCIDBASE_ADDR A:0xfc461298
y.create.l HWIO_SNOC_MSS_TFILT_SRCIDMASK_ADDR A:0xfc46129c
y.create.l HWIO_SNOC_MSS_TFILT_OPCODE_ADDR A:0xfc4612a0
y.create.l HWIO_SNOC_MSS_NAV_TFILT_ID_COREID_ADDR A:0xfc461300
y.create.l HWIO_SNOC_MSS_NAV_TFILT_ID_REVISIONID_ADDR A:0xfc461304
y.create.l HWIO_SNOC_MSS_NAV_TFILT_MODE_ADDR A:0xfc461308
y.create.l HWIO_SNOC_MSS_NAV_TFILT_ADDRBASE_LOW_ADDR A:0xfc46130c
y.create.l HWIO_SNOC_MSS_NAV_TFILT_ADDRBASE_HIGH_ADDR A:0xfc461310
y.create.l HWIO_SNOC_MSS_NAV_TFILT_ADDRWINDOWSIZE_ADDR A:0xfc461314
y.create.l HWIO_SNOC_MSS_NAV_TFILT_SRCIDBASE_ADDR A:0xfc461318
y.create.l HWIO_SNOC_MSS_NAV_TFILT_SRCIDMASK_ADDR A:0xfc46131c
y.create.l HWIO_SNOC_MSS_NAV_TFILT_OPCODE_ADDR A:0xfc461320
y.create.l HWIO_SNOC_QXM_IPA_TFILT_ID_COREID_ADDR A:0xfc461380
y.create.l HWIO_SNOC_QXM_IPA_TFILT_ID_REVISIONID_ADDR A:0xfc461384
y.create.l HWIO_SNOC_QXM_IPA_TFILT_MODE_ADDR A:0xfc461388
y.create.l HWIO_SNOC_QXM_IPA_TFILT_ADDRBASE_LOW_ADDR A:0xfc46138c
y.create.l HWIO_SNOC_QXM_IPA_TFILT_ADDRBASE_HIGH_ADDR A:0xfc461390
y.create.l HWIO_SNOC_QXM_IPA_TFILT_ADDRWINDOWSIZE_ADDR A:0xfc461394
y.create.l HWIO_SNOC_QXM_IPA_TFILT_SRCIDBASE_ADDR A:0xfc461398
y.create.l HWIO_SNOC_QXM_IPA_TFILT_SRCIDMASK_ADDR A:0xfc46139c
y.create.l HWIO_SNOC_QXM_IPA_TFILT_OPCODE_ADDR A:0xfc4613a0
y.create.l HWIO_SNOC_PNOC_TFILT_ID_COREID_ADDR A:0xfc461400
y.create.l HWIO_SNOC_PNOC_TFILT_ID_REVISIONID_ADDR A:0xfc461404
y.create.l HWIO_SNOC_PNOC_TFILT_MODE_ADDR A:0xfc461408
y.create.l HWIO_SNOC_PNOC_TFILT_ADDRBASE_LOW_ADDR A:0xfc46140c
y.create.l HWIO_SNOC_PNOC_TFILT_ADDRBASE_HIGH_ADDR A:0xfc461410
y.create.l HWIO_SNOC_PNOC_TFILT_ADDRWINDOWSIZE_ADDR A:0xfc461414
y.create.l HWIO_SNOC_PNOC_TFILT_SRCIDBASE_ADDR A:0xfc461418
y.create.l HWIO_SNOC_PNOC_TFILT_SRCIDMASK_ADDR A:0xfc46141c
y.create.l HWIO_SNOC_PNOC_TFILT_OPCODE_ADDR A:0xfc461420
y.create.l HWIO_SNOC_QDSS_ETR_TFILT_ID_COREID_ADDR A:0xfc461500
y.create.l HWIO_SNOC_QDSS_ETR_TFILT_ID_REVISIONID_ADDR A:0xfc461504
y.create.l HWIO_SNOC_QDSS_ETR_TFILT_MODE_ADDR A:0xfc461508
y.create.l HWIO_SNOC_QDSS_ETR_TFILT_ADDRBASE_LOW_ADDR A:0xfc46150c
y.create.l HWIO_SNOC_QDSS_ETR_TFILT_ADDRWINDOWSIZE_ADDR A:0xfc461514
y.create.l HWIO_SNOC_QDSS_ETR_TFILT_SRCIDBASE_ADDR A:0xfc461518
y.create.l HWIO_SNOC_QDSS_ETR_TFILT_SRCIDMASK_ADDR A:0xfc46151c
y.create.l HWIO_SNOC_QDSS_ETR_TFILT_OPCODE_ADDR A:0xfc461520
y.create.l HWIO_SNOC_TPRB0_TPROF_ID_COREID_ADDR A:0xfc461600
y.create.l HWIO_SNOC_TPRB0_TPROF_ID_REVISIONID_ADDR A:0xfc461604
y.create.l HWIO_SNOC_TPRB0_TPROF_EN_ADDR A:0xfc461608
y.create.l HWIO_SNOC_TPRB0_TPROF_MODE_ADDR A:0xfc46160c
y.create.l HWIO_SNOC_TPRB0_TPROF_OBSERVEDSEL_0_ADDR A:0xfc461610
y.create.l HWIO_SNOC_TPRB0_TPROF_OBSERVEDSEL_1_ADDR A:0xfc461614
y.create.l HWIO_SNOC_TPRB0_TPROF_NTENURELINES_0_ADDR A:0xfc461620
y.create.l HWIO_SNOC_TPRB0_TPROF_THRESHOLDS_0_0_ADDR A:0xfc46162c
y.create.l HWIO_SNOC_TPRB0_TPROF_THRESHOLDS_0_1_ADDR A:0xfc461630
y.create.l HWIO_SNOC_TPRB0_TPROF_THRESHOLDS_0_2_ADDR A:0xfc461634
y.create.l HWIO_SNOC_TPRB0_TPROF_THRESHOLDS_1_0_ADDR A:0xfc46163c
y.create.l HWIO_SNOC_TPRB0_TPROF_THRESHOLDS_1_1_ADDR A:0xfc461640
y.create.l HWIO_SNOC_TPRB0_TPROF_THRESHOLDS_1_2_ADDR A:0xfc461644
y.create.l HWIO_SNOC_TPRB0_TPROF_OVERFLOWSTATUS_ADDR A:0xfc46166c
y.create.l HWIO_SNOC_TPRB0_TPROF_OVERFLOWRESET_ADDR A:0xfc461670
y.create.l HWIO_SNOC_TPRB0_TPROF_PENDINGEVENTMODE_ADDR A:0xfc461674
y.create.l HWIO_SNOC_TPRB0_TPROF_PRESCALER_ADDR A:0xfc461678
y.create.l HWIO_SNOC_TPRB1_TPROF_ID_COREID_ADDR A:0xfc461680
y.create.l HWIO_SNOC_TPRB1_TPROF_ID_REVISIONID_ADDR A:0xfc461684
y.create.l HWIO_SNOC_TPRB1_TPROF_EN_ADDR A:0xfc461688
y.create.l HWIO_SNOC_TPRB1_TPROF_MODE_ADDR A:0xfc46168c
y.create.l HWIO_SNOC_TPRB1_TPROF_OBSERVEDSEL_0_ADDR A:0xfc461690
y.create.l HWIO_SNOC_TPRB1_TPROF_OBSERVEDSEL_1_ADDR A:0xfc461694
y.create.l HWIO_SNOC_TPRB1_TPROF_NTENURELINES_0_ADDR A:0xfc4616a0
y.create.l HWIO_SNOC_TPRB1_TPROF_THRESHOLDS_0_0_ADDR A:0xfc4616ac
y.create.l HWIO_SNOC_TPRB1_TPROF_THRESHOLDS_0_1_ADDR A:0xfc4616b0
y.create.l HWIO_SNOC_TPRB1_TPROF_THRESHOLDS_0_2_ADDR A:0xfc4616b4
y.create.l HWIO_SNOC_TPRB1_TPROF_THRESHOLDS_1_0_ADDR A:0xfc4616bc
y.create.l HWIO_SNOC_TPRB1_TPROF_THRESHOLDS_1_1_ADDR A:0xfc4616c0
y.create.l HWIO_SNOC_TPRB1_TPROF_THRESHOLDS_1_2_ADDR A:0xfc4616c4
y.create.l HWIO_SNOC_TPRB1_TPROF_OVERFLOWSTATUS_ADDR A:0xfc4616ec
y.create.l HWIO_SNOC_TPRB1_TPROF_OVERFLOWRESET_ADDR A:0xfc4616f0
y.create.l HWIO_SNOC_TPRB1_TPROF_PENDINGEVENTMODE_ADDR A:0xfc4616f4
y.create.l HWIO_SNOC_TPRB1_TPROF_PRESCALER_ADDR A:0xfc4616f8
y.create.l HWIO_SNOC_TPRB2_TPROF_ID_COREID_ADDR A:0xfc461700
y.create.l HWIO_SNOC_TPRB2_TPROF_ID_REVISIONID_ADDR A:0xfc461704
y.create.l HWIO_SNOC_TPRB2_TPROF_EN_ADDR A:0xfc461708
y.create.l HWIO_SNOC_TPRB2_TPROF_MODE_ADDR A:0xfc46170c
y.create.l HWIO_SNOC_TPRB2_TPROF_OBSERVEDSEL_0_ADDR A:0xfc461710
y.create.l HWIO_SNOC_TPRB2_TPROF_OBSERVEDSEL_1_ADDR A:0xfc461714
y.create.l HWIO_SNOC_TPRB2_TPROF_NTENURELINES_0_ADDR A:0xfc461720
y.create.l HWIO_SNOC_TPRB2_TPROF_THRESHOLDS_0_0_ADDR A:0xfc46172c
y.create.l HWIO_SNOC_TPRB2_TPROF_THRESHOLDS_0_1_ADDR A:0xfc461730
y.create.l HWIO_SNOC_TPRB2_TPROF_THRESHOLDS_0_2_ADDR A:0xfc461734
y.create.l HWIO_SNOC_TPRB2_TPROF_THRESHOLDS_1_0_ADDR A:0xfc46173c
y.create.l HWIO_SNOC_TPRB2_TPROF_THRESHOLDS_1_1_ADDR A:0xfc461740
y.create.l HWIO_SNOC_TPRB2_TPROF_THRESHOLDS_1_2_ADDR A:0xfc461744
y.create.l HWIO_SNOC_TPRB2_TPROF_OVERFLOWSTATUS_ADDR A:0xfc46176c
y.create.l HWIO_SNOC_TPRB2_TPROF_OVERFLOWRESET_ADDR A:0xfc461770
y.create.l HWIO_SNOC_TPRB2_TPROF_PENDINGEVENTMODE_ADDR A:0xfc461774
y.create.l HWIO_SNOC_TPRB2_TPROF_PRESCALER_ADDR A:0xfc461778
y.create.l HWIO_SNOC_EPRB0_SPROF_ID_COREID_ADDR A:0xfc461800
y.create.l HWIO_SNOC_EPRB0_SPROF_ID_REVISIONID_ADDR A:0xfc461804
y.create.l HWIO_SNOC_EPRB0_SPROF_MAINCTL_ADDR A:0xfc461808
y.create.l HWIO_SNOC_EPRB0_SPROF_CFGCTL_ADDR A:0xfc46180c
y.create.l HWIO_SNOC_EPRB0_SPROF_TRACEPORTSEL_ADDR A:0xfc461810
y.create.l HWIO_SNOC_EPRB0_SPROF_FILTERLUT_ADDR A:0xfc461814
y.create.l HWIO_SNOC_EPRB0_SPROF_TRACEALARMEN_ADDR A:0xfc461818
y.create.l HWIO_SNOC_EPRB0_SPROF_TRACEALARMSTATUS_ADDR A:0xfc46181c
y.create.l HWIO_SNOC_EPRB0_SPROF_TRACEALARMCLR_ADDR A:0xfc461820
y.create.l HWIO_SNOC_EPRB0_SPROF_STATPERIOD_ADDR A:0xfc461824
y.create.l HWIO_SNOC_EPRB0_SPROF_STATGO_ADDR A:0xfc461828
y.create.l HWIO_SNOC_EPRB0_SPROF_STATALARMMIN_ADDR A:0xfc46182c
y.create.l HWIO_SNOC_EPRB0_SPROF_STATALARMMAX_ADDR A:0xfc461830
y.create.l HWIO_SNOC_EPRB0_SPROF_STATALARMSTATUS_ADDR A:0xfc461834
y.create.l HWIO_SNOC_EPRB0_SPROF_STATALARMCLR_ADDR A:0xfc461838
y.create.l HWIO_SNOC_EPRB0_SPROF_FILTERS_0_ROUTEIDBASE_ADDR A:0xfc461844
y.create.l HWIO_SNOC_EPRB0_SPROF_FILTERS_0_ROUTEIDMASK_ADDR A:0xfc461848
y.create.l HWIO_SNOC_EPRB0_SPROF_FILTERS_0_ADDRBASE_LOW_ADDR A:0xfc46184c
y.create.l HWIO_SNOC_EPRB0_SPROF_FILTERS_0_ADDRBASE_HIGH_ADDR A:0xfc461850
y.create.l HWIO_SNOC_EPRB0_SPROF_FILTERS_0_WINDOWSIZE_ADDR A:0xfc461854
y.create.l HWIO_SNOC_EPRB0_SPROF_FILTERS_0_OPCODE_ADDR A:0xfc461860
y.create.l HWIO_SNOC_EPRB0_SPROF_FILTERS_0_STATUS_ADDR A:0xfc461864
y.create.l HWIO_SNOC_EPRB0_SPROF_FILTERS_0_LENGTH_ADDR A:0xfc461868
y.create.l HWIO_SNOC_EPRB0_SPROF_FILTERS_0_URGENCY_ADDR A:0xfc46186c
y.create.l HWIO_SNOC_EPRB0_SPROF_FILTERS_1_ROUTEIDBASE_ADDR A:0xfc461880
y.create.l HWIO_SNOC_EPRB0_SPROF_FILTERS_1_ROUTEIDMASK_ADDR A:0xfc461884
y.create.l HWIO_SNOC_EPRB0_SPROF_FILTERS_1_ADDRBASE_LOW_ADDR A:0xfc461888
y.create.l HWIO_SNOC_EPRB0_SPROF_FILTERS_1_ADDRBASE_HIGH_ADDR A:0xfc46188c
y.create.l HWIO_SNOC_EPRB0_SPROF_FILTERS_1_WINDOWSIZE_ADDR A:0xfc461890
y.create.l HWIO_SNOC_EPRB0_SPROF_FILTERS_1_OPCODE_ADDR A:0xfc46189c
y.create.l HWIO_SNOC_EPRB0_SPROF_FILTERS_1_STATUS_ADDR A:0xfc4618a0
y.create.l HWIO_SNOC_EPRB0_SPROF_FILTERS_1_LENGTH_ADDR A:0xfc4618a4
y.create.l HWIO_SNOC_EPRB0_SPROF_FILTERS_1_URGENCY_ADDR A:0xfc4618a8
y.create.l HWIO_SNOC_EPRB0_SPROF_FILTERS_2_ROUTEIDBASE_ADDR A:0xfc4618bc
y.create.l HWIO_SNOC_EPRB0_SPROF_FILTERS_2_ROUTEIDMASK_ADDR A:0xfc4618c0
y.create.l HWIO_SNOC_EPRB0_SPROF_FILTERS_2_ADDRBASE_LOW_ADDR A:0xfc4618c4
y.create.l HWIO_SNOC_EPRB0_SPROF_FILTERS_2_ADDRBASE_HIGH_ADDR A:0xfc4618c8
y.create.l HWIO_SNOC_EPRB0_SPROF_FILTERS_2_WINDOWSIZE_ADDR A:0xfc4618cc
y.create.l HWIO_SNOC_EPRB0_SPROF_FILTERS_2_OPCODE_ADDR A:0xfc4618d8
y.create.l HWIO_SNOC_EPRB0_SPROF_FILTERS_2_STATUS_ADDR A:0xfc4618dc
y.create.l HWIO_SNOC_EPRB0_SPROF_FILTERS_2_LENGTH_ADDR A:0xfc4618e0
y.create.l HWIO_SNOC_EPRB0_SPROF_FILTERS_2_URGENCY_ADDR A:0xfc4618e4
y.create.l HWIO_SNOC_EPRB0_SPROF_FILTERS_3_ROUTEIDBASE_ADDR A:0xfc4618f8
y.create.l HWIO_SNOC_EPRB0_SPROF_FILTERS_3_ROUTEIDMASK_ADDR A:0xfc4618fc
y.create.l HWIO_SNOC_EPRB0_SPROF_FILTERS_3_ADDRBASE_LOW_ADDR A:0xfc461900
y.create.l HWIO_SNOC_EPRB0_SPROF_FILTERS_3_ADDRBASE_HIGH_ADDR A:0xfc461904
y.create.l HWIO_SNOC_EPRB0_SPROF_FILTERS_3_WINDOWSIZE_ADDR A:0xfc461908
y.create.l HWIO_SNOC_EPRB0_SPROF_FILTERS_3_OPCODE_ADDR A:0xfc461914
y.create.l HWIO_SNOC_EPRB0_SPROF_FILTERS_3_STATUS_ADDR A:0xfc461918
y.create.l HWIO_SNOC_EPRB0_SPROF_FILTERS_3_LENGTH_ADDR A:0xfc46191c
y.create.l HWIO_SNOC_EPRB0_SPROF_FILTERS_3_URGENCY_ADDR A:0xfc461920
y.create.l HWIO_SNOC_EPRB0_SPROF_COUNTERS_0_PORTSEL_ADDR A:0xfc461934
y.create.l HWIO_SNOC_EPRB0_SPROF_COUNTERS_0_SRC_ADDR A:0xfc461938
y.create.l HWIO_SNOC_EPRB0_SPROF_COUNTERS_0_ALARMMODE_ADDR A:0xfc46193c
y.create.l HWIO_SNOC_EPRB0_SPROF_COUNTERS_0_VAL_ADDR A:0xfc461940
y.create.l HWIO_SNOC_EPRB0_SPROF_COUNTERS_1_PORTSEL_ADDR A:0xfc461948
y.create.l HWIO_SNOC_EPRB0_SPROF_COUNTERS_1_SRC_ADDR A:0xfc46194c
y.create.l HWIO_SNOC_EPRB0_SPROF_COUNTERS_1_ALARMMODE_ADDR A:0xfc461950
y.create.l HWIO_SNOC_EPRB0_SPROF_COUNTERS_1_VAL_ADDR A:0xfc461954
y.create.l HWIO_SNOC_EPRB0_SPROF_COUNTERS_2_PORTSEL_ADDR A:0xfc46195c
y.create.l HWIO_SNOC_EPRB0_SPROF_COUNTERS_2_SRC_ADDR A:0xfc461960
y.create.l HWIO_SNOC_EPRB0_SPROF_COUNTERS_2_ALARMMODE_ADDR A:0xfc461964
y.create.l HWIO_SNOC_EPRB0_SPROF_COUNTERS_2_VAL_ADDR A:0xfc461968
y.create.l HWIO_SNOC_EPRB0_SPROF_COUNTERS_3_PORTSEL_ADDR A:0xfc461970
y.create.l HWIO_SNOC_EPRB0_SPROF_COUNTERS_3_SRC_ADDR A:0xfc461974
y.create.l HWIO_SNOC_EPRB0_SPROF_COUNTERS_3_ALARMMODE_ADDR A:0xfc461978
y.create.l HWIO_SNOC_EPRB0_SPROF_COUNTERS_3_VAL_ADDR A:0xfc46197c
y.create.l HWIO_SNOC_EPRB0_SPROF_COUNTERS_4_PORTSEL_ADDR A:0xfc461984
y.create.l HWIO_SNOC_EPRB0_SPROF_COUNTERS_4_SRC_ADDR A:0xfc461988
y.create.l HWIO_SNOC_EPRB0_SPROF_COUNTERS_4_ALARMMODE_ADDR A:0xfc46198c
y.create.l HWIO_SNOC_EPRB0_SPROF_COUNTERS_4_VAL_ADDR A:0xfc461990
y.create.l HWIO_SNOC_EPRB0_SPROF_COUNTERS_5_PORTSEL_ADDR A:0xfc461998
y.create.l HWIO_SNOC_EPRB0_SPROF_COUNTERS_5_SRC_ADDR A:0xfc46199c
y.create.l HWIO_SNOC_EPRB0_SPROF_COUNTERS_5_ALARMMODE_ADDR A:0xfc4619a0
y.create.l HWIO_SNOC_EPRB0_SPROF_COUNTERS_5_VAL_ADDR A:0xfc4619a4
y.create.l HWIO_SNOC_EPRB0_SPROF_COUNTERS_6_PORTSEL_ADDR A:0xfc4619ac
y.create.l HWIO_SNOC_EPRB0_SPROF_COUNTERS_6_SRC_ADDR A:0xfc4619b0
y.create.l HWIO_SNOC_EPRB0_SPROF_COUNTERS_6_ALARMMODE_ADDR A:0xfc4619b4
y.create.l HWIO_SNOC_EPRB0_SPROF_COUNTERS_6_VAL_ADDR A:0xfc4619b8
y.create.l HWIO_SNOC_EPRB0_SPROF_COUNTERS_7_PORTSEL_ADDR A:0xfc4619c0
y.create.l HWIO_SNOC_EPRB0_SPROF_COUNTERS_7_SRC_ADDR A:0xfc4619c4
y.create.l HWIO_SNOC_EPRB0_SPROF_COUNTERS_7_ALARMMODE_ADDR A:0xfc4619c8
y.create.l HWIO_SNOC_EPRB0_SPROF_COUNTERS_7_VAL_ADDR A:0xfc4619cc
y.create.l HWIO_SNOC_EPRB0_SPROF_COUNTERS_8_PORTSEL_ADDR A:0xfc4619d4
y.create.l HWIO_SNOC_EPRB0_SPROF_COUNTERS_8_SRC_ADDR A:0xfc4619d8
y.create.l HWIO_SNOC_EPRB0_SPROF_COUNTERS_8_ALARMMODE_ADDR A:0xfc4619dc
y.create.l HWIO_SNOC_EPRB0_SPROF_COUNTERS_8_VAL_ADDR A:0xfc4619e0
y.create.l HWIO_SNOC_EPRB0_SPROF_COUNTERS_9_PORTSEL_ADDR A:0xfc4619e8
y.create.l HWIO_SNOC_EPRB0_SPROF_COUNTERS_9_SRC_ADDR A:0xfc4619ec
y.create.l HWIO_SNOC_EPRB0_SPROF_COUNTERS_9_ALARMMODE_ADDR A:0xfc4619f0
y.create.l HWIO_SNOC_EPRB0_SPROF_COUNTERS_9_VAL_ADDR A:0xfc4619f4
y.create.l HWIO_SNOC_EPRB1_SPROF_ID_COREID_ADDR A:0xfc461c00
y.create.l HWIO_SNOC_EPRB1_SPROF_ID_REVISIONID_ADDR A:0xfc461c04
y.create.l HWIO_SNOC_EPRB1_SPROF_MAINCTL_ADDR A:0xfc461c08
y.create.l HWIO_SNOC_EPRB1_SPROF_CFGCTL_ADDR A:0xfc461c0c
y.create.l HWIO_SNOC_EPRB1_SPROF_TRACEPORTSEL_ADDR A:0xfc461c10
y.create.l HWIO_SNOC_EPRB1_SPROF_FILTERLUT_ADDR A:0xfc461c14
y.create.l HWIO_SNOC_EPRB1_SPROF_TRACEALARMEN_ADDR A:0xfc461c18
y.create.l HWIO_SNOC_EPRB1_SPROF_TRACEALARMSTATUS_ADDR A:0xfc461c1c
y.create.l HWIO_SNOC_EPRB1_SPROF_TRACEALARMCLR_ADDR A:0xfc461c20
y.create.l HWIO_SNOC_EPRB1_SPROF_STATPERIOD_ADDR A:0xfc461c24
y.create.l HWIO_SNOC_EPRB1_SPROF_STATGO_ADDR A:0xfc461c28
y.create.l HWIO_SNOC_EPRB1_SPROF_STATALARMMIN_ADDR A:0xfc461c2c
y.create.l HWIO_SNOC_EPRB1_SPROF_STATALARMMAX_ADDR A:0xfc461c30
y.create.l HWIO_SNOC_EPRB1_SPROF_STATALARMSTATUS_ADDR A:0xfc461c34
y.create.l HWIO_SNOC_EPRB1_SPROF_STATALARMCLR_ADDR A:0xfc461c38
y.create.l HWIO_SNOC_EPRB1_SPROF_FILTERS_0_ROUTEIDBASE_ADDR A:0xfc461c44
y.create.l HWIO_SNOC_EPRB1_SPROF_FILTERS_0_ROUTEIDMASK_ADDR A:0xfc461c48
y.create.l HWIO_SNOC_EPRB1_SPROF_FILTERS_0_ADDRBASE_LOW_ADDR A:0xfc461c4c
y.create.l HWIO_SNOC_EPRB1_SPROF_FILTERS_0_ADDRBASE_HIGH_ADDR A:0xfc461c50
y.create.l HWIO_SNOC_EPRB1_SPROF_FILTERS_0_WINDOWSIZE_ADDR A:0xfc461c54
y.create.l HWIO_SNOC_EPRB1_SPROF_FILTERS_0_OPCODE_ADDR A:0xfc461c60
y.create.l HWIO_SNOC_EPRB1_SPROF_FILTERS_0_STATUS_ADDR A:0xfc461c64
y.create.l HWIO_SNOC_EPRB1_SPROF_FILTERS_0_LENGTH_ADDR A:0xfc461c68
y.create.l HWIO_SNOC_EPRB1_SPROF_FILTERS_0_URGENCY_ADDR A:0xfc461c6c
y.create.l HWIO_SNOC_EPRB1_SPROF_FILTERS_1_ROUTEIDBASE_ADDR A:0xfc461c80
y.create.l HWIO_SNOC_EPRB1_SPROF_FILTERS_1_ROUTEIDMASK_ADDR A:0xfc461c84
y.create.l HWIO_SNOC_EPRB1_SPROF_FILTERS_1_ADDRBASE_LOW_ADDR A:0xfc461c88
y.create.l HWIO_SNOC_EPRB1_SPROF_FILTERS_1_ADDRBASE_HIGH_ADDR A:0xfc461c8c
y.create.l HWIO_SNOC_EPRB1_SPROF_FILTERS_1_WINDOWSIZE_ADDR A:0xfc461c90
y.create.l HWIO_SNOC_EPRB1_SPROF_FILTERS_1_OPCODE_ADDR A:0xfc461c9c
y.create.l HWIO_SNOC_EPRB1_SPROF_FILTERS_1_STATUS_ADDR A:0xfc461ca0
y.create.l HWIO_SNOC_EPRB1_SPROF_FILTERS_1_LENGTH_ADDR A:0xfc461ca4
y.create.l HWIO_SNOC_EPRB1_SPROF_FILTERS_1_URGENCY_ADDR A:0xfc461ca8
y.create.l HWIO_SNOC_EPRB1_SPROF_FILTERS_2_ROUTEIDBASE_ADDR A:0xfc461cbc
y.create.l HWIO_SNOC_EPRB1_SPROF_FILTERS_2_ROUTEIDMASK_ADDR A:0xfc461cc0
y.create.l HWIO_SNOC_EPRB1_SPROF_FILTERS_2_ADDRBASE_LOW_ADDR A:0xfc461cc4
y.create.l HWIO_SNOC_EPRB1_SPROF_FILTERS_2_ADDRBASE_HIGH_ADDR A:0xfc461cc8
y.create.l HWIO_SNOC_EPRB1_SPROF_FILTERS_2_WINDOWSIZE_ADDR A:0xfc461ccc
y.create.l HWIO_SNOC_EPRB1_SPROF_FILTERS_2_OPCODE_ADDR A:0xfc461cd8
y.create.l HWIO_SNOC_EPRB1_SPROF_FILTERS_2_STATUS_ADDR A:0xfc461cdc
y.create.l HWIO_SNOC_EPRB1_SPROF_FILTERS_2_LENGTH_ADDR A:0xfc461ce0
y.create.l HWIO_SNOC_EPRB1_SPROF_FILTERS_2_URGENCY_ADDR A:0xfc461ce4
y.create.l HWIO_SNOC_EPRB1_SPROF_FILTERS_3_ROUTEIDBASE_ADDR A:0xfc461cf8
y.create.l HWIO_SNOC_EPRB1_SPROF_FILTERS_3_ROUTEIDMASK_ADDR A:0xfc461cfc
y.create.l HWIO_SNOC_EPRB1_SPROF_FILTERS_3_ADDRBASE_LOW_ADDR A:0xfc461d00
y.create.l HWIO_SNOC_EPRB1_SPROF_FILTERS_3_ADDRBASE_HIGH_ADDR A:0xfc461d04
y.create.l HWIO_SNOC_EPRB1_SPROF_FILTERS_3_WINDOWSIZE_ADDR A:0xfc461d08
y.create.l HWIO_SNOC_EPRB1_SPROF_FILTERS_3_OPCODE_ADDR A:0xfc461d14
y.create.l HWIO_SNOC_EPRB1_SPROF_FILTERS_3_STATUS_ADDR A:0xfc461d18
y.create.l HWIO_SNOC_EPRB1_SPROF_FILTERS_3_LENGTH_ADDR A:0xfc461d1c
y.create.l HWIO_SNOC_EPRB1_SPROF_FILTERS_3_URGENCY_ADDR A:0xfc461d20
y.create.l HWIO_SNOC_EPRB1_SPROF_COUNTERS_0_PORTSEL_ADDR A:0xfc461d34
y.create.l HWIO_SNOC_EPRB1_SPROF_COUNTERS_0_SRC_ADDR A:0xfc461d38
y.create.l HWIO_SNOC_EPRB1_SPROF_COUNTERS_0_ALARMMODE_ADDR A:0xfc461d3c
y.create.l HWIO_SNOC_EPRB1_SPROF_COUNTERS_0_VAL_ADDR A:0xfc461d40
y.create.l HWIO_SNOC_EPRB1_SPROF_COUNTERS_1_PORTSEL_ADDR A:0xfc461d48
y.create.l HWIO_SNOC_EPRB1_SPROF_COUNTERS_1_SRC_ADDR A:0xfc461d4c
y.create.l HWIO_SNOC_EPRB1_SPROF_COUNTERS_1_ALARMMODE_ADDR A:0xfc461d50
y.create.l HWIO_SNOC_EPRB1_SPROF_COUNTERS_1_VAL_ADDR A:0xfc461d54
y.create.l HWIO_SNOC_EPRB1_SPROF_COUNTERS_2_PORTSEL_ADDR A:0xfc461d5c
y.create.l HWIO_SNOC_EPRB1_SPROF_COUNTERS_2_SRC_ADDR A:0xfc461d60
y.create.l HWIO_SNOC_EPRB1_SPROF_COUNTERS_2_ALARMMODE_ADDR A:0xfc461d64
y.create.l HWIO_SNOC_EPRB1_SPROF_COUNTERS_2_VAL_ADDR A:0xfc461d68
y.create.l HWIO_SNOC_EPRB1_SPROF_COUNTERS_3_PORTSEL_ADDR A:0xfc461d70
y.create.l HWIO_SNOC_EPRB1_SPROF_COUNTERS_3_SRC_ADDR A:0xfc461d74
y.create.l HWIO_SNOC_EPRB1_SPROF_COUNTERS_3_ALARMMODE_ADDR A:0xfc461d78
y.create.l HWIO_SNOC_EPRB1_SPROF_COUNTERS_3_VAL_ADDR A:0xfc461d7c
y.create.l HWIO_SNOC_EPRB1_SPROF_COUNTERS_4_PORTSEL_ADDR A:0xfc461d84
y.create.l HWIO_SNOC_EPRB1_SPROF_COUNTERS_4_SRC_ADDR A:0xfc461d88
y.create.l HWIO_SNOC_EPRB1_SPROF_COUNTERS_4_ALARMMODE_ADDR A:0xfc461d8c
y.create.l HWIO_SNOC_EPRB1_SPROF_COUNTERS_4_VAL_ADDR A:0xfc461d90
y.create.l HWIO_SNOC_EPRB1_SPROF_COUNTERS_5_PORTSEL_ADDR A:0xfc461d98
y.create.l HWIO_SNOC_EPRB1_SPROF_COUNTERS_5_SRC_ADDR A:0xfc461d9c
y.create.l HWIO_SNOC_EPRB1_SPROF_COUNTERS_5_ALARMMODE_ADDR A:0xfc461da0
y.create.l HWIO_SNOC_EPRB1_SPROF_COUNTERS_5_VAL_ADDR A:0xfc461da4
y.create.l HWIO_SNOC_EPRB1_SPROF_COUNTERS_6_PORTSEL_ADDR A:0xfc461dac
y.create.l HWIO_SNOC_EPRB1_SPROF_COUNTERS_6_SRC_ADDR A:0xfc461db0
y.create.l HWIO_SNOC_EPRB1_SPROF_COUNTERS_6_ALARMMODE_ADDR A:0xfc461db4
y.create.l HWIO_SNOC_EPRB1_SPROF_COUNTERS_6_VAL_ADDR A:0xfc461db8
y.create.l HWIO_SNOC_EPRB1_SPROF_COUNTERS_7_PORTSEL_ADDR A:0xfc461dc0
y.create.l HWIO_SNOC_EPRB1_SPROF_COUNTERS_7_SRC_ADDR A:0xfc461dc4
y.create.l HWIO_SNOC_EPRB1_SPROF_COUNTERS_7_ALARMMODE_ADDR A:0xfc461dc8
y.create.l HWIO_SNOC_EPRB1_SPROF_COUNTERS_7_VAL_ADDR A:0xfc461dcc
y.create.l HWIO_SNOC_EPRB1_SPROF_COUNTERS_8_PORTSEL_ADDR A:0xfc461dd4
y.create.l HWIO_SNOC_EPRB1_SPROF_COUNTERS_8_SRC_ADDR A:0xfc461dd8
y.create.l HWIO_SNOC_EPRB1_SPROF_COUNTERS_8_ALARMMODE_ADDR A:0xfc461ddc
y.create.l HWIO_SNOC_EPRB1_SPROF_COUNTERS_8_VAL_ADDR A:0xfc461de0
y.create.l HWIO_SNOC_EPRB1_SPROF_COUNTERS_9_PORTSEL_ADDR A:0xfc461de8
y.create.l HWIO_SNOC_EPRB1_SPROF_COUNTERS_9_SRC_ADDR A:0xfc461dec
y.create.l HWIO_SNOC_EPRB1_SPROF_COUNTERS_9_ALARMMODE_ADDR A:0xfc461df0
y.create.l HWIO_SNOC_EPRB1_SPROF_COUNTERS_9_VAL_ADDR A:0xfc461df4
y.create.l HWIO_SNOC_TPRB0_SPROF_ID_COREID_ADDR A:0xfc462000
y.create.l HWIO_SNOC_TPRB0_SPROF_ID_REVISIONID_ADDR A:0xfc462004
y.create.l HWIO_SNOC_TPRB0_SPROF_MAINCTL_ADDR A:0xfc462008
y.create.l HWIO_SNOC_TPRB0_SPROF_CFGCTL_ADDR A:0xfc46200c
y.create.l HWIO_SNOC_TPRB0_SPROF_STATPERIOD_ADDR A:0xfc462024
y.create.l HWIO_SNOC_TPRB0_SPROF_STATGO_ADDR A:0xfc462028
y.create.l HWIO_SNOC_TPRB0_SPROF_STATALARMMIN_ADDR A:0xfc46202c
y.create.l HWIO_SNOC_TPRB0_SPROF_STATALARMMAX_ADDR A:0xfc462030
y.create.l HWIO_SNOC_TPRB0_SPROF_STATALARMSTATUS_ADDR A:0xfc462034
y.create.l HWIO_SNOC_TPRB0_SPROF_STATALARMCLR_ADDR A:0xfc462038
y.create.l HWIO_SNOC_TPRB0_SPROF_COUNTERS_0_SRC_ADDR A:0xfc462138
y.create.l HWIO_SNOC_TPRB0_SPROF_COUNTERS_0_ALARMMODE_ADDR A:0xfc46213c
y.create.l HWIO_SNOC_TPRB0_SPROF_COUNTERS_0_VAL_ADDR A:0xfc462140
y.create.l HWIO_SNOC_TPRB0_SPROF_COUNTERS_1_SRC_ADDR A:0xfc46214c
y.create.l HWIO_SNOC_TPRB0_SPROF_COUNTERS_1_ALARMMODE_ADDR A:0xfc462150
y.create.l HWIO_SNOC_TPRB0_SPROF_COUNTERS_1_VAL_ADDR A:0xfc462154
y.create.l HWIO_SNOC_TPRB0_SPROF_COUNTERS_2_SRC_ADDR A:0xfc462160
y.create.l HWIO_SNOC_TPRB0_SPROF_COUNTERS_2_ALARMMODE_ADDR A:0xfc462164
y.create.l HWIO_SNOC_TPRB0_SPROF_COUNTERS_2_VAL_ADDR A:0xfc462168
y.create.l HWIO_SNOC_TPRB0_SPROF_COUNTERS_3_SRC_ADDR A:0xfc462174
y.create.l HWIO_SNOC_TPRB0_SPROF_COUNTERS_3_ALARMMODE_ADDR A:0xfc462178
y.create.l HWIO_SNOC_TPRB0_SPROF_COUNTERS_3_VAL_ADDR A:0xfc46217c
y.create.l HWIO_SNOC_TPRB0_SPROF_COUNTERS_4_SRC_ADDR A:0xfc462188
y.create.l HWIO_SNOC_TPRB0_SPROF_COUNTERS_4_ALARMMODE_ADDR A:0xfc46218c
y.create.l HWIO_SNOC_TPRB0_SPROF_COUNTERS_4_VAL_ADDR A:0xfc462190
y.create.l HWIO_SNOC_TPRB0_SPROF_COUNTERS_5_SRC_ADDR A:0xfc46219c
y.create.l HWIO_SNOC_TPRB0_SPROF_COUNTERS_5_ALARMMODE_ADDR A:0xfc4621a0
y.create.l HWIO_SNOC_TPRB0_SPROF_COUNTERS_5_VAL_ADDR A:0xfc4621a4
y.create.l HWIO_SNOC_TPRB0_SPROF_COUNTERS_6_SRC_ADDR A:0xfc4621b0
y.create.l HWIO_SNOC_TPRB0_SPROF_COUNTERS_6_ALARMMODE_ADDR A:0xfc4621b4
y.create.l HWIO_SNOC_TPRB0_SPROF_COUNTERS_6_VAL_ADDR A:0xfc4621b8
y.create.l HWIO_SNOC_TPRB0_SPROF_COUNTERS_7_SRC_ADDR A:0xfc4621c4
y.create.l HWIO_SNOC_TPRB0_SPROF_COUNTERS_7_ALARMMODE_ADDR A:0xfc4621c8
y.create.l HWIO_SNOC_TPRB0_SPROF_COUNTERS_7_VAL_ADDR A:0xfc4621cc
y.create.l HWIO_SNOC_TPRB0_SPROF_COUNTERS_8_SRC_ADDR A:0xfc4621d8
y.create.l HWIO_SNOC_TPRB0_SPROF_COUNTERS_8_ALARMMODE_ADDR A:0xfc4621dc
y.create.l HWIO_SNOC_TPRB0_SPROF_COUNTERS_8_VAL_ADDR A:0xfc4621e0
y.create.l HWIO_SNOC_TPRB0_SPROF_COUNTERS_9_SRC_ADDR A:0xfc4621ec
y.create.l HWIO_SNOC_TPRB0_SPROF_COUNTERS_9_ALARMMODE_ADDR A:0xfc4621f0
y.create.l HWIO_SNOC_TPRB0_SPROF_COUNTERS_9_VAL_ADDR A:0xfc4621f4
y.create.l HWIO_SNOC_TPRB0_SPROF_COUNTERS_10_SRC_ADDR A:0xfc462200
y.create.l HWIO_SNOC_TPRB0_SPROF_COUNTERS_10_ALARMMODE_ADDR A:0xfc462204
y.create.l HWIO_SNOC_TPRB0_SPROF_COUNTERS_10_VAL_ADDR A:0xfc462208
y.create.l HWIO_SNOC_TPRB0_SPROF_COUNTERS_11_SRC_ADDR A:0xfc462214
y.create.l HWIO_SNOC_TPRB0_SPROF_COUNTERS_11_ALARMMODE_ADDR A:0xfc462218
y.create.l HWIO_SNOC_TPRB0_SPROF_COUNTERS_11_VAL_ADDR A:0xfc46221c
y.create.l HWIO_SNOC_TPRB0_SPROF_COUNTERS_12_SRC_ADDR A:0xfc462228
y.create.l HWIO_SNOC_TPRB0_SPROF_COUNTERS_12_ALARMMODE_ADDR A:0xfc46222c
y.create.l HWIO_SNOC_TPRB0_SPROF_COUNTERS_12_VAL_ADDR A:0xfc462230
y.create.l HWIO_SNOC_TPRB0_SPROF_COUNTERS_13_SRC_ADDR A:0xfc46223c
y.create.l HWIO_SNOC_TPRB0_SPROF_COUNTERS_13_ALARMMODE_ADDR A:0xfc462240
y.create.l HWIO_SNOC_TPRB0_SPROF_COUNTERS_13_VAL_ADDR A:0xfc462244
y.create.l HWIO_SNOC_TPRB0_SPROF_COUNTERS_14_SRC_ADDR A:0xfc462250
y.create.l HWIO_SNOC_TPRB0_SPROF_COUNTERS_14_ALARMMODE_ADDR A:0xfc462254
y.create.l HWIO_SNOC_TPRB0_SPROF_COUNTERS_14_VAL_ADDR A:0xfc462258
y.create.l HWIO_SNOC_TPRB0_SPROF_COUNTERS_15_SRC_ADDR A:0xfc462264
y.create.l HWIO_SNOC_TPRB0_SPROF_COUNTERS_15_ALARMMODE_ADDR A:0xfc462268
y.create.l HWIO_SNOC_TPRB0_SPROF_COUNTERS_15_VAL_ADDR A:0xfc46226c
y.create.l HWIO_SNOC_TPRB1_SPROF_ID_COREID_ADDR A:0xfc462400
y.create.l HWIO_SNOC_TPRB1_SPROF_ID_REVISIONID_ADDR A:0xfc462404
y.create.l HWIO_SNOC_TPRB1_SPROF_MAINCTL_ADDR A:0xfc462408
y.create.l HWIO_SNOC_TPRB1_SPROF_CFGCTL_ADDR A:0xfc46240c
y.create.l HWIO_SNOC_TPRB1_SPROF_STATPERIOD_ADDR A:0xfc462424
y.create.l HWIO_SNOC_TPRB1_SPROF_STATGO_ADDR A:0xfc462428
y.create.l HWIO_SNOC_TPRB1_SPROF_STATALARMMIN_ADDR A:0xfc46242c
y.create.l HWIO_SNOC_TPRB1_SPROF_STATALARMMAX_ADDR A:0xfc462430
y.create.l HWIO_SNOC_TPRB1_SPROF_STATALARMSTATUS_ADDR A:0xfc462434
y.create.l HWIO_SNOC_TPRB1_SPROF_STATALARMCLR_ADDR A:0xfc462438
y.create.l HWIO_SNOC_TPRB1_SPROF_COUNTERS_0_SRC_ADDR A:0xfc462538
y.create.l HWIO_SNOC_TPRB1_SPROF_COUNTERS_0_ALARMMODE_ADDR A:0xfc46253c
y.create.l HWIO_SNOC_TPRB1_SPROF_COUNTERS_0_VAL_ADDR A:0xfc462540
y.create.l HWIO_SNOC_TPRB1_SPROF_COUNTERS_1_SRC_ADDR A:0xfc46254c
y.create.l HWIO_SNOC_TPRB1_SPROF_COUNTERS_1_ALARMMODE_ADDR A:0xfc462550
y.create.l HWIO_SNOC_TPRB1_SPROF_COUNTERS_1_VAL_ADDR A:0xfc462554
y.create.l HWIO_SNOC_TPRB1_SPROF_COUNTERS_2_SRC_ADDR A:0xfc462560
y.create.l HWIO_SNOC_TPRB1_SPROF_COUNTERS_2_ALARMMODE_ADDR A:0xfc462564
y.create.l HWIO_SNOC_TPRB1_SPROF_COUNTERS_2_VAL_ADDR A:0xfc462568
y.create.l HWIO_SNOC_TPRB1_SPROF_COUNTERS_3_SRC_ADDR A:0xfc462574
y.create.l HWIO_SNOC_TPRB1_SPROF_COUNTERS_3_ALARMMODE_ADDR A:0xfc462578
y.create.l HWIO_SNOC_TPRB1_SPROF_COUNTERS_3_VAL_ADDR A:0xfc46257c
y.create.l HWIO_SNOC_TPRB1_SPROF_COUNTERS_4_SRC_ADDR A:0xfc462588
y.create.l HWIO_SNOC_TPRB1_SPROF_COUNTERS_4_ALARMMODE_ADDR A:0xfc46258c
y.create.l HWIO_SNOC_TPRB1_SPROF_COUNTERS_4_VAL_ADDR A:0xfc462590
y.create.l HWIO_SNOC_TPRB1_SPROF_COUNTERS_5_SRC_ADDR A:0xfc46259c
y.create.l HWIO_SNOC_TPRB1_SPROF_COUNTERS_5_ALARMMODE_ADDR A:0xfc4625a0
y.create.l HWIO_SNOC_TPRB1_SPROF_COUNTERS_5_VAL_ADDR A:0xfc4625a4
y.create.l HWIO_SNOC_TPRB1_SPROF_COUNTERS_6_SRC_ADDR A:0xfc4625b0
y.create.l HWIO_SNOC_TPRB1_SPROF_COUNTERS_6_ALARMMODE_ADDR A:0xfc4625b4
y.create.l HWIO_SNOC_TPRB1_SPROF_COUNTERS_6_VAL_ADDR A:0xfc4625b8
y.create.l HWIO_SNOC_TPRB1_SPROF_COUNTERS_7_SRC_ADDR A:0xfc4625c4
y.create.l HWIO_SNOC_TPRB1_SPROF_COUNTERS_7_ALARMMODE_ADDR A:0xfc4625c8
y.create.l HWIO_SNOC_TPRB1_SPROF_COUNTERS_7_VAL_ADDR A:0xfc4625cc
y.create.l HWIO_SNOC_TPRB1_SPROF_COUNTERS_8_SRC_ADDR A:0xfc4625d8
y.create.l HWIO_SNOC_TPRB1_SPROF_COUNTERS_8_ALARMMODE_ADDR A:0xfc4625dc
y.create.l HWIO_SNOC_TPRB1_SPROF_COUNTERS_8_VAL_ADDR A:0xfc4625e0
y.create.l HWIO_SNOC_TPRB1_SPROF_COUNTERS_9_SRC_ADDR A:0xfc4625ec
y.create.l HWIO_SNOC_TPRB1_SPROF_COUNTERS_9_ALARMMODE_ADDR A:0xfc4625f0
y.create.l HWIO_SNOC_TPRB1_SPROF_COUNTERS_9_VAL_ADDR A:0xfc4625f4
y.create.l HWIO_SNOC_TPRB1_SPROF_COUNTERS_10_SRC_ADDR A:0xfc462600
y.create.l HWIO_SNOC_TPRB1_SPROF_COUNTERS_10_ALARMMODE_ADDR A:0xfc462604
y.create.l HWIO_SNOC_TPRB1_SPROF_COUNTERS_10_VAL_ADDR A:0xfc462608
y.create.l HWIO_SNOC_TPRB1_SPROF_COUNTERS_11_SRC_ADDR A:0xfc462614
y.create.l HWIO_SNOC_TPRB1_SPROF_COUNTERS_11_ALARMMODE_ADDR A:0xfc462618
y.create.l HWIO_SNOC_TPRB1_SPROF_COUNTERS_11_VAL_ADDR A:0xfc46261c
y.create.l HWIO_SNOC_TPRB1_SPROF_COUNTERS_12_SRC_ADDR A:0xfc462628
y.create.l HWIO_SNOC_TPRB1_SPROF_COUNTERS_12_ALARMMODE_ADDR A:0xfc46262c
y.create.l HWIO_SNOC_TPRB1_SPROF_COUNTERS_12_VAL_ADDR A:0xfc462630
y.create.l HWIO_SNOC_TPRB1_SPROF_COUNTERS_13_SRC_ADDR A:0xfc46263c
y.create.l HWIO_SNOC_TPRB1_SPROF_COUNTERS_13_ALARMMODE_ADDR A:0xfc462640
y.create.l HWIO_SNOC_TPRB1_SPROF_COUNTERS_13_VAL_ADDR A:0xfc462644
y.create.l HWIO_SNOC_TPRB1_SPROF_COUNTERS_14_SRC_ADDR A:0xfc462650
y.create.l HWIO_SNOC_TPRB1_SPROF_COUNTERS_14_ALARMMODE_ADDR A:0xfc462654
y.create.l HWIO_SNOC_TPRB1_SPROF_COUNTERS_14_VAL_ADDR A:0xfc462658
y.create.l HWIO_SNOC_TPRB1_SPROF_COUNTERS_15_SRC_ADDR A:0xfc462664
y.create.l HWIO_SNOC_TPRB1_SPROF_COUNTERS_15_ALARMMODE_ADDR A:0xfc462668
y.create.l HWIO_SNOC_TPRB1_SPROF_COUNTERS_15_VAL_ADDR A:0xfc46266c
y.create.l HWIO_SNOC_TPRB2_SPROF_ID_COREID_ADDR A:0xfc462800
y.create.l HWIO_SNOC_TPRB2_SPROF_ID_REVISIONID_ADDR A:0xfc462804
y.create.l HWIO_SNOC_TPRB2_SPROF_MAINCTL_ADDR A:0xfc462808
y.create.l HWIO_SNOC_TPRB2_SPROF_CFGCTL_ADDR A:0xfc46280c
y.create.l HWIO_SNOC_TPRB2_SPROF_STATPERIOD_ADDR A:0xfc462824
y.create.l HWIO_SNOC_TPRB2_SPROF_STATGO_ADDR A:0xfc462828
y.create.l HWIO_SNOC_TPRB2_SPROF_STATALARMMIN_ADDR A:0xfc46282c
y.create.l HWIO_SNOC_TPRB2_SPROF_STATALARMMAX_ADDR A:0xfc462830
y.create.l HWIO_SNOC_TPRB2_SPROF_STATALARMSTATUS_ADDR A:0xfc462834
y.create.l HWIO_SNOC_TPRB2_SPROF_STATALARMCLR_ADDR A:0xfc462838
y.create.l HWIO_SNOC_TPRB2_SPROF_COUNTERS_0_SRC_ADDR A:0xfc462938
y.create.l HWIO_SNOC_TPRB2_SPROF_COUNTERS_0_ALARMMODE_ADDR A:0xfc46293c
y.create.l HWIO_SNOC_TPRB2_SPROF_COUNTERS_0_VAL_ADDR A:0xfc462940
y.create.l HWIO_SNOC_TPRB2_SPROF_COUNTERS_1_SRC_ADDR A:0xfc46294c
y.create.l HWIO_SNOC_TPRB2_SPROF_COUNTERS_1_ALARMMODE_ADDR A:0xfc462950
y.create.l HWIO_SNOC_TPRB2_SPROF_COUNTERS_1_VAL_ADDR A:0xfc462954
y.create.l HWIO_SNOC_TPRB2_SPROF_COUNTERS_2_SRC_ADDR A:0xfc462960
y.create.l HWIO_SNOC_TPRB2_SPROF_COUNTERS_2_ALARMMODE_ADDR A:0xfc462964
y.create.l HWIO_SNOC_TPRB2_SPROF_COUNTERS_2_VAL_ADDR A:0xfc462968
y.create.l HWIO_SNOC_TPRB2_SPROF_COUNTERS_3_SRC_ADDR A:0xfc462974
y.create.l HWIO_SNOC_TPRB2_SPROF_COUNTERS_3_ALARMMODE_ADDR A:0xfc462978
y.create.l HWIO_SNOC_TPRB2_SPROF_COUNTERS_3_VAL_ADDR A:0xfc46297c
y.create.l HWIO_SNOC_TPRB2_SPROF_COUNTERS_4_SRC_ADDR A:0xfc462988
y.create.l HWIO_SNOC_TPRB2_SPROF_COUNTERS_4_ALARMMODE_ADDR A:0xfc46298c
y.create.l HWIO_SNOC_TPRB2_SPROF_COUNTERS_4_VAL_ADDR A:0xfc462990
y.create.l HWIO_SNOC_TPRB2_SPROF_COUNTERS_5_SRC_ADDR A:0xfc46299c
y.create.l HWIO_SNOC_TPRB2_SPROF_COUNTERS_5_ALARMMODE_ADDR A:0xfc4629a0
y.create.l HWIO_SNOC_TPRB2_SPROF_COUNTERS_5_VAL_ADDR A:0xfc4629a4
y.create.l HWIO_SNOC_TPRB2_SPROF_COUNTERS_6_SRC_ADDR A:0xfc4629b0
y.create.l HWIO_SNOC_TPRB2_SPROF_COUNTERS_6_ALARMMODE_ADDR A:0xfc4629b4
y.create.l HWIO_SNOC_TPRB2_SPROF_COUNTERS_6_VAL_ADDR A:0xfc4629b8
y.create.l HWIO_SNOC_TPRB2_SPROF_COUNTERS_7_SRC_ADDR A:0xfc4629c4
y.create.l HWIO_SNOC_TPRB2_SPROF_COUNTERS_7_ALARMMODE_ADDR A:0xfc4629c8
y.create.l HWIO_SNOC_TPRB2_SPROF_COUNTERS_7_VAL_ADDR A:0xfc4629cc
y.create.l HWIO_SNOC_TPRB2_SPROF_COUNTERS_8_SRC_ADDR A:0xfc4629d8
y.create.l HWIO_SNOC_TPRB2_SPROF_COUNTERS_8_ALARMMODE_ADDR A:0xfc4629dc
y.create.l HWIO_SNOC_TPRB2_SPROF_COUNTERS_8_VAL_ADDR A:0xfc4629e0
y.create.l HWIO_SNOC_TPRB2_SPROF_COUNTERS_9_SRC_ADDR A:0xfc4629ec
y.create.l HWIO_SNOC_TPRB2_SPROF_COUNTERS_9_ALARMMODE_ADDR A:0xfc4629f0
y.create.l HWIO_SNOC_TPRB2_SPROF_COUNTERS_9_VAL_ADDR A:0xfc4629f4
y.create.l HWIO_SNOC_TPRB2_SPROF_COUNTERS_10_SRC_ADDR A:0xfc462a00
y.create.l HWIO_SNOC_TPRB2_SPROF_COUNTERS_10_ALARMMODE_ADDR A:0xfc462a04
y.create.l HWIO_SNOC_TPRB2_SPROF_COUNTERS_10_VAL_ADDR A:0xfc462a08
y.create.l HWIO_SNOC_TPRB2_SPROF_COUNTERS_11_SRC_ADDR A:0xfc462a14
y.create.l HWIO_SNOC_TPRB2_SPROF_COUNTERS_11_ALARMMODE_ADDR A:0xfc462a18
y.create.l HWIO_SNOC_TPRB2_SPROF_COUNTERS_11_VAL_ADDR A:0xfc462a1c
y.create.l HWIO_SNOC_TPRB2_SPROF_COUNTERS_12_SRC_ADDR A:0xfc462a28
y.create.l HWIO_SNOC_TPRB2_SPROF_COUNTERS_12_ALARMMODE_ADDR A:0xfc462a2c
y.create.l HWIO_SNOC_TPRB2_SPROF_COUNTERS_12_VAL_ADDR A:0xfc462a30
y.create.l HWIO_SNOC_TPRB2_SPROF_COUNTERS_13_SRC_ADDR A:0xfc462a3c
y.create.l HWIO_SNOC_TPRB2_SPROF_COUNTERS_13_ALARMMODE_ADDR A:0xfc462a40
y.create.l HWIO_SNOC_TPRB2_SPROF_COUNTERS_13_VAL_ADDR A:0xfc462a44
y.create.l HWIO_SNOC_TPRB2_SPROF_COUNTERS_14_SRC_ADDR A:0xfc462a50
y.create.l HWIO_SNOC_TPRB2_SPROF_COUNTERS_14_ALARMMODE_ADDR A:0xfc462a54
y.create.l HWIO_SNOC_TPRB2_SPROF_COUNTERS_14_VAL_ADDR A:0xfc462a58
y.create.l HWIO_SNOC_TPRB2_SPROF_COUNTERS_15_SRC_ADDR A:0xfc462a64
y.create.l HWIO_SNOC_TPRB2_SPROF_COUNTERS_15_ALARMMODE_ADDR A:0xfc462a68
y.create.l HWIO_SNOC_TPRB2_SPROF_COUNTERS_15_VAL_ADDR A:0xfc462a6c
y.create.l HWIO_SNOC_QHM_LPASS_QOS_ID_COREID_ADDR A:0xfc463000
y.create.l HWIO_SNOC_QHM_LPASS_QOS_ID_REVISIONID_ADDR A:0xfc463004
y.create.l HWIO_SNOC_QHM_LPASS_QOS_PRIORITY_ADDR A:0xfc463008
y.create.l HWIO_SNOC_QDSS_BAM_QOS_ID_COREID_ADDR A:0xfc463080
y.create.l HWIO_SNOC_QDSS_BAM_QOS_ID_REVISIONID_ADDR A:0xfc463084
y.create.l HWIO_SNOC_QDSS_BAM_QOS_PRIORITY_ADDR A:0xfc463088
y.create.l HWIO_SNOC_CRYPTO0_QOS_ID_COREID_ADDR A:0xfc463100
y.create.l HWIO_SNOC_CRYPTO0_QOS_ID_REVISIONID_ADDR A:0xfc463104
y.create.l HWIO_SNOC_CRYPTO0_QOS_PRIORITY_ADDR A:0xfc463108
y.create.l HWIO_SNOC_QXM_IPA_QOS_ID_COREID_ADDR A:0xfc463180
y.create.l HWIO_SNOC_QXM_IPA_QOS_ID_REVISIONID_ADDR A:0xfc463184
y.create.l HWIO_SNOC_QXM_IPA_QOS_PRIORITY_ADDR A:0xfc463188
y.create.l HWIO_SNOC_QXM_LPASS_QOS_ID_COREID_ADDR A:0xfc463200
y.create.l HWIO_SNOC_QXM_LPASS_QOS_ID_REVISIONID_ADDR A:0xfc463204
y.create.l HWIO_SNOC_QXM_LPASS_QOS_PRIORITY_ADDR A:0xfc463208
y.create.l HWIO_SNOC_MSS_QOS_ID_COREID_ADDR A:0xfc463280
y.create.l HWIO_SNOC_MSS_QOS_ID_REVISIONID_ADDR A:0xfc463284
y.create.l HWIO_SNOC_MSS_QOS_PRIORITY_ADDR A:0xfc463288
y.create.l HWIO_SNOC_MSS_QOS_MODE_ADDR A:0xfc46328c
y.create.l HWIO_SNOC_MSS_QOS_BANDWIDTH_ADDR A:0xfc463290
y.create.l HWIO_SNOC_MSS_QOS_SATURATION_ADDR A:0xfc463294
y.create.l HWIO_SNOC_MSS_NAV_QOS_ID_COREID_ADDR A:0xfc463300
y.create.l HWIO_SNOC_MSS_NAV_QOS_ID_REVISIONID_ADDR A:0xfc463304
y.create.l HWIO_SNOC_MSS_NAV_QOS_PRIORITY_ADDR A:0xfc463308
y.create.l HWIO_SNOC_PNOC_QOS_ID_COREID_ADDR A:0xfc463400
y.create.l HWIO_SNOC_PNOC_QOS_ID_REVISIONID_ADDR A:0xfc463404
y.create.l HWIO_SNOC_PNOC_QOS_PRIORITY_ADDR A:0xfc463408
y.create.l HWIO_SNOC_QDSS_ETR_QOS_ID_COREID_ADDR A:0xfc463500
y.create.l HWIO_SNOC_QDSS_ETR_QOS_ID_REVISIONID_ADDR A:0xfc463504
y.create.l HWIO_SNOC_QDSS_ETR_QOS_PRIORITY_ADDR A:0xfc463508
y.create.l HWIO_TLMM_XPU_SCR_ADDR A:0xfd500000
y.create.l HWIO_TLMM_XPU_SWDR_ADDR A:0xfd500004
y.create.l HWIO_TLMM_XPU_SEAR0_ADDR A:0xfd500040
y.create.l HWIO_TLMM_XPU_SESR_ADDR A:0xfd500048
y.create.l HWIO_TLMM_XPU_SESRRESTORE_ADDR A:0xfd50004c
y.create.l HWIO_TLMM_XPU_SESYNR0_ADDR A:0xfd500050
y.create.l HWIO_TLMM_XPU_SESYNR1_ADDR A:0xfd500054
y.create.l HWIO_TLMM_XPU_SESYNR2_ADDR A:0xfd500058
y.create.l HWIO_TLMM_XPU_MCR_ADDR A:0xfd500100
y.create.l HWIO_TLMM_XPU_MEAR0_ADDR A:0xfd500140
y.create.l HWIO_TLMM_XPU_MESR_ADDR A:0xfd500148
y.create.l HWIO_TLMM_XPU_MESRRESTORE_ADDR A:0xfd50014c
y.create.l HWIO_TLMM_XPU_MESYNR0_ADDR A:0xfd500150
y.create.l HWIO_TLMM_XPU_MESYNR1_ADDR A:0xfd500154
y.create.l HWIO_TLMM_XPU_MESYNR2_ADDR A:0xfd500158
y.create.l HWIO_TLMM_XPU_CR_ADDR A:0xfd500080
y.create.l HWIO_TLMM_XPU_RPU_ACR0_ADDR A:0xfd5000a0
y.create.l HWIO_TLMM_XPU_EAR0_ADDR A:0xfd5000c0
y.create.l HWIO_TLMM_XPU_ESR_ADDR A:0xfd5000c8
y.create.l HWIO_TLMM_XPU_ESRRESTORE_ADDR A:0xfd5000cc
y.create.l HWIO_TLMM_XPU_ESYNR0_ADDR A:0xfd5000d0
y.create.l HWIO_TLMM_XPU_ESYNR1_ADDR A:0xfd5000d4
y.create.l HWIO_TLMM_XPU_ESYNR2_ADDR A:0xfd5000d8
y.create.l HWIO_TLMM_XPU_IDR0_ADDR A:0xfd500074
y.create.l HWIO_TLMM_XPU_IDR1_ADDR A:0xfd500078
y.create.l HWIO_TLMM_XPU_REV_ADDR A:0xfd50007c
y.create.l HWIO_TLMM_XPU_RG0_RACR0_ADDR A:0xfd500200
y.create.l HWIO_TLMM_XPU_RG1_RACR0_ADDR A:0xfd500280
y.create.l HWIO_TLMM_XPU_RG2_RACR0_ADDR A:0xfd500300
y.create.l HWIO_TLMM_XPU_RG3_RACR0_ADDR A:0xfd500380
y.create.l HWIO_TLMM_XPU_RG4_RACR0_ADDR A:0xfd500400
y.create.l HWIO_TLMM_XPU_RG5_RACR0_ADDR A:0xfd500480
y.create.l HWIO_TLMM_XPU_RG6_RACR0_ADDR A:0xfd500500
y.create.l HWIO_TLMM_XPU_RG7_RACR0_ADDR A:0xfd500580
y.create.l HWIO_TLMM_XPU_RG8_RACR0_ADDR A:0xfd500600
y.create.l HWIO_TLMM_XPU_RG9_RACR0_ADDR A:0xfd500680
y.create.l HWIO_TLMM_XPU_RG0_SCR_ADDR A:0xfd500250
y.create.l HWIO_TLMM_XPU_RG1_SCR_ADDR A:0xfd5002d0
y.create.l HWIO_TLMM_XPU_RG2_SCR_ADDR A:0xfd500350
y.create.l HWIO_TLMM_XPU_RG3_SCR_ADDR A:0xfd5003d0
y.create.l HWIO_TLMM_XPU_RG4_SCR_ADDR A:0xfd500450
y.create.l HWIO_TLMM_XPU_RG5_SCR_ADDR A:0xfd5004d0
y.create.l HWIO_TLMM_XPU_RG6_SCR_ADDR A:0xfd500550
y.create.l HWIO_TLMM_XPU_RG7_SCR_ADDR A:0xfd5005d0
y.create.l HWIO_TLMM_XPU_RG8_SCR_ADDR A:0xfd500650
y.create.l HWIO_TLMM_XPU_RG9_SCR_ADDR A:0xfd5006d0
y.create.l HWIO_TLMM_XPU_RG0_MCR_ADDR A:0xfd500254
y.create.l HWIO_TLMM_XPU_RG1_MCR_ADDR A:0xfd5002d4
y.create.l HWIO_TLMM_XPU_RG2_MCR_ADDR A:0xfd500354
y.create.l HWIO_TLMM_XPU_RG3_MCR_ADDR A:0xfd5003d4
y.create.l HWIO_TLMM_XPU_RG4_MCR_ADDR A:0xfd500454
y.create.l HWIO_TLMM_XPU_RG5_MCR_ADDR A:0xfd5004d4
y.create.l HWIO_TLMM_XPU_RG6_MCR_ADDR A:0xfd500554
y.create.l HWIO_TLMM_XPU_RG7_MCR_ADDR A:0xfd5005d4
y.create.l HWIO_TLMM_XPU_RG8_MCR_ADDR A:0xfd500654
y.create.l HWIO_TLMM_XPU_RG9_MCR_ADDR A:0xfd5006d4
y.create.l HWIO_TLMM_GPIO_CFG0_ADDR A:0xfd511000
y.create.l HWIO_TLMM_GPIO_CFG1_ADDR A:0xfd511010
y.create.l HWIO_TLMM_GPIO_CFG2_ADDR A:0xfd511020
y.create.l HWIO_TLMM_GPIO_CFG3_ADDR A:0xfd511030
y.create.l HWIO_TLMM_GPIO_CFG4_ADDR A:0xfd511040
y.create.l HWIO_TLMM_GPIO_CFG5_ADDR A:0xfd511050
y.create.l HWIO_TLMM_GPIO_CFG6_ADDR A:0xfd511060
y.create.l HWIO_TLMM_GPIO_CFG7_ADDR A:0xfd511070
y.create.l HWIO_TLMM_GPIO_CFG8_ADDR A:0xfd511080
y.create.l HWIO_TLMM_GPIO_CFG9_ADDR A:0xfd511090
y.create.l HWIO_TLMM_GPIO_IN_OUT0_ADDR A:0xfd511004
y.create.l HWIO_TLMM_GPIO_IN_OUT1_ADDR A:0xfd511014
y.create.l HWIO_TLMM_GPIO_IN_OUT2_ADDR A:0xfd511024
y.create.l HWIO_TLMM_GPIO_IN_OUT3_ADDR A:0xfd511034
y.create.l HWIO_TLMM_GPIO_IN_OUT4_ADDR A:0xfd511044
y.create.l HWIO_TLMM_GPIO_IN_OUT5_ADDR A:0xfd511054
y.create.l HWIO_TLMM_GPIO_IN_OUT6_ADDR A:0xfd511064
y.create.l HWIO_TLMM_GPIO_IN_OUT7_ADDR A:0xfd511074
y.create.l HWIO_TLMM_GPIO_IN_OUT8_ADDR A:0xfd511084
y.create.l HWIO_TLMM_GPIO_IN_OUT9_ADDR A:0xfd511094
y.create.l HWIO_TLMM_GPIO_INTR_CFG0_ADDR A:0xfd511008
y.create.l HWIO_TLMM_GPIO_INTR_CFG1_ADDR A:0xfd511018
y.create.l HWIO_TLMM_GPIO_INTR_CFG2_ADDR A:0xfd511028
y.create.l HWIO_TLMM_GPIO_INTR_CFG3_ADDR A:0xfd511038
y.create.l HWIO_TLMM_GPIO_INTR_CFG4_ADDR A:0xfd511048
y.create.l HWIO_TLMM_GPIO_INTR_CFG5_ADDR A:0xfd511058
y.create.l HWIO_TLMM_GPIO_INTR_CFG6_ADDR A:0xfd511068
y.create.l HWIO_TLMM_GPIO_INTR_CFG7_ADDR A:0xfd511078
y.create.l HWIO_TLMM_GPIO_INTR_CFG8_ADDR A:0xfd511088
y.create.l HWIO_TLMM_GPIO_INTR_CFG9_ADDR A:0xfd511098
y.create.l HWIO_TLMM_GPIO_INTR_STATUS0_ADDR A:0xfd51100c
y.create.l HWIO_TLMM_GPIO_INTR_STATUS1_ADDR A:0xfd51101c
y.create.l HWIO_TLMM_GPIO_INTR_STATUS2_ADDR A:0xfd51102c
y.create.l HWIO_TLMM_GPIO_INTR_STATUS3_ADDR A:0xfd51103c
y.create.l HWIO_TLMM_GPIO_INTR_STATUS4_ADDR A:0xfd51104c
y.create.l HWIO_TLMM_GPIO_INTR_STATUS5_ADDR A:0xfd51105c
y.create.l HWIO_TLMM_GPIO_INTR_STATUS6_ADDR A:0xfd51106c
y.create.l HWIO_TLMM_GPIO_INTR_STATUS7_ADDR A:0xfd51107c
y.create.l HWIO_TLMM_GPIO_INTR_STATUS8_ADDR A:0xfd51108c
y.create.l HWIO_TLMM_GPIO_INTR_STATUS9_ADDR A:0xfd51109c
y.create.l HWIO_TLMM_CLK_GATE_EN_ADDR A:0xfd512000
y.create.l HWIO_TLMM_IE_CTRL_DISABLE_ADDR A:0xfd512004
y.create.l HWIO_TLMM_MPM_WAKEUP_INT_EN_0_ADDR A:0xfd512008
y.create.l HWIO_TLMM_MPM_WAKEUP_INT_EN_1_ADDR A:0xfd51200c
y.create.l HWIO_TLMM_INT_JTAG_CTL_ADDR A:0xfd512010
y.create.l HWIO_TLMM_ETM_MODE_ADDR A:0xfd512014
y.create.l HWIO_TLMM_DBG_BUS_OUT_SEL_ADDR A:0xfd512018
y.create.l HWIO_TLMM_CHIP_MODE_ADDR A:0xfd512020
y.create.l HWIO_TLMM_SPARE_ADDR A:0xfd512024
y.create.l HWIO_TLMM_HW_REVISION_NUMBER_ADDR A:0xfd512028
y.create.l HWIO_TLMM_SLIMBUS_CTL_ADDR A:0xfd512030
y.create.l HWIO_TLMM_RFFE_CTL_ADDR A:0xfd512034
y.create.l HWIO_TLMM_RESOUT_HDRV_CTL_ADDR A:0xfd512038
y.create.l HWIO_TLMM_JTAG_HDRV_CTL_ADDR A:0xfd51203c
y.create.l HWIO_TLMM_PMIC_HDRV_PULL_CTL_ADDR A:0xfd512040
y.create.l HWIO_TLMM_SDC1_HDRV_PULL_CTL_ADDR A:0xfd512044
y.create.l HWIO_TLMM_SDC2_HDRV_PULL_CTL_ADDR A:0xfd512048
y.create.l HWIO_TLMM_MODE_PULL_CTL_ADDR A:0xfd51204c
y.create.l HWIO_TLMM_GPIO_HSIC_STROBE_PAD_CTL_ADDR A:0xfd512050
y.create.l HWIO_TLMM_GPIO_HSIC_DATA_PAD_CTL_ADDR A:0xfd512054
y.create.l HWIO_TLMM_HSIC_CAL_PAD_CTL_ADDR A:0xfd512058
y.create.l HWIO_TLMM_EBI2_HDRV_PULL_CTL_ADDR A:0xfd51205c
y.create.l HWIO_TLMM_DIR_CONN_INTR0_CFG_WCSS_ADDR A:0xfd512100
y.create.l HWIO_TLMM_DIR_CONN_INTR1_CFG_WCSS_ADDR A:0xfd512104
y.create.l HWIO_TLMM_DIR_CONN_INTR0_CFG_SENSORS_ADDR A:0xfd512200
y.create.l HWIO_TLMM_DIR_CONN_INTR1_CFG_SENSORS_ADDR A:0xfd512204
y.create.l HWIO_TLMM_DIR_CONN_INTR2_CFG_SENSORS_ADDR A:0xfd512208
y.create.l HWIO_TLMM_DIR_CONN_INTR3_CFG_SENSORS_ADDR A:0xfd51220c
y.create.l HWIO_TLMM_DIR_CONN_INTR4_CFG_SENSORS_ADDR A:0xfd512210
y.create.l HWIO_TLMM_DIR_CONN_INTR5_CFG_SENSORS_ADDR A:0xfd512214
y.create.l HWIO_TLMM_DIR_CONN_INTR6_CFG_SENSORS_ADDR A:0xfd512218
y.create.l HWIO_TLMM_DIR_CONN_INTR7_CFG_SENSORS_ADDR A:0xfd51221c
y.create.l HWIO_TLMM_DIR_CONN_INTR8_CFG_SENSORS_ADDR A:0xfd512220
y.create.l HWIO_TLMM_DIR_CONN_INTR9_CFG_SENSORS_ADDR A:0xfd512224
y.create.l HWIO_TLMM_DIR_CONN_INTR0_CFG_LPA_DSP_ADDR A:0xfd512500
y.create.l HWIO_TLMM_DIR_CONN_INTR1_CFG_LPA_DSP_ADDR A:0xfd512504
y.create.l HWIO_TLMM_DIR_CONN_INTR2_CFG_LPA_DSP_ADDR A:0xfd512508
y.create.l HWIO_TLMM_DIR_CONN_INTR3_CFG_LPA_DSP_ADDR A:0xfd51250c
y.create.l HWIO_TLMM_DIR_CONN_INTR4_CFG_LPA_DSP_ADDR A:0xfd512510
y.create.l HWIO_TLMM_DIR_CONN_INTR5_CFG_LPA_DSP_ADDR A:0xfd512514
y.create.l HWIO_TLMM_DIR_CONN_INTR0_CFG_RPM_ADDR A:0xfd512700
y.create.l HWIO_TLMM_DIR_CONN_INTR0_CFG_KPSS_ADDR A:0xfd512800
y.create.l HWIO_TLMM_DIR_CONN_INTR1_CFG_KPSS_ADDR A:0xfd512804
y.create.l HWIO_TLMM_DIR_CONN_INTR2_CFG_KPSS_ADDR A:0xfd512808
y.create.l HWIO_TLMM_DIR_CONN_INTR3_CFG_KPSS_ADDR A:0xfd51280c
y.create.l HWIO_TLMM_DIR_CONN_INTR4_CFG_KPSS_ADDR A:0xfd512810
y.create.l HWIO_TLMM_DIR_CONN_INTR5_CFG_KPSS_ADDR A:0xfd512814
y.create.l HWIO_TLMM_DIR_CONN_INTR6_CFG_KPSS_ADDR A:0xfd512818
y.create.l HWIO_TLMM_DIR_CONN_INTR7_CFG_KPSS_ADDR A:0xfd51281c
y.create.l HWIO_TLMM_DIR_CONN_INTR0_CFG_MSS_ADDR A:0xfd512a00
y.create.l HWIO_TLMM_DIR_CONN_INTR1_CFG_MSS_ADDR A:0xfd512a04
y.create.l HWIO_TLMM_GPIO_OUT_0_ADDR A:0xfd513000
y.create.l HWIO_TLMM_GPIO_OUT_1_ADDR A:0xfd513004
y.create.l HWIO_TLMM_GPIO_OUT_2_ADDR A:0xfd513008
y.create.l HWIO_TLMM_GPIO_OUT_CLR_0_ADDR A:0xfd513020
y.create.l HWIO_TLMM_GPIO_OUT_CLR_1_ADDR A:0xfd513024
y.create.l HWIO_TLMM_GPIO_OUT_CLR_2_ADDR A:0xfd513028
y.create.l HWIO_TLMM_GPIO_OUT_SET_0_ADDR A:0xfd513040
y.create.l HWIO_TLMM_GPIO_OUT_SET_1_ADDR A:0xfd513044
y.create.l HWIO_TLMM_GPIO_OUT_SET_2_ADDR A:0xfd513048
y.create.l HWIO_TLMM_GPIO_IN_0_ADDR A:0xfd513060
y.create.l HWIO_TLMM_GPIO_IN_1_ADDR A:0xfd513064
y.create.l HWIO_TLMM_GPIO_IN_2_ADDR A:0xfd513068
y.create.l HWIO_TLMM_GPIO_OE_0_ADDR A:0xfd513080
y.create.l HWIO_TLMM_GPIO_OE_1_ADDR A:0xfd513084
y.create.l HWIO_TLMM_GPIO_OE_2_ADDR A:0xfd513088
y.create.l HWIO_TLMM_GPIO_OE_CLR_0_ADDR A:0xfd513100
y.create.l HWIO_TLMM_GPIO_OE_CLR_1_ADDR A:0xfd513104
y.create.l HWIO_TLMM_GPIO_OE_CLR_2_ADDR A:0xfd513108
y.create.l HWIO_TLMM_GPIO_OE_SET_0_ADDR A:0xfd513120
y.create.l HWIO_TLMM_GPIO_OE_SET_1_ADDR A:0xfd513124
y.create.l HWIO_TLMM_GPIO_OE_SET_2_ADDR A:0xfd513128
y.create.l HWIO_XPU_CFG_DDR_PHY_CFG_XPU_SCR_ADDR A:0xfc501000
y.create.l HWIO_XPU_CFG_DDR_PHY_CFG_XPU_SWDR_ADDR A:0xfc501004
y.create.l HWIO_XPU_CFG_DDR_PHY_CFG_XPU_SEAR0_ADDR A:0xfc501040
y.create.l HWIO_XPU_CFG_DDR_PHY_CFG_XPU_SESR_ADDR A:0xfc501048
y.create.l HWIO_XPU_CFG_DDR_PHY_CFG_XPU_SESRRESTORE_ADDR A:0xfc50104c
y.create.l HWIO_XPU_CFG_DDR_PHY_CFG_XPU_SESYNR0_ADDR A:0xfc501050
y.create.l HWIO_XPU_CFG_DDR_PHY_CFG_XPU_SESYNR1_ADDR A:0xfc501054
y.create.l HWIO_XPU_CFG_DDR_PHY_CFG_XPU_SESYNR2_ADDR A:0xfc501058
y.create.l HWIO_XPU_CFG_DDR_PHY_CFG_XPU_MCR_ADDR A:0xfc501100
y.create.l HWIO_XPU_CFG_DDR_PHY_CFG_XPU_MEAR0_ADDR A:0xfc501140
y.create.l HWIO_XPU_CFG_DDR_PHY_CFG_XPU_MESR_ADDR A:0xfc501148
y.create.l HWIO_XPU_CFG_DDR_PHY_CFG_XPU_MESRRESTORE_ADDR A:0xfc50114c
y.create.l HWIO_XPU_CFG_DDR_PHY_CFG_XPU_MESYNR0_ADDR A:0xfc501150
y.create.l HWIO_XPU_CFG_DDR_PHY_CFG_XPU_MESYNR1_ADDR A:0xfc501154
y.create.l HWIO_XPU_CFG_DDR_PHY_CFG_XPU_MESYNR2_ADDR A:0xfc501158
y.create.l HWIO_XPU_CFG_DDR_PHY_CFG_XPU_CR_ADDR A:0xfc501080
y.create.l HWIO_XPU_CFG_DDR_PHY_CFG_XPU_RPU_ACR0_ADDR A:0xfc5010a0
y.create.l HWIO_XPU_CFG_DDR_PHY_CFG_XPU_EAR0_ADDR A:0xfc5010c0
y.create.l HWIO_XPU_CFG_DDR_PHY_CFG_XPU_ESR_ADDR A:0xfc5010c8
y.create.l HWIO_XPU_CFG_DDR_PHY_CFG_XPU_ESRRESTORE_ADDR A:0xfc5010cc
y.create.l HWIO_XPU_CFG_DDR_PHY_CFG_XPU_ESYNR0_ADDR A:0xfc5010d0
y.create.l HWIO_XPU_CFG_DDR_PHY_CFG_XPU_ESYNR1_ADDR A:0xfc5010d4
y.create.l HWIO_XPU_CFG_DDR_PHY_CFG_XPU_ESYNR2_ADDR A:0xfc5010d8
y.create.l HWIO_XPU_CFG_DDR_PHY_CFG_XPU_IDR0_ADDR A:0xfc501074
y.create.l HWIO_XPU_CFG_DDR_PHY_CFG_XPU_IDR1_ADDR A:0xfc501078
y.create.l HWIO_XPU_CFG_DDR_PHY_CFG_XPU_REV_ADDR A:0xfc50107c
y.create.l HWIO_XPU_CFG_DDR_PHY_CFG_XPU_RG0_RACR0_ADDR A:0xfc501200
y.create.l HWIO_XPU_CFG_DDR_PHY_CFG_XPU_RG1_RACR0_ADDR A:0xfc501280
y.create.l HWIO_XPU_CFG_DDR_PHY_CFG_XPU_RG0_WACR0_ADDR A:0xfc501220
y.create.l HWIO_XPU_CFG_DDR_PHY_CFG_XPU_RG1_WACR0_ADDR A:0xfc5012a0
y.create.l HWIO_XPU_CFG_DDR_PHY_CFG_XPU_RG0_SCR_ADDR A:0xfc501250
y.create.l HWIO_XPU_CFG_DDR_PHY_CFG_XPU_RG1_SCR_ADDR A:0xfc5012d0
y.create.l HWIO_XPU_CFG_DDR_PHY_CFG_XPU_RG0_MCR_ADDR A:0xfc501254
y.create.l HWIO_XPU_CFG_DDR_PHY_CFG_XPU_RG1_MCR_ADDR A:0xfc5012d4
y.create.l HWIO_XPU_CFG_QDSS_XPU_SCR_ADDR A:0xfc48d000
y.create.l HWIO_XPU_CFG_QDSS_XPU_SWDR_ADDR A:0xfc48d004
y.create.l HWIO_XPU_CFG_QDSS_XPU_SEAR0_ADDR A:0xfc48d040
y.create.l HWIO_XPU_CFG_QDSS_XPU_SESR_ADDR A:0xfc48d048
y.create.l HWIO_XPU_CFG_QDSS_XPU_SESRRESTORE_ADDR A:0xfc48d04c
y.create.l HWIO_XPU_CFG_QDSS_XPU_SESYNR0_ADDR A:0xfc48d050
y.create.l HWIO_XPU_CFG_QDSS_XPU_SESYNR1_ADDR A:0xfc48d054
y.create.l HWIO_XPU_CFG_QDSS_XPU_SESYNR2_ADDR A:0xfc48d058
y.create.l HWIO_XPU_CFG_QDSS_XPU_MCR_ADDR A:0xfc48d100
y.create.l HWIO_XPU_CFG_QDSS_XPU_MEAR0_ADDR A:0xfc48d140
y.create.l HWIO_XPU_CFG_QDSS_XPU_MESR_ADDR A:0xfc48d148
y.create.l HWIO_XPU_CFG_QDSS_XPU_MESRRESTORE_ADDR A:0xfc48d14c
y.create.l HWIO_XPU_CFG_QDSS_XPU_MESYNR0_ADDR A:0xfc48d150
y.create.l HWIO_XPU_CFG_QDSS_XPU_MESYNR1_ADDR A:0xfc48d154
y.create.l HWIO_XPU_CFG_QDSS_XPU_MESYNR2_ADDR A:0xfc48d158
y.create.l HWIO_XPU_CFG_QDSS_XPU_CR_ADDR A:0xfc48d080
y.create.l HWIO_XPU_CFG_QDSS_XPU_RPU_ACR0_ADDR A:0xfc48d0a0
y.create.l HWIO_XPU_CFG_QDSS_XPU_EAR0_ADDR A:0xfc48d0c0
y.create.l HWIO_XPU_CFG_QDSS_XPU_ESR_ADDR A:0xfc48d0c8
y.create.l HWIO_XPU_CFG_QDSS_XPU_ESRRESTORE_ADDR A:0xfc48d0cc
y.create.l HWIO_XPU_CFG_QDSS_XPU_ESYNR0_ADDR A:0xfc48d0d0
y.create.l HWIO_XPU_CFG_QDSS_XPU_ESYNR1_ADDR A:0xfc48d0d4
y.create.l HWIO_XPU_CFG_QDSS_XPU_ESYNR2_ADDR A:0xfc48d0d8
y.create.l HWIO_XPU_CFG_QDSS_XPU_IDR0_ADDR A:0xfc48d074
y.create.l HWIO_XPU_CFG_QDSS_XPU_IDR1_ADDR A:0xfc48d078
y.create.l HWIO_XPU_CFG_QDSS_XPU_REV_ADDR A:0xfc48d07c
y.create.l HWIO_XPU_CFG_QDSS_XPU_RG0_RACR0_ADDR A:0xfc48d200
y.create.l HWIO_XPU_CFG_QDSS_XPU_RG1_RACR0_ADDR A:0xfc48d280
y.create.l HWIO_XPU_CFG_QDSS_XPU_RG0_WACR0_ADDR A:0xfc48d220
y.create.l HWIO_XPU_CFG_QDSS_XPU_RG1_WACR0_ADDR A:0xfc48d2a0
y.create.l HWIO_XPU_CFG_QDSS_XPU_RG0_SCR_ADDR A:0xfc48d250
y.create.l HWIO_XPU_CFG_QDSS_XPU_RG1_SCR_ADDR A:0xfc48d2d0
y.create.l HWIO_XPU_CFG_QDSS_XPU_RG0_MCR_ADDR A:0xfc48d254
y.create.l HWIO_XPU_CFG_QDSS_XPU_RG1_MCR_ADDR A:0xfc48d2d4
y.create.l HWIO_XPU_CFG_SNOC_CFG_XPU_SCR_ADDR A:0xfc48c000
y.create.l HWIO_XPU_CFG_SNOC_CFG_XPU_SWDR_ADDR A:0xfc48c004
y.create.l HWIO_XPU_CFG_SNOC_CFG_XPU_PRTN_RACR_SSHADOW_ADDR A:0xfc48c008
y.create.l HWIO_XPU_CFG_SNOC_CFG_XPU_PRTN_WACR_SSHADOW_ADDR A:0xfc48c00c
y.create.l HWIO_XPU_CFG_SNOC_CFG_XPU_PRTN_START_SSHADOW0_ADDR A:0xfc48c010
y.create.l HWIO_XPU_CFG_SNOC_CFG_XPU_PRTN_END_SSHADOW0_ADDR A:0xfc48c018
y.create.l HWIO_XPU_CFG_SNOC_CFG_XPU_SEAR0_ADDR A:0xfc48c040
y.create.l HWIO_XPU_CFG_SNOC_CFG_XPU_SESR_ADDR A:0xfc48c048
y.create.l HWIO_XPU_CFG_SNOC_CFG_XPU_SESRRESTORE_ADDR A:0xfc48c04c
y.create.l HWIO_XPU_CFG_SNOC_CFG_XPU_SESYNR0_ADDR A:0xfc48c050
y.create.l HWIO_XPU_CFG_SNOC_CFG_XPU_SESYNR1_ADDR A:0xfc48c054
y.create.l HWIO_XPU_CFG_SNOC_CFG_XPU_SESYNR2_ADDR A:0xfc48c058
y.create.l HWIO_XPU_CFG_SNOC_CFG_XPU_MCR_ADDR A:0xfc48c100
y.create.l HWIO_XPU_CFG_SNOC_CFG_XPU_MEAR0_ADDR A:0xfc48c140
y.create.l HWIO_XPU_CFG_SNOC_CFG_XPU_MESR_ADDR A:0xfc48c148
y.create.l HWIO_XPU_CFG_SNOC_CFG_XPU_MESRRESTORE_ADDR A:0xfc48c14c
y.create.l HWIO_XPU_CFG_SNOC_CFG_XPU_MESYNR0_ADDR A:0xfc48c150
y.create.l HWIO_XPU_CFG_SNOC_CFG_XPU_MESYNR1_ADDR A:0xfc48c154
y.create.l HWIO_XPU_CFG_SNOC_CFG_XPU_MESYNR2_ADDR A:0xfc48c158
y.create.l HWIO_XPU_CFG_SNOC_CFG_XPU_CR_ADDR A:0xfc48c080
y.create.l HWIO_XPU_CFG_SNOC_CFG_XPU_PRTN_RACR_SHADOW_ADDR A:0xfc48c088
y.create.l HWIO_XPU_CFG_SNOC_CFG_XPU_PRTN_WACR_SHADOW_ADDR A:0xfc48c08c
y.create.l HWIO_XPU_CFG_SNOC_CFG_XPU_PRTN_START_SHADOW0_ADDR A:0xfc48c090
y.create.l HWIO_XPU_CFG_SNOC_CFG_XPU_PRTN_END_SHADOW0_ADDR A:0xfc48c098
y.create.l HWIO_XPU_CFG_SNOC_CFG_XPU_RPU_ACR0_ADDR A:0xfc48c0a0
y.create.l HWIO_XPU_CFG_SNOC_CFG_XPU_EAR0_ADDR A:0xfc48c0c0
y.create.l HWIO_XPU_CFG_SNOC_CFG_XPU_ESR_ADDR A:0xfc48c0c8
y.create.l HWIO_XPU_CFG_SNOC_CFG_XPU_ESRRESTORE_ADDR A:0xfc48c0cc
y.create.l HWIO_XPU_CFG_SNOC_CFG_XPU_ESYNR0_ADDR A:0xfc48c0d0
y.create.l HWIO_XPU_CFG_SNOC_CFG_XPU_ESYNR1_ADDR A:0xfc48c0d4
y.create.l HWIO_XPU_CFG_SNOC_CFG_XPU_ESYNR2_ADDR A:0xfc48c0d8
y.create.l HWIO_XPU_CFG_SNOC_CFG_XPU_UMR_RACR_ADDR A:0xfc48c0e0
y.create.l HWIO_XPU_CFG_SNOC_CFG_XPU_UMR_WACR_ADDR A:0xfc48c0e4
y.create.l HWIO_XPU_CFG_SNOC_CFG_XPU_IDR0_ADDR A:0xfc48c074
y.create.l HWIO_XPU_CFG_SNOC_CFG_XPU_IDR1_ADDR A:0xfc48c078
y.create.l HWIO_XPU_CFG_SNOC_CFG_XPU_REV_ADDR A:0xfc48c07c
y.create.l HWIO_XPU_CFG_SNOC_CFG_XPU_PRT0_RACR0_ADDR A:0xfc48c200
y.create.l HWIO_XPU_CFG_SNOC_CFG_XPU_PRT1_RACR0_ADDR A:0xfc48c280
y.create.l HWIO_XPU_CFG_SNOC_CFG_XPU_PRT2_RACR0_ADDR A:0xfc48c300
y.create.l HWIO_XPU_CFG_SNOC_CFG_XPU_PRT3_RACR0_ADDR A:0xfc48c380
y.create.l HWIO_XPU_CFG_SNOC_CFG_XPU_PRT4_RACR0_ADDR A:0xfc48c400
y.create.l HWIO_XPU_CFG_SNOC_CFG_XPU_PRT5_RACR0_ADDR A:0xfc48c480
y.create.l HWIO_XPU_CFG_SNOC_CFG_XPU_PRT6_RACR0_ADDR A:0xfc48c500
y.create.l HWIO_XPU_CFG_SNOC_CFG_XPU_PRT7_RACR0_ADDR A:0xfc48c580
y.create.l HWIO_XPU_CFG_SNOC_CFG_XPU_PRT8_RACR0_ADDR A:0xfc48c600
y.create.l HWIO_XPU_CFG_SNOC_CFG_XPU_PRT9_RACR0_ADDR A:0xfc48c680
y.create.l HWIO_XPU_CFG_SNOC_CFG_XPU_PRT0_WACR0_ADDR A:0xfc48c220
y.create.l HWIO_XPU_CFG_SNOC_CFG_XPU_PRT1_WACR0_ADDR A:0xfc48c2a0
y.create.l HWIO_XPU_CFG_SNOC_CFG_XPU_PRT2_WACR0_ADDR A:0xfc48c320
y.create.l HWIO_XPU_CFG_SNOC_CFG_XPU_PRT3_WACR0_ADDR A:0xfc48c3a0
y.create.l HWIO_XPU_CFG_SNOC_CFG_XPU_PRT4_WACR0_ADDR A:0xfc48c420
y.create.l HWIO_XPU_CFG_SNOC_CFG_XPU_PRT5_WACR0_ADDR A:0xfc48c4a0
y.create.l HWIO_XPU_CFG_SNOC_CFG_XPU_PRT6_WACR0_ADDR A:0xfc48c520
y.create.l HWIO_XPU_CFG_SNOC_CFG_XPU_PRT7_WACR0_ADDR A:0xfc48c5a0
y.create.l HWIO_XPU_CFG_SNOC_CFG_XPU_PRT8_WACR0_ADDR A:0xfc48c620
y.create.l HWIO_XPU_CFG_SNOC_CFG_XPU_PRT9_WACR0_ADDR A:0xfc48c6a0
y.create.l HWIO_XPU_CFG_SNOC_CFG_XPU_PRT0_START0_ADDR A:0xfc48c240
y.create.l HWIO_XPU_CFG_SNOC_CFG_XPU_PRT1_START0_ADDR A:0xfc48c2c0
y.create.l HWIO_XPU_CFG_SNOC_CFG_XPU_PRT2_START0_ADDR A:0xfc48c340
y.create.l HWIO_XPU_CFG_SNOC_CFG_XPU_PRT3_START0_ADDR A:0xfc48c3c0
y.create.l HWIO_XPU_CFG_SNOC_CFG_XPU_PRT4_START0_ADDR A:0xfc48c440
y.create.l HWIO_XPU_CFG_SNOC_CFG_XPU_PRT5_START0_ADDR A:0xfc48c4c0
y.create.l HWIO_XPU_CFG_SNOC_CFG_XPU_PRT6_START0_ADDR A:0xfc48c540
y.create.l HWIO_XPU_CFG_SNOC_CFG_XPU_PRT7_START0_ADDR A:0xfc48c5c0
y.create.l HWIO_XPU_CFG_SNOC_CFG_XPU_PRT8_START0_ADDR A:0xfc48c640
y.create.l HWIO_XPU_CFG_SNOC_CFG_XPU_PRT9_START0_ADDR A:0xfc48c6c0
y.create.l HWIO_XPU_CFG_SNOC_CFG_XPU_PRT0_END0_ADDR A:0xfc48c248
y.create.l HWIO_XPU_CFG_SNOC_CFG_XPU_PRT1_END0_ADDR A:0xfc48c2c8
y.create.l HWIO_XPU_CFG_SNOC_CFG_XPU_PRT2_END0_ADDR A:0xfc48c348
y.create.l HWIO_XPU_CFG_SNOC_CFG_XPU_PRT3_END0_ADDR A:0xfc48c3c8
y.create.l HWIO_XPU_CFG_SNOC_CFG_XPU_PRT4_END0_ADDR A:0xfc48c448
y.create.l HWIO_XPU_CFG_SNOC_CFG_XPU_PRT5_END0_ADDR A:0xfc48c4c8
y.create.l HWIO_XPU_CFG_SNOC_CFG_XPU_PRT6_END0_ADDR A:0xfc48c548
y.create.l HWIO_XPU_CFG_SNOC_CFG_XPU_PRT7_END0_ADDR A:0xfc48c5c8
y.create.l HWIO_XPU_CFG_SNOC_CFG_XPU_PRT8_END0_ADDR A:0xfc48c648
y.create.l HWIO_XPU_CFG_SNOC_CFG_XPU_PRT9_END0_ADDR A:0xfc48c6c8
y.create.l HWIO_XPU_CFG_SNOC_CFG_XPU_PRT0_SCR_ADDR A:0xfc48c250
y.create.l HWIO_XPU_CFG_SNOC_CFG_XPU_PRT1_SCR_ADDR A:0xfc48c2d0
y.create.l HWIO_XPU_CFG_SNOC_CFG_XPU_PRT2_SCR_ADDR A:0xfc48c350
y.create.l HWIO_XPU_CFG_SNOC_CFG_XPU_PRT3_SCR_ADDR A:0xfc48c3d0
y.create.l HWIO_XPU_CFG_SNOC_CFG_XPU_PRT4_SCR_ADDR A:0xfc48c450
y.create.l HWIO_XPU_CFG_SNOC_CFG_XPU_PRT5_SCR_ADDR A:0xfc48c4d0
y.create.l HWIO_XPU_CFG_SNOC_CFG_XPU_PRT6_SCR_ADDR A:0xfc48c550
y.create.l HWIO_XPU_CFG_SNOC_CFG_XPU_PRT7_SCR_ADDR A:0xfc48c5d0
y.create.l HWIO_XPU_CFG_SNOC_CFG_XPU_PRT8_SCR_ADDR A:0xfc48c650
y.create.l HWIO_XPU_CFG_SNOC_CFG_XPU_PRT9_SCR_ADDR A:0xfc48c6d0
y.create.l HWIO_XPU_CFG_SNOC_CFG_XPU_PRT0_MCR_ADDR A:0xfc48c254
y.create.l HWIO_XPU_CFG_SNOC_CFG_XPU_PRT1_MCR_ADDR A:0xfc48c2d4
y.create.l HWIO_XPU_CFG_SNOC_CFG_XPU_PRT2_MCR_ADDR A:0xfc48c354
y.create.l HWIO_XPU_CFG_SNOC_CFG_XPU_PRT3_MCR_ADDR A:0xfc48c3d4
y.create.l HWIO_XPU_CFG_SNOC_CFG_XPU_PRT4_MCR_ADDR A:0xfc48c454
y.create.l HWIO_XPU_CFG_SNOC_CFG_XPU_PRT5_MCR_ADDR A:0xfc48c4d4
y.create.l HWIO_XPU_CFG_SNOC_CFG_XPU_PRT6_MCR_ADDR A:0xfc48c554
y.create.l HWIO_XPU_CFG_SNOC_CFG_XPU_PRT7_MCR_ADDR A:0xfc48c5d4
y.create.l HWIO_XPU_CFG_SNOC_CFG_XPU_PRT8_MCR_ADDR A:0xfc48c654
y.create.l HWIO_XPU_CFG_SNOC_CFG_XPU_PRT9_MCR_ADDR A:0xfc48c6d4
y.create.l HWIO_XPU_CFG_SNOC_CFG_XPU_PRT0_CNTL0_ADDR A:0xfc48c258
y.create.l HWIO_XPU_CFG_SNOC_CFG_XPU_PRT1_CNTL0_ADDR A:0xfc48c2d8
y.create.l HWIO_XPU_CFG_SNOC_CFG_XPU_PRT2_CNTL0_ADDR A:0xfc48c358
y.create.l HWIO_XPU_CFG_SNOC_CFG_XPU_PRT3_CNTL0_ADDR A:0xfc48c3d8
y.create.l HWIO_XPU_CFG_SNOC_CFG_XPU_PRT4_CNTL0_ADDR A:0xfc48c458
y.create.l HWIO_XPU_CFG_SNOC_CFG_XPU_PRT5_CNTL0_ADDR A:0xfc48c4d8
y.create.l HWIO_XPU_CFG_SNOC_CFG_XPU_PRT6_CNTL0_ADDR A:0xfc48c558
y.create.l HWIO_XPU_CFG_SNOC_CFG_XPU_PRT7_CNTL0_ADDR A:0xfc48c5d8
y.create.l HWIO_XPU_CFG_SNOC_CFG_XPU_PRT8_CNTL0_ADDR A:0xfc48c658
y.create.l HWIO_XPU_CFG_SNOC_CFG_XPU_PRT9_CNTL0_ADDR A:0xfc48c6d8
y.create.l HWIO_XPU_CFG_SNOC_CFG_XPU_PRT0_CNTL1_ADDR A:0xfc48c25c
y.create.l HWIO_XPU_CFG_SNOC_CFG_XPU_PRT1_CNTL1_ADDR A:0xfc48c2dc
y.create.l HWIO_XPU_CFG_SNOC_CFG_XPU_PRT2_CNTL1_ADDR A:0xfc48c35c
y.create.l HWIO_XPU_CFG_SNOC_CFG_XPU_PRT3_CNTL1_ADDR A:0xfc48c3dc
y.create.l HWIO_XPU_CFG_SNOC_CFG_XPU_PRT4_CNTL1_ADDR A:0xfc48c45c
y.create.l HWIO_XPU_CFG_SNOC_CFG_XPU_PRT5_CNTL1_ADDR A:0xfc48c4dc
y.create.l HWIO_XPU_CFG_SNOC_CFG_XPU_PRT6_CNTL1_ADDR A:0xfc48c55c
y.create.l HWIO_XPU_CFG_SNOC_CFG_XPU_PRT7_CNTL1_ADDR A:0xfc48c5dc
y.create.l HWIO_XPU_CFG_SNOC_CFG_XPU_PRT8_CNTL1_ADDR A:0xfc48c65c
y.create.l HWIO_XPU_CFG_SNOC_CFG_XPU_PRT9_CNTL1_ADDR A:0xfc48c6dc
y.create.done
