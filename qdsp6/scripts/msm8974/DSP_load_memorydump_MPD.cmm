;****************************************************************
; filename: DSP_timestamp_check.cmm
;
;****************************************************************
LOCAL &ramdumppath &smddumppath &f3logpath &ulogpath &otherinfo
entry &choice 

TOOLBAR ON
STATUSBAR ON

ENTRY

AREA.RESet
WINPOS 0. 0. 100% 100%
AREA.Create "output"
AREA.view "output"

;----------------------------------------------------------------------------
; Set the desired CPU
;----------------------------------------------------------------------------
;sys.cpu HexagonV5H
;sys.up

pwd
cd ../../../
pwd

print " "
print "PLEASE ENTERT ADSP image START ADDRESS: (eg: 0x00000000)" 
print " "
print " "
print " "
print " "
enter &adspbaseadd 

print " "
print "Enter the choice number. DO YOU HAVE THE RAM DUMP FROM QPST?" 
print " "
print " "
print "1.  Yes"
print "2.  No"
print " "
print " "
enter &choice

if &choice==1
(
    print "PLEASE ENTER THE PATH INCLUDING THE RAMDUMP FILE NAME FROM QPST" 
    print " "
    print " "
    enter &ramdumppath

    win.title "&ramdumppath"

    do qdsp6\scripts\msm8974\DSP_connect_memdump_MPD.cmm &ramdumppath 0x000000 &adspbaseadd 

    win.title "&ramdumppath"

    Area.Select "output"
    AREA.view "output"
)
else
(
    print " "
    print "Enter the choice number. DO YOU HAVE THE RAM DUMP FOR SMD?" 
    print " "
    print " "
    print "1.  Yes"
    print "2.  No"
    print " "
    print " "
    enter &choice

    print "PLEASE ENTER THE PATH INCLUDING THE RAMDUMP FILE NAME" 
    print " "
    print " "
    enter &ramdumppath

    win.title "&ramdumppath"
    if &choice==1
    (
        print "PLEASE ENTER THE PATH INCLUDING THE SMD RAMDUMP FILE NAME" 
        print " "
        print " "
        enter &smddumppath
    )

    Area.Select "output"
    AREA.view "output"

    if &choice==1

    (
        do qdsp6\scripts\msm8974\DSP_connect_memdump_MPD.cmm &ramdumppath &adspbaseadd  &adspbaseadd  &smddumppath 0xfa00000
    )
    else
    (
        do qdsp6\scripts\msm8974\DSP_connect_memdump_MPD.cmm &ramdumppath &adspbaseadd  &adspbaseadd
    )

)

win.title "&ramdumppath"
do qdsp6\scripts\msm8974\analy_qurt_error.cmm
win.title "&ramdumppath"

do qdsp6\scripts\msm8974\DSP_load_pagetables.cmm
win.title "&ramdumppath"

Area.Select "output"
AREA.view "output"
&choice=0

print " "
print "Enter the choice number. Do you need F3 log?" 
print " "
print " "
print "1.  Yes"
print "2.  No"
print " "
print " "
enter &choice

if &choice==1
(
    print "PLEASE ENTER THE PATH YOU WANT TO STORE THE F3 LOG" 
    print " "
    print " "
    enter &f3logpath
    cd qdsp6\scripts
    do recover_f3.cmm &f3logpath
    cd ../..
)

Area.Select "output"
AREA.view "output"
&choice=0

print " "
print "Enter the choice number. Do you need U-log?" 
print " "
print " "
print "1.  Yes"
print "2.  No"
print " "
print " "
enter &choice

if &choice==1
(
    print "PLEASE ENTER THE PATH YOU WANT TO STORE THE U-LOG" 
    print " "
    print " "
    enter &ulogpath
    do core\power\ulog\scripts\ULogDump_QuRTMPD.cmm &ulogpath &ELF_reloc
)

Area.Select "output"
AREA.view "output"

&choice=0

print " "
print "Enter the choice number. Do you want more information?" 
print " "

print " "
print "1.  Yes"
print "2.  No"
print " "
print " "
enter &choice

if &choice==1
(
    print "PLEASE ENTER THE PATH YOU WANT TO STORE THE INFO" 
    print " "
    print " "
    enter &otherinfo

    do qdsp6\scripts\msm8974\DSP_dump_info.cmm &otherinfo

    print " "
    print " "
    print "Information is saved in the location"
    print " "
    print " "
)

print " "
print " "
print "DONE"
print " "
print " "

