;****************************************************************
;    filename: DSP_load_osam.cmm
;
; usage:
;    DSP_load_osam
; example:
;    DSP_load_osam
;****************************************************************

print "DSP address vritual=0x" &Qube_va " physical=0x" &Qube_pa

mmu.tlb.scan
mmu.format Blast QURTK_pagetables &Qube_va--(&Qube_va+0xffffff) &Qube_pa
mmu.on
mmu.autoscan on
mmu.tablewalk on

; LOAD RTOS AWARENESS MODULE
TASK.CONFIG &elfdir\..\..\core\kernel\qurt\install_again\MMv5\debugger\T32\qurt_model.t32
MENU.ReProgram &elfdir\..\..\core\kernel\qurt\install_again\MMv5\debugger\T32\qurt_model.men


; Enable RTOS debug messages
;ext.debug 1


y.spath.srd + &elfdir\..\..
MENU.REPROGRAM &elfdir\..\..\core\systemdrivers\hwio\scripts\mdm9x25\hwioreg.men
path . + &elfdir\..\..\core\systemdrivers\hwio\scripts\mdm9x25
do hwio.cmm

b.s QURTK_tlb_crash
b.s QURTK_fatal_error
b.s QURTK_nonfatal_error
b.s QURTK_handle_error
b.s QURTK_handle_nmi
b.s err_fatal_handler

enddo

